;-----------------------------------------------------------------------------
; Trace32 HWIO Symbol Loader
;-----------------------------------------------------------------------------

y.create.l HWIO_APCS_QGIC2_REG_BASE_START_ADDR A:0xb000000
y.create.l HWIO_APCS_QGIC2_REG_BASE_LAST_ADDR A:0xb005000
y.create.l HWIO_APCS_QGIC2_REG_BASE_END_ADDR A:0xb006000
y.create.l HWIO_APCS_GICD_CTLR_ADDR A:0xb000000
y.create.l HWIO_APCS_GICD_TYPER_ADDR A:0xb000004
y.create.l HWIO_APCS_GICD_IIDR_ADDR A:0xb000008
y.create.l HWIO_APCS_GICD_ANSACR_ADDR A:0xb000020
y.create.l HWIO_APCS_GICD_CGCR_ADDR A:0xb000024
y.create.l HWIO_APCS_GICD_HW_VERSION_ADDR A:0xb000030
y.create.l HWIO_APCS_GICD_ISR0_ADDR A:0xb000080
y.create.l HWIO_APCS_GICD_ISR1_ADDR A:0xb000084
y.create.l HWIO_APCS_GICD_ISR2_ADDR A:0xb000088
y.create.l HWIO_APCS_GICD_ISR3_ADDR A:0xb00008c
y.create.l HWIO_APCS_GICD_ISR4_ADDR A:0xb000090
y.create.l HWIO_APCS_GICD_ISR5_ADDR A:0xb000094
y.create.l HWIO_APCS_GICD_ISR6_ADDR A:0xb000098
y.create.l HWIO_APCS_GICD_ISR7_ADDR A:0xb00009c
y.create.l HWIO_APCS_GICD_ISR8_ADDR A:0xb0000a0
y.create.l HWIO_APCS_GICD_ISENABLER0_ADDR A:0xb000100
y.create.l HWIO_APCS_GICD_ISENABLER1_ADDR A:0xb000104
y.create.l HWIO_APCS_GICD_ISENABLER2_ADDR A:0xb000108
y.create.l HWIO_APCS_GICD_ISENABLER3_ADDR A:0xb00010c
y.create.l HWIO_APCS_GICD_ISENABLER4_ADDR A:0xb000110
y.create.l HWIO_APCS_GICD_ISENABLER5_ADDR A:0xb000114
y.create.l HWIO_APCS_GICD_ISENABLER6_ADDR A:0xb000118
y.create.l HWIO_APCS_GICD_ISENABLER7_ADDR A:0xb00011c
y.create.l HWIO_APCS_GICD_ISENABLER8_ADDR A:0xb000120
y.create.l HWIO_APCS_GICD_ICENABLER0_ADDR A:0xb000180
y.create.l HWIO_APCS_GICD_ICENABLER1_ADDR A:0xb000184
y.create.l HWIO_APCS_GICD_ICENABLER2_ADDR A:0xb000188
y.create.l HWIO_APCS_GICD_ICENABLER3_ADDR A:0xb00018c
y.create.l HWIO_APCS_GICD_ICENABLER4_ADDR A:0xb000190
y.create.l HWIO_APCS_GICD_ICENABLER5_ADDR A:0xb000194
y.create.l HWIO_APCS_GICD_ICENABLER6_ADDR A:0xb000198
y.create.l HWIO_APCS_GICD_ICENABLER7_ADDR A:0xb00019c
y.create.l HWIO_APCS_GICD_ICENABLER8_ADDR A:0xb0001a0
y.create.l HWIO_APCS_GICD_ISPENDR0_ADDR A:0xb000200
y.create.l HWIO_APCS_GICD_ISPENDR1_ADDR A:0xb000204
y.create.l HWIO_APCS_GICD_ISPENDR2_ADDR A:0xb000208
y.create.l HWIO_APCS_GICD_ISPENDR3_ADDR A:0xb00020c
y.create.l HWIO_APCS_GICD_ISPENDR4_ADDR A:0xb000210
y.create.l HWIO_APCS_GICD_ISPENDR5_ADDR A:0xb000214
y.create.l HWIO_APCS_GICD_ISPENDR6_ADDR A:0xb000218
y.create.l HWIO_APCS_GICD_ISPENDR7_ADDR A:0xb00021c
y.create.l HWIO_APCS_GICD_ISPENDR8_ADDR A:0xb000220
y.create.l HWIO_APCS_GICD_ICPENDR0_ADDR A:0xb000280
y.create.l HWIO_APCS_GICD_ICPENDR1_ADDR A:0xb000284
y.create.l HWIO_APCS_GICD_ICPENDR2_ADDR A:0xb000288
y.create.l HWIO_APCS_GICD_ICPENDR3_ADDR A:0xb00028c
y.create.l HWIO_APCS_GICD_ICPENDR4_ADDR A:0xb000290
y.create.l HWIO_APCS_GICD_ICPENDR5_ADDR A:0xb000294
y.create.l HWIO_APCS_GICD_ICPENDR6_ADDR A:0xb000298
y.create.l HWIO_APCS_GICD_ICPENDR7_ADDR A:0xb00029c
y.create.l HWIO_APCS_GICD_ICPENDR8_ADDR A:0xb0002a0
y.create.l HWIO_APCS_GICD_ISACTIVER0_ADDR A:0xb000300
y.create.l HWIO_APCS_GICD_ISACTIVER1_ADDR A:0xb000304
y.create.l HWIO_APCS_GICD_ISACTIVER2_ADDR A:0xb000308
y.create.l HWIO_APCS_GICD_ISACTIVER3_ADDR A:0xb00030c
y.create.l HWIO_APCS_GICD_ISACTIVER4_ADDR A:0xb000310
y.create.l HWIO_APCS_GICD_ISACTIVER5_ADDR A:0xb000314
y.create.l HWIO_APCS_GICD_ISACTIVER6_ADDR A:0xb000318
y.create.l HWIO_APCS_GICD_ISACTIVER7_ADDR A:0xb00031c
y.create.l HWIO_APCS_GICD_ISACTIVER8_ADDR A:0xb000320
y.create.l HWIO_APCS_GICD_ICACTIVER0_ADDR A:0xb000380
y.create.l HWIO_APCS_GICD_ICACTIVER1_ADDR A:0xb000384
y.create.l HWIO_APCS_GICD_ICACTIVER2_ADDR A:0xb000388
y.create.l HWIO_APCS_GICD_ICACTIVER3_ADDR A:0xb00038c
y.create.l HWIO_APCS_GICD_ICACTIVER4_ADDR A:0xb000390
y.create.l HWIO_APCS_GICD_ICACTIVER5_ADDR A:0xb000394
y.create.l HWIO_APCS_GICD_ICACTIVER6_ADDR A:0xb000398
y.create.l HWIO_APCS_GICD_ICACTIVER7_ADDR A:0xb00039c
y.create.l HWIO_APCS_GICD_ICACTIVER8_ADDR A:0xb0003a0
y.create.l HWIO_APCS_GICD_IPRIORITYR0_ADDR A:0xb000400
y.create.l HWIO_APCS_GICD_IPRIORITYR1_ADDR A:0xb000404
y.create.l HWIO_APCS_GICD_IPRIORITYR2_ADDR A:0xb000408
y.create.l HWIO_APCS_GICD_IPRIORITYR3_ADDR A:0xb00040c
y.create.l HWIO_APCS_GICD_IPRIORITYR4_ADDR A:0xb000410
y.create.l HWIO_APCS_GICD_IPRIORITYR5_ADDR A:0xb000414
y.create.l HWIO_APCS_GICD_IPRIORITYR6_ADDR A:0xb000418
y.create.l HWIO_APCS_GICD_IPRIORITYR7_ADDR A:0xb00041c
y.create.l HWIO_APCS_GICD_IPRIORITYR8_ADDR A:0xb000420
y.create.l HWIO_APCS_GICD_IPRIORITYR9_ADDR A:0xb000424
y.create.l HWIO_APCS_GICD_ITARGETSR0_ADDR A:0xb000800
y.create.l HWIO_APCS_GICD_ITARGETSR1_ADDR A:0xb000804
y.create.l HWIO_APCS_GICD_ITARGETSR2_ADDR A:0xb000808
y.create.l HWIO_APCS_GICD_ITARGETSR3_ADDR A:0xb00080c
y.create.l HWIO_APCS_GICD_ITARGETSR4_ADDR A:0xb000810
y.create.l HWIO_APCS_GICD_ITARGETSR5_ADDR A:0xb000814
y.create.l HWIO_APCS_GICD_ITARGETSR6_ADDR A:0xb000818
y.create.l HWIO_APCS_GICD_ITARGETSR7_ADDR A:0xb00081c
y.create.l HWIO_APCS_GICD_ITARGETSR8_ADDR A:0xb000820
y.create.l HWIO_APCS_GICD_ITARGETSR9_ADDR A:0xb000824
y.create.l HWIO_APCS_GICD_ICFGR0_ADDR A:0xb000c00
y.create.l HWIO_APCS_GICD_ICFGR1_ADDR A:0xb000c04
y.create.l HWIO_APCS_GICD_ICFGR2_ADDR A:0xb000c08
y.create.l HWIO_APCS_GICD_ICFGR3_ADDR A:0xb000c0c
y.create.l HWIO_APCS_GICD_ICFGR4_ADDR A:0xb000c10
y.create.l HWIO_APCS_GICD_ICFGR5_ADDR A:0xb000c14
y.create.l HWIO_APCS_GICD_ICFGR6_ADDR A:0xb000c18
y.create.l HWIO_APCS_GICD_ICFGR7_ADDR A:0xb000c1c
y.create.l HWIO_APCS_GICD_ICFGR8_ADDR A:0xb000c20
y.create.l HWIO_APCS_GICD_ICFGR9_ADDR A:0xb000c24
y.create.l HWIO_APCS_GICD_SGIR_ADDR A:0xb000f00
y.create.l HWIO_APCS_GICD_CPENDSGIR0_ADDR A:0xb000f10
y.create.l HWIO_APCS_GICD_CPENDSGIR1_ADDR A:0xb000f14
y.create.l HWIO_APCS_GICD_CPENDSGIR2_ADDR A:0xb000f18
y.create.l HWIO_APCS_GICD_CPENDSGIR3_ADDR A:0xb000f1c
y.create.l HWIO_APCS_GICD_SPENDSGIR0_ADDR A:0xb000f20
y.create.l HWIO_APCS_GICD_SPENDSGIR1_ADDR A:0xb000f24
y.create.l HWIO_APCS_GICD_SPENDSGIR2_ADDR A:0xb000f28
y.create.l HWIO_APCS_GICD_SPENDSGIR3_ADDR A:0xb000f2c
y.create.l HWIO_APCS_GICD_PIDR0_ADDR A:0xb000fd0
y.create.l HWIO_APCS_GICD_PIDR1_ADDR A:0xb000fd4
y.create.l HWIO_APCS_GICD_PIDR2_ADDR A:0xb000fd8
y.create.l HWIO_APCS_GICD_PIDR3_ADDR A:0xb000fdc
y.create.l HWIO_APCS_GICD_PIDR4_ADDR A:0xb000fe0
y.create.l HWIO_APCS_GICD_PIDR5_ADDR A:0xb000fe4
y.create.l HWIO_APCS_GICD_PIDR6_ADDR A:0xb000fe8
y.create.l HWIO_APCS_GICD_PIDR7_ADDR A:0xb000fec
y.create.l HWIO_APCS_GICD_CIDR0_ADDR A:0xb000ff0
y.create.l HWIO_APCS_GICD_CIDR1_ADDR A:0xb000ff4
y.create.l HWIO_APCS_GICD_CIDR2_ADDR A:0xb000ff8
y.create.l HWIO_APCS_GICD_CIDR3_ADDR A:0xb000ffc
y.create.l HWIO_APCS_GICH_HCR_ADDR A:0xb001000
y.create.l HWIO_APCS_GICH_VTR_ADDR A:0xb001004
y.create.l HWIO_APCS_GICH_VMCR_ADDR A:0xb001008
y.create.l HWIO_APCS_GICH_MISR_ADDR A:0xb001010
y.create.l HWIO_APCS_GICH_EISR_ADDR A:0xb001020
y.create.l HWIO_APCS_GICH_ELRSR_ADDR A:0xb001030
y.create.l HWIO_APCS_GICH_APR_ADDR A:0xb0010f0
y.create.l HWIO_APCS_GICH_LR0_ADDR A:0xb001100
y.create.l HWIO_APCS_GICH_LR1_ADDR A:0xb001104
y.create.l HWIO_APCS_GICH_LR2_ADDR A:0xb001108
y.create.l HWIO_APCS_GICH_LR3_ADDR A:0xb00110c
y.create.l HWIO_APCS_GICH_SW_LR_ADDR A:0xb001120
y.create.l HWIO_APCS_GICC_CTLR_ADDR A:0xb002000
y.create.l HWIO_APCS_GICC_PMR_ADDR A:0xb002004
y.create.l HWIO_APCS_GICC_BPR_ADDR A:0xb002008
y.create.l HWIO_APCS_GICC_IAR_ADDR A:0xb00200c
y.create.l HWIO_APCS_GICC_EOIR_ADDR A:0xb002010
y.create.l HWIO_APCS_GICC_RPR_ADDR A:0xb002014
y.create.l HWIO_APCS_GICC_HPPIR_ADDR A:0xb002018
y.create.l HWIO_APCS_GICC_ABPR_ADDR A:0xb00201c
y.create.l HWIO_APCS_GICC_AIAR_ADDR A:0xb002020
y.create.l HWIO_APCS_GICC_AEOIR_ADDR A:0xb002024
y.create.l HWIO_APCS_GICC_AHPPIR_ADDR A:0xb002028
y.create.l HWIO_APCS_GICC_APR_ADDR A:0xb0020d0
y.create.l HWIO_APCS_GICC_NSAPR_ADDR A:0xb0020e0
y.create.l HWIO_APCS_GICC_IIDR_ADDR A:0xb0020fc
y.create.l HWIO_APCS_GICC_DIR_ADDR A:0xb003000
y.create.l HWIO_APCS_GICV_CTLR_ADDR A:0xb004000
y.create.l HWIO_APCS_GICV_PMR_ADDR A:0xb004004
y.create.l HWIO_APCS_GICV_BPR_ADDR A:0xb004008
y.create.l HWIO_APCS_GICV_IAR_ADDR A:0xb00400c
y.create.l HWIO_APCS_GICV_EOIR_ADDR A:0xb004010
y.create.l HWIO_APCS_GICV_RPR_ADDR A:0xb004014
y.create.l HWIO_APCS_GICV_HPPIR_ADDR A:0xb004018
y.create.l HWIO_APCS_GICV_ABPR_ADDR A:0xb00401c
y.create.l HWIO_APCS_GICV_AIAR_ADDR A:0xb004020
y.create.l HWIO_APCS_GICV_AEOIR_ADDR A:0xb004024
y.create.l HWIO_APCS_GICV_AHPPIR_ADDR A:0xb004028
y.create.l HWIO_APCS_GICV_APR_ADDR A:0xb0040d0
y.create.l HWIO_APCS_GICV_IIDR_ADDR A:0xb0040fc
y.create.l HWIO_APCS_GICV_DIR_ADDR A:0xb005000
y.create.l HWIO_APCS_ACC_REG_BASE_START_ADDR A:0xb008000
y.create.l HWIO_APCS_ACC_REG_BASE_LAST_ADDR A:0xb00804c
y.create.l HWIO_APCS_ACC_REG_BASE_END_ADDR A:0xb009000
y.create.l HWIO_APCS_ACCSECURE_ADDR A:0xb008000
y.create.l HWIO_APCS_CPU_PWR_CTL_ADDR A:0xb008004
y.create.l HWIO_APCS_ACC_STS_ADDR A:0xb008008
y.create.l HWIO_APCS_ATSTBUS_SEL_ADDR A:0xb00800c
y.create.l HWIO_APCS_CPU_TRGTD_DBG_RST_ADDR A:0xb008010
y.create.l HWIO_APCS_CPU_AUX_CLK_SEL_ADDR A:0xb008014
y.create.l HWIO_APCS_CPU_PLL_MODE_ADDR A:0xb008018
y.create.l HWIO_APCS_CPU_PLL_L_VAL_ADDR A:0xb00801c
y.create.l HWIO_APCS_CPU_PLL_ALPHA_VAL_ADDR A:0xb008020
y.create.l HWIO_APCS_CPU_PLL_ALPHA_VAL_U_ADDR A:0xb008024
y.create.l HWIO_APCS_CPU_PLL_USER_CTL_ADDR A:0xb008028
y.create.l HWIO_APCS_CPU_PLL_USER_CTL_U_ADDR A:0xb00802c
y.create.l HWIO_APCS_CPU_PLL_CONFIG_CTL_ADDR A:0xb008030
y.create.l HWIO_APCS_CPU_PLL_TEST_CTL_ADDR A:0xb008034
y.create.l HWIO_APCS_CPU_PLL_TEST_CTL_U_ADDR A:0xb008038
y.create.l HWIO_APCS_CPU_PLL_STATUS_ADDR A:0xb00803c
y.create.l HWIO_APCS_CPU_PLL_FREQ_CTL_ADDR A:0xb008040
y.create.l HWIO_APCS_TZIPC_INTERRUPT_ADDR A:0xb008044
y.create.l HWIO_APCS_A7_CFG_ADDR A:0xb008048
y.create.l HWIO_GCC_DBG_CLK_ON_REQ_ADDR A:0xb00804c
y.create.l HWIO_APCS_SAW2_REG_BASE_START_ADDR A:0xb009000
y.create.l HWIO_APCS_SAW2_REG_BASE_LAST_ADDR A:0xb009fd0
y.create.l HWIO_APCS_SAW2_REG_BASE_END_ADDR A:0xb00a000
y.create.l HWIO_APCS_SAW2_SECURE_ADDR A:0xb009000
y.create.l HWIO_APCS_SAW2_ID_ADDR A:0xb009004
y.create.l HWIO_APCS_SAW2_CFG_ADDR A:0xb009008
y.create.l HWIO_APCS_SAW2_SPM_STS_ADDR A:0xb00900c
y.create.l HWIO_APCS_SAW2_AVS_STS_ADDR A:0xb009010
y.create.l HWIO_APCS_SAW2_PMIC_STS_ADDR A:0xb009014
y.create.l HWIO_APCS_SAW2_RST_ADDR A:0xb009018
y.create.l HWIO_APCS_SAW2_SPM_CTL_ADDR A:0xb009030
y.create.l HWIO_APCS_SAW2_SPM_DLY_ADDR A:0xb009034
y.create.l HWIO_APCS_SAW2_SPM_STS2_ADDR A:0xb009038
y.create.l HWIO_APCS_SAW2_SPM_SLP_SEQ_ENTRY_0_ADDR A:0xb009400
y.create.l HWIO_APCS_SAW2_SPM_SLP_SEQ_ENTRY_1_ADDR A:0xb009404
y.create.l HWIO_APCS_SAW2_SPM_SLP_SEQ_ENTRY_2_ADDR A:0xb009408
y.create.l HWIO_APCS_SAW2_SPM_SLP_SEQ_ENTRY_3_ADDR A:0xb00940c
y.create.l HWIO_APCS_SAW2_SPM_SLP_SEQ_ENTRY_4_ADDR A:0xb009410
y.create.l HWIO_APCS_SAW2_SPM_SLP_SEQ_ENTRY_5_ADDR A:0xb009414
y.create.l HWIO_APCS_SAW2_SPM_SLP_SEQ_ENTRY_6_ADDR A:0xb009418
y.create.l HWIO_APCS_SAW2_SPM_SLP_SEQ_ENTRY_7_ADDR A:0xb00941c
y.create.l HWIO_APCS_SAW2_SPM_SLP_SEQ_ENTRY_8_ADDR A:0xb009420
y.create.l HWIO_APCS_SAW2_SPM_SLP_SEQ_ENTRY_9_ADDR A:0xb009424
y.create.l HWIO_APCS_SAW2_SPM_PMIC_DATA_0_ADDR A:0xb009040
y.create.l HWIO_APCS_SAW2_SPM_PMIC_DATA_1_ADDR A:0xb009044
y.create.l HWIO_APCS_SAW2_VERSION_ADDR A:0xb009fd0
y.create.l HWIO_QTMR_AC_REG_BASE_START_ADDR A:0xb020000
y.create.l HWIO_QTMR_AC_REG_BASE_LAST_ADDR A:0xb020fd0
y.create.l HWIO_QTMR_AC_REG_BASE_END_ADDR A:0xb021000
y.create.l HWIO_QTMR_AC_CNTFRQ_ADDR A:0xb020000
y.create.l HWIO_QTMR_AC_CNTSR_ADDR A:0xb020004
y.create.l HWIO_QTMR_AC_CNTTID_ADDR A:0xb020008
y.create.l HWIO_QTMR_AC_CNTACR_0_ADDR A:0xb020040
y.create.l HWIO_QTMR_AC_CNTACR_1_ADDR A:0xb020044
y.create.l HWIO_QTMR_AC_CNTACR_2_ADDR A:0xb020048
y.create.l HWIO_QTMR_AC_CNTACR_3_ADDR A:0xb02004c
y.create.l HWIO_QTMR_AC_CNTACR_4_ADDR A:0xb020050
y.create.l HWIO_QTMR_AC_CNTACR_5_ADDR A:0xb020054
y.create.l HWIO_QTMR_AC_CNTACR_6_ADDR A:0xb020058
y.create.l HWIO_QTMR_AC_CNTACR_7_ADDR A:0xb02005c
y.create.l HWIO_QTMR_AC_CNTVOFF_LO_0_ADDR A:0xb020080
y.create.l HWIO_QTMR_AC_CNTVOFF_LO_1_ADDR A:0xb020088
y.create.l HWIO_QTMR_AC_CNTVOFF_LO_2_ADDR A:0xb020090
y.create.l HWIO_QTMR_AC_CNTVOFF_LO_3_ADDR A:0xb020098
y.create.l HWIO_QTMR_AC_CNTVOFF_LO_4_ADDR A:0xb0200a0
y.create.l HWIO_QTMR_AC_CNTVOFF_LO_5_ADDR A:0xb0200a8
y.create.l HWIO_QTMR_AC_CNTVOFF_LO_6_ADDR A:0xb0200b0
y.create.l HWIO_QTMR_AC_CNTVOFF_LO_7_ADDR A:0xb0200b8
y.create.l HWIO_QTMR_AC_CNTVOFF_HI_0_ADDR A:0xb020084
y.create.l HWIO_QTMR_AC_CNTVOFF_HI_1_ADDR A:0xb02008c
y.create.l HWIO_QTMR_AC_CNTVOFF_HI_2_ADDR A:0xb020094
y.create.l HWIO_QTMR_AC_CNTVOFF_HI_3_ADDR A:0xb02009c
y.create.l HWIO_QTMR_AC_CNTVOFF_HI_4_ADDR A:0xb0200a4
y.create.l HWIO_QTMR_AC_CNTVOFF_HI_5_ADDR A:0xb0200ac
y.create.l HWIO_QTMR_AC_CNTVOFF_HI_6_ADDR A:0xb0200b4
y.create.l HWIO_QTMR_AC_CNTVOFF_HI_7_ADDR A:0xb0200bc
y.create.l HWIO_QTMR_AC_CFG_ADDR A:0xb020fc0
y.create.l HWIO_QTMR_AC_VERSION_ADDR A:0xb020fd0
y.create.l HWIO_APCS_F0_QTMR_V1_REG_BASE_START_ADDR A:0xb021000
y.create.l HWIO_APCS_F0_QTMR_V1_REG_BASE_LAST_ADDR A:0xb021fd0
y.create.l HWIO_APCS_F0_QTMR_V1_REG_BASE_END_ADDR A:0xb022000
y.create.l HWIO_APCS_F0_QTMR_V1_CNTPCT_LO_ADDR A:0xb021000
y.create.l HWIO_APCS_F0_QTMR_V1_CNTPCT_HI_ADDR A:0xb021004
y.create.l HWIO_APCS_F0_QTMR_V1_CNTVCT_LO_ADDR A:0xb021008
y.create.l HWIO_APCS_F0_QTMR_V1_CNTVCT_HI_ADDR A:0xb02100c
y.create.l HWIO_APCS_F0_QTMR_V1_CNTFRQ_ADDR A:0xb021010
y.create.l HWIO_APCS_F0_QTMR_V1_CNTPL0ACR_ADDR A:0xb021014
y.create.l HWIO_APCS_F0_QTMR_V1_CNTVOFF_LO_ADDR A:0xb021018
y.create.l HWIO_APCS_F0_QTMR_V1_CNTVOFF_HI_ADDR A:0xb02101c
y.create.l HWIO_APCS_F0_QTMR_V1_CNTP_CVAL_LO_ADDR A:0xb021020
y.create.l HWIO_APCS_F0_QTMR_V1_CNTP_CVAL_HI_ADDR A:0xb021024
y.create.l HWIO_APCS_F0_QTMR_V1_CNTP_TVAL_ADDR A:0xb021028
y.create.l HWIO_APCS_F0_QTMR_V1_CNTP_CTL_ADDR A:0xb02102c
y.create.l HWIO_APCS_F0_QTMR_V1_CNTV_CVAL_LO_ADDR A:0xb021030
y.create.l HWIO_APCS_F0_QTMR_V1_CNTV_CVAL_HI_ADDR A:0xb021034
y.create.l HWIO_APCS_F0_QTMR_V1_CNTV_TVAL_ADDR A:0xb021038
y.create.l HWIO_APCS_F0_QTMR_V1_CNTV_CTL_ADDR A:0xb02103c
y.create.l HWIO_APCS_F0_QTMR_V1_VERSION_ADDR A:0xb021fd0
y.create.l HWIO_APCS_F0_QTMR_V2_REG_BASE_START_ADDR A:0xb022000
y.create.l HWIO_APCS_F0_QTMR_V2_REG_BASE_LAST_ADDR A:0xb022fd0
y.create.l HWIO_APCS_F0_QTMR_V2_REG_BASE_END_ADDR A:0xb023000
y.create.l HWIO_APCS_F0_QTMR_V2_CNTPCT_LO_ADDR A:0xb022000
y.create.l HWIO_APCS_F0_QTMR_V2_CNTPCT_HI_ADDR A:0xb022004
y.create.l HWIO_APCS_F0_QTMR_V2_CNTVCT_LO_ADDR A:0xb022008
y.create.l HWIO_APCS_F0_QTMR_V2_CNTVCT_HI_ADDR A:0xb02200c
y.create.l HWIO_APCS_F0_QTMR_V2_CNTFRQ_ADDR A:0xb022010
y.create.l HWIO_APCS_F0_QTMR_V2_CNTP_CVAL_LO_ADDR A:0xb022020
y.create.l HWIO_APCS_F0_QTMR_V2_CNTP_CVAL_HI_ADDR A:0xb022024
y.create.l HWIO_APCS_F0_QTMR_V2_CNTP_TVAL_ADDR A:0xb022028
y.create.l HWIO_APCS_F0_QTMR_V2_CNTP_CTL_ADDR A:0xb02202c
y.create.l HWIO_APCS_F0_QTMR_V2_CNTV_CVAL_LO_ADDR A:0xb022030
y.create.l HWIO_APCS_F0_QTMR_V2_CNTV_CVAL_HI_ADDR A:0xb022034
y.create.l HWIO_APCS_F0_QTMR_V2_CNTV_TVAL_ADDR A:0xb022038
y.create.l HWIO_APCS_F0_QTMR_V2_CNTV_CTL_ADDR A:0xb02203c
y.create.l HWIO_APCS_F0_QTMR_V2_VERSION_ADDR A:0xb022fd0
y.create.l HWIO_APCS_F1_QTMR_V1_REG_BASE_START_ADDR A:0xb023000
y.create.l HWIO_APCS_F1_QTMR_V1_REG_BASE_LAST_ADDR A:0xb023fd0
y.create.l HWIO_APCS_F1_QTMR_V1_REG_BASE_END_ADDR A:0xb024000
y.create.l HWIO_APCS_F1_QTMR_V1_CNTPCT_LO_ADDR A:0xb023000
y.create.l HWIO_APCS_F1_QTMR_V1_CNTPCT_HI_ADDR A:0xb023004
y.create.l HWIO_APCS_F1_QTMR_V1_CNTVCT_LO_ADDR A:0xb023008
y.create.l HWIO_APCS_F1_QTMR_V1_CNTVCT_HI_ADDR A:0xb02300c
y.create.l HWIO_APCS_F1_QTMR_V1_CNTFRQ_ADDR A:0xb023010
y.create.l HWIO_APCS_F1_QTMR_V1_CNTPL0ACR_ADDR A:0xb023014
y.create.l HWIO_APCS_F1_QTMR_V1_CNTVOFF_LO_ADDR A:0xb023018
y.create.l HWIO_APCS_F1_QTMR_V1_CNTVOFF_HI_ADDR A:0xb02301c
y.create.l HWIO_APCS_F1_QTMR_V1_CNTP_CVAL_LO_ADDR A:0xb023020
y.create.l HWIO_APCS_F1_QTMR_V1_CNTP_CVAL_HI_ADDR A:0xb023024
y.create.l HWIO_APCS_F1_QTMR_V1_CNTP_TVAL_ADDR A:0xb023028
y.create.l HWIO_APCS_F1_QTMR_V1_CNTP_CTL_ADDR A:0xb02302c
y.create.l HWIO_APCS_F1_QTMR_V1_CNTV_CVAL_LO_ADDR A:0xb023030
y.create.l HWIO_APCS_F1_QTMR_V1_CNTV_CVAL_HI_ADDR A:0xb023034
y.create.l HWIO_APCS_F1_QTMR_V1_CNTV_TVAL_ADDR A:0xb023038
y.create.l HWIO_APCS_F1_QTMR_V1_CNTV_CTL_ADDR A:0xb02303c
y.create.l HWIO_APCS_F1_QTMR_V1_VERSION_ADDR A:0xb023fd0
y.create.l HWIO_APCS_F2_QTMR_V1_REG_BASE_START_ADDR A:0xb024000
y.create.l HWIO_APCS_F2_QTMR_V1_REG_BASE_LAST_ADDR A:0xb024fd0
y.create.l HWIO_APCS_F2_QTMR_V1_REG_BASE_END_ADDR A:0xb025000
y.create.l HWIO_APCS_F2_QTMR_V1_CNTPCT_LO_ADDR A:0xb024000
y.create.l HWIO_APCS_F2_QTMR_V1_CNTPCT_HI_ADDR A:0xb024004
y.create.l HWIO_APCS_F2_QTMR_V1_CNTVCT_LO_ADDR A:0xb024008
y.create.l HWIO_APCS_F2_QTMR_V1_CNTVCT_HI_ADDR A:0xb02400c
y.create.l HWIO_APCS_F2_QTMR_V1_CNTFRQ_ADDR A:0xb024010
y.create.l HWIO_APCS_F2_QTMR_V1_CNTPL0ACR_ADDR A:0xb024014
y.create.l HWIO_APCS_F2_QTMR_V1_CNTVOFF_LO_ADDR A:0xb024018
y.create.l HWIO_APCS_F2_QTMR_V1_CNTVOFF_HI_ADDR A:0xb02401c
y.create.l HWIO_APCS_F2_QTMR_V1_CNTP_CVAL_LO_ADDR A:0xb024020
y.create.l HWIO_APCS_F2_QTMR_V1_CNTP_CVAL_HI_ADDR A:0xb024024
y.create.l HWIO_APCS_F2_QTMR_V1_CNTP_TVAL_ADDR A:0xb024028
y.create.l HWIO_APCS_F2_QTMR_V1_CNTP_CTL_ADDR A:0xb02402c
y.create.l HWIO_APCS_F2_QTMR_V1_CNTV_CVAL_LO_ADDR A:0xb024030
y.create.l HWIO_APCS_F2_QTMR_V1_CNTV_CVAL_HI_ADDR A:0xb024034
y.create.l HWIO_APCS_F2_QTMR_V1_CNTV_TVAL_ADDR A:0xb024038
y.create.l HWIO_APCS_F2_QTMR_V1_CNTV_CTL_ADDR A:0xb02403c
y.create.l HWIO_APCS_F2_QTMR_V1_VERSION_ADDR A:0xb024fd0
y.create.l HWIO_APCS_F3_QTMR_V1_REG_BASE_START_ADDR A:0xb025000
y.create.l HWIO_APCS_F3_QTMR_V1_REG_BASE_LAST_ADDR A:0xb025fd0
y.create.l HWIO_APCS_F3_QTMR_V1_REG_BASE_END_ADDR A:0xb026000
y.create.l HWIO_APCS_F3_QTMR_V1_CNTPCT_LO_ADDR A:0xb025000
y.create.l HWIO_APCS_F3_QTMR_V1_CNTPCT_HI_ADDR A:0xb025004
y.create.l HWIO_APCS_F3_QTMR_V1_CNTVCT_LO_ADDR A:0xb025008
y.create.l HWIO_APCS_F3_QTMR_V1_CNTVCT_HI_ADDR A:0xb02500c
y.create.l HWIO_APCS_F3_QTMR_V1_CNTFRQ_ADDR A:0xb025010
y.create.l HWIO_APCS_F3_QTMR_V1_CNTPL0ACR_ADDR A:0xb025014
y.create.l HWIO_APCS_F3_QTMR_V1_CNTVOFF_LO_ADDR A:0xb025018
y.create.l HWIO_APCS_F3_QTMR_V1_CNTVOFF_HI_ADDR A:0xb02501c
y.create.l HWIO_APCS_F3_QTMR_V1_CNTP_CVAL_LO_ADDR A:0xb025020
y.create.l HWIO_APCS_F3_QTMR_V1_CNTP_CVAL_HI_ADDR A:0xb025024
y.create.l HWIO_APCS_F3_QTMR_V1_CNTP_TVAL_ADDR A:0xb025028
y.create.l HWIO_APCS_F3_QTMR_V1_CNTP_CTL_ADDR A:0xb02502c
y.create.l HWIO_APCS_F3_QTMR_V1_CNTV_CVAL_LO_ADDR A:0xb025030
y.create.l HWIO_APCS_F3_QTMR_V1_CNTV_CVAL_HI_ADDR A:0xb025034
y.create.l HWIO_APCS_F3_QTMR_V1_CNTV_TVAL_ADDR A:0xb025038
y.create.l HWIO_APCS_F3_QTMR_V1_CNTV_CTL_ADDR A:0xb02503c
y.create.l HWIO_APCS_F3_QTMR_V1_VERSION_ADDR A:0xb025fd0
y.create.l HWIO_APCS_F4_QTMR_V1_REG_BASE_START_ADDR A:0xb026000
y.create.l HWIO_APCS_F4_QTMR_V1_REG_BASE_LAST_ADDR A:0xb026fd0
y.create.l HWIO_APCS_F4_QTMR_V1_REG_BASE_END_ADDR A:0xb027000
y.create.l HWIO_APCS_F4_QTMR_V1_CNTPCT_LO_ADDR A:0xb026000
y.create.l HWIO_APCS_F4_QTMR_V1_CNTPCT_HI_ADDR A:0xb026004
y.create.l HWIO_APCS_F4_QTMR_V1_CNTVCT_LO_ADDR A:0xb026008
y.create.l HWIO_APCS_F4_QTMR_V1_CNTVCT_HI_ADDR A:0xb02600c
y.create.l HWIO_APCS_F4_QTMR_V1_CNTFRQ_ADDR A:0xb026010
y.create.l HWIO_APCS_F4_QTMR_V1_CNTPL0ACR_ADDR A:0xb026014
y.create.l HWIO_APCS_F4_QTMR_V1_CNTVOFF_LO_ADDR A:0xb026018
y.create.l HWIO_APCS_F4_QTMR_V1_CNTVOFF_HI_ADDR A:0xb02601c
y.create.l HWIO_APCS_F4_QTMR_V1_CNTP_CVAL_LO_ADDR A:0xb026020
y.create.l HWIO_APCS_F4_QTMR_V1_CNTP_CVAL_HI_ADDR A:0xb026024
y.create.l HWIO_APCS_F4_QTMR_V1_CNTP_TVAL_ADDR A:0xb026028
y.create.l HWIO_APCS_F4_QTMR_V1_CNTP_CTL_ADDR A:0xb02602c
y.create.l HWIO_APCS_F4_QTMR_V1_CNTV_CVAL_LO_ADDR A:0xb026030
y.create.l HWIO_APCS_F4_QTMR_V1_CNTV_CVAL_HI_ADDR A:0xb026034
y.create.l HWIO_APCS_F4_QTMR_V1_CNTV_TVAL_ADDR A:0xb026038
y.create.l HWIO_APCS_F4_QTMR_V1_CNTV_CTL_ADDR A:0xb02603c
y.create.l HWIO_APCS_F4_QTMR_V1_VERSION_ADDR A:0xb026fd0
y.create.l HWIO_APCS_F5_QTMR_V1_REG_BASE_START_ADDR A:0xb027000
y.create.l HWIO_APCS_F5_QTMR_V1_REG_BASE_LAST_ADDR A:0xb027fd0
y.create.l HWIO_APCS_F5_QTMR_V1_REG_BASE_END_ADDR A:0xb028000
y.create.l HWIO_APCS_F5_QTMR_V1_CNTPCT_LO_ADDR A:0xb027000
y.create.l HWIO_APCS_F5_QTMR_V1_CNTPCT_HI_ADDR A:0xb027004
y.create.l HWIO_APCS_F5_QTMR_V1_CNTVCT_LO_ADDR A:0xb027008
y.create.l HWIO_APCS_F5_QTMR_V1_CNTVCT_HI_ADDR A:0xb02700c
y.create.l HWIO_APCS_F5_QTMR_V1_CNTFRQ_ADDR A:0xb027010
y.create.l HWIO_APCS_F5_QTMR_V1_CNTPL0ACR_ADDR A:0xb027014
y.create.l HWIO_APCS_F5_QTMR_V1_CNTVOFF_LO_ADDR A:0xb027018
y.create.l HWIO_APCS_F5_QTMR_V1_CNTVOFF_HI_ADDR A:0xb02701c
y.create.l HWIO_APCS_F5_QTMR_V1_CNTP_CVAL_LO_ADDR A:0xb027020
y.create.l HWIO_APCS_F5_QTMR_V1_CNTP_CVAL_HI_ADDR A:0xb027024
y.create.l HWIO_APCS_F5_QTMR_V1_CNTP_TVAL_ADDR A:0xb027028
y.create.l HWIO_APCS_F5_QTMR_V1_CNTP_CTL_ADDR A:0xb02702c
y.create.l HWIO_APCS_F5_QTMR_V1_CNTV_CVAL_LO_ADDR A:0xb027030
y.create.l HWIO_APCS_F5_QTMR_V1_CNTV_CVAL_HI_ADDR A:0xb027034
y.create.l HWIO_APCS_F5_QTMR_V1_CNTV_TVAL_ADDR A:0xb027038
y.create.l HWIO_APCS_F5_QTMR_V1_CNTV_CTL_ADDR A:0xb02703c
y.create.l HWIO_APCS_F5_QTMR_V1_VERSION_ADDR A:0xb027fd0
y.create.l HWIO_APCS_F6_QTMR_V1_REG_BASE_START_ADDR A:0xb028000
y.create.l HWIO_APCS_F6_QTMR_V1_REG_BASE_LAST_ADDR A:0xb028fd0
y.create.l HWIO_APCS_F6_QTMR_V1_REG_BASE_END_ADDR A:0xb029000
y.create.l HWIO_APCS_F6_QTMR_V1_CNTPCT_LO_ADDR A:0xb028000
y.create.l HWIO_APCS_F6_QTMR_V1_CNTPCT_HI_ADDR A:0xb028004
y.create.l HWIO_APCS_F6_QTMR_V1_CNTVCT_LO_ADDR A:0xb028008
y.create.l HWIO_APCS_F6_QTMR_V1_CNTVCT_HI_ADDR A:0xb02800c
y.create.l HWIO_APCS_F6_QTMR_V1_CNTFRQ_ADDR A:0xb028010
y.create.l HWIO_APCS_F6_QTMR_V1_CNTPL0ACR_ADDR A:0xb028014
y.create.l HWIO_APCS_F6_QTMR_V1_CNTVOFF_LO_ADDR A:0xb028018
y.create.l HWIO_APCS_F6_QTMR_V1_CNTVOFF_HI_ADDR A:0xb02801c
y.create.l HWIO_APCS_F6_QTMR_V1_CNTP_CVAL_LO_ADDR A:0xb028020
y.create.l HWIO_APCS_F6_QTMR_V1_CNTP_CVAL_HI_ADDR A:0xb028024
y.create.l HWIO_APCS_F6_QTMR_V1_CNTP_TVAL_ADDR A:0xb028028
y.create.l HWIO_APCS_F6_QTMR_V1_CNTP_CTL_ADDR A:0xb02802c
y.create.l HWIO_APCS_F6_QTMR_V1_CNTV_CVAL_LO_ADDR A:0xb028030
y.create.l HWIO_APCS_F6_QTMR_V1_CNTV_CVAL_HI_ADDR A:0xb028034
y.create.l HWIO_APCS_F6_QTMR_V1_CNTV_TVAL_ADDR A:0xb028038
y.create.l HWIO_APCS_F6_QTMR_V1_CNTV_CTL_ADDR A:0xb02803c
y.create.l HWIO_APCS_F6_QTMR_V1_VERSION_ADDR A:0xb028fd0
y.create.l HWIO_APCS_F7_QTMR_V1_REG_BASE_START_ADDR A:0xb029000
y.create.l HWIO_APCS_F7_QTMR_V1_REG_BASE_LAST_ADDR A:0xb029fd0
y.create.l HWIO_APCS_F7_QTMR_V1_REG_BASE_END_ADDR A:0xb02a000
y.create.l HWIO_APCS_F7_QTMR_V1_CNTPCT_LO_ADDR A:0xb029000
y.create.l HWIO_APCS_F7_QTMR_V1_CNTPCT_HI_ADDR A:0xb029004
y.create.l HWIO_APCS_F7_QTMR_V1_CNTVCT_LO_ADDR A:0xb029008
y.create.l HWIO_APCS_F7_QTMR_V1_CNTVCT_HI_ADDR A:0xb02900c
y.create.l HWIO_APCS_F7_QTMR_V1_CNTFRQ_ADDR A:0xb029010
y.create.l HWIO_APCS_F7_QTMR_V1_CNTPL0ACR_ADDR A:0xb029014
y.create.l HWIO_APCS_F7_QTMR_V1_CNTVOFF_LO_ADDR A:0xb029018
y.create.l HWIO_APCS_F7_QTMR_V1_CNTVOFF_HI_ADDR A:0xb02901c
y.create.l HWIO_APCS_F7_QTMR_V1_CNTP_CVAL_LO_ADDR A:0xb029020
y.create.l HWIO_APCS_F7_QTMR_V1_CNTP_CVAL_HI_ADDR A:0xb029024
y.create.l HWIO_APCS_F7_QTMR_V1_CNTP_TVAL_ADDR A:0xb029028
y.create.l HWIO_APCS_F7_QTMR_V1_CNTP_CTL_ADDR A:0xb02902c
y.create.l HWIO_APCS_F7_QTMR_V1_CNTV_CVAL_LO_ADDR A:0xb029030
y.create.l HWIO_APCS_F7_QTMR_V1_CNTV_CVAL_HI_ADDR A:0xb029034
y.create.l HWIO_APCS_F7_QTMR_V1_CNTV_TVAL_ADDR A:0xb029038
y.create.l HWIO_APCS_F7_QTMR_V1_CNTV_CTL_ADDR A:0xb02903c
y.create.l HWIO_APCS_F7_QTMR_V1_VERSION_ADDR A:0xb029fd0
y.create.l HWIO_APCS_WDT_REG_BASE_START_ADDR A:0xb017000
y.create.l HWIO_APCS_WDT_REG_BASE_LAST_ADDR A:0xb017020
y.create.l HWIO_APCS_WDT_REG_BASE_END_ADDR A:0xb018000
y.create.l HWIO_WDOG_SECURE_ADDR A:0xb017000
y.create.l HWIO_WDOG_RESET_ADDR A:0xb017004
y.create.l HWIO_WDOG_CTL_ADDR A:0xb017008
y.create.l HWIO_WDOG_STATUS_ADDR A:0xb01700c
y.create.l HWIO_WDOG_BARK_TIME_ADDR A:0xb017010
y.create.l HWIO_WDOG_BITE_TIME_ADDR A:0xb017014
y.create.l HWIO_WDOG_TEST_LOAD_STATUS_ADDR A:0xb017018
y.create.l HWIO_WDOG_TEST_LOAD_ADDR A:0xb01701c
y.create.l HWIO_WDOG_TEST_ADDR A:0xb017020
y.create.l HWIO_APCS_GLB_REG_BASE_START_ADDR A:0xb010000
y.create.l HWIO_APCS_GLB_REG_BASE_LAST_ADDR A:0xb010060
y.create.l HWIO_APCS_GLB_REG_BASE_END_ADDR A:0xb011000
y.create.l HWIO_APCS_GLBSECURE_ADDR A:0xb010000
y.create.l HWIO_APCS_START_ADDR_ADDR A:0xb010004
y.create.l HWIO_APCS_CMD_RCGR_ADDR A:0xb010008
y.create.l HWIO_APCS_CFG_RCGR_ADDR A:0xb01000c
y.create.l HWIO_APCS_CBCR_ADDR A:0xb010010
y.create.l HWIO_APCS_GLB_CFG_ADDR A:0xb010014
y.create.l HWIO_APCS_GLB_BOOT_REMAP_ADDR A:0xb010018
y.create.l HWIO_APCS_GLB_TEST_BUSSEL_ADDR A:0xb01001c
y.create.l HWIO_APCS_GLB_EN_PWR_ST_ADDR A:0xb010020
y.create.l HWIO_APCS_GLB_QSB_LP_ADDR A:0xb010024
y.create.l HWIO_APCS_GLB_AHB_CLKON_ADDR A:0xb010028
y.create.l HWIO_APCS_GLB_QGIC_CFG_ADDR A:0xb01002c
y.create.l HWIO_APCS_GLB_GHDS_CNTR_ADDR A:0xb010030
y.create.l HWIO_APCS_TCM_REDIRECT_ADDR_ADDR A:0xb010034
y.create.l HWIO_APCS_A7_GLB_CFG_ADDR A:0xb010038
y.create.l HWIO_SPM_VOTE_TZ_ADDR A:0xb01003c
y.create.l HWIO_SPM_VOTE_HLOS_ADDR A:0xb010040
y.create.l HWIO_SPM_VOTE_HYP_ADDR A:0xb010044
y.create.l HWIO_SPM_VOTE_INT_STS_ADDR A:0xb010048
y.create.l HWIO_SPM_VOTE_INT_CLR_ADDR A:0xb01004c
y.create.l HWIO_APPS_BOOTFSM_CTL_ADDR A:0xb010050
y.create.l HWIO_APPS_BOOTFSM_STATUS_ADDR A:0xb010054
y.create.l HWIO_RBCPR_CLK_SEL_ADDR A:0xb010058
y.create.l HWIO_RBCPR_BCR_ADDR A:0xb01005c
y.create.l HWIO_RBCPR_PMIC_ADDR A:0xb010060
y.create.l HWIO_APCS_GCC_REG_BASE_START_ADDR A:0xb011000
y.create.l HWIO_APCS_GCC_REG_BASE_LAST_ADDR A:0xb0110b4
y.create.l HWIO_APCS_GCC_REG_BASE_END_ADDR A:0xb012000
y.create.l HWIO_APCS_GCCSECURE_ADDR A:0xb011000
y.create.l HWIO_APCS_IPC_SECURITY_ADDR A:0xb011004
y.create.l HWIO_APCS_IPC_ADDR A:0xb011008
y.create.l HWIO_APCS_PWR_CTL_OVERRIDE_ADDR A:0xb01100c
y.create.l HWIO_APCS_GCLK_STS_ADDR A:0xb011010
y.create.l HWIO_APCS_L2_PWR_CTL_ADDR A:0xb011014
y.create.l HWIO_APCS_PWR_STS_ADDR A:0xb011018
y.create.l HWIO_APCS_CLK_DIAG_ADDR A:0xb01101c
y.create.l HWIO_APCS_ALL_TSTBUS_SEL_ADDR A:0xb011020
y.create.l HWIO_APCS_DBG_PWR_CTL_ADDR A:0xb011024
y.create.l HWIO_APCS_L2_AUX_CLK_SEL_ADDR A:0xb011028
y.create.l HWIO_APCS_SPARE_ADDR A:0xb01102c
y.create.l HWIO_APCS_SPARE_STS_ADDR A:0xb011030
y.create.l HWIO_XPU_STATUS_ADDR A:0xb011034
y.create.l HWIO_APCS_HW_EVENT_SEL_0_ADDR A:0xb011038
y.create.l HWIO_APCS_HW_EVENT_SEL_1_ADDR A:0xb01103c
y.create.l HWIO_APCS_HW_EVENT_SEL_2_ADDR A:0xb011040
y.create.l HWIO_APCS_HW_EVENT_SEL_3_ADDR A:0xb011044
y.create.l HWIO_APCS_HW_EVENT_SEL_4_ADDR A:0xb011048
y.create.l HWIO_APCS_HW_EVENT_SEL_5_ADDR A:0xb01104c
y.create.l HWIO_APCS_HW_EVENT_SEL_6_ADDR A:0xb011050
y.create.l HWIO_APCS_HW_EVENT_SEL_7_ADDR A:0xb011054
y.create.l HWIO_APCS_HW_EVENT_SEL_8_ADDR A:0xb011058
y.create.l HWIO_APCS_HW_EVENT_SEL_9_ADDR A:0xb01105c
y.create.l HWIO_BIMC_GLOBAL0_REG_BASE_START_ADDR A:0x400000
y.create.l HWIO_BIMC_GLOBAL0_REG_BASE_LAST_ADDR A:0x400ff0
y.create.l HWIO_BIMC_GLOBAL0_REG_BASE_END_ADDR A:0x401000
y.create.l HWIO_BIMC_HW_VERSION_ADDR A:0x400000
y.create.l HWIO_BIMC_CORE_INFO_ADDR A:0x400004
y.create.l HWIO_BIMC_HW_INFO_ADDR A:0x400008
y.create.l HWIO_BIMC_DDR_CH0_CLK_2X_MODE_ADDR A:0x400020
y.create.l HWIO_BIMC_DDR_CH0_CLK_PERIOD_ADDR A:0x400028
y.create.l HWIO_BIMC_DDR_CH0_PHY_CLK_SEL_ADDR A:0x400030
y.create.l HWIO_BIMC_DDR_CH0_LP_CLK_DIV_CFG_ADDR A:0x400050
y.create.l HWIO_BIMC_SCMO0_LOCAL_CGC_THRESHOLD_ADDR A:0x400100
y.create.l HWIO_BIMC_DPE0_LOCAL_CGC_THRESHOLD_ADDR A:0x400140
y.create.l HWIO_BIMC_MPORT_CORE_DOMAIN_LOCAL_CGC_THRESHOLD_ADDR A:0x400180
y.create.l HWIO_BIMC_MPORT0_CLK_LOCAL_CGC_THRESHOLD_ADDR A:0x4001c0
y.create.l HWIO_BIMC_MPORT1_CLK_LOCAL_CGC_THRESHOLD_ADDR A:0x4001c4
y.create.l HWIO_BIMC_MPORT2_CLK_LOCAL_CGC_THRESHOLD_ADDR A:0x4001c8
y.create.l HWIO_BIMC_MPORT3_CLK_LOCAL_CGC_THRESHOLD_ADDR A:0x4001cc
y.create.l HWIO_BIMC_SWAY_LOCAL_CGC_THRESHOLD_ADDR A:0x400200
y.create.l HWIO_BIMC_SCMO0_CGC_CFG_ADDR A:0x400240
y.create.l HWIO_BIMC_DPE0_CGC_CFG_ADDR A:0x400280
y.create.l HWIO_BIMC_DDR_CH0_CAL_CFG_0_ADDR A:0x400400
y.create.l HWIO_BIMC_DDR_CH0_CAL_CFG_1_ADDR A:0x400410
y.create.l HWIO_BIMC_DDR_CH0_CAL_CFG_2_ADDR A:0x400420
y.create.l HWIO_BIMC_DDR_CH0_CAL_CFG_3_ADDR A:0x400428
y.create.l HWIO_BIMC_DDR_CH0_SW_CAL_ENA_ADDR A:0x400430
y.create.l HWIO_BIMC_DDR_CH0_SW_CLKEN_DDRCC_ADDR A:0x400438
y.create.l HWIO_BIMC_DDR_CH0_SW_CLKEN_CAPHY_ADDR A:0x400440
y.create.l HWIO_BIMC_DDR_CH0_SW_CLKEN_DQPHY_ADDR A:0x400448
y.create.l HWIO_BIMC_DDR_CH0_SW_CLK_READY_OVERRIDE_ADDR A:0x400450
y.create.l HWIO_BIMC_DDR_CH0_DDRCC_CLK_EXTEND_ADDR A:0x400460
y.create.l HWIO_BIMC_DDR_CH0_CAPHY_CLK_EXTEND_ADDR A:0x400470
y.create.l HWIO_BIMC_DDR_CH0_DQPHY_CLK_EXTEND_ADDR A:0x400480
y.create.l HWIO_BIMC_DDR_CH0_PHY_PIPE_CLK_CTRL_ADDR A:0x400490
y.create.l HWIO_BIMC_DDR_CH0_PIPE_CGC_EN_EXTEND_ADDR A:0x4004a0
y.create.l HWIO_BIMC_DDR_CH0_DQPHY_CLK_CTRL_ADDR A:0x4004b0
y.create.l HWIO_BIMC_DDR_CH0_DQPHY_CLK_STATUS_ADDR A:0x4004c0
y.create.l HWIO_BIMC_DDR_CH0_PIPESTAGES_TIMER_ADDR A:0x4004d0
y.create.l HWIO_BIMC_DDR_CH0_DQPHY_CLK_OFF_HYSTERESIS_ADDR A:0x4004e0
y.create.l HWIO_BIMC_DDR_CH0_DQPHY_CLK_ON_HYSTERESIS_0_ADDR A:0x4004f0
y.create.l HWIO_BIMC_DDR_CH0_DQPHY_CLK_ON_HYSTERESIS_1_ADDR A:0x400500
y.create.l HWIO_BIMC_DDR_CH0_DQPHY_CLK_ON_HYSTERESIS_2_ADDR A:0x400510
y.create.l HWIO_BIMC_DFI0_LP_CFG_ADDR A:0x400600
y.create.l HWIO_BIMC_DDR_CH0_HFSC_CFG_ADDR A:0x400800
y.create.l HWIO_BIMC_DDR_CH0_HFSC_STATUS_ADDR A:0x400810
y.create.l HWIO_BIMC_DDR_CH0_HFSC_STAGE1_CTRL_ADDR A:0x400820
y.create.l HWIO_BIMC_DDR_CH0_HFSC_STAGE2_CTRL_ADDR A:0x400830
y.create.l HWIO_BIMC_DDR_CH0_HFSC_STAGE1_HANDSHAKE_CTRL_ADDR A:0x400840
y.create.l HWIO_BIMC_DDR_CH0_HFSC_STAGE2_HANDSHAKE_CTRL_ADDR A:0x400850
y.create.l HWIO_BIMC_DDR_CH0_HFSPC_CFG_ADDR A:0x4008a0
y.create.l HWIO_BIMC_DDR_CH0_HFSPC_STATUS_ADDR A:0x4008a8
y.create.l HWIO_BIMC_QOS_CTRL_ADDR A:0x400900
y.create.l HWIO_BIMC_QOS_CFG_ADDR A:0x400904
y.create.l HWIO_BIMC_QOS_TIMEOUT_CNT_LOW_URGENCY_ADDR A:0x400908
y.create.l HWIO_BIMC_QOS_TIMEOUT_CNT_HIGH_URGENCY_ADDR A:0x40090c
y.create.l HWIO_BIMC_QOS_STATUS_ADDR A:0x400910
y.create.l HWIO_BIMC_QOS_STATUS_CLR_ADDR A:0x400914
y.create.l HWIO_BIMC_QOS_TIMER_RATE_CFG_ADDR A:0x400980
y.create.l HWIO_BIMC_QOS_DOWNTIME_HANDSHAKE_CFG_0_ADDR A:0x4009a0
y.create.l HWIO_BIMC_QOS_DOWNTIME_HANDSHAKE_CFG_1_ADDR A:0x4009a4
y.create.l HWIO_BIMC_QOS_DOWNTIME_HANDSHAKE_CFG_2_ADDR A:0x4009a8
y.create.l HWIO_BIMC_QOS_DOWNTIME_HANDSHAKE_CFG_3_ADDR A:0x4009ac
y.create.l HWIO_BIMC_QOS_FREQ_BAND_BNDRY_0_ADDR A:0x4009c0
y.create.l HWIO_BIMC_QOS_FREQ_BAND_BNDRY_1_ADDR A:0x4009c4
y.create.l HWIO_BIMC_QOS_FREQ_BAND_BNDRY_2_ADDR A:0x4009c8
y.create.l HWIO_BIMC_QOS_PROFILING_SIGNALS_SEL_ADDR A:0x4009d8
y.create.l HWIO_BIMC_QOS_ASSIST_REQ_THRESHOLD_1_ADDR A:0x4009e0
y.create.l HWIO_BIMC_QOS_ASSIST_REQ_THRESHOLD_2_ADDR A:0x4009e4
y.create.l HWIO_BIMC_QOS_ASSIST_REQ_THRESHOLD_3_ADDR A:0x4009e8
y.create.l HWIO_BIMC_QOS_ASSIST_REQ_THRESHOLD_4_ADDR A:0x4009ec
y.create.l HWIO_BIMC_QOS_ASSIST_REQ_THRESHOLD_5_ADDR A:0x4009f0
y.create.l HWIO_BIMC_QOS_ASSIST_REQ_THRESHOLD_6_ADDR A:0x4009f4
y.create.l HWIO_BIMC_QOS_ASSIST_REQ_THRESHOLD_7_ADDR A:0x4009f8
y.create.l HWIO_BIMC_QOS_DT_REQ_SRC_SEL_ADDR A:0x400a00
y.create.l HWIO_BIMC_QOS_DT_REQ_SRC_SW_ADDR A:0x400a04
y.create.l HWIO_BIMC_QOS_DT_REQ_SRC_DBG_ADDR A:0x400a08
y.create.l HWIO_BIMC_QOS_DT_ACK_SRC_SEL_ADDR A:0x400a0c
y.create.l HWIO_BIMC_QOS_DT_ACK_SRC_DBG_ADDR A:0x400a10
y.create.l HWIO_BIMC_QOS_DANGER_SAFE_SRC_SEL_ADDR A:0x400a14
y.create.l HWIO_BIMC_QOS_DANGER_SAFE_SRC_SW_ADDR A:0x400a18
y.create.l HWIO_BIMC_QOS_DANGER_SAFE_SRC_DBG_ADDR A:0x400a1c
y.create.l HWIO_BIMC_QOS_ASSIST_REQ_SRC_SEL_ADDR A:0x400a20
y.create.l HWIO_BIMC_QOS_ASSIST_REQ_SRC_DBG_ADDR A:0x400a28
y.create.l HWIO_BIMC_QOS_DDRCLK_PERIOD_SRC_SEL_ADDR A:0x400b00
y.create.l HWIO_BIMC_QOS_DDRCLK_PERIOD_SRC_DBG_ADDR A:0x400b04
y.create.l HWIO_BIMC_QOS_DT_HANDSHAKE_EN_EFFECTIVE_ADDR A:0x400d00
y.create.l HWIO_BIMC_QOS_CURRENT_DOWNTIME_STATUS_ADDR A:0x400d04
y.create.l HWIO_BIMC_QOS_CURRENT_DDRCLK_PERIOD_ADDR A:0x400d08
y.create.l HWIO_BIMC_QOS_CURRENT_DANGER_SAFE_ADDR A:0x400d0c
y.create.l HWIO_BIMC_QOS_CURRENT_ASSIST_REQ_ADDR A:0x400e00
y.create.l HWIO_BIMC_QOS_POST_STALL_TIMEOUT_ADDR A:0x400e04
y.create.l HWIO_BIMC_QOS_POST_STALL_TIMEOUT_CLR_ADDR A:0x400e08
y.create.l HWIO_BIMC_QOS_RESERVE_ADDR A:0x400ff0
y.create.l HWIO_BIMC_QOS_FSSH_CTRL_ADDR A:0x400920
y.create.l HWIO_BIMC_QOS_FSSH_FREQ_THRESHOLD_URGENCY_BAND0_ADDR A:0x400930
y.create.l HWIO_BIMC_QOS_FSSH_URGENCY_SEL_ADDR A:0x400940
y.create.l HWIO_BIMC_DTE_REG_BASE_START_ADDR A:0x406000
y.create.l HWIO_BIMC_DTE_REG_BASE_LAST_ADDR A:0x40603c
y.create.l HWIO_BIMC_DTE_REG_BASE_END_ADDR A:0x40605c
y.create.l HWIO_BIMC_DTE_HW_INFO_ADDR A:0x406000
y.create.l HWIO_BIMC_DTE_GLOBAL_CNTL_ADDR A:0x406004
y.create.l HWIO_BIMC_DTE_PROGRAM_CNTL_ADDR A:0x40600c
y.create.l HWIO_BIMC_DTE_REG_CNTL_ADDR A:0x406010
y.create.l HWIO_BIMC_DTE_REG_DATA_ADDR A:0x406014
y.create.l HWIO_BIMC_DTE_TEST_STATUS_DDR_ADDR A:0x406020
y.create.l HWIO_BIMC_DTE_TEST_STATUS_QSB_ADDR A:0x406024
y.create.l HWIO_BIMC_DTE_TEST_MEM_CNTL_ADDR A:0x406030
y.create.l HWIO_BIMC_DTE_TEST_MEM_DATA_0_ADDR A:0x406038
y.create.l HWIO_BIMC_DTE_TEST_MEM_DATA_1_ADDR A:0x40603c
y.create.l HWIO_BIMC_GLOBAL1_REG_BASE_START_ADDR A:0x401000
y.create.l HWIO_BIMC_GLOBAL1_REG_BASE_LAST_ADDR A:0x40144c
y.create.l HWIO_BIMC_GLOBAL1_REG_BASE_END_ADDR A:0x402000
y.create.l HWIO_BIMC_BRIC_GLOBAL1_COMPONENT_INFO_ADDR A:0x401000
y.create.l HWIO_BIMC_BRIC_HW_INFO_ADDR A:0x401010
y.create.l HWIO_BIMC_BRIC_HW_VERSION_ADDR A:0x401014
y.create.l HWIO_BIMC_BRIC_CONFIGURATION_INFO_0_ADDR A:0x401020
y.create.l HWIO_BIMC_BRIC_CONFIGURATION_INFO_1_ADDR A:0x401030
y.create.l HWIO_BIMC_BRIC_CONFIGURATION_INFO_2A_ADDR A:0x401040
y.create.l HWIO_BIMC_BRIC_CONFIGURATION_INFO_2B_ADDR A:0x401044
y.create.l HWIO_BIMC_BRIC_CONFIGURATION_INFO_2C_ADDR A:0x401048
y.create.l HWIO_BIMC_BRIC_CONFIGURATION_INFO_2D_ADDR A:0x40104c
y.create.l HWIO_BIMC_BRIC_INTERRUPT_0_STATUS_0_ADDR A:0x401100
y.create.l HWIO_BIMC_BRIC_INTERRUPT_0_CLEAR_0_ADDR A:0x401108
y.create.l HWIO_BIMC_BRIC_INTERRUPT_0_ENABLE_0_ADDR A:0x40110c
y.create.l HWIO_BIMC_BRIC_INTERRUPT_0_STATUS_1_ADDR A:0x401110
y.create.l HWIO_BIMC_BRIC_INTERRUPT_0_CLEAR_1_ADDR A:0x401118
y.create.l HWIO_BIMC_BRIC_INTERRUPT_0_ENABLE_1_ADDR A:0x40111c
y.create.l HWIO_BIMC_BRIC_INTERRUPT_0_STATUS_2_ADDR A:0x401120
y.create.l HWIO_BIMC_BRIC_INTERRUPT_0_CLEAR_2_ADDR A:0x401128
y.create.l HWIO_BIMC_BRIC_INTERRUPT_0_ENABLE_2_ADDR A:0x40112c
y.create.l HWIO_BIMC_BRIC_INTERRUPT_0_STATUS_3_ADDR A:0x401130
y.create.l HWIO_BIMC_BRIC_INTERRUPT_0_CLEAR_3_ADDR A:0x401138
y.create.l HWIO_BIMC_BRIC_INTERRUPT_0_ENABLE_3_ADDR A:0x40113c
y.create.l HWIO_BIMC_BRIC_INTERRUPT_0_STATUS_4_ADDR A:0x401140
y.create.l HWIO_BIMC_BRIC_INTERRUPT_0_CLEAR_4_ADDR A:0x401148
y.create.l HWIO_BIMC_BRIC_INTERRUPT_0_ENABLE_4_ADDR A:0x40114c
y.create.l HWIO_BIMC_BRIC_INTERRUPT_2_STATUS_0_ADDR A:0x401180
y.create.l HWIO_BIMC_BRIC_INTERRUPT_2_CLEAR_0_ADDR A:0x401188
y.create.l HWIO_BIMC_BRIC_INTERRUPT_2_ENABLE_0_ADDR A:0x40118c
y.create.l HWIO_BIMC_BRIC_INTERRUPT_2_STATUS_1_ADDR A:0x401190
y.create.l HWIO_BIMC_BRIC_INTERRUPT_2_CLEAR_1_ADDR A:0x401198
y.create.l HWIO_BIMC_BRIC_INTERRUPT_2_ENABLE_1_ADDR A:0x40119c
y.create.l HWIO_BIMC_BRIC_INTERRUPT_2_STATUS_2_ADDR A:0x4011a0
y.create.l HWIO_BIMC_BRIC_INTERRUPT_2_CLEAR_2_ADDR A:0x4011a8
y.create.l HWIO_BIMC_BRIC_INTERRUPT_2_ENABLE_2_ADDR A:0x4011ac
y.create.l HWIO_BIMC_BRIC_INTERRUPT_2_STATUS_3_ADDR A:0x4011b0
y.create.l HWIO_BIMC_BRIC_INTERRUPT_2_CLEAR_3_ADDR A:0x4011b8
y.create.l HWIO_BIMC_BRIC_INTERRUPT_2_ENABLE_3_ADDR A:0x4011bc
y.create.l HWIO_BIMC_BRIC_INTERRUPT_2_STATUS_4_ADDR A:0x4011c0
y.create.l HWIO_BIMC_BRIC_INTERRUPT_2_CLEAR_4_ADDR A:0x4011c8
y.create.l HWIO_BIMC_BRIC_INTERRUPT_2_ENABLE_4_ADDR A:0x4011cc
y.create.l HWIO_BIMC_BRIC_INTERRUPT_3_STATUS_0_ADDR A:0x401400
y.create.l HWIO_BIMC_BRIC_INTERRUPT_3_CLEAR_0_ADDR A:0x401408
y.create.l HWIO_BIMC_BRIC_INTERRUPT_3_ENABLE_0_ADDR A:0x40140c
y.create.l HWIO_BIMC_BRIC_INTERRUPT_3_STATUS_1_ADDR A:0x401410
y.create.l HWIO_BIMC_BRIC_INTERRUPT_3_CLEAR_1_ADDR A:0x401418
y.create.l HWIO_BIMC_BRIC_INTERRUPT_3_ENABLE_1_ADDR A:0x40141c
y.create.l HWIO_BIMC_BRIC_INTERRUPT_3_STATUS_2_ADDR A:0x401420
y.create.l HWIO_BIMC_BRIC_INTERRUPT_3_CLEAR_2_ADDR A:0x401428
y.create.l HWIO_BIMC_BRIC_INTERRUPT_3_ENABLE_2_ADDR A:0x40142c
y.create.l HWIO_BIMC_BRIC_INTERRUPT_3_STATUS_3_ADDR A:0x401430
y.create.l HWIO_BIMC_BRIC_INTERRUPT_3_CLEAR_3_ADDR A:0x401438
y.create.l HWIO_BIMC_BRIC_INTERRUPT_3_ENABLE_3_ADDR A:0x40143c
y.create.l HWIO_BIMC_BRIC_INTERRUPT_3_STATUS_4_ADDR A:0x401440
y.create.l HWIO_BIMC_BRIC_INTERRUPT_3_CLEAR_4_ADDR A:0x401448
y.create.l HWIO_BIMC_BRIC_INTERRUPT_3_ENABLE_4_ADDR A:0x40144c
y.create.l HWIO_BIMC_BRIC_REF_TIMER_INTERVAL_ADDR A:0x401200
y.create.l HWIO_BIMC_BRIC_SLAVE_RESP_TIMEOUT_ADDR A:0x401204
y.create.l HWIO_BIMC_BRIC_DEBUG_SELECT_ADDR A:0x401210
y.create.l HWIO_BIMC_BRIC_MSA_LOCKS_ADDR A:0x401300
y.create.l HWIO_BIMC_BRIC_PROTNS_LOCKS_ADDR A:0x401310
y.create.l HWIO_BIMC_BRIC_SP_LOCKS_ADDR A:0x401320
y.create.l HWIO_BIMC_GLOBAL2_REG_BASE_START_ADDR A:0x402000
y.create.l HWIO_BIMC_GLOBAL2_REG_BASE_LAST_ADDR A:0x402ae4
y.create.l HWIO_BIMC_GLOBAL2_REG_BASE_END_ADDR A:0x403000
y.create.l HWIO_BIMC_BRIC_GLOBAL2_COMPONENT_INFO_ADDR A:0x402000
y.create.l HWIO_BIMC_BRIC_INTERRUPT_1_STATUS_0_ADDR A:0x402100
y.create.l HWIO_BIMC_BRIC_INTERRUPT_1_CLEAR_0_ADDR A:0x402108
y.create.l HWIO_BIMC_BRIC_INTERRUPT_1_ENABLE_0_ADDR A:0x40210c
y.create.l HWIO_BIMC_BRIC_INTERRUPT_1_STATUS_1_ADDR A:0x402110
y.create.l HWIO_BIMC_BRIC_INTERRUPT_1_CLEAR_1_ADDR A:0x402118
y.create.l HWIO_BIMC_BRIC_INTERRUPT_1_ENABLE_1_ADDR A:0x40211c
y.create.l HWIO_BIMC_BRIC_INTERRUPT_1_STATUS_2_ADDR A:0x402120
y.create.l HWIO_BIMC_BRIC_INTERRUPT_1_CLEAR_2_ADDR A:0x402128
y.create.l HWIO_BIMC_BRIC_INTERRUPT_1_ENABLE_2_ADDR A:0x40212c
y.create.l HWIO_BIMC_BRIC_INTERRUPT_1_STATUS_3_ADDR A:0x402130
y.create.l HWIO_BIMC_BRIC_INTERRUPT_1_CLEAR_3_ADDR A:0x402138
y.create.l HWIO_BIMC_BRIC_INTERRUPT_1_ENABLE_3_ADDR A:0x40213c
y.create.l HWIO_BIMC_BRIC_INTERRUPT_1_STATUS_4_ADDR A:0x402140
y.create.l HWIO_BIMC_BRIC_INTERRUPT_1_CLEAR_4_ADDR A:0x402148
y.create.l HWIO_BIMC_BRIC_INTERRUPT_1_ENABLE_4_ADDR A:0x40214c
y.create.l HWIO_BIMC_BRIC_DEFAULT_SEGMENT_ADDR A:0x4021f0
y.create.l HWIO_BIMC_BRIC_REDIRECT_CTRL_ADDR A:0x4021f4
y.create.l HWIO_BIMC_BRIC_REDIRECT_MSTR_EN_ADDR A:0x4021f8
y.create.l HWIO_BIMC_BRIC_REDIRECT_CTRL_STATUS_ADDR A:0x4021fc
y.create.l HWIO_BIMC_BRIC_SEGMENT0_ADDR_BASE_A_LOWER_ADDR A:0x402200
y.create.l HWIO_BIMC_BRIC_SEGMENT1_ADDR_BASE_A_LOWER_ADDR A:0x402280
y.create.l HWIO_BIMC_BRIC_SEGMENT2_ADDR_BASE_A_LOWER_ADDR A:0x402300
y.create.l HWIO_BIMC_BRIC_SEGMENT0_ADDR_BASE_A_UPPER_ADDR A:0x402204
y.create.l HWIO_BIMC_BRIC_SEGMENT1_ADDR_BASE_A_UPPER_ADDR A:0x402284
y.create.l HWIO_BIMC_BRIC_SEGMENT2_ADDR_BASE_A_UPPER_ADDR A:0x402304
y.create.l HWIO_BIMC_BRIC_SEGMENT0_ADDR_MASK_A_LOWER_ADDR A:0x402208
y.create.l HWIO_BIMC_BRIC_SEGMENT1_ADDR_MASK_A_LOWER_ADDR A:0x402288
y.create.l HWIO_BIMC_BRIC_SEGMENT2_ADDR_MASK_A_LOWER_ADDR A:0x402308
y.create.l HWIO_BIMC_BRIC_SEGMENT0_ADDR_MASK_A_UPPER_ADDR A:0x40220c
y.create.l HWIO_BIMC_BRIC_SEGMENT1_ADDR_MASK_A_UPPER_ADDR A:0x40228c
y.create.l HWIO_BIMC_BRIC_SEGMENT2_ADDR_MASK_A_UPPER_ADDR A:0x40230c
y.create.l HWIO_BIMC_BRIC_SEGMENT0_ADDR_BASE_B_LOWER_ADDR A:0x402210
y.create.l HWIO_BIMC_BRIC_SEGMENT1_ADDR_BASE_B_LOWER_ADDR A:0x402290
y.create.l HWIO_BIMC_BRIC_SEGMENT2_ADDR_BASE_B_LOWER_ADDR A:0x402310
y.create.l HWIO_BIMC_BRIC_SEGMENT0_ADDR_BASE_B_UPPER_ADDR A:0x402214
y.create.l HWIO_BIMC_BRIC_SEGMENT1_ADDR_BASE_B_UPPER_ADDR A:0x402294
y.create.l HWIO_BIMC_BRIC_SEGMENT2_ADDR_BASE_B_UPPER_ADDR A:0x402314
y.create.l HWIO_BIMC_BRIC_SEGMENT0_ADDR_MASK_B_LOWER_ADDR A:0x402218
y.create.l HWIO_BIMC_BRIC_SEGMENT1_ADDR_MASK_B_LOWER_ADDR A:0x402298
y.create.l HWIO_BIMC_BRIC_SEGMENT2_ADDR_MASK_B_LOWER_ADDR A:0x402318
y.create.l HWIO_BIMC_BRIC_SEGMENT0_ADDR_MASK_B_UPPER_ADDR A:0x40221c
y.create.l HWIO_BIMC_BRIC_SEGMENT1_ADDR_MASK_B_UPPER_ADDR A:0x40229c
y.create.l HWIO_BIMC_BRIC_SEGMENT2_ADDR_MASK_B_UPPER_ADDR A:0x40231c
y.create.l HWIO_BIMC_BRIC_SEGMENT0_ADDR_BASE_C_LOWER_ADDR A:0x402220
y.create.l HWIO_BIMC_BRIC_SEGMENT1_ADDR_BASE_C_LOWER_ADDR A:0x4022a0
y.create.l HWIO_BIMC_BRIC_SEGMENT2_ADDR_BASE_C_LOWER_ADDR A:0x402320
y.create.l HWIO_BIMC_BRIC_SEGMENT0_ADDR_BASE_C_UPPER_ADDR A:0x402224
y.create.l HWIO_BIMC_BRIC_SEGMENT1_ADDR_BASE_C_UPPER_ADDR A:0x4022a4
y.create.l HWIO_BIMC_BRIC_SEGMENT2_ADDR_BASE_C_UPPER_ADDR A:0x402324
y.create.l HWIO_BIMC_BRIC_SEGMENT0_ADDR_MASK_C_LOWER_ADDR A:0x402228
y.create.l HWIO_BIMC_BRIC_SEGMENT1_ADDR_MASK_C_LOWER_ADDR A:0x4022a8
y.create.l HWIO_BIMC_BRIC_SEGMENT2_ADDR_MASK_C_LOWER_ADDR A:0x402328
y.create.l HWIO_BIMC_BRIC_SEGMENT0_ADDR_MASK_C_UPPER_ADDR A:0x40222c
y.create.l HWIO_BIMC_BRIC_SEGMENT1_ADDR_MASK_C_UPPER_ADDR A:0x4022ac
y.create.l HWIO_BIMC_BRIC_SEGMENT2_ADDR_MASK_C_UPPER_ADDR A:0x40232c
y.create.l HWIO_BIMC_BRIC_SEGMENT0_ADDR_BASE_D_LOWER_ADDR A:0x402230
y.create.l HWIO_BIMC_BRIC_SEGMENT1_ADDR_BASE_D_LOWER_ADDR A:0x4022b0
y.create.l HWIO_BIMC_BRIC_SEGMENT2_ADDR_BASE_D_LOWER_ADDR A:0x402330
y.create.l HWIO_BIMC_BRIC_SEGMENT0_ADDR_BASE_D_UPPER_ADDR A:0x402234
y.create.l HWIO_BIMC_BRIC_SEGMENT1_ADDR_BASE_D_UPPER_ADDR A:0x4022b4
y.create.l HWIO_BIMC_BRIC_SEGMENT2_ADDR_BASE_D_UPPER_ADDR A:0x402334
y.create.l HWIO_BIMC_BRIC_SEGMENT0_ADDR_MASK_D_LOWER_ADDR A:0x402238
y.create.l HWIO_BIMC_BRIC_SEGMENT1_ADDR_MASK_D_LOWER_ADDR A:0x4022b8
y.create.l HWIO_BIMC_BRIC_SEGMENT2_ADDR_MASK_D_LOWER_ADDR A:0x402338
y.create.l HWIO_BIMC_BRIC_SEGMENT0_ADDR_MASK_D_UPPER_ADDR A:0x40223c
y.create.l HWIO_BIMC_BRIC_SEGMENT1_ADDR_MASK_D_UPPER_ADDR A:0x4022bc
y.create.l HWIO_BIMC_BRIC_SEGMENT2_ADDR_MASK_D_UPPER_ADDR A:0x40233c
y.create.l HWIO_BIMC_BRIC_REMAP0_ADDR_BASE_LOWER_ADDR A:0x402a00
y.create.l HWIO_BIMC_BRIC_REMAP1_ADDR_BASE_LOWER_ADDR A:0x402a40
y.create.l HWIO_BIMC_BRIC_REMAP2_ADDR_BASE_LOWER_ADDR A:0x402a80
y.create.l HWIO_BIMC_BRIC_REMAP3_ADDR_BASE_LOWER_ADDR A:0x402ac0
y.create.l HWIO_BIMC_BRIC_REMAP0_ADDR_BASE_UPPER_ADDR A:0x402a04
y.create.l HWIO_BIMC_BRIC_REMAP1_ADDR_BASE_UPPER_ADDR A:0x402a44
y.create.l HWIO_BIMC_BRIC_REMAP2_ADDR_BASE_UPPER_ADDR A:0x402a84
y.create.l HWIO_BIMC_BRIC_REMAP3_ADDR_BASE_UPPER_ADDR A:0x402ac4
y.create.l HWIO_BIMC_BRIC_REMAP0_ADDR_MASK_LOWER_ADDR A:0x402a08
y.create.l HWIO_BIMC_BRIC_REMAP1_ADDR_MASK_LOWER_ADDR A:0x402a48
y.create.l HWIO_BIMC_BRIC_REMAP2_ADDR_MASK_LOWER_ADDR A:0x402a88
y.create.l HWIO_BIMC_BRIC_REMAP3_ADDR_MASK_LOWER_ADDR A:0x402ac8
y.create.l HWIO_BIMC_BRIC_REMAP0_ADDR_MASK_UPPER_ADDR A:0x402a0c
y.create.l HWIO_BIMC_BRIC_REMAP1_ADDR_MASK_UPPER_ADDR A:0x402a4c
y.create.l HWIO_BIMC_BRIC_REMAP2_ADDR_MASK_UPPER_ADDR A:0x402a8c
y.create.l HWIO_BIMC_BRIC_REMAP3_ADDR_MASK_UPPER_ADDR A:0x402acc
y.create.l HWIO_BIMC_BRIC_REMAP0_OP0_ADDR A:0x402a20
y.create.l HWIO_BIMC_BRIC_REMAP1_OP0_ADDR A:0x402a60
y.create.l HWIO_BIMC_BRIC_REMAP2_OP0_ADDR A:0x402aa0
y.create.l HWIO_BIMC_BRIC_REMAP3_OP0_ADDR A:0x402ae0
y.create.l HWIO_BIMC_BRIC_REMAP0_OP1_ADDR A:0x402a24
y.create.l HWIO_BIMC_BRIC_REMAP1_OP1_ADDR A:0x402a64
y.create.l HWIO_BIMC_BRIC_REMAP2_OP1_ADDR A:0x402aa4
y.create.l HWIO_BIMC_BRIC_REMAP3_OP1_ADDR A:0x402ae4
y.create.l HWIO_BIMC_PERFMON_REG_BASE_START_ADDR A:0x403000
y.create.l HWIO_BIMC_PERFMON_REG_BASE_LAST_ADDR A:0x4034fc
y.create.l HWIO_BIMC_PERFMON_REG_BASE_END_ADDR A:0x404000
y.create.l HWIO_BIMC_PERFMON_COMPONENT_INFO_ADDR A:0x403000
y.create.l HWIO_BIMC_PERFMON_CONFIGURATION_INFO_ADDR A:0x403020
y.create.l HWIO_BIMC_PERFMON_CLOCK_CTRL_ADDR A:0x403200
y.create.l HWIO_BIMC_PERFMON_MODE_ADDR A:0x403210
y.create.l HWIO_BIMC_PERFMON_DUMP_ADDR A:0x403214
y.create.l HWIO_BIMC_PERFMON_TIMED_MODE_INTERVAL_ADDR A:0x403220
y.create.l HWIO_BIMC_PERFMON_TIMED_MODE_ITERATIONS_ADDR A:0x403230
y.create.l HWIO_BIMC_PERFMON_STATUS_ADDR A:0x4032f0
y.create.l HWIO_BIMC_PERFMON_COUNTER_0_CONFIG_ADDR A:0x403300
y.create.l HWIO_BIMC_PERFMON_COUNTER_1_CONFIG_ADDR A:0x403310
y.create.l HWIO_BIMC_PERFMON_COUNTER_2_CONFIG_ADDR A:0x403320
y.create.l HWIO_BIMC_PERFMON_COUNTER_3_CONFIG_ADDR A:0x403330
y.create.l HWIO_BIMC_PERFMON_COUNTER_4_CONFIG_ADDR A:0x403340
y.create.l HWIO_BIMC_PERFMON_COUNTER_5_CONFIG_ADDR A:0x403350
y.create.l HWIO_BIMC_PERFMON_COUNTER_6_CONFIG_ADDR A:0x403360
y.create.l HWIO_BIMC_PERFMON_COUNTER_7_CONFIG_ADDR A:0x403370
y.create.l HWIO_BIMC_PERFMON_COUNTER_8_CONFIG_ADDR A:0x403380
y.create.l HWIO_BIMC_PERFMON_COUNTER_9_CONFIG_ADDR A:0x403390
y.create.l HWIO_BIMC_PERFMON_COUNTER_0_ADDR A:0x403308
y.create.l HWIO_BIMC_PERFMON_COUNTER_1_ADDR A:0x403318
y.create.l HWIO_BIMC_PERFMON_COUNTER_2_ADDR A:0x403328
y.create.l HWIO_BIMC_PERFMON_COUNTER_3_ADDR A:0x403338
y.create.l HWIO_BIMC_PERFMON_COUNTER_4_ADDR A:0x403348
y.create.l HWIO_BIMC_PERFMON_COUNTER_5_ADDR A:0x403358
y.create.l HWIO_BIMC_PERFMON_COUNTER_6_ADDR A:0x403368
y.create.l HWIO_BIMC_PERFMON_COUNTER_7_ADDR A:0x403378
y.create.l HWIO_BIMC_PERFMON_COUNTER_8_ADDR A:0x403388
y.create.l HWIO_BIMC_PERFMON_COUNTER_9_ADDR A:0x403398
y.create.l HWIO_BIMC_PERFMON_COUNTER_0_OVERFLOW_ADDR A:0x40330c
y.create.l HWIO_BIMC_PERFMON_COUNTER_1_OVERFLOW_ADDR A:0x40331c
y.create.l HWIO_BIMC_PERFMON_COUNTER_2_OVERFLOW_ADDR A:0x40332c
y.create.l HWIO_BIMC_PERFMON_COUNTER_3_OVERFLOW_ADDR A:0x40333c
y.create.l HWIO_BIMC_PERFMON_COUNTER_4_OVERFLOW_ADDR A:0x40334c
y.create.l HWIO_BIMC_PERFMON_COUNTER_5_OVERFLOW_ADDR A:0x40335c
y.create.l HWIO_BIMC_PERFMON_COUNTER_6_OVERFLOW_ADDR A:0x40336c
y.create.l HWIO_BIMC_PERFMON_COUNTER_7_OVERFLOW_ADDR A:0x40337c
y.create.l HWIO_BIMC_PERFMON_COUNTER_8_OVERFLOW_ADDR A:0x40338c
y.create.l HWIO_BIMC_PERFMON_COUNTER_9_OVERFLOW_ADDR A:0x40339c
y.create.l HWIO_BIMC_M_APP_MPORT_REG_BASE_START_ADDR A:0x408000
y.create.l HWIO_BIMC_M_APP_MPORT_REG_BASE_LAST_ADDR A:0x408a4c
y.create.l HWIO_BIMC_M_APP_MPORT_REG_BASE_END_ADDR A:0x409000
y.create.l HWIO_BIMC_M_APP_MPORT_COMPONENT_INFO_ADDR A:0x408000
y.create.l HWIO_BIMC_M_APP_MPORT_CONFIGURATION_INFO_0_ADDR A:0x408020
y.create.l HWIO_BIMC_M_APP_MPORT_CONFIGURATION_INFO_1_ADDR A:0x408030
y.create.l HWIO_BIMC_M_APP_MPORT_CONFIGURATION_INFO_2A_ADDR A:0x408040
y.create.l HWIO_BIMC_M_APP_MPORT_CONFIGURATION_INFO_2B_ADDR A:0x408044
y.create.l HWIO_BIMC_M_APP_MPORT_CONFIGURATION_INFO_3_ADDR A:0x408050
y.create.l HWIO_BIMC_M_APP_MPORT_CONFIGURATION_INFO_4_ADDR A:0x408060
y.create.l HWIO_BIMC_M_APP_MPORT_CONFIGURATION_INFO_5A_ADDR A:0x408070
y.create.l HWIO_BIMC_M_APP_MPORT_CONFIGURATION_INFO_5B_ADDR A:0x408074
y.create.l HWIO_BIMC_M_APP_MPORT_CONFIGURATION_INFO_5C_ADDR A:0x408078
y.create.l HWIO_BIMC_M_APP_MPORT_CONFIGURATION_INFO_5D_ADDR A:0x40807c
y.create.l HWIO_BIMC_M_APP_MPORT_INTERRUPT_STATUS_ADDR A:0x408100
y.create.l HWIO_BIMC_M_APP_MPORT_INTERRUPT_CLEAR_ADDR A:0x408108
y.create.l HWIO_BIMC_M_APP_MPORT_INTERRUPT_ENABLE_ADDR A:0x40810c
y.create.l HWIO_BIMC_M_APP_MPORT_CLOCK_CTRL_ADDR A:0x408200
y.create.l HWIO_BIMC_M_APP_MPORT_CDC_CTRL_ADDR A:0x408208
y.create.l HWIO_BIMC_M_APP_MPORT_MODE_ADDR A:0x408210
y.create.l HWIO_BIMC_M_APP_MPORT_REDIRECT_CTRL_ADDR A:0x408218
y.create.l HWIO_BIMC_M_APP_MPORT_WR_WAY_CROSSING_ADDR A:0x408220
y.create.l HWIO_BIMC_M_APP_MPORT_PRIORITYLVL_OVERRIDE_ADDR A:0x408230
y.create.l HWIO_BIMC_M_APP_MPORT_READ_COMMAND_OVERRIDE_ADDR A:0x408240
y.create.l HWIO_BIMC_M_APP_MPORT_WRITE_COMMAND_OVERRIDE_0_ADDR A:0x408250
y.create.l HWIO_BIMC_M_APP_MPORT_WRITE_COMMAND_OVERRIDE_1_ADDR A:0x408254
y.create.l HWIO_BIMC_M_APP_MPORT_RD_TRACKING_INDEX_ADDR A:0x408270
y.create.l HWIO_BIMC_M_APP_MPORT_WR_TRACKING_INDEX_ADDR A:0x408274
y.create.l HWIO_BIMC_M_APP_MPORT_BAMON_ADDR A:0x408278
y.create.l HWIO_BIMC_M_APP_MPORT_BWMON_ENABLE_ADDR A:0x408280
y.create.l HWIO_BIMC_M_APP_MPORT_BWMON_CLEAR_ADDR A:0x408284
y.create.l HWIO_BIMC_M_APP_MPORT_BWMON_BYTE_COUNT_ADDR A:0x408288
y.create.l HWIO_BIMC_M_APP_MPORT_BWMON_THRESHOLD_ADDR A:0x408290
y.create.l HWIO_BIMC_M_APP_MPORT_BWMON_MID_MASK_ADDR A:0x408298
y.create.l HWIO_BIMC_M_APP_MPORT_BWMON_MID_MATCH_ADDR A:0x40829c
y.create.l HWIO_BIMC_M_APP_MPORT_BWMON2_ENABLE_ADDR A:0x4082a0
y.create.l HWIO_BIMC_M_APP_MPORT_BWMON2_CLEAR_ADDR A:0x4082a4
y.create.l HWIO_BIMC_M_APP_MPORT_BWMON2_SAMPLING_WINDOW_ADDR A:0x4082a8
y.create.l HWIO_BIMC_M_APP_MPORT_BWMON2_BYTE_COUNT_THRESHOLD_HIGH_ADDR A:0x4082ac
y.create.l HWIO_BIMC_M_APP_MPORT_BWMON2_BYTE_COUNT_THRESHOLD_MEDIUM_ADDR A:0x4082b0
y.create.l HWIO_BIMC_M_APP_MPORT_BWMON2_BYTE_COUNT_THRESHOLD_LOW_ADDR A:0x4082b4
y.create.l HWIO_BIMC_M_APP_MPORT_BWMON2_ZONE_ACTIONS_ADDR A:0x4082b8
y.create.l HWIO_BIMC_M_APP_MPORT_BWMON2_ZONE_COUNT_THRESHOLD_ADDR A:0x4082bc
y.create.l HWIO_BIMC_M_APP_MPORT_BWMON2_BYTE_COUNT_ADDR A:0x4082d0
y.create.l HWIO_BIMC_M_APP_MPORT_BWMON2_WINDOW_TIMER_ADDR A:0x4082d4
y.create.l HWIO_BIMC_M_APP_MPORT_BWMON2_ZONE_COUNT_ADDR A:0x4082d8
y.create.l HWIO_BIMC_M_APP_MPORT_BWMON2_ZONE0_MAX_BYTE_COUNT_ADDR A:0x4082e0
y.create.l HWIO_BIMC_M_APP_MPORT_BWMON2_ZONE1_MAX_BYTE_COUNT_ADDR A:0x4082e4
y.create.l HWIO_BIMC_M_APP_MPORT_BWMON2_ZONE2_MAX_BYTE_COUNT_ADDR A:0x4082e8
y.create.l HWIO_BIMC_M_APP_MPORT_BWMON2_ZONE3_MAX_BYTE_COUNT_ADDR A:0x4082ec
y.create.l HWIO_BIMC_M_APP_MPORT_BKE_ENABLE_ADDR A:0x408300
y.create.l HWIO_BIMC_M_APP_MPORT_BKE_GRANT_PERIOD_ADDR A:0x408304
y.create.l HWIO_BIMC_M_APP_MPORT_BKE_GRANT_COUNT_ADDR A:0x408308
y.create.l HWIO_BIMC_M_APP_MPORT_BKE_THRESHOLD_HIGH_ADDR A:0x408320
y.create.l HWIO_BIMC_M_APP_MPORT_BKE_THRESHOLD_MEDIUM_ADDR A:0x408324
y.create.l HWIO_BIMC_M_APP_MPORT_BKE_THRESHOLD_LOW_ADDR A:0x408328
y.create.l HWIO_BIMC_M_APP_MPORT_BKE_HEALTH_0_ADDR A:0x408340
y.create.l HWIO_BIMC_M_APP_MPORT_BKE_HEALTH_1_ADDR A:0x408344
y.create.l HWIO_BIMC_M_APP_MPORT_BKE_HEALTH_2_ADDR A:0x408348
y.create.l HWIO_BIMC_M_APP_MPORT_BKE_HEALTH_3_ADDR A:0x40834c
y.create.l HWIO_BIMC_M_APP_MPORT_STATUS_0A_ADDR A:0x408400
y.create.l HWIO_BIMC_M_APP_MPORT_STATUS_0B_ADDR A:0x408404
y.create.l HWIO_BIMC_M_APP_MPORT_STATUS_1A_ADDR A:0x408410
y.create.l HWIO_BIMC_M_APP_MPORT_STATUS_2A_ADDR A:0x408420
y.create.l HWIO_BIMC_M_APP_MPORT_STATUS_2B_ADDR A:0x408424
y.create.l HWIO_BIMC_M_APP_MPORT_STATUS_3A_ADDR A:0x408430
y.create.l HWIO_BIMC_M_APP_MPORT_STATUS_3B_ADDR A:0x408434
y.create.l HWIO_BIMC_M_APP_MPORT_BKE1_ENABLE_ADDR A:0x408800
y.create.l HWIO_BIMC_M_APP_MPORT_BKE1_GRANT_PERIOD_ADDR A:0x408804
y.create.l HWIO_BIMC_M_APP_MPORT_BKE1_GRANT_COUNT_ADDR A:0x408808
y.create.l HWIO_BIMC_M_APP_MPORT_BKE1_THRESHOLD_HIGH_ADDR A:0x408820
y.create.l HWIO_BIMC_M_APP_MPORT_BKE1_THRESHOLD_MEDIUM_ADDR A:0x408824
y.create.l HWIO_BIMC_M_APP_MPORT_BKE1_THRESHOLD_LOW_ADDR A:0x408828
y.create.l HWIO_BIMC_M_APP_MPORT_BKE1_HEALTH_0_ADDR A:0x408840
y.create.l HWIO_BIMC_M_APP_MPORT_BKE1_HEALTH_1_ADDR A:0x408844
y.create.l HWIO_BIMC_M_APP_MPORT_BKE1_HEALTH_2_ADDR A:0x408848
y.create.l HWIO_BIMC_M_APP_MPORT_BKE1_HEALTH_3_ADDR A:0x40884c
y.create.l HWIO_BIMC_M_APP_MPORT_BKE2_ENABLE_ADDR A:0x408900
y.create.l HWIO_BIMC_M_APP_MPORT_BKE2_GRANT_PERIOD_ADDR A:0x408904
y.create.l HWIO_BIMC_M_APP_MPORT_BKE2_GRANT_COUNT_ADDR A:0x408908
y.create.l HWIO_BIMC_M_APP_MPORT_BKE2_THRESHOLD_HIGH_ADDR A:0x408920
y.create.l HWIO_BIMC_M_APP_MPORT_BKE2_THRESHOLD_MEDIUM_ADDR A:0x408924
y.create.l HWIO_BIMC_M_APP_MPORT_BKE2_THRESHOLD_LOW_ADDR A:0x408928
y.create.l HWIO_BIMC_M_APP_MPORT_BKE2_HEALTH_0_ADDR A:0x408940
y.create.l HWIO_BIMC_M_APP_MPORT_BKE2_HEALTH_1_ADDR A:0x408944
y.create.l HWIO_BIMC_M_APP_MPORT_BKE2_HEALTH_2_ADDR A:0x408948
y.create.l HWIO_BIMC_M_APP_MPORT_BKE2_HEALTH_3_ADDR A:0x40894c
y.create.l HWIO_BIMC_M_APP_MPORT_BKE3_ENABLE_ADDR A:0x408a00
y.create.l HWIO_BIMC_M_APP_MPORT_BKE3_GRANT_PERIOD_ADDR A:0x408a04
y.create.l HWIO_BIMC_M_APP_MPORT_BKE3_GRANT_COUNT_ADDR A:0x408a08
y.create.l HWIO_BIMC_M_APP_MPORT_BKE3_THRESHOLD_HIGH_ADDR A:0x408a20
y.create.l HWIO_BIMC_M_APP_MPORT_BKE3_THRESHOLD_MEDIUM_ADDR A:0x408a24
y.create.l HWIO_BIMC_M_APP_MPORT_BKE3_THRESHOLD_LOW_ADDR A:0x408a28
y.create.l HWIO_BIMC_M_APP_MPORT_BKE3_HEALTH_0_ADDR A:0x408a40
y.create.l HWIO_BIMC_M_APP_MPORT_BKE3_HEALTH_1_ADDR A:0x408a44
y.create.l HWIO_BIMC_M_APP_MPORT_BKE3_HEALTH_2_ADDR A:0x408a48
y.create.l HWIO_BIMC_M_APP_MPORT_BKE3_HEALTH_3_ADDR A:0x408a4c
y.create.l HWIO_BIMC_M_APP_PROF_REG_BASE_START_ADDR A:0x409000
y.create.l HWIO_BIMC_M_APP_PROF_REG_BASE_LAST_ADDR A:0x409424
y.create.l HWIO_BIMC_M_APP_PROF_REG_BASE_END_ADDR A:0x40a000
y.create.l HWIO_BIMC_M_APP_PROF_COMPONENT_INFO_ADDR A:0x409000
y.create.l HWIO_BIMC_M_APP_PROF_CONFIGURATION_INFO_0_ADDR A:0x409020
y.create.l HWIO_BIMC_M_APP_PROF_CONFIGURATION_INFO_1_ADDR A:0x409030
y.create.l HWIO_BIMC_M_APP_PROF_CLOCK_CTRL_ADDR A:0x409200
y.create.l HWIO_BIMC_M_APP_PROF_MODE_ADDR A:0x409210
y.create.l HWIO_BIMC_M_APP_PROF_RD_TENURE_THRESHOLD_ADDR A:0x409214
y.create.l HWIO_BIMC_M_APP_PROF_WR_TENURE_THRESHOLD_ADDR A:0x409218
y.create.l HWIO_BIMC_M_APP_PROF_SWAY_SELECT_ADDR A:0x409220
y.create.l HWIO_BIMC_M_APP_PROF_MID_MASK_ADDR A:0x409230
y.create.l HWIO_BIMC_M_APP_PROF_MID_MATCH_ADDR A:0x409234
y.create.l HWIO_BIMC_M_APP_PROF_MID_INV_MATCH_ADDR A:0x409238
y.create.l HWIO_BIMC_M_APP_PROF_ADDR_MASK_LOWER_ADDR A:0x409240
y.create.l HWIO_BIMC_M_APP_PROF_ADDR_MASK_UPPER_ADDR A:0x409244
y.create.l HWIO_BIMC_M_APP_PROF_ADDR_MATCH_LOWER_ADDR A:0x409248
y.create.l HWIO_BIMC_M_APP_PROF_ADDR_MATCH_UPPER_ADDR A:0x40924c
y.create.l HWIO_BIMC_M_APP_PROF_ADDR_INV_MATCH_ADDR A:0x409250
y.create.l HWIO_BIMC_M_APP_PROF_ACH_MASK_0_ADDR A:0x409260
y.create.l HWIO_BIMC_M_APP_PROF_ACH_MATCH_0_ADDR A:0x409264
y.create.l HWIO_BIMC_M_APP_PROF_ACH_MASK_1_ADDR A:0x409270
y.create.l HWIO_BIMC_M_APP_PROF_ACH_MATCH_1_ADDR A:0x409274
y.create.l HWIO_BIMC_M_APP_PROF_ACH_INV_MATCH_1_ADDR A:0x409278
y.create.l HWIO_BIMC_M_APP_PROF_ACH_MASK_2_ADDR A:0x409280
y.create.l HWIO_BIMC_M_APP_PROF_ACH_MATCH_2_ADDR A:0x409284
y.create.l HWIO_BIMC_M_APP_PROF_ACH_MASK_3_ADDR A:0x409290
y.create.l HWIO_BIMC_M_APP_PROF_ACH_MATCH_3_ADDR A:0x409294
y.create.l HWIO_BIMC_M_APP_PROF_ACH_INV_MATCH_3_ADDR A:0x409298
y.create.l HWIO_BIMC_M_APP_PROF_ACH_MASK_4_ADDR A:0x4092a0
y.create.l HWIO_BIMC_M_APP_PROF_ACH_MATCH_4_ADDR A:0x4092a4
y.create.l HWIO_BIMC_M_APP_PROF_ACH_INV_MATCH_4_ADDR A:0x4092a8
y.create.l HWIO_BIMC_M_APP_PROF_ACH_MASK_5_ADDR A:0x4092b0
y.create.l HWIO_BIMC_M_APP_PROF_ACH_MATCH_5_ADDR A:0x4092b4
y.create.l HWIO_BIMC_M_APP_PROF_BCH_MASK_ADDR A:0x409300
y.create.l HWIO_BIMC_M_APP_PROF_BCH_MATCH_ADDR A:0x409304
y.create.l HWIO_BIMC_M_APP_PROF_BCH_INV_MATCH_ADDR A:0x409308
y.create.l HWIO_BIMC_M_APP_PROF_RCH_MASK_ADDR A:0x409340
y.create.l HWIO_BIMC_M_APP_PROF_RCH_MATCH_ADDR A:0x409344
y.create.l HWIO_BIMC_M_APP_PROF_RCH_INV_MATCH_ADDR A:0x409348
y.create.l HWIO_BIMC_M_APP_PROF_RD_STATUS_0_ADDR A:0x409400
y.create.l HWIO_BIMC_M_APP_PROF_RD_STATUS_1_ADDR A:0x409404
y.create.l HWIO_BIMC_M_APP_PROF_WR_STATUS_0_ADDR A:0x409410
y.create.l HWIO_BIMC_M_APP_PROF_WR_STATUS_1_ADDR A:0x409414
y.create.l HWIO_BIMC_M_APP_PROF_TENURES_MISSED_0_ADDR A:0x409420
y.create.l HWIO_BIMC_M_APP_PROF_TENURES_MISSED_1_ADDR A:0x409424
y.create.l HWIO_BIMC_M_DSP_MPORT_REG_BASE_START_ADDR A:0x40c000
y.create.l HWIO_BIMC_M_DSP_MPORT_REG_BASE_LAST_ADDR A:0x40ca4c
y.create.l HWIO_BIMC_M_DSP_MPORT_REG_BASE_END_ADDR A:0x40d000
y.create.l HWIO_BIMC_M_DSP_MPORT_COMPONENT_INFO_ADDR A:0x40c000
y.create.l HWIO_BIMC_M_DSP_MPORT_CONFIGURATION_INFO_0_ADDR A:0x40c020
y.create.l HWIO_BIMC_M_DSP_MPORT_CONFIGURATION_INFO_1_ADDR A:0x40c030
y.create.l HWIO_BIMC_M_DSP_MPORT_CONFIGURATION_INFO_2A_ADDR A:0x40c040
y.create.l HWIO_BIMC_M_DSP_MPORT_CONFIGURATION_INFO_2B_ADDR A:0x40c044
y.create.l HWIO_BIMC_M_DSP_MPORT_CONFIGURATION_INFO_3_ADDR A:0x40c050
y.create.l HWIO_BIMC_M_DSP_MPORT_CONFIGURATION_INFO_4_ADDR A:0x40c060
y.create.l HWIO_BIMC_M_DSP_MPORT_CONFIGURATION_INFO_5A_ADDR A:0x40c070
y.create.l HWIO_BIMC_M_DSP_MPORT_CONFIGURATION_INFO_5B_ADDR A:0x40c074
y.create.l HWIO_BIMC_M_DSP_MPORT_CONFIGURATION_INFO_5C_ADDR A:0x40c078
y.create.l HWIO_BIMC_M_DSP_MPORT_CONFIGURATION_INFO_5D_ADDR A:0x40c07c
y.create.l HWIO_BIMC_M_DSP_MPORT_INTERRUPT_STATUS_ADDR A:0x40c100
y.create.l HWIO_BIMC_M_DSP_MPORT_INTERRUPT_CLEAR_ADDR A:0x40c108
y.create.l HWIO_BIMC_M_DSP_MPORT_INTERRUPT_ENABLE_ADDR A:0x40c10c
y.create.l HWIO_BIMC_M_DSP_MPORT_CLOCK_CTRL_ADDR A:0x40c200
y.create.l HWIO_BIMC_M_DSP_MPORT_CDC_CTRL_ADDR A:0x40c208
y.create.l HWIO_BIMC_M_DSP_MPORT_MODE_ADDR A:0x40c210
y.create.l HWIO_BIMC_M_DSP_MPORT_REDIRECT_CTRL_ADDR A:0x40c218
y.create.l HWIO_BIMC_M_DSP_MPORT_WR_WAY_CROSSING_ADDR A:0x40c220
y.create.l HWIO_BIMC_M_DSP_MPORT_PRIORITYLVL_OVERRIDE_ADDR A:0x40c230
y.create.l HWIO_BIMC_M_DSP_MPORT_READ_COMMAND_OVERRIDE_ADDR A:0x40c240
y.create.l HWIO_BIMC_M_DSP_MPORT_WRITE_COMMAND_OVERRIDE_0_ADDR A:0x40c250
y.create.l HWIO_BIMC_M_DSP_MPORT_WRITE_COMMAND_OVERRIDE_1_ADDR A:0x40c254
y.create.l HWIO_BIMC_M_DSP_MPORT_RD_TRACKING_INDEX_ADDR A:0x40c270
y.create.l HWIO_BIMC_M_DSP_MPORT_WR_TRACKING_INDEX_ADDR A:0x40c274
y.create.l HWIO_BIMC_M_DSP_MPORT_BAMON_ADDR A:0x40c278
y.create.l HWIO_BIMC_M_DSP_MPORT_BWMON_ENABLE_ADDR A:0x40c280
y.create.l HWIO_BIMC_M_DSP_MPORT_BWMON_CLEAR_ADDR A:0x40c284
y.create.l HWIO_BIMC_M_DSP_MPORT_BWMON_BYTE_COUNT_ADDR A:0x40c288
y.create.l HWIO_BIMC_M_DSP_MPORT_BWMON_THRESHOLD_ADDR A:0x40c290
y.create.l HWIO_BIMC_M_DSP_MPORT_BWMON_MID_MASK_ADDR A:0x40c298
y.create.l HWIO_BIMC_M_DSP_MPORT_BWMON_MID_MATCH_ADDR A:0x40c29c
y.create.l HWIO_BIMC_M_DSP_MPORT_BKE_ENABLE_ADDR A:0x40c300
y.create.l HWIO_BIMC_M_DSP_MPORT_BKE_GRANT_PERIOD_ADDR A:0x40c304
y.create.l HWIO_BIMC_M_DSP_MPORT_BKE_GRANT_COUNT_ADDR A:0x40c308
y.create.l HWIO_BIMC_M_DSP_MPORT_BKE_THRESHOLD_HIGH_ADDR A:0x40c320
y.create.l HWIO_BIMC_M_DSP_MPORT_BKE_THRESHOLD_MEDIUM_ADDR A:0x40c324
y.create.l HWIO_BIMC_M_DSP_MPORT_BKE_THRESHOLD_LOW_ADDR A:0x40c328
y.create.l HWIO_BIMC_M_DSP_MPORT_BKE_HEALTH_0_ADDR A:0x40c340
y.create.l HWIO_BIMC_M_DSP_MPORT_BKE_HEALTH_1_ADDR A:0x40c344
y.create.l HWIO_BIMC_M_DSP_MPORT_BKE_HEALTH_2_ADDR A:0x40c348
y.create.l HWIO_BIMC_M_DSP_MPORT_BKE_HEALTH_3_ADDR A:0x40c34c
y.create.l HWIO_BIMC_M_DSP_MPORT_STATUS_0A_ADDR A:0x40c400
y.create.l HWIO_BIMC_M_DSP_MPORT_STATUS_0B_ADDR A:0x40c404
y.create.l HWIO_BIMC_M_DSP_MPORT_STATUS_1A_ADDR A:0x40c410
y.create.l HWIO_BIMC_M_DSP_MPORT_STATUS_2A_ADDR A:0x40c420
y.create.l HWIO_BIMC_M_DSP_MPORT_STATUS_2B_ADDR A:0x40c424
y.create.l HWIO_BIMC_M_DSP_MPORT_STATUS_3A_ADDR A:0x40c430
y.create.l HWIO_BIMC_M_DSP_MPORT_STATUS_3B_ADDR A:0x40c434
y.create.l HWIO_BIMC_M_DSP_MPORT_BKE1_ENABLE_ADDR A:0x40c800
y.create.l HWIO_BIMC_M_DSP_MPORT_BKE1_GRANT_PERIOD_ADDR A:0x40c804
y.create.l HWIO_BIMC_M_DSP_MPORT_BKE1_GRANT_COUNT_ADDR A:0x40c808
y.create.l HWIO_BIMC_M_DSP_MPORT_BKE1_THRESHOLD_HIGH_ADDR A:0x40c820
y.create.l HWIO_BIMC_M_DSP_MPORT_BKE1_THRESHOLD_MEDIUM_ADDR A:0x40c824
y.create.l HWIO_BIMC_M_DSP_MPORT_BKE1_THRESHOLD_LOW_ADDR A:0x40c828
y.create.l HWIO_BIMC_M_DSP_MPORT_BKE1_HEALTH_0_ADDR A:0x40c840
y.create.l HWIO_BIMC_M_DSP_MPORT_BKE1_HEALTH_1_ADDR A:0x40c844
y.create.l HWIO_BIMC_M_DSP_MPORT_BKE1_HEALTH_2_ADDR A:0x40c848
y.create.l HWIO_BIMC_M_DSP_MPORT_BKE1_HEALTH_3_ADDR A:0x40c84c
y.create.l HWIO_BIMC_M_DSP_MPORT_BKE2_ENABLE_ADDR A:0x40c900
y.create.l HWIO_BIMC_M_DSP_MPORT_BKE2_GRANT_PERIOD_ADDR A:0x40c904
y.create.l HWIO_BIMC_M_DSP_MPORT_BKE2_GRANT_COUNT_ADDR A:0x40c908
y.create.l HWIO_BIMC_M_DSP_MPORT_BKE2_THRESHOLD_HIGH_ADDR A:0x40c920
y.create.l HWIO_BIMC_M_DSP_MPORT_BKE2_THRESHOLD_MEDIUM_ADDR A:0x40c924
y.create.l HWIO_BIMC_M_DSP_MPORT_BKE2_THRESHOLD_LOW_ADDR A:0x40c928
y.create.l HWIO_BIMC_M_DSP_MPORT_BKE2_HEALTH_0_ADDR A:0x40c940
y.create.l HWIO_BIMC_M_DSP_MPORT_BKE2_HEALTH_1_ADDR A:0x40c944
y.create.l HWIO_BIMC_M_DSP_MPORT_BKE2_HEALTH_2_ADDR A:0x40c948
y.create.l HWIO_BIMC_M_DSP_MPORT_BKE2_HEALTH_3_ADDR A:0x40c94c
y.create.l HWIO_BIMC_M_DSP_MPORT_BKE3_ENABLE_ADDR A:0x40ca00
y.create.l HWIO_BIMC_M_DSP_MPORT_BKE3_GRANT_PERIOD_ADDR A:0x40ca04
y.create.l HWIO_BIMC_M_DSP_MPORT_BKE3_GRANT_COUNT_ADDR A:0x40ca08
y.create.l HWIO_BIMC_M_DSP_MPORT_BKE3_THRESHOLD_HIGH_ADDR A:0x40ca20
y.create.l HWIO_BIMC_M_DSP_MPORT_BKE3_THRESHOLD_MEDIUM_ADDR A:0x40ca24
y.create.l HWIO_BIMC_M_DSP_MPORT_BKE3_THRESHOLD_LOW_ADDR A:0x40ca28
y.create.l HWIO_BIMC_M_DSP_MPORT_BKE3_HEALTH_0_ADDR A:0x40ca40
y.create.l HWIO_BIMC_M_DSP_MPORT_BKE3_HEALTH_1_ADDR A:0x40ca44
y.create.l HWIO_BIMC_M_DSP_MPORT_BKE3_HEALTH_2_ADDR A:0x40ca48
y.create.l HWIO_BIMC_M_DSP_MPORT_BKE3_HEALTH_3_ADDR A:0x40ca4c
y.create.l HWIO_BIMC_M_DSP_PROF_REG_BASE_START_ADDR A:0x40d000
y.create.l HWIO_BIMC_M_DSP_PROF_REG_BASE_LAST_ADDR A:0x40d424
y.create.l HWIO_BIMC_M_DSP_PROF_REG_BASE_END_ADDR A:0x40e000
y.create.l HWIO_BIMC_M_DSP_PROF_COMPONENT_INFO_ADDR A:0x40d000
y.create.l HWIO_BIMC_M_DSP_PROF_CONFIGURATION_INFO_0_ADDR A:0x40d020
y.create.l HWIO_BIMC_M_DSP_PROF_CONFIGURATION_INFO_1_ADDR A:0x40d030
y.create.l HWIO_BIMC_M_DSP_PROF_CLOCK_CTRL_ADDR A:0x40d200
y.create.l HWIO_BIMC_M_DSP_PROF_MODE_ADDR A:0x40d210
y.create.l HWIO_BIMC_M_DSP_PROF_RD_TENURE_THRESHOLD_ADDR A:0x40d214
y.create.l HWIO_BIMC_M_DSP_PROF_WR_TENURE_THRESHOLD_ADDR A:0x40d218
y.create.l HWIO_BIMC_M_DSP_PROF_SWAY_SELECT_ADDR A:0x40d220
y.create.l HWIO_BIMC_M_DSP_PROF_MID_MASK_ADDR A:0x40d230
y.create.l HWIO_BIMC_M_DSP_PROF_MID_MATCH_ADDR A:0x40d234
y.create.l HWIO_BIMC_M_DSP_PROF_MID_INV_MATCH_ADDR A:0x40d238
y.create.l HWIO_BIMC_M_DSP_PROF_ADDR_MASK_LOWER_ADDR A:0x40d240
y.create.l HWIO_BIMC_M_DSP_PROF_ADDR_MASK_UPPER_ADDR A:0x40d244
y.create.l HWIO_BIMC_M_DSP_PROF_ADDR_MATCH_LOWER_ADDR A:0x40d248
y.create.l HWIO_BIMC_M_DSP_PROF_ADDR_MATCH_UPPER_ADDR A:0x40d24c
y.create.l HWIO_BIMC_M_DSP_PROF_ADDR_INV_MATCH_ADDR A:0x40d250
y.create.l HWIO_BIMC_M_DSP_PROF_ACH_MASK_0_ADDR A:0x40d260
y.create.l HWIO_BIMC_M_DSP_PROF_ACH_MATCH_0_ADDR A:0x40d264
y.create.l HWIO_BIMC_M_DSP_PROF_ACH_MASK_1_ADDR A:0x40d270
y.create.l HWIO_BIMC_M_DSP_PROF_ACH_MATCH_1_ADDR A:0x40d274
y.create.l HWIO_BIMC_M_DSP_PROF_ACH_INV_MATCH_1_ADDR A:0x40d278
y.create.l HWIO_BIMC_M_DSP_PROF_ACH_MASK_2_ADDR A:0x40d280
y.create.l HWIO_BIMC_M_DSP_PROF_ACH_MATCH_2_ADDR A:0x40d284
y.create.l HWIO_BIMC_M_DSP_PROF_ACH_MASK_3_ADDR A:0x40d290
y.create.l HWIO_BIMC_M_DSP_PROF_ACH_MATCH_3_ADDR A:0x40d294
y.create.l HWIO_BIMC_M_DSP_PROF_ACH_INV_MATCH_3_ADDR A:0x40d298
y.create.l HWIO_BIMC_M_DSP_PROF_ACH_MASK_4_ADDR A:0x40d2a0
y.create.l HWIO_BIMC_M_DSP_PROF_ACH_MATCH_4_ADDR A:0x40d2a4
y.create.l HWIO_BIMC_M_DSP_PROF_ACH_INV_MATCH_4_ADDR A:0x40d2a8
y.create.l HWIO_BIMC_M_DSP_PROF_ACH_MASK_5_ADDR A:0x40d2b0
y.create.l HWIO_BIMC_M_DSP_PROF_ACH_MATCH_5_ADDR A:0x40d2b4
y.create.l HWIO_BIMC_M_DSP_PROF_BCH_MASK_ADDR A:0x40d300
y.create.l HWIO_BIMC_M_DSP_PROF_BCH_MATCH_ADDR A:0x40d304
y.create.l HWIO_BIMC_M_DSP_PROF_BCH_INV_MATCH_ADDR A:0x40d308
y.create.l HWIO_BIMC_M_DSP_PROF_RCH_MASK_ADDR A:0x40d340
y.create.l HWIO_BIMC_M_DSP_PROF_RCH_MATCH_ADDR A:0x40d344
y.create.l HWIO_BIMC_M_DSP_PROF_RCH_INV_MATCH_ADDR A:0x40d348
y.create.l HWIO_BIMC_M_DSP_PROF_RD_STATUS_0_ADDR A:0x40d400
y.create.l HWIO_BIMC_M_DSP_PROF_RD_STATUS_1_ADDR A:0x40d404
y.create.l HWIO_BIMC_M_DSP_PROF_WR_STATUS_0_ADDR A:0x40d410
y.create.l HWIO_BIMC_M_DSP_PROF_WR_STATUS_1_ADDR A:0x40d414
y.create.l HWIO_BIMC_M_DSP_PROF_TENURES_MISSED_0_ADDR A:0x40d420
y.create.l HWIO_BIMC_M_DSP_PROF_TENURES_MISSED_1_ADDR A:0x40d424
y.create.l HWIO_BIMC_M_MCDMA_MPORT_REG_BASE_START_ADDR A:0x410000
y.create.l HWIO_BIMC_M_MCDMA_MPORT_REG_BASE_LAST_ADDR A:0x410a4c
y.create.l HWIO_BIMC_M_MCDMA_MPORT_REG_BASE_END_ADDR A:0x411000
y.create.l HWIO_BIMC_M_MCDMA_MPORT_COMPONENT_INFO_ADDR A:0x410000
y.create.l HWIO_BIMC_M_MCDMA_MPORT_CONFIGURATION_INFO_0_ADDR A:0x410020
y.create.l HWIO_BIMC_M_MCDMA_MPORT_CONFIGURATION_INFO_1_ADDR A:0x410030
y.create.l HWIO_BIMC_M_MCDMA_MPORT_CONFIGURATION_INFO_2A_ADDR A:0x410040
y.create.l HWIO_BIMC_M_MCDMA_MPORT_CONFIGURATION_INFO_2B_ADDR A:0x410044
y.create.l HWIO_BIMC_M_MCDMA_MPORT_CONFIGURATION_INFO_3_ADDR A:0x410050
y.create.l HWIO_BIMC_M_MCDMA_MPORT_CONFIGURATION_INFO_4_ADDR A:0x410060
y.create.l HWIO_BIMC_M_MCDMA_MPORT_CONFIGURATION_INFO_5A_ADDR A:0x410070
y.create.l HWIO_BIMC_M_MCDMA_MPORT_CONFIGURATION_INFO_5B_ADDR A:0x410074
y.create.l HWIO_BIMC_M_MCDMA_MPORT_CONFIGURATION_INFO_5C_ADDR A:0x410078
y.create.l HWIO_BIMC_M_MCDMA_MPORT_CONFIGURATION_INFO_5D_ADDR A:0x41007c
y.create.l HWIO_BIMC_M_MCDMA_MPORT_INTERRUPT_STATUS_ADDR A:0x410100
y.create.l HWIO_BIMC_M_MCDMA_MPORT_INTERRUPT_CLEAR_ADDR A:0x410108
y.create.l HWIO_BIMC_M_MCDMA_MPORT_INTERRUPT_ENABLE_ADDR A:0x41010c
y.create.l HWIO_BIMC_M_MCDMA_MPORT_CLOCK_CTRL_ADDR A:0x410200
y.create.l HWIO_BIMC_M_MCDMA_MPORT_CDC_CTRL_ADDR A:0x410208
y.create.l HWIO_BIMC_M_MCDMA_MPORT_MODE_ADDR A:0x410210
y.create.l HWIO_BIMC_M_MCDMA_MPORT_REDIRECT_CTRL_ADDR A:0x410218
y.create.l HWIO_BIMC_M_MCDMA_MPORT_WR_WAY_CROSSING_ADDR A:0x410220
y.create.l HWIO_BIMC_M_MCDMA_MPORT_PRIORITYLVL_OVERRIDE_ADDR A:0x410230
y.create.l HWIO_BIMC_M_MCDMA_MPORT_READ_COMMAND_OVERRIDE_ADDR A:0x410240
y.create.l HWIO_BIMC_M_MCDMA_MPORT_WRITE_COMMAND_OVERRIDE_0_ADDR A:0x410250
y.create.l HWIO_BIMC_M_MCDMA_MPORT_WRITE_COMMAND_OVERRIDE_1_ADDR A:0x410254
y.create.l HWIO_BIMC_M_MCDMA_MPORT_RD_TRACKING_INDEX_ADDR A:0x410270
y.create.l HWIO_BIMC_M_MCDMA_MPORT_WR_TRACKING_INDEX_ADDR A:0x410274
y.create.l HWIO_BIMC_M_MCDMA_MPORT_BAMON_ADDR A:0x410278
y.create.l HWIO_BIMC_M_MCDMA_MPORT_BWMON_ENABLE_ADDR A:0x410280
y.create.l HWIO_BIMC_M_MCDMA_MPORT_BWMON_CLEAR_ADDR A:0x410284
y.create.l HWIO_BIMC_M_MCDMA_MPORT_BWMON_BYTE_COUNT_ADDR A:0x410288
y.create.l HWIO_BIMC_M_MCDMA_MPORT_BWMON_THRESHOLD_ADDR A:0x410290
y.create.l HWIO_BIMC_M_MCDMA_MPORT_BWMON_MID_MASK_ADDR A:0x410298
y.create.l HWIO_BIMC_M_MCDMA_MPORT_BWMON_MID_MATCH_ADDR A:0x41029c
y.create.l HWIO_BIMC_M_MCDMA_MPORT_BKE_ENABLE_ADDR A:0x410300
y.create.l HWIO_BIMC_M_MCDMA_MPORT_BKE_GRANT_PERIOD_ADDR A:0x410304
y.create.l HWIO_BIMC_M_MCDMA_MPORT_BKE_GRANT_COUNT_ADDR A:0x410308
y.create.l HWIO_BIMC_M_MCDMA_MPORT_BKE_THRESHOLD_HIGH_ADDR A:0x410320
y.create.l HWIO_BIMC_M_MCDMA_MPORT_BKE_THRESHOLD_MEDIUM_ADDR A:0x410324
y.create.l HWIO_BIMC_M_MCDMA_MPORT_BKE_THRESHOLD_LOW_ADDR A:0x410328
y.create.l HWIO_BIMC_M_MCDMA_MPORT_BKE_HEALTH_0_ADDR A:0x410340
y.create.l HWIO_BIMC_M_MCDMA_MPORT_BKE_HEALTH_1_ADDR A:0x410344
y.create.l HWIO_BIMC_M_MCDMA_MPORT_BKE_HEALTH_2_ADDR A:0x410348
y.create.l HWIO_BIMC_M_MCDMA_MPORT_BKE_HEALTH_3_ADDR A:0x41034c
y.create.l HWIO_BIMC_M_MCDMA_MPORT_STATUS_0A_ADDR A:0x410400
y.create.l HWIO_BIMC_M_MCDMA_MPORT_STATUS_0B_ADDR A:0x410404
y.create.l HWIO_BIMC_M_MCDMA_MPORT_STATUS_1A_ADDR A:0x410410
y.create.l HWIO_BIMC_M_MCDMA_MPORT_STATUS_2A_ADDR A:0x410420
y.create.l HWIO_BIMC_M_MCDMA_MPORT_STATUS_2B_ADDR A:0x410424
y.create.l HWIO_BIMC_M_MCDMA_MPORT_STATUS_3A_ADDR A:0x410430
y.create.l HWIO_BIMC_M_MCDMA_MPORT_STATUS_3B_ADDR A:0x410434
y.create.l HWIO_BIMC_M_MCDMA_MPORT_BKE1_ENABLE_ADDR A:0x410800
y.create.l HWIO_BIMC_M_MCDMA_MPORT_BKE1_GRANT_PERIOD_ADDR A:0x410804
y.create.l HWIO_BIMC_M_MCDMA_MPORT_BKE1_GRANT_COUNT_ADDR A:0x410808
y.create.l HWIO_BIMC_M_MCDMA_MPORT_BKE1_THRESHOLD_HIGH_ADDR A:0x410820
y.create.l HWIO_BIMC_M_MCDMA_MPORT_BKE1_THRESHOLD_MEDIUM_ADDR A:0x410824
y.create.l HWIO_BIMC_M_MCDMA_MPORT_BKE1_THRESHOLD_LOW_ADDR A:0x410828
y.create.l HWIO_BIMC_M_MCDMA_MPORT_BKE1_HEALTH_0_ADDR A:0x410840
y.create.l HWIO_BIMC_M_MCDMA_MPORT_BKE1_HEALTH_1_ADDR A:0x410844
y.create.l HWIO_BIMC_M_MCDMA_MPORT_BKE1_HEALTH_2_ADDR A:0x410848
y.create.l HWIO_BIMC_M_MCDMA_MPORT_BKE1_HEALTH_3_ADDR A:0x41084c
y.create.l HWIO_BIMC_M_MCDMA_MPORT_BKE2_ENABLE_ADDR A:0x410900
y.create.l HWIO_BIMC_M_MCDMA_MPORT_BKE2_GRANT_PERIOD_ADDR A:0x410904
y.create.l HWIO_BIMC_M_MCDMA_MPORT_BKE2_GRANT_COUNT_ADDR A:0x410908
y.create.l HWIO_BIMC_M_MCDMA_MPORT_BKE2_THRESHOLD_HIGH_ADDR A:0x410920
y.create.l HWIO_BIMC_M_MCDMA_MPORT_BKE2_THRESHOLD_MEDIUM_ADDR A:0x410924
y.create.l HWIO_BIMC_M_MCDMA_MPORT_BKE2_THRESHOLD_LOW_ADDR A:0x410928
y.create.l HWIO_BIMC_M_MCDMA_MPORT_BKE2_HEALTH_0_ADDR A:0x410940
y.create.l HWIO_BIMC_M_MCDMA_MPORT_BKE2_HEALTH_1_ADDR A:0x410944
y.create.l HWIO_BIMC_M_MCDMA_MPORT_BKE2_HEALTH_2_ADDR A:0x410948
y.create.l HWIO_BIMC_M_MCDMA_MPORT_BKE2_HEALTH_3_ADDR A:0x41094c
y.create.l HWIO_BIMC_M_MCDMA_MPORT_BKE3_ENABLE_ADDR A:0x410a00
y.create.l HWIO_BIMC_M_MCDMA_MPORT_BKE3_GRANT_PERIOD_ADDR A:0x410a04
y.create.l HWIO_BIMC_M_MCDMA_MPORT_BKE3_GRANT_COUNT_ADDR A:0x410a08
y.create.l HWIO_BIMC_M_MCDMA_MPORT_BKE3_THRESHOLD_HIGH_ADDR A:0x410a20
y.create.l HWIO_BIMC_M_MCDMA_MPORT_BKE3_THRESHOLD_MEDIUM_ADDR A:0x410a24
y.create.l HWIO_BIMC_M_MCDMA_MPORT_BKE3_THRESHOLD_LOW_ADDR A:0x410a28
y.create.l HWIO_BIMC_M_MCDMA_MPORT_BKE3_HEALTH_0_ADDR A:0x410a40
y.create.l HWIO_BIMC_M_MCDMA_MPORT_BKE3_HEALTH_1_ADDR A:0x410a44
y.create.l HWIO_BIMC_M_MCDMA_MPORT_BKE3_HEALTH_2_ADDR A:0x410a48
y.create.l HWIO_BIMC_M_MCDMA_MPORT_BKE3_HEALTH_3_ADDR A:0x410a4c
y.create.l HWIO_BIMC_M_MCDMA_PROF_REG_BASE_START_ADDR A:0x411000
y.create.l HWIO_BIMC_M_MCDMA_PROF_REG_BASE_LAST_ADDR A:0x411424
y.create.l HWIO_BIMC_M_MCDMA_PROF_REG_BASE_END_ADDR A:0x412000
y.create.l HWIO_BIMC_M_MCDMA_PROF_COMPONENT_INFO_ADDR A:0x411000
y.create.l HWIO_BIMC_M_MCDMA_PROF_CONFIGURATION_INFO_0_ADDR A:0x411020
y.create.l HWIO_BIMC_M_MCDMA_PROF_CONFIGURATION_INFO_1_ADDR A:0x411030
y.create.l HWIO_BIMC_M_MCDMA_PROF_CLOCK_CTRL_ADDR A:0x411200
y.create.l HWIO_BIMC_M_MCDMA_PROF_MODE_ADDR A:0x411210
y.create.l HWIO_BIMC_M_MCDMA_PROF_RD_TENURE_THRESHOLD_ADDR A:0x411214
y.create.l HWIO_BIMC_M_MCDMA_PROF_WR_TENURE_THRESHOLD_ADDR A:0x411218
y.create.l HWIO_BIMC_M_MCDMA_PROF_SWAY_SELECT_ADDR A:0x411220
y.create.l HWIO_BIMC_M_MCDMA_PROF_MID_MASK_ADDR A:0x411230
y.create.l HWIO_BIMC_M_MCDMA_PROF_MID_MATCH_ADDR A:0x411234
y.create.l HWIO_BIMC_M_MCDMA_PROF_MID_INV_MATCH_ADDR A:0x411238
y.create.l HWIO_BIMC_M_MCDMA_PROF_ADDR_MASK_LOWER_ADDR A:0x411240
y.create.l HWIO_BIMC_M_MCDMA_PROF_ADDR_MASK_UPPER_ADDR A:0x411244
y.create.l HWIO_BIMC_M_MCDMA_PROF_ADDR_MATCH_LOWER_ADDR A:0x411248
y.create.l HWIO_BIMC_M_MCDMA_PROF_ADDR_MATCH_UPPER_ADDR A:0x41124c
y.create.l HWIO_BIMC_M_MCDMA_PROF_ADDR_INV_MATCH_ADDR A:0x411250
y.create.l HWIO_BIMC_M_MCDMA_PROF_ACH_MASK_0_ADDR A:0x411260
y.create.l HWIO_BIMC_M_MCDMA_PROF_ACH_MATCH_0_ADDR A:0x411264
y.create.l HWIO_BIMC_M_MCDMA_PROF_ACH_MASK_1_ADDR A:0x411270
y.create.l HWIO_BIMC_M_MCDMA_PROF_ACH_MATCH_1_ADDR A:0x411274
y.create.l HWIO_BIMC_M_MCDMA_PROF_ACH_INV_MATCH_1_ADDR A:0x411278
y.create.l HWIO_BIMC_M_MCDMA_PROF_ACH_MASK_2_ADDR A:0x411280
y.create.l HWIO_BIMC_M_MCDMA_PROF_ACH_MATCH_2_ADDR A:0x411284
y.create.l HWIO_BIMC_M_MCDMA_PROF_ACH_MASK_3_ADDR A:0x411290
y.create.l HWIO_BIMC_M_MCDMA_PROF_ACH_MATCH_3_ADDR A:0x411294
y.create.l HWIO_BIMC_M_MCDMA_PROF_ACH_INV_MATCH_3_ADDR A:0x411298
y.create.l HWIO_BIMC_M_MCDMA_PROF_ACH_MASK_4_ADDR A:0x4112a0
y.create.l HWIO_BIMC_M_MCDMA_PROF_ACH_MATCH_4_ADDR A:0x4112a4
y.create.l HWIO_BIMC_M_MCDMA_PROF_ACH_INV_MATCH_4_ADDR A:0x4112a8
y.create.l HWIO_BIMC_M_MCDMA_PROF_ACH_MASK_5_ADDR A:0x4112b0
y.create.l HWIO_BIMC_M_MCDMA_PROF_ACH_MATCH_5_ADDR A:0x4112b4
y.create.l HWIO_BIMC_M_MCDMA_PROF_BCH_MASK_ADDR A:0x411300
y.create.l HWIO_BIMC_M_MCDMA_PROF_BCH_MATCH_ADDR A:0x411304
y.create.l HWIO_BIMC_M_MCDMA_PROF_BCH_INV_MATCH_ADDR A:0x411308
y.create.l HWIO_BIMC_M_MCDMA_PROF_RCH_MASK_ADDR A:0x411340
y.create.l HWIO_BIMC_M_MCDMA_PROF_RCH_MATCH_ADDR A:0x411344
y.create.l HWIO_BIMC_M_MCDMA_PROF_RCH_INV_MATCH_ADDR A:0x411348
y.create.l HWIO_BIMC_M_MCDMA_PROF_RD_STATUS_0_ADDR A:0x411400
y.create.l HWIO_BIMC_M_MCDMA_PROF_RD_STATUS_1_ADDR A:0x411404
y.create.l HWIO_BIMC_M_MCDMA_PROF_WR_STATUS_0_ADDR A:0x411410
y.create.l HWIO_BIMC_M_MCDMA_PROF_WR_STATUS_1_ADDR A:0x411414
y.create.l HWIO_BIMC_M_MCDMA_PROF_TENURES_MISSED_0_ADDR A:0x411420
y.create.l HWIO_BIMC_M_MCDMA_PROF_TENURES_MISSED_1_ADDR A:0x411424
y.create.l HWIO_BIMC_M_SYS_MPORT_REG_BASE_START_ADDR A:0x414000
y.create.l HWIO_BIMC_M_SYS_MPORT_REG_BASE_LAST_ADDR A:0x414a4c
y.create.l HWIO_BIMC_M_SYS_MPORT_REG_BASE_END_ADDR A:0x415000
y.create.l HWIO_BIMC_M_SYS_MPORT_COMPONENT_INFO_ADDR A:0x414000
y.create.l HWIO_BIMC_M_SYS_MPORT_CONFIGURATION_INFO_0_ADDR A:0x414020
y.create.l HWIO_BIMC_M_SYS_MPORT_CONFIGURATION_INFO_1_ADDR A:0x414030
y.create.l HWIO_BIMC_M_SYS_MPORT_CONFIGURATION_INFO_2A_ADDR A:0x414040
y.create.l HWIO_BIMC_M_SYS_MPORT_CONFIGURATION_INFO_2B_ADDR A:0x414044
y.create.l HWIO_BIMC_M_SYS_MPORT_CONFIGURATION_INFO_3_ADDR A:0x414050
y.create.l HWIO_BIMC_M_SYS_MPORT_CONFIGURATION_INFO_4_ADDR A:0x414060
y.create.l HWIO_BIMC_M_SYS_MPORT_CONFIGURATION_INFO_5A_ADDR A:0x414070
y.create.l HWIO_BIMC_M_SYS_MPORT_CONFIGURATION_INFO_5B_ADDR A:0x414074
y.create.l HWIO_BIMC_M_SYS_MPORT_CONFIGURATION_INFO_5C_ADDR A:0x414078
y.create.l HWIO_BIMC_M_SYS_MPORT_CONFIGURATION_INFO_5D_ADDR A:0x41407c
y.create.l HWIO_BIMC_M_SYS_MPORT_INTERRUPT_STATUS_ADDR A:0x414100
y.create.l HWIO_BIMC_M_SYS_MPORT_INTERRUPT_CLEAR_ADDR A:0x414108
y.create.l HWIO_BIMC_M_SYS_MPORT_INTERRUPT_ENABLE_ADDR A:0x41410c
y.create.l HWIO_BIMC_M_SYS_MPORT_CLOCK_CTRL_ADDR A:0x414200
y.create.l HWIO_BIMC_M_SYS_MPORT_CDC_CTRL_ADDR A:0x414208
y.create.l HWIO_BIMC_M_SYS_MPORT_MODE_ADDR A:0x414210
y.create.l HWIO_BIMC_M_SYS_MPORT_REDIRECT_CTRL_ADDR A:0x414218
y.create.l HWIO_BIMC_M_SYS_MPORT_WR_WAY_CROSSING_ADDR A:0x414220
y.create.l HWIO_BIMC_M_SYS_MPORT_PRIORITYLVL_OVERRIDE_ADDR A:0x414230
y.create.l HWIO_BIMC_M_SYS_MPORT_READ_COMMAND_OVERRIDE_ADDR A:0x414240
y.create.l HWIO_BIMC_M_SYS_MPORT_WRITE_COMMAND_OVERRIDE_0_ADDR A:0x414250
y.create.l HWIO_BIMC_M_SYS_MPORT_WRITE_COMMAND_OVERRIDE_1_ADDR A:0x414254
y.create.l HWIO_BIMC_M_SYS_MPORT_RD_TRACKING_INDEX_ADDR A:0x414270
y.create.l HWIO_BIMC_M_SYS_MPORT_WR_TRACKING_INDEX_ADDR A:0x414274
y.create.l HWIO_BIMC_M_SYS_MPORT_BAMON_ADDR A:0x414278
y.create.l HWIO_BIMC_M_SYS_MPORT_BWMON_ENABLE_ADDR A:0x414280
y.create.l HWIO_BIMC_M_SYS_MPORT_BWMON_CLEAR_ADDR A:0x414284
y.create.l HWIO_BIMC_M_SYS_MPORT_BWMON_BYTE_COUNT_ADDR A:0x414288
y.create.l HWIO_BIMC_M_SYS_MPORT_BWMON_THRESHOLD_ADDR A:0x414290
y.create.l HWIO_BIMC_M_SYS_MPORT_BWMON_MID_MASK_ADDR A:0x414298
y.create.l HWIO_BIMC_M_SYS_MPORT_BWMON_MID_MATCH_ADDR A:0x41429c
y.create.l HWIO_BIMC_M_SYS_MPORT_BKE_ENABLE_ADDR A:0x414300
y.create.l HWIO_BIMC_M_SYS_MPORT_BKE_GRANT_PERIOD_ADDR A:0x414304
y.create.l HWIO_BIMC_M_SYS_MPORT_BKE_GRANT_COUNT_ADDR A:0x414308
y.create.l HWIO_BIMC_M_SYS_MPORT_BKE_THRESHOLD_HIGH_ADDR A:0x414320
y.create.l HWIO_BIMC_M_SYS_MPORT_BKE_THRESHOLD_MEDIUM_ADDR A:0x414324
y.create.l HWIO_BIMC_M_SYS_MPORT_BKE_THRESHOLD_LOW_ADDR A:0x414328
y.create.l HWIO_BIMC_M_SYS_MPORT_BKE_HEALTH_0_ADDR A:0x414340
y.create.l HWIO_BIMC_M_SYS_MPORT_BKE_HEALTH_1_ADDR A:0x414344
y.create.l HWIO_BIMC_M_SYS_MPORT_BKE_HEALTH_2_ADDR A:0x414348
y.create.l HWIO_BIMC_M_SYS_MPORT_BKE_HEALTH_3_ADDR A:0x41434c
y.create.l HWIO_BIMC_M_SYS_MPORT_STATUS_0A_ADDR A:0x414400
y.create.l HWIO_BIMC_M_SYS_MPORT_STATUS_0B_ADDR A:0x414404
y.create.l HWIO_BIMC_M_SYS_MPORT_STATUS_1A_ADDR A:0x414410
y.create.l HWIO_BIMC_M_SYS_MPORT_STATUS_2A_ADDR A:0x414420
y.create.l HWIO_BIMC_M_SYS_MPORT_STATUS_2B_ADDR A:0x414424
y.create.l HWIO_BIMC_M_SYS_MPORT_STATUS_3A_ADDR A:0x414430
y.create.l HWIO_BIMC_M_SYS_MPORT_STATUS_3B_ADDR A:0x414434
y.create.l HWIO_BIMC_M_SYS_MPORT_BKE1_ENABLE_ADDR A:0x414800
y.create.l HWIO_BIMC_M_SYS_MPORT_BKE1_GRANT_PERIOD_ADDR A:0x414804
y.create.l HWIO_BIMC_M_SYS_MPORT_BKE1_GRANT_COUNT_ADDR A:0x414808
y.create.l HWIO_BIMC_M_SYS_MPORT_BKE1_THRESHOLD_HIGH_ADDR A:0x414820
y.create.l HWIO_BIMC_M_SYS_MPORT_BKE1_THRESHOLD_MEDIUM_ADDR A:0x414824
y.create.l HWIO_BIMC_M_SYS_MPORT_BKE1_THRESHOLD_LOW_ADDR A:0x414828
y.create.l HWIO_BIMC_M_SYS_MPORT_BKE1_HEALTH_0_ADDR A:0x414840
y.create.l HWIO_BIMC_M_SYS_MPORT_BKE1_HEALTH_1_ADDR A:0x414844
y.create.l HWIO_BIMC_M_SYS_MPORT_BKE1_HEALTH_2_ADDR A:0x414848
y.create.l HWIO_BIMC_M_SYS_MPORT_BKE1_HEALTH_3_ADDR A:0x41484c
y.create.l HWIO_BIMC_M_SYS_MPORT_BKE2_ENABLE_ADDR A:0x414900
y.create.l HWIO_BIMC_M_SYS_MPORT_BKE2_GRANT_PERIOD_ADDR A:0x414904
y.create.l HWIO_BIMC_M_SYS_MPORT_BKE2_GRANT_COUNT_ADDR A:0x414908
y.create.l HWIO_BIMC_M_SYS_MPORT_BKE2_THRESHOLD_HIGH_ADDR A:0x414920
y.create.l HWIO_BIMC_M_SYS_MPORT_BKE2_THRESHOLD_MEDIUM_ADDR A:0x414924
y.create.l HWIO_BIMC_M_SYS_MPORT_BKE2_THRESHOLD_LOW_ADDR A:0x414928
y.create.l HWIO_BIMC_M_SYS_MPORT_BKE2_HEALTH_0_ADDR A:0x414940
y.create.l HWIO_BIMC_M_SYS_MPORT_BKE2_HEALTH_1_ADDR A:0x414944
y.create.l HWIO_BIMC_M_SYS_MPORT_BKE2_HEALTH_2_ADDR A:0x414948
y.create.l HWIO_BIMC_M_SYS_MPORT_BKE2_HEALTH_3_ADDR A:0x41494c
y.create.l HWIO_BIMC_M_SYS_MPORT_BKE3_ENABLE_ADDR A:0x414a00
y.create.l HWIO_BIMC_M_SYS_MPORT_BKE3_GRANT_PERIOD_ADDR A:0x414a04
y.create.l HWIO_BIMC_M_SYS_MPORT_BKE3_GRANT_COUNT_ADDR A:0x414a08
y.create.l HWIO_BIMC_M_SYS_MPORT_BKE3_THRESHOLD_HIGH_ADDR A:0x414a20
y.create.l HWIO_BIMC_M_SYS_MPORT_BKE3_THRESHOLD_MEDIUM_ADDR A:0x414a24
y.create.l HWIO_BIMC_M_SYS_MPORT_BKE3_THRESHOLD_LOW_ADDR A:0x414a28
y.create.l HWIO_BIMC_M_SYS_MPORT_BKE3_HEALTH_0_ADDR A:0x414a40
y.create.l HWIO_BIMC_M_SYS_MPORT_BKE3_HEALTH_1_ADDR A:0x414a44
y.create.l HWIO_BIMC_M_SYS_MPORT_BKE3_HEALTH_2_ADDR A:0x414a48
y.create.l HWIO_BIMC_M_SYS_MPORT_BKE3_HEALTH_3_ADDR A:0x414a4c
y.create.l HWIO_BIMC_M_SYS_PROF_REG_BASE_START_ADDR A:0x415000
y.create.l HWIO_BIMC_M_SYS_PROF_REG_BASE_LAST_ADDR A:0x415424
y.create.l HWIO_BIMC_M_SYS_PROF_REG_BASE_END_ADDR A:0x416000
y.create.l HWIO_BIMC_M_SYS_PROF_COMPONENT_INFO_ADDR A:0x415000
y.create.l HWIO_BIMC_M_SYS_PROF_CONFIGURATION_INFO_0_ADDR A:0x415020
y.create.l HWIO_BIMC_M_SYS_PROF_CONFIGURATION_INFO_1_ADDR A:0x415030
y.create.l HWIO_BIMC_M_SYS_PROF_CLOCK_CTRL_ADDR A:0x415200
y.create.l HWIO_BIMC_M_SYS_PROF_MODE_ADDR A:0x415210
y.create.l HWIO_BIMC_M_SYS_PROF_RD_TENURE_THRESHOLD_ADDR A:0x415214
y.create.l HWIO_BIMC_M_SYS_PROF_WR_TENURE_THRESHOLD_ADDR A:0x415218
y.create.l HWIO_BIMC_M_SYS_PROF_SWAY_SELECT_ADDR A:0x415220
y.create.l HWIO_BIMC_M_SYS_PROF_MID_MASK_ADDR A:0x415230
y.create.l HWIO_BIMC_M_SYS_PROF_MID_MATCH_ADDR A:0x415234
y.create.l HWIO_BIMC_M_SYS_PROF_MID_INV_MATCH_ADDR A:0x415238
y.create.l HWIO_BIMC_M_SYS_PROF_ADDR_MASK_LOWER_ADDR A:0x415240
y.create.l HWIO_BIMC_M_SYS_PROF_ADDR_MASK_UPPER_ADDR A:0x415244
y.create.l HWIO_BIMC_M_SYS_PROF_ADDR_MATCH_LOWER_ADDR A:0x415248
y.create.l HWIO_BIMC_M_SYS_PROF_ADDR_MATCH_UPPER_ADDR A:0x41524c
y.create.l HWIO_BIMC_M_SYS_PROF_ADDR_INV_MATCH_ADDR A:0x415250
y.create.l HWIO_BIMC_M_SYS_PROF_ACH_MASK_0_ADDR A:0x415260
y.create.l HWIO_BIMC_M_SYS_PROF_ACH_MATCH_0_ADDR A:0x415264
y.create.l HWIO_BIMC_M_SYS_PROF_ACH_MASK_1_ADDR A:0x415270
y.create.l HWIO_BIMC_M_SYS_PROF_ACH_MATCH_1_ADDR A:0x415274
y.create.l HWIO_BIMC_M_SYS_PROF_ACH_INV_MATCH_1_ADDR A:0x415278
y.create.l HWIO_BIMC_M_SYS_PROF_ACH_MASK_2_ADDR A:0x415280
y.create.l HWIO_BIMC_M_SYS_PROF_ACH_MATCH_2_ADDR A:0x415284
y.create.l HWIO_BIMC_M_SYS_PROF_ACH_MASK_3_ADDR A:0x415290
y.create.l HWIO_BIMC_M_SYS_PROF_ACH_MATCH_3_ADDR A:0x415294
y.create.l HWIO_BIMC_M_SYS_PROF_ACH_INV_MATCH_3_ADDR A:0x415298
y.create.l HWIO_BIMC_M_SYS_PROF_ACH_MASK_4_ADDR A:0x4152a0
y.create.l HWIO_BIMC_M_SYS_PROF_ACH_MATCH_4_ADDR A:0x4152a4
y.create.l HWIO_BIMC_M_SYS_PROF_ACH_INV_MATCH_4_ADDR A:0x4152a8
y.create.l HWIO_BIMC_M_SYS_PROF_ACH_MASK_5_ADDR A:0x4152b0
y.create.l HWIO_BIMC_M_SYS_PROF_ACH_MATCH_5_ADDR A:0x4152b4
y.create.l HWIO_BIMC_M_SYS_PROF_BCH_MASK_ADDR A:0x415300
y.create.l HWIO_BIMC_M_SYS_PROF_BCH_MATCH_ADDR A:0x415304
y.create.l HWIO_BIMC_M_SYS_PROF_BCH_INV_MATCH_ADDR A:0x415308
y.create.l HWIO_BIMC_M_SYS_PROF_RCH_MASK_ADDR A:0x415340
y.create.l HWIO_BIMC_M_SYS_PROF_RCH_MATCH_ADDR A:0x415344
y.create.l HWIO_BIMC_M_SYS_PROF_RCH_INV_MATCH_ADDR A:0x415348
y.create.l HWIO_BIMC_M_SYS_PROF_RD_STATUS_0_ADDR A:0x415400
y.create.l HWIO_BIMC_M_SYS_PROF_RD_STATUS_1_ADDR A:0x415404
y.create.l HWIO_BIMC_M_SYS_PROF_WR_STATUS_0_ADDR A:0x415410
y.create.l HWIO_BIMC_M_SYS_PROF_WR_STATUS_1_ADDR A:0x415414
y.create.l HWIO_BIMC_M_SYS_PROF_TENURES_MISSED_0_ADDR A:0x415420
y.create.l HWIO_BIMC_M_SYS_PROF_TENURES_MISSED_1_ADDR A:0x415424
y.create.l HWIO_BIMC_S_DDR0_SCMO_REG_BASE_START_ADDR A:0x430000
y.create.l HWIO_BIMC_S_DDR0_SCMO_REG_BASE_LAST_ADDR A:0x430a40
y.create.l HWIO_BIMC_S_DDR0_SCMO_REG_BASE_END_ADDR A:0x431000
y.create.l HWIO_BIMC_S_DDR0_SCMO_COMPONENT_INFO_ADDR A:0x430000
y.create.l HWIO_BIMC_S_DDR0_SCMO_HW_INFO_ADDR A:0x430010
y.create.l HWIO_BIMC_S_DDR0_SCMO_CONFIGURATION_INFO_0_ADDR A:0x430020
y.create.l HWIO_BIMC_S_DDR0_SCMO_CONFIGURATION_INFO_1_ADDR A:0x430030
y.create.l HWIO_BIMC_S_DDR0_SCMO_CONFIGURATION_INFO_2_ADDR A:0x430040
y.create.l HWIO_BIMC_S_DDR0_SCMO_CONFIGURATION_INFO_3_ADDR A:0x430050
y.create.l HWIO_BIMC_S_DDR0_SCMO_CONFIGURATION_INFO_4_ADDR A:0x430060
y.create.l HWIO_BIMC_S_DDR0_SCMO_CONFIGURATION_INFO_5_ADDR A:0x430070
y.create.l HWIO_BIMC_S_DDR0_SCMO_CONFIGURATION_INFO_6_ADDR A:0x430080
y.create.l HWIO_BIMC_S_DDR0_SCMO_INTERRUPT_STATUS_ADDR A:0x430100
y.create.l HWIO_BIMC_S_DDR0_SCMO_INTERRUPT_CLEAR_ADDR A:0x430108
y.create.l HWIO_BIMC_S_DDR0_SCMO_INTERRUPT_ENABLE_ADDR A:0x43010c
y.create.l HWIO_BIMC_S_DDR0_SCMO_ESYN_ADDR_ADDR A:0x430120
y.create.l HWIO_BIMC_S_DDR0_SCMO_ESYN_APACKET_0_ADDR A:0x430128
y.create.l HWIO_BIMC_S_DDR0_SCMO_ESYN_APACKET_1_ADDR A:0x43012c
y.create.l HWIO_BIMC_S_DDR0_SCMO_ESYN_APACKET_2_ADDR A:0x430130
y.create.l HWIO_BIMC_S_DDR0_SCMO_CLOCK_CTRL_ADDR A:0x430200
y.create.l HWIO_BIMC_S_DDR0_SCMO_SLV_INTERLEAVE_CFG_ADDR A:0x430400
y.create.l HWIO_BIMC_S_DDR0_SCMO_ADDR_BASE_CS0_ADDR A:0x430410
y.create.l HWIO_BIMC_S_DDR0_SCMO_ADDR_BASE_CS1_ADDR A:0x430414
y.create.l HWIO_BIMC_S_DDR0_SCMO_ADDR_MAP_CS0_ADDR A:0x430420
y.create.l HWIO_BIMC_S_DDR0_SCMO_ADDR_MAP_CS1_ADDR A:0x430424
y.create.l HWIO_BIMC_S_DDR0_SCMO_ADDR_MASK_CS0_ADDR A:0x430430
y.create.l HWIO_BIMC_S_DDR0_SCMO_ADDR_MASK_CS1_ADDR A:0x430434
y.create.l HWIO_BIMC_S_DDR0_SCMO_SLV_STATUS_ADDR A:0x430450
y.create.l HWIO_BIMC_S_DDR0_SCMO_GLOBAL_MON_CFG_ADDR A:0x430460
y.create.l HWIO_BIMC_S_DDR0_SCMO_CMD_BUF_CFG_ADDR A:0x430500
y.create.l HWIO_BIMC_S_DDR0_SCMO_CMD_BUF_STATUS_ADDR A:0x430520
y.create.l HWIO_BIMC_S_DDR0_SCMO_RCH_SELECT_ADDR A:0x430540
y.create.l HWIO_BIMC_S_DDR0_SCMO_RCH_BKPR_CFG_ADDR A:0x430544
y.create.l HWIO_BIMC_S_DDR0_SCMO_RCH_STATUS_ADDR A:0x430560
y.create.l HWIO_BIMC_S_DDR0_SCMO_WCH_BUF_CFG_ADDR A:0x430580
y.create.l HWIO_BIMC_S_DDR0_SCMO_WCH_STATUS_ADDR A:0x4305a0
y.create.l HWIO_BIMC_S_DDR0_SCMO_FLUSH_CFG_ADDR A:0x4305c0
y.create.l HWIO_BIMC_S_DDR0_SCMO_FLUSH_CMD_ADDR A:0x4305c4
y.create.l HWIO_BIMC_S_DDR0_SCMO_CMD_OPT_CFG0_ADDR A:0x430700
y.create.l HWIO_BIMC_S_DDR0_SCMO_CMD_OPT_CFG1_ADDR A:0x430704
y.create.l HWIO_BIMC_S_DDR0_SCMO_CMD_OPT_CFG2_ADDR A:0x430708
y.create.l HWIO_BIMC_S_DDR0_SCMO_CMD_OPT_CFG3_ADDR A:0x43070c
y.create.l HWIO_BIMC_S_DDR0_SCMO_CMD_OPT_CFG4_ADDR A:0x430710
y.create.l HWIO_BIMC_S_DDR0_SCMO_DPE_CQ_STATUS_ADDR A:0x430720
y.create.l HWIO_BIMC_S_DDR0_SCMO_FSP_STATUS_ADDR A:0x430a40
y.create.l HWIO_BIMC_S_DDR0_ARB_REG_BASE_START_ADDR A:0x431000
y.create.l HWIO_BIMC_S_DDR0_ARB_REG_BASE_LAST_ADDR A:0x431800
y.create.l HWIO_BIMC_S_DDR0_ARB_REG_BASE_END_ADDR A:0x432000
y.create.l HWIO_BIMC_S_DDR0_ARB_COMPONENT_INFO_ADDR A:0x431000
y.create.l HWIO_BIMC_S_DDR0_ARB_CONFIGURATION_INFO_0_ADDR A:0x431020
y.create.l HWIO_BIMC_S_DDR0_ARB_CONFIGURATION_INFO_1A_ADDR A:0x431030
y.create.l HWIO_BIMC_S_DDR0_ARB_CONFIGURATION_INFO_1B_ADDR A:0x431034
y.create.l HWIO_BIMC_S_DDR0_ARB_CONFIGURATION_INFO_2_ADDR A:0x431040
y.create.l HWIO_BIMC_S_DDR0_ARB_INTERRUPT_STATUS_ADDR A:0x431100
y.create.l HWIO_BIMC_S_DDR0_ARB_INTERRUPT_CLEAR_ADDR A:0x431108
y.create.l HWIO_BIMC_S_DDR0_ARB_INTERRUPT_ENABLE_ADDR A:0x43110c
y.create.l HWIO_BIMC_S_DDR0_ARB_CLOCK_CTRL_ADDR A:0x431200
y.create.l HWIO_BIMC_S_DDR0_ARB_MODE_ADDR A:0x431210
y.create.l HWIO_BIMC_S_DDR0_ARB_MASTER0_GRANTS_ADDR A:0x431220
y.create.l HWIO_BIMC_S_DDR0_ARB_MASTER1_GRANTS_ADDR A:0x431224
y.create.l HWIO_BIMC_S_DDR0_ARB_MASTER2_GRANTS_ADDR A:0x431228
y.create.l HWIO_BIMC_S_DDR0_ARB_MASTER3_GRANTS_ADDR A:0x43122c
y.create.l HWIO_BIMC_S_DDR0_ARB_BAMON_ADDR A:0x431500
y.create.l HWIO_BIMC_S_DDR0_ARB_BWMON_ENABLE_ADDR A:0x431510
y.create.l HWIO_BIMC_S_DDR0_ARB_BWMON_CLEAR_ADDR A:0x431514
y.create.l HWIO_BIMC_S_DDR0_ARB_BWMON_BYTE_COUNT_ADDR A:0x431518
y.create.l HWIO_BIMC_S_DDR0_ARB_BWMON_THRESHOLD_ADDR A:0x431520
y.create.l HWIO_BIMC_S_DDR0_ARB_BWMON_MID_MASK_ADDR A:0x431528
y.create.l HWIO_BIMC_S_DDR0_ARB_BWMON_MID_MATCH_ADDR A:0x43152c
y.create.l HWIO_BIMC_S_DDR0_ARB_STATUS_0A_ADDR A:0x431800
y.create.l HWIO_BIMC_S_SYS_SWAY_REG_BASE_START_ADDR A:0x43c000
y.create.l HWIO_BIMC_S_SYS_SWAY_REG_BASE_LAST_ADDR A:0x43c440
y.create.l HWIO_BIMC_S_SYS_SWAY_REG_BASE_END_ADDR A:0x43d000
y.create.l HWIO_BIMC_S_SYS_SWAY_COMPONENT_INFO_ADDR A:0x43c000
y.create.l HWIO_BIMC_S_SYS_SWAY_CONFIGURATION_INFO_0_ADDR A:0x43c020
y.create.l HWIO_BIMC_S_SYS_SWAY_CONFIGURATION_INFO_1_ADDR A:0x43c030
y.create.l HWIO_BIMC_S_SYS_SWAY_CONFIGURATION_INFO_2_ADDR A:0x43c040
y.create.l HWIO_BIMC_S_SYS_SWAY_CONFIGURATION_INFO_3_ADDR A:0x43c050
y.create.l HWIO_BIMC_S_SYS_SWAY_CONFIGURATION_INFO_4_ADDR A:0x43c060
y.create.l HWIO_BIMC_S_SYS_SWAY_CONFIGURATION_INFO_5_ADDR A:0x43c070
y.create.l HWIO_BIMC_S_SYS_SWAY_CONFIGURATION_INFO_6A_ADDR A:0x43c080
y.create.l HWIO_BIMC_S_SYS_SWAY_CONFIGURATION_INFO_6B_ADDR A:0x43c084
y.create.l HWIO_BIMC_S_SYS_SWAY_CONFIGURATION_INFO_6C_ADDR A:0x43c088
y.create.l HWIO_BIMC_S_SYS_SWAY_CONFIGURATION_INFO_6D_ADDR A:0x43c08c
y.create.l HWIO_BIMC_S_SYS_SWAY_INTERRUPT_STATUS_ADDR A:0x43c100
y.create.l HWIO_BIMC_S_SYS_SWAY_INTERRUPT_CLEAR_ADDR A:0x43c108
y.create.l HWIO_BIMC_S_SYS_SWAY_INTERRUPT_ENABLE_ADDR A:0x43c10c
y.create.l HWIO_BIMC_S_SYS_SWAY_CLOCK_CTRL_ADDR A:0x43c200
y.create.l HWIO_BIMC_S_SYS_SWAY_CDC_CTRL_ADDR A:0x43c208
y.create.l HWIO_BIMC_S_SYS_SWAY_RCH_SELECT_ADDR A:0x43c210
y.create.l HWIO_BIMC_S_SYS_SWAY_MAX_OUTSTANDING_REQUESTS_ADDR A:0x43c220
y.create.l HWIO_BIMC_S_SYS_SWAY_GATHERING_ADDR A:0x43c230
y.create.l HWIO_BIMC_S_SYS_SWAY_MODE_ADDR A:0x43c240
y.create.l HWIO_BIMC_S_SYS_SWAY_READ_COMMAND_OVERRIDE_ADDR A:0x43c250
y.create.l HWIO_BIMC_S_SYS_SWAY_WRITE_COMMAND_OVERRIDE_ADDR A:0x43c260
y.create.l HWIO_BIMC_S_SYS_SWAY_STATUS_0A_ADDR A:0x43c400
y.create.l HWIO_BIMC_S_SYS_SWAY_STATUS_0B_ADDR A:0x43c404
y.create.l HWIO_BIMC_S_SYS_SWAY_STATUS_0C_ADDR A:0x43c408
y.create.l HWIO_BIMC_S_SYS_SWAY_STATUS_0D_ADDR A:0x43c40c
y.create.l HWIO_BIMC_S_SYS_SWAY_STATUS_1A_ADDR A:0x43c410
y.create.l HWIO_BIMC_S_SYS_SWAY_STATUS_1B_ADDR A:0x43c414
y.create.l HWIO_BIMC_S_SYS_SWAY_STATUS_1C_ADDR A:0x43c418
y.create.l HWIO_BIMC_S_SYS_SWAY_STATUS_2A_ADDR A:0x43c420
y.create.l HWIO_BIMC_S_SYS_SWAY_STATUS_2B_ADDR A:0x43c424
y.create.l HWIO_BIMC_S_SYS_SWAY_STATUS_2C_ADDR A:0x43c428
y.create.l HWIO_BIMC_S_SYS_SWAY_STATUS_2D_ADDR A:0x43c42c
y.create.l HWIO_BIMC_S_SYS_SWAY_STATUS_3A_ADDR A:0x43c430
y.create.l HWIO_BIMC_S_SYS_SWAY_STATUS_3B_ADDR A:0x43c434
y.create.l HWIO_BIMC_S_SYS_SWAY_STATUS_3C_ADDR A:0x43c438
y.create.l HWIO_BIMC_S_SYS_SWAY_STATUS_3D_ADDR A:0x43c43c
y.create.l HWIO_BIMC_S_SYS_SWAY_STATUS_4A_ADDR A:0x43c440
y.create.l HWIO_BIMC_S_SYS_ARB_REG_BASE_START_ADDR A:0x43d000
y.create.l HWIO_BIMC_S_SYS_ARB_REG_BASE_LAST_ADDR A:0x43d800
y.create.l HWIO_BIMC_S_SYS_ARB_REG_BASE_END_ADDR A:0x43e000
y.create.l HWIO_BIMC_S_SYS_ARB_COMPONENT_INFO_ADDR A:0x43d000
y.create.l HWIO_BIMC_S_SYS_ARB_CONFIGURATION_INFO_0_ADDR A:0x43d020
y.create.l HWIO_BIMC_S_SYS_ARB_CONFIGURATION_INFO_1A_ADDR A:0x43d030
y.create.l HWIO_BIMC_S_SYS_ARB_CONFIGURATION_INFO_1B_ADDR A:0x43d034
y.create.l HWIO_BIMC_S_SYS_ARB_CONFIGURATION_INFO_2_ADDR A:0x43d040
y.create.l HWIO_BIMC_S_SYS_ARB_INTERRUPT_STATUS_ADDR A:0x43d100
y.create.l HWIO_BIMC_S_SYS_ARB_INTERRUPT_CLEAR_ADDR A:0x43d108
y.create.l HWIO_BIMC_S_SYS_ARB_INTERRUPT_ENABLE_ADDR A:0x43d10c
y.create.l HWIO_BIMC_S_SYS_ARB_CLOCK_CTRL_ADDR A:0x43d200
y.create.l HWIO_BIMC_S_SYS_ARB_MODE_ADDR A:0x43d210
y.create.l HWIO_BIMC_S_SYS_ARB_BAMON_ADDR A:0x43d500
y.create.l HWIO_BIMC_S_SYS_ARB_STATUS_0A_ADDR A:0x43d800
y.create.l HWIO_BIMC_S_DEFAULT_SWAY_REG_BASE_START_ADDR A:0x444000
y.create.l HWIO_BIMC_S_DEFAULT_SWAY_REG_BASE_LAST_ADDR A:0x444420
y.create.l HWIO_BIMC_S_DEFAULT_SWAY_REG_BASE_END_ADDR A:0x445000
y.create.l HWIO_BIMC_S_DEFAULT_SWAY_COMPONENT_INFO_ADDR A:0x444000
y.create.l HWIO_BIMC_S_DEFAULT_SWAY_CONFIGURATION_INFO_0_ADDR A:0x444020
y.create.l HWIO_BIMC_S_DEFAULT_SWAY_CONFIGURATION_INFO_1_ADDR A:0x444030
y.create.l HWIO_BIMC_S_DEFAULT_SWAY_INTERRUPT_STATUS_ADDR A:0x444100
y.create.l HWIO_BIMC_S_DEFAULT_SWAY_INTERRUPT_CLEAR_ADDR A:0x444108
y.create.l HWIO_BIMC_S_DEFAULT_SWAY_INTERRUPT_ENABLE_ADDR A:0x44410c
y.create.l HWIO_BIMC_S_DEFAULT_SWAY_DEFAULT_SLAVE_STATUS_0_ADDR A:0x444400
y.create.l HWIO_BIMC_S_DEFAULT_SWAY_DEFAULT_SLAVE_STATUS_1_ADDR A:0x444410
y.create.l HWIO_BIMC_S_DEFAULT_SWAY_DEFAULT_SLAVE_STATUS_2_ADDR A:0x444420
y.create.l HWIO_BIMC_S_DEFAULT_ARB_REG_BASE_START_ADDR A:0x445000
y.create.l HWIO_BIMC_S_DEFAULT_ARB_REG_BASE_LAST_ADDR A:0x445800
y.create.l HWIO_BIMC_S_DEFAULT_ARB_REG_BASE_END_ADDR A:0x446000
y.create.l HWIO_BIMC_S_DEFAULT_ARB_COMPONENT_INFO_ADDR A:0x445000
y.create.l HWIO_BIMC_S_DEFAULT_ARB_CONFIGURATION_INFO_0_ADDR A:0x445020
y.create.l HWIO_BIMC_S_DEFAULT_ARB_CONFIGURATION_INFO_1A_ADDR A:0x445030
y.create.l HWIO_BIMC_S_DEFAULT_ARB_CONFIGURATION_INFO_1B_ADDR A:0x445034
y.create.l HWIO_BIMC_S_DEFAULT_ARB_CONFIGURATION_INFO_2_ADDR A:0x445040
y.create.l HWIO_BIMC_S_DEFAULT_ARB_INTERRUPT_STATUS_ADDR A:0x445100
y.create.l HWIO_BIMC_S_DEFAULT_ARB_INTERRUPT_CLEAR_ADDR A:0x445108
y.create.l HWIO_BIMC_S_DEFAULT_ARB_INTERRUPT_ENABLE_ADDR A:0x44510c
y.create.l HWIO_BIMC_S_DEFAULT_ARB_CLOCK_CTRL_ADDR A:0x445200
y.create.l HWIO_BIMC_S_DEFAULT_ARB_MODE_ADDR A:0x445210
y.create.l HWIO_BIMC_S_DEFAULT_ARB_BAMON_ADDR A:0x445500
y.create.l HWIO_BIMC_S_DEFAULT_ARB_STATUS_0A_ADDR A:0x445800
y.create.l HWIO_BIMC_S_DDR0_REG_BASE_START_ADDR A:0x432000
y.create.l HWIO_BIMC_S_DDR0_REG_BASE_LAST_ADDR A:0x43357c
y.create.l HWIO_BIMC_S_DDR0_REG_BASE_END_ADDR A:0x433580
y.create.l HWIO_BIMC_S_DDR0_XPU_SCR_ADDR A:0x432000
y.create.l HWIO_BIMC_S_DDR0_XPU_SWDR_ADDR A:0x432004
y.create.l HWIO_BIMC_S_DDR0_XPU_PRTN_RACR_SSHADOW_ADDR A:0x432008
y.create.l HWIO_BIMC_S_DDR0_XPU_PRTN_WACR_SSHADOW_ADDR A:0x43200c
y.create.l HWIO_BIMC_S_DDR0_XPU_PRTN_START_SSHADOW0_ADDR A:0x432010
y.create.l HWIO_BIMC_S_DDR0_XPU_PRTN_END_SSHADOW0_ADDR A:0x432018
y.create.l HWIO_BIMC_S_DDR0_XPU_SEAR0_ADDR A:0x432040
y.create.l HWIO_BIMC_S_DDR0_XPU_SESR_ADDR A:0x432048
y.create.l HWIO_BIMC_S_DDR0_XPU_SESRRESTORE_ADDR A:0x43204c
y.create.l HWIO_BIMC_S_DDR0_XPU_SESYNR0_ADDR A:0x432050
y.create.l HWIO_BIMC_S_DDR0_XPU_SESYNR1_ADDR A:0x432054
y.create.l HWIO_BIMC_S_DDR0_XPU_SESYNR2_ADDR A:0x432058
y.create.l HWIO_BIMC_S_DDR0_XPU_MCR_ADDR A:0x432100
y.create.l HWIO_BIMC_S_DDR0_XPU_MEAR0_ADDR A:0x432140
y.create.l HWIO_BIMC_S_DDR0_XPU_MESR_ADDR A:0x432148
y.create.l HWIO_BIMC_S_DDR0_XPU_MESRRESTORE_ADDR A:0x43214c
y.create.l HWIO_BIMC_S_DDR0_XPU_MESYNR0_ADDR A:0x432150
y.create.l HWIO_BIMC_S_DDR0_XPU_MESYNR1_ADDR A:0x432154
y.create.l HWIO_BIMC_S_DDR0_XPU_MESYNR2_ADDR A:0x432158
y.create.l HWIO_BIMC_S_DDR0_XPU_CR_ADDR A:0x432080
y.create.l HWIO_BIMC_S_DDR0_XPU_PRTN_RACR_SHADOW_ADDR A:0x432088
y.create.l HWIO_BIMC_S_DDR0_XPU_PRTN_WACR_SHADOW_ADDR A:0x43208c
y.create.l HWIO_BIMC_S_DDR0_XPU_PRTN_START_SHADOW0_ADDR A:0x432090
y.create.l HWIO_BIMC_S_DDR0_XPU_PRTN_END_SHADOW0_ADDR A:0x432098
y.create.l HWIO_BIMC_S_DDR0_XPU_RPU_ACR0_ADDR A:0x4320a0
y.create.l HWIO_BIMC_S_DDR0_XPU_EAR0_ADDR A:0x4320c0
y.create.l HWIO_BIMC_S_DDR0_XPU_ESR_ADDR A:0x4320c8
y.create.l HWIO_BIMC_S_DDR0_XPU_ESRRESTORE_ADDR A:0x4320cc
y.create.l HWIO_BIMC_S_DDR0_XPU_ESYNR0_ADDR A:0x4320d0
y.create.l HWIO_BIMC_S_DDR0_XPU_ESYNR1_ADDR A:0x4320d4
y.create.l HWIO_BIMC_S_DDR0_XPU_ESYNR2_ADDR A:0x4320d8
y.create.l HWIO_BIMC_S_DDR0_XPU_UMR_RACR_ADDR A:0x4320e0
y.create.l HWIO_BIMC_S_DDR0_XPU_UMR_WACR_ADDR A:0x4320e4
y.create.l HWIO_BIMC_S_DDR0_XPU_UMR_CNTL_ADDR A:0x4320f0
y.create.l HWIO_BIMC_S_DDR0_XPU_IDR0_ADDR A:0x432074
y.create.l HWIO_BIMC_S_DDR0_XPU_IDR1_ADDR A:0x432078
y.create.l HWIO_BIMC_S_DDR0_XPU_REV_ADDR A:0x43207c
y.create.l HWIO_BIMC_S_DDR0_XPU_PRT0_RACR0_ADDR A:0x432200
y.create.l HWIO_BIMC_S_DDR0_XPU_PRT1_RACR0_ADDR A:0x432280
y.create.l HWIO_BIMC_S_DDR0_XPU_PRT2_RACR0_ADDR A:0x432300
y.create.l HWIO_BIMC_S_DDR0_XPU_PRT3_RACR0_ADDR A:0x432380
y.create.l HWIO_BIMC_S_DDR0_XPU_PRT4_RACR0_ADDR A:0x432400
y.create.l HWIO_BIMC_S_DDR0_XPU_PRT5_RACR0_ADDR A:0x432480
y.create.l HWIO_BIMC_S_DDR0_XPU_PRT6_RACR0_ADDR A:0x432500
y.create.l HWIO_BIMC_S_DDR0_XPU_PRT7_RACR0_ADDR A:0x432580
y.create.l HWIO_BIMC_S_DDR0_XPU_PRT8_RACR0_ADDR A:0x432600
y.create.l HWIO_BIMC_S_DDR0_XPU_PRT9_RACR0_ADDR A:0x432680
y.create.l HWIO_BIMC_S_DDR0_XPU_PRT0_WACR0_ADDR A:0x432220
y.create.l HWIO_BIMC_S_DDR0_XPU_PRT1_WACR0_ADDR A:0x4322a0
y.create.l HWIO_BIMC_S_DDR0_XPU_PRT2_WACR0_ADDR A:0x432320
y.create.l HWIO_BIMC_S_DDR0_XPU_PRT3_WACR0_ADDR A:0x4323a0
y.create.l HWIO_BIMC_S_DDR0_XPU_PRT4_WACR0_ADDR A:0x432420
y.create.l HWIO_BIMC_S_DDR0_XPU_PRT5_WACR0_ADDR A:0x4324a0
y.create.l HWIO_BIMC_S_DDR0_XPU_PRT6_WACR0_ADDR A:0x432520
y.create.l HWIO_BIMC_S_DDR0_XPU_PRT7_WACR0_ADDR A:0x4325a0
y.create.l HWIO_BIMC_S_DDR0_XPU_PRT8_WACR0_ADDR A:0x432620
y.create.l HWIO_BIMC_S_DDR0_XPU_PRT9_WACR0_ADDR A:0x4326a0
y.create.l HWIO_BIMC_S_DDR0_XPU_PRT0_START0_ADDR A:0x432240
y.create.l HWIO_BIMC_S_DDR0_XPU_PRT1_START0_ADDR A:0x4322c0
y.create.l HWIO_BIMC_S_DDR0_XPU_PRT2_START0_ADDR A:0x432340
y.create.l HWIO_BIMC_S_DDR0_XPU_PRT3_START0_ADDR A:0x4323c0
y.create.l HWIO_BIMC_S_DDR0_XPU_PRT4_START0_ADDR A:0x432440
y.create.l HWIO_BIMC_S_DDR0_XPU_PRT5_START0_ADDR A:0x4324c0
y.create.l HWIO_BIMC_S_DDR0_XPU_PRT6_START0_ADDR A:0x432540
y.create.l HWIO_BIMC_S_DDR0_XPU_PRT7_START0_ADDR A:0x4325c0
y.create.l HWIO_BIMC_S_DDR0_XPU_PRT8_START0_ADDR A:0x432640
y.create.l HWIO_BIMC_S_DDR0_XPU_PRT9_START0_ADDR A:0x4326c0
y.create.l HWIO_BIMC_S_DDR0_XPU_PRT0_END0_ADDR A:0x432248
y.create.l HWIO_BIMC_S_DDR0_XPU_PRT1_END0_ADDR A:0x4322c8
y.create.l HWIO_BIMC_S_DDR0_XPU_PRT2_END0_ADDR A:0x432348
y.create.l HWIO_BIMC_S_DDR0_XPU_PRT3_END0_ADDR A:0x4323c8
y.create.l HWIO_BIMC_S_DDR0_XPU_PRT4_END0_ADDR A:0x432448
y.create.l HWIO_BIMC_S_DDR0_XPU_PRT5_END0_ADDR A:0x4324c8
y.create.l HWIO_BIMC_S_DDR0_XPU_PRT6_END0_ADDR A:0x432548
y.create.l HWIO_BIMC_S_DDR0_XPU_PRT7_END0_ADDR A:0x4325c8
y.create.l HWIO_BIMC_S_DDR0_XPU_PRT8_END0_ADDR A:0x432648
y.create.l HWIO_BIMC_S_DDR0_XPU_PRT9_END0_ADDR A:0x4326c8
y.create.l HWIO_BIMC_S_DDR0_XPU_PRT0_SCR_ADDR A:0x432250
y.create.l HWIO_BIMC_S_DDR0_XPU_PRT1_SCR_ADDR A:0x4322d0
y.create.l HWIO_BIMC_S_DDR0_XPU_PRT2_SCR_ADDR A:0x432350
y.create.l HWIO_BIMC_S_DDR0_XPU_PRT3_SCR_ADDR A:0x4323d0
y.create.l HWIO_BIMC_S_DDR0_XPU_PRT4_SCR_ADDR A:0x432450
y.create.l HWIO_BIMC_S_DDR0_XPU_PRT5_SCR_ADDR A:0x4324d0
y.create.l HWIO_BIMC_S_DDR0_XPU_PRT6_SCR_ADDR A:0x432550
y.create.l HWIO_BIMC_S_DDR0_XPU_PRT7_SCR_ADDR A:0x4325d0
y.create.l HWIO_BIMC_S_DDR0_XPU_PRT8_SCR_ADDR A:0x432650
y.create.l HWIO_BIMC_S_DDR0_XPU_PRT9_SCR_ADDR A:0x4326d0
y.create.l HWIO_BIMC_S_DDR0_XPU_PRT0_MCR_ADDR A:0x432254
y.create.l HWIO_BIMC_S_DDR0_XPU_PRT1_MCR_ADDR A:0x4322d4
y.create.l HWIO_BIMC_S_DDR0_XPU_PRT2_MCR_ADDR A:0x432354
y.create.l HWIO_BIMC_S_DDR0_XPU_PRT3_MCR_ADDR A:0x4323d4
y.create.l HWIO_BIMC_S_DDR0_XPU_PRT4_MCR_ADDR A:0x432454
y.create.l HWIO_BIMC_S_DDR0_XPU_PRT5_MCR_ADDR A:0x4324d4
y.create.l HWIO_BIMC_S_DDR0_XPU_PRT6_MCR_ADDR A:0x432554
y.create.l HWIO_BIMC_S_DDR0_XPU_PRT7_MCR_ADDR A:0x4325d4
y.create.l HWIO_BIMC_S_DDR0_XPU_PRT8_MCR_ADDR A:0x432654
y.create.l HWIO_BIMC_S_DDR0_XPU_PRT9_MCR_ADDR A:0x4326d4
y.create.l HWIO_BIMC_S_DDR0_XPU_PRT0_CNTL0_ADDR A:0x432258
y.create.l HWIO_BIMC_S_DDR0_XPU_PRT1_CNTL0_ADDR A:0x4322d8
y.create.l HWIO_BIMC_S_DDR0_XPU_PRT2_CNTL0_ADDR A:0x432358
y.create.l HWIO_BIMC_S_DDR0_XPU_PRT3_CNTL0_ADDR A:0x4323d8
y.create.l HWIO_BIMC_S_DDR0_XPU_PRT4_CNTL0_ADDR A:0x432458
y.create.l HWIO_BIMC_S_DDR0_XPU_PRT5_CNTL0_ADDR A:0x4324d8
y.create.l HWIO_BIMC_S_DDR0_XPU_PRT6_CNTL0_ADDR A:0x432558
y.create.l HWIO_BIMC_S_DDR0_XPU_PRT7_CNTL0_ADDR A:0x4325d8
y.create.l HWIO_BIMC_S_DDR0_XPU_PRT8_CNTL0_ADDR A:0x432658
y.create.l HWIO_BIMC_S_DDR0_XPU_PRT9_CNTL0_ADDR A:0x4326d8
y.create.l HWIO_BIMC_S_DDR0_XPU_PRT0_CNTL1_ADDR A:0x43225c
y.create.l HWIO_BIMC_S_DDR0_XPU_PRT1_CNTL1_ADDR A:0x4322dc
y.create.l HWIO_BIMC_S_DDR0_XPU_PRT2_CNTL1_ADDR A:0x43235c
y.create.l HWIO_BIMC_S_DDR0_XPU_PRT3_CNTL1_ADDR A:0x4323dc
y.create.l HWIO_BIMC_S_DDR0_XPU_PRT4_CNTL1_ADDR A:0x43245c
y.create.l HWIO_BIMC_S_DDR0_XPU_PRT5_CNTL1_ADDR A:0x4324dc
y.create.l HWIO_BIMC_S_DDR0_XPU_PRT6_CNTL1_ADDR A:0x43255c
y.create.l HWIO_BIMC_S_DDR0_XPU_PRT7_CNTL1_ADDR A:0x4325dc
y.create.l HWIO_BIMC_S_DDR0_XPU_PRT8_CNTL1_ADDR A:0x43265c
y.create.l HWIO_BIMC_S_DDR0_XPU_PRT9_CNTL1_ADDR A:0x4326dc
y.create.l HWIO_BIMC_S_DDR0_XPU_AMT_RACR_ADDR A:0x4320e8
y.create.l HWIO_BIMC_S_DDR0_XPU_AMT_WACR_ADDR A:0x4320ec
y.create.l HWIO_BIMC_S_DDR0_XPU_AMTR0_ADDR A:0x433380
y.create.l HWIO_BIMC_S_DDR0_XPU_AMTR1_ADDR A:0x433384
y.create.l HWIO_BIMC_S_DDR0_XPU_AMTR2_ADDR A:0x433388
y.create.l HWIO_BIMC_S_DDR0_XPU_AMTR3_ADDR A:0x43338c
y.create.l HWIO_BIMC_S_DDR0_XPU_AMTR4_ADDR A:0x433390
y.create.l HWIO_BIMC_S_DDR0_XPU_AMTR5_ADDR A:0x433394
y.create.l HWIO_BIMC_S_DDR0_XPU_AMTR6_ADDR A:0x433398
y.create.l HWIO_BIMC_S_DDR0_XPU_AMTR7_ADDR A:0x43339c
y.create.l HWIO_BIMC_S_DDR0_XPU_AMTR8_ADDR A:0x4333a0
y.create.l HWIO_BIMC_S_DDR0_XPU_AMTR9_ADDR A:0x4333a4
y.create.l HWIO_BIMC_S_DDR0_DPE_REG_BASE_START_ADDR A:0x434000
y.create.l HWIO_BIMC_S_DDR0_DPE_REG_BASE_LAST_ADDR A:0x4346e4
y.create.l HWIO_BIMC_S_DDR0_DPE_REG_BASE_END_ADDR A:0x435000
y.create.l HWIO_BIMC_S_DDR0_DPE_HW_INFO_ADDR A:0x434000
y.create.l HWIO_BIMC_S_DDR0_DPE_CONFIG_0_ADDR A:0x434010
y.create.l HWIO_BIMC_S_DDR0_DPE_CONFIG_1_ADDR A:0x434014
y.create.l HWIO_BIMC_S_DDR0_DPE_CONFIG_2_ADDR A:0x434018
y.create.l HWIO_BIMC_S_DDR0_DPE_CONFIG_3_ADDR A:0x43401c
y.create.l HWIO_BIMC_S_DDR0_DPE_CONFIG_4_ADDR A:0x434020
y.create.l HWIO_BIMC_S_DDR0_DPE_CONFIG_5_ADDR A:0x434024
y.create.l HWIO_BIMC_S_DDR0_DPE_CONFIG_6_ADDR A:0x434028
y.create.l HWIO_BIMC_S_DDR0_DPE_CONFIG_7_ADDR A:0x43402c
y.create.l HWIO_BIMC_S_DDR0_DPE_CONFIG_DQ_MAP_ADDR A:0x434038
y.create.l HWIO_BIMC_S_DDR0_DPE_ODT_CONFIG_0_ADDR A:0x434040
y.create.l HWIO_BIMC_S_DDR0_DPE_ODT_CONFIG_1_ADDR A:0x434044
y.create.l HWIO_BIMC_S_DDR0_DPE_CA_TRAIN_PRE_CS_ADDR A:0x434050
y.create.l HWIO_BIMC_S_DDR0_DPE_CA_TRAIN_CS_ADDR A:0x434054
y.create.l HWIO_BIMC_S_DDR0_DPE_CA_TRAIN_POST_CS_ADDR A:0x434058
y.create.l HWIO_BIMC_S_DDR0_DPE_RCW_CTRL_ADDR A:0x434060
y.create.l HWIO_BIMC_S_DDR0_DPE_PWR_CTRL_0_ADDR A:0x434068
y.create.l HWIO_BIMC_S_DDR0_DPE_OPT_CTRL_0_ADDR A:0x434078
y.create.l HWIO_BIMC_S_DDR0_DPE_OPT_CTRL_1_ADDR A:0x43407c
y.create.l HWIO_BIMC_S_DDR0_DPE_DRAM_STATUS_0_ADDR A:0x43408c
y.create.l HWIO_BIMC_S_DDR0_DPE_MEMC_STATUS_0_ADDR A:0x43409c
y.create.l HWIO_BIMC_S_DDR0_DPE_MEMC_STATUS_1_ADDR A:0x4340a0
y.create.l HWIO_BIMC_S_DDR0_DPE_MEMC_STATUS_2_ADDR A:0x4340a4
y.create.l HWIO_BIMC_S_DDR0_DPE_INTERRUPT_ENABLE_ADDR A:0x4340b4
y.create.l HWIO_BIMC_S_DDR0_DPE_INTERRUPT_STATUS_ADDR A:0x4340b8
y.create.l HWIO_BIMC_S_DDR0_DPE_INTERRUPT_CLR_ADDR A:0x4340bc
y.create.l HWIO_BIMC_S_DDR0_DPE_INTERRUPT_SET_ADDR A:0x4340c0
y.create.l HWIO_BIMC_S_DDR0_DPE_ELEVATE_PRI_RD_ADDR A:0x4340d0
y.create.l HWIO_BIMC_S_DDR0_DPE_ELEVATE_PRI_WR_ADDR A:0x4340d4
y.create.l HWIO_BIMC_S_DDR0_DPE_TIMER_0_ADDR A:0x4340e4
y.create.l HWIO_BIMC_S_DDR0_DPE_TIMER_1_ADDR A:0x4340e8
y.create.l HWIO_BIMC_S_DDR0_DPE_TIMER_2_ADDR A:0x4340ec
y.create.l HWIO_BIMC_S_DDR0_DPE_TIMER_3_ADDR A:0x4340f0
y.create.l HWIO_BIMC_S_DDR0_DPE_MRW_BEFORE_FREQ_SWITCH_0_ADDR A:0x434114
y.create.l HWIO_BIMC_S_DDR0_DPE_MRW_BEFORE_FREQ_SWITCH_1_ADDR A:0x434118
y.create.l HWIO_BIMC_S_DDR0_DPE_MRW_BEFORE_FREQ_SWITCH_2_ADDR A:0x43411c
y.create.l HWIO_BIMC_S_DDR0_DPE_MRW_BEFORE_FREQ_SWITCH_3_ADDR A:0x434120
y.create.l HWIO_BIMC_S_DDR0_DPE_MRW_AFTER_FREQ_SWITCH_0_ADDR A:0x434124
y.create.l HWIO_BIMC_S_DDR0_DPE_MRW_AFTER_FREQ_SWITCH_1_ADDR A:0x434128
y.create.l HWIO_BIMC_S_DDR0_DPE_MRW_AFTER_FREQ_SWITCH_2_ADDR A:0x43412c
y.create.l HWIO_BIMC_S_DDR0_DPE_MRW_AFTER_FREQ_SWITCH_3_ADDR A:0x434130
y.create.l HWIO_BIMC_S_DDR0_DPE_MRW_FREQ_SWITCH_ADDR A:0x434134
y.create.l HWIO_BIMC_S_DDR0_DPE_DRAM_TIMING_0_ADDR A:0x434144
y.create.l HWIO_BIMC_S_DDR0_DPE_DRAM_TIMING_1_ADDR A:0x434148
y.create.l HWIO_BIMC_S_DDR0_DPE_DRAM_TIMING_2_ADDR A:0x43414c
y.create.l HWIO_BIMC_S_DDR0_DPE_DRAM_TIMING_3_ADDR A:0x434150
y.create.l HWIO_BIMC_S_DDR0_DPE_DRAM_TIMING_4_ADDR A:0x434154
y.create.l HWIO_BIMC_S_DDR0_DPE_DRAM_TIMING_5_ADDR A:0x434158
y.create.l HWIO_BIMC_S_DDR0_DPE_DRAM_TIMING_6_ADDR A:0x43415c
y.create.l HWIO_BIMC_S_DDR0_DPE_DRAM_TIMING_7_ADDR A:0x434160
y.create.l HWIO_BIMC_S_DDR0_DPE_DRAM_TIMING_8_ADDR A:0x434164
y.create.l HWIO_BIMC_S_DDR0_DPE_DRAM_TIMING_9_ADDR A:0x434168
y.create.l HWIO_BIMC_S_DDR0_DPE_DRAM_TIMING_10_ADDR A:0x43416c
y.create.l HWIO_BIMC_S_DDR0_DPE_DRAM_TIMING_11_ADDR A:0x434170
y.create.l HWIO_BIMC_S_DDR0_DPE_DRAM_TIMING_12_ADDR A:0x434174
y.create.l HWIO_BIMC_S_DDR0_DPE_DRAM_TIMING_13_ADDR A:0x434178
y.create.l HWIO_BIMC_S_DDR0_DPE_DRAM_TIMING_14_ADDR A:0x43417c
y.create.l HWIO_BIMC_S_DDR0_DPE_DRAM_TIMING_15_ADDR A:0x434180
y.create.l HWIO_BIMC_S_DDR0_DPE_DRAM_TIMING_16_ADDR A:0x434184
y.create.l HWIO_BIMC_S_DDR0_DPE_DRAM_TIMING_17_ADDR A:0x434188
y.create.l HWIO_BIMC_S_DDR0_DPE_DRAM_TIMING_18_ADDR A:0x43418c
y.create.l HWIO_BIMC_S_DDR0_DPE_DRAM_TIMING_19_ADDR A:0x434190
y.create.l HWIO_BIMC_S_DDR0_DPE_DRAM_TIMING_20_ADDR A:0x434194
y.create.l HWIO_BIMC_S_DDR0_DPE_DRAM_TIMING_21_ADDR A:0x434198
y.create.l HWIO_BIMC_S_DDR0_DPE_DRAM_TIMING_22_ADDR A:0x43419c
y.create.l HWIO_BIMC_S_DDR0_DPE_DRAM_TIMING_23_ADDR A:0x4341a0
y.create.l HWIO_BIMC_S_DDR0_DPE_DRAM_TIMING_0_ACT_ADDR A:0x4341a4
y.create.l HWIO_BIMC_S_DDR0_DPE_DRAM_TIMING_1_ACT_ADDR A:0x4341a8
y.create.l HWIO_BIMC_S_DDR0_DPE_DRAM_TIMING_2_ACT_ADDR A:0x4341ac
y.create.l HWIO_BIMC_S_DDR0_DPE_DRAM_TIMING_3_ACT_ADDR A:0x4341b0
y.create.l HWIO_BIMC_S_DDR0_DPE_DRAM_TIMING_4_ACT_ADDR A:0x4341b4
y.create.l HWIO_BIMC_S_DDR0_DPE_DRAM_TIMING_5_ACT_ADDR A:0x4341b8
y.create.l HWIO_BIMC_S_DDR0_DPE_DRAM_TIMING_6_ACT_ADDR A:0x4341bc
y.create.l HWIO_BIMC_S_DDR0_DPE_DRAM_TIMING_7_ACT_ADDR A:0x4341c0
y.create.l HWIO_BIMC_S_DDR0_DPE_DRAM_TIMING_8_ACT_ADDR A:0x4341c4
y.create.l HWIO_BIMC_S_DDR0_DPE_DRAM_TIMING_9_ACT_ADDR A:0x4341c8
y.create.l HWIO_BIMC_S_DDR0_DPE_DRAM_TIMING_10_ACT_ADDR A:0x4341cc
y.create.l HWIO_BIMC_S_DDR0_DPE_DRAM_TIMING_11_ACT_ADDR A:0x4341d0
y.create.l HWIO_BIMC_S_DDR0_DPE_DRAM_TIMING_12_ACT_ADDR A:0x4341d4
y.create.l HWIO_BIMC_S_DDR0_DPE_DRAM_TIMING_13_ACT_ADDR A:0x4341d8
y.create.l HWIO_BIMC_S_DDR0_DPE_DRAM_TIMING_14_ACT_ADDR A:0x4341dc
y.create.l HWIO_BIMC_S_DDR0_DPE_DRAM_TIMING_15_ACT_ADDR A:0x4341e0
y.create.l HWIO_BIMC_S_DDR0_DPE_DRAM_TIMING_16_ACT_ADDR A:0x4341e4
y.create.l HWIO_BIMC_S_DDR0_DPE_DRAM_TIMING_17_ACT_ADDR A:0x4341e8
y.create.l HWIO_BIMC_S_DDR0_DPE_DRAM_TIMING_18_ACT_ADDR A:0x4341ec
y.create.l HWIO_BIMC_S_DDR0_DPE_DRAM_TIMING_19_ACT_ADDR A:0x4341f0
y.create.l HWIO_BIMC_S_DDR0_DPE_DRAM_TIMING_20_ACT_ADDR A:0x4341f4
y.create.l HWIO_BIMC_S_DDR0_DPE_DRAM_TIMING_21_ACT_ADDR A:0x4341f8
y.create.l HWIO_BIMC_S_DDR0_DPE_DRAM_TIMING_22_ACT_ADDR A:0x4341fc
y.create.l HWIO_BIMC_S_DDR0_DPE_DRAM_TIMING_23_ACT_ADDR A:0x434200
y.create.l HWIO_BIMC_S_DDR0_DPE_TESTBUS_CTRL_ADDR A:0x434204
y.create.l HWIO_BIMC_S_DDR0_DPE_SPARE_REG_ADDR A:0x434214
y.create.l HWIO_BIMC_S_DDR0_DPE_SPARE_REG_ACT_ADDR A:0x434224
y.create.l HWIO_BIMC_S_DDR0_DPE_DQCAL_RDATA_RANK1_U_ADDR A:0x434240
y.create.l HWIO_BIMC_S_DDR0_DPE_DQCAL_RDATA_RANK1_L_ADDR A:0x434244
y.create.l HWIO_BIMC_S_DDR0_DPE_DQCAL_RDATA_RANK0_U_ADDR A:0x434248
y.create.l HWIO_BIMC_S_DDR0_DPE_DQCAL_RDATA_RANK0_L_ADDR A:0x43424c
y.create.l HWIO_BIMC_S_DDR0_DPE_DQCAL_STATUS0_RANK1_ADDR A:0x434260
y.create.l HWIO_BIMC_S_DDR0_DPE_DQCAL_STATUS1_RANK1_ADDR A:0x434264
y.create.l HWIO_BIMC_S_DDR0_DPE_DQCAL_STATUS2_RANK1_ADDR A:0x434268
y.create.l HWIO_BIMC_S_DDR0_DPE_DQCAL_STATUS0_RANK0_ADDR A:0x434280
y.create.l HWIO_BIMC_S_DDR0_DPE_DQCAL_STATUS1_RANK0_ADDR A:0x434284
y.create.l HWIO_BIMC_S_DDR0_DPE_DQCAL_STATUS2_RANK0_ADDR A:0x434288
y.create.l HWIO_BIMC_S_DDR0_DPE_CGC_CTRL_ADDR A:0x4342fc
y.create.l HWIO_BIMC_S_DDR0_DPE_PMON_EN_ADDR A:0x434300
y.create.l HWIO_BIMC_S_DDR0_DPE_PMON_CFG_ADDR A:0x434304
y.create.l HWIO_BIMC_S_DDR0_DPE_PMON_CMD_QUEUED_0_ADDR A:0x434310
y.create.l HWIO_BIMC_S_DDR0_DPE_PMON_CMD_QUEUED_1_ADDR A:0x434314
y.create.l HWIO_BIMC_S_DDR0_DPE_PMON_CMD_QUEUED_2_ADDR A:0x434318
y.create.l HWIO_BIMC_S_DDR0_DPE_PMON_CMD_QUEUED_3_ADDR A:0x43431c
y.create.l HWIO_BIMC_S_DDR0_DPE_PMON_CMD_EXEC_0_ADDR A:0x434320
y.create.l HWIO_BIMC_S_DDR0_DPE_PMON_CMD_EXEC_1_ADDR A:0x434324
y.create.l HWIO_BIMC_S_DDR0_DPE_PMON_CMD_EXEC_2_ADDR A:0x434328
y.create.l HWIO_BIMC_S_DDR0_DPE_PMON_CMD_EXEC_3_ADDR A:0x43432c
y.create.l HWIO_BIMC_S_DDR0_DPE_PMON_CMD_FLTR_0_ADDR A:0x434330
y.create.l HWIO_BIMC_S_DDR0_DPE_PMON_CMD_FLTR_1_ADDR A:0x434334
y.create.l HWIO_BIMC_S_DDR0_DPE_PMON_CMD_FLTR_2_ADDR A:0x434338
y.create.l HWIO_BIMC_S_DDR0_DPE_PMON_CMD_FLTR_3_ADDR A:0x43433c
y.create.l HWIO_BIMC_S_DDR0_DPE_PMON_ADDR_FLTR_0_ADDR A:0x434340
y.create.l HWIO_BIMC_S_DDR0_DPE_PMON_ADDR_FLTR_1_ADDR A:0x434344
y.create.l HWIO_BIMC_S_DDR0_DPE_PMON_ADDR_FLTR_2_ADDR A:0x434348
y.create.l HWIO_BIMC_S_DDR0_DPE_PMON_ADDR_FLTR_3_ADDR A:0x43434c
y.create.l HWIO_BIMC_S_DDR0_DPE_PMON_MID_FLTR_0_ADDR A:0x434350
y.create.l HWIO_BIMC_S_DDR0_DPE_PMON_MID_FLTR_1_ADDR A:0x434354
y.create.l HWIO_BIMC_S_DDR0_DPE_PMON_LAT_LIM_0_ADDR A:0x434360
y.create.l HWIO_BIMC_S_DDR0_DPE_PMON_LAT_LIM_1_ADDR A:0x434364
y.create.l HWIO_BIMC_S_DDR0_DPE_PMON_LAT_LIM_2_ADDR A:0x434368
y.create.l HWIO_BIMC_S_DDR0_DPE_PMON_LAT_LIM_3_ADDR A:0x43436c
y.create.l HWIO_BIMC_S_DDR0_DPE_PMON_PRI_FLTR_0_ADDR A:0x434370
y.create.l HWIO_BIMC_S_DDR0_DPE_PMON_PRI_FLTR_1_ADDR A:0x434374
y.create.l HWIO_BIMC_S_DDR0_DPE_PMON_PRI_FLTR_2_ADDR A:0x434378
y.create.l HWIO_BIMC_S_DDR0_DPE_PMON_PRI_FLTR_3_ADDR A:0x43437c
y.create.l HWIO_BIMC_S_DDR0_DPE_PMON_CMDQ_0_ADDR A:0x434380
y.create.l HWIO_BIMC_S_DDR0_DPE_PMON_CMDQ_1_ADDR A:0x434384
y.create.l HWIO_BIMC_S_DDR0_DPE_PMON_WRBUF_0_ADDR A:0x434388
y.create.l HWIO_BIMC_S_DDR0_DPE_PMON_WRBUF_1_ADDR A:0x43438c
y.create.l HWIO_BIMC_S_DDR0_DPE_PMON_DDR_CMD_0_ADDR A:0x434390
y.create.l HWIO_BIMC_S_DDR0_DPE_PMON_DDR_CMD_1_ADDR A:0x434394
y.create.l HWIO_BIMC_S_DDR0_DPE_PMON_DDR_CMD_2_ADDR A:0x434398
y.create.l HWIO_BIMC_S_DDR0_DPE_PMON_DDR_CMD_3_ADDR A:0x43439c
y.create.l HWIO_BIMC_S_DDR0_DPE_PMON_DDR_DATA_0_ADDR A:0x4343a0
y.create.l HWIO_BIMC_S_DDR0_DPE_PMON_DDR_DATA_1_ADDR A:0x4343a4
y.create.l HWIO_BIMC_S_DDR0_DPE_PMON_RANK_STATE_0_ADDR A:0x4343b0
y.create.l HWIO_BIMC_S_DDR0_DPE_PMON_RANK_STATE_1_ADDR A:0x4343b4
y.create.l HWIO_BIMC_S_DDR0_DPE_PMON_RANK_STATE_2_ADDR A:0x4343b8
y.create.l HWIO_BIMC_S_DDR0_DPE_PMON_RANK_STATE_3_ADDR A:0x4343bc
y.create.l HWIO_BIMC_S_DDR0_DPE_PMON_SHKE_0_ADDR A:0x4343c0
y.create.l HWIO_BIMC_S_DDR0_DPE_PMON_SHKE_1_ADDR A:0x4343c4
y.create.l HWIO_BIMC_S_DDR0_DPE_PMON_SHKE_2_ADDR A:0x4343c8
y.create.l HWIO_BIMC_S_DDR0_DPE_PMON_SHKE_3_ADDR A:0x4343cc
y.create.l HWIO_BIMC_S_DDR0_DPE_PMON_SHKE_4_ADDR A:0x4343d0
y.create.l HWIO_BIMC_S_DDR0_DPE_PMON_SHKE_5_ADDR A:0x4343d4
y.create.l HWIO_BIMC_S_DDR0_DPE_PMON_SHKE_6_ADDR A:0x4343d8
y.create.l HWIO_BIMC_S_DDR0_DPE_PMON_SHKE_7_ADDR A:0x4343dc
y.create.l HWIO_BIMC_S_DDR0_DPE_DERATE_TEMP_CTRL_ADDR A:0x4346e0
y.create.l HWIO_BIMC_S_DDR0_DPE_WR_DATA_CTRL_ADDR A:0x4346e4
y.create.l HWIO_BIMC_S_DDR0_SHKE_REG_BASE_START_ADDR A:0x435000
y.create.l HWIO_BIMC_S_DDR0_SHKE_REG_BASE_LAST_ADDR A:0x435130
y.create.l HWIO_BIMC_S_DDR0_SHKE_REG_BASE_END_ADDR A:0x436000
y.create.l HWIO_BIMC_S_DDR0_SHKE_HW_INFO_ADDR A:0x435000
y.create.l HWIO_BIMC_S_DDR0_SHKE_CONFIG_ADDR A:0x435004
y.create.l HWIO_BIMC_S_DDR0_SHKE_CGC_CNTL_ADDR A:0x435010
y.create.l HWIO_BIMC_S_DDR0_SHKE_DRAM_MANUAL_0_ADDR A:0x435020
y.create.l HWIO_BIMC_S_DDR0_SHKE_DRAM_MANUAL_1_ADDR A:0x435024
y.create.l HWIO_BIMC_S_DDR0_SHKE_MREG_ADDR_WDATA_CNTL_ADDR A:0x435030
y.create.l HWIO_BIMC_S_DDR0_SHKE_MREG_RDATA_RANK1_U_ADDR A:0x435050
y.create.l HWIO_BIMC_S_DDR0_SHKE_MREG_RDATA_RANK1_L_ADDR A:0x435054
y.create.l HWIO_BIMC_S_DDR0_SHKE_MREG_RDATA_RANK0_U_ADDR A:0x435060
y.create.l HWIO_BIMC_S_DDR0_SHKE_MREG_RDATA_RANK0_L_ADDR A:0x435064
y.create.l HWIO_BIMC_S_DDR0_SHKE_MREG_RDATA_STATUS_ADDR A:0x435070
y.create.l HWIO_BIMC_S_DDR0_SHKE_DRAM_STATUS_ADDR A:0x435074
y.create.l HWIO_BIMC_S_DDR0_SHKE_DRAM_DEBUG_CMD_0_ADDR A:0x435080
y.create.l HWIO_BIMC_S_DDR0_SHKE_DRAM_DEBUG_CMD_1_ADDR A:0x435084
y.create.l HWIO_BIMC_S_DDR0_SHKE_DRAM_DEBUG_CMD_2_ADDR A:0x435088
y.create.l HWIO_BIMC_S_DDR0_SHKE_PERIODIC_MRR_ADDR A:0x4350a0
y.create.l HWIO_BIMC_S_DDR0_SHKE_PERIODIC_MRR_RDATA_RANK1_U_ADDR A:0x4350b0
y.create.l HWIO_BIMC_S_DDR0_SHKE_PERIODIC_MRR_RDATA_RANK1_L_ADDR A:0x4350b4
y.create.l HWIO_BIMC_S_DDR0_SHKE_PERIODIC_MRR_RDATA_RANK0_U_ADDR A:0x4350b8
y.create.l HWIO_BIMC_S_DDR0_SHKE_PERIODIC_MRR_RDATA_RANK0_L_ADDR A:0x4350bc
y.create.l HWIO_BIMC_S_DDR0_SHKE_PERIODIC_ZQCAL_ADDR A:0x4350d0
y.create.l HWIO_BIMC_S_DDR0_SHKE_AUTO_REFRESH_CNTL_ADDR A:0x4350f0
y.create.l HWIO_BIMC_S_DDR0_SHKE_SELF_REFRESH_CNTL_ADDR A:0x4350f4
y.create.l HWIO_BIMC_S_DDR0_SHKE_AUTO_REFRESH_CNTL_1_ADDR A:0x435100
y.create.l HWIO_BIMC_S_DDR0_SHKE_AUTO_REFRESH_CNTL_2_ADDR A:0x435104
y.create.l HWIO_BIMC_S_DDR0_SHKE_TESTBUS_CNTL_ADDR A:0x435114
y.create.l HWIO_BIMC_S_DDR0_SHKE_SPARE_REG_ADDR A:0x435130
y.create.l HWIO_BIMC_S_DDR0_SHKE_DERATE_REF_RANK0_ADDR A:0x4350c0
y.create.l HWIO_BIMC_S_DDR0_SHKE_DERATE_REF_RANK1_ADDR A:0x4350c4
y.create.l HWIO_BIMC_MPU_MPU1132_32_M31L10_AHB_REG_BASE_START_ADDR A:0x31000
y.create.l HWIO_BIMC_MPU_MPU1132_32_M31L10_AHB_REG_BASE_LAST_ADDR A:0x321dc
y.create.l HWIO_BIMC_MPU_MPU1132_32_M31L10_AHB_REG_BASE_END_ADDR A:0x32200
y.create.l HWIO_BIMC_MPU_XPU_SCR_ADDR A:0x31000
y.create.l HWIO_BIMC_MPU_XPU_SWDR_ADDR A:0x31004
y.create.l HWIO_BIMC_MPU_XPU_PRTN_RACR_SSHADOW_ADDR A:0x31008
y.create.l HWIO_BIMC_MPU_XPU_PRTN_WACR_SSHADOW_ADDR A:0x3100c
y.create.l HWIO_BIMC_MPU_XPU_PRTN_START_SSHADOW0_ADDR A:0x31010
y.create.l HWIO_BIMC_MPU_XPU_PRTN_END_SSHADOW0_ADDR A:0x31018
y.create.l HWIO_BIMC_MPU_XPU_SEAR0_ADDR A:0x31040
y.create.l HWIO_BIMC_MPU_XPU_SESR_ADDR A:0x31048
y.create.l HWIO_BIMC_MPU_XPU_SESRRESTORE_ADDR A:0x3104c
y.create.l HWIO_BIMC_MPU_XPU_SESYNR0_ADDR A:0x31050
y.create.l HWIO_BIMC_MPU_XPU_SESYNR1_ADDR A:0x31054
y.create.l HWIO_BIMC_MPU_XPU_SESYNR2_ADDR A:0x31058
y.create.l HWIO_BIMC_MPU_XPU_MCR_ADDR A:0x31100
y.create.l HWIO_BIMC_MPU_XPU_MEAR0_ADDR A:0x31140
y.create.l HWIO_BIMC_MPU_XPU_MESR_ADDR A:0x31148
y.create.l HWIO_BIMC_MPU_XPU_MESRRESTORE_ADDR A:0x3114c
y.create.l HWIO_BIMC_MPU_XPU_MESYNR0_ADDR A:0x31150
y.create.l HWIO_BIMC_MPU_XPU_MESYNR1_ADDR A:0x31154
y.create.l HWIO_BIMC_MPU_XPU_MESYNR2_ADDR A:0x31158
y.create.l HWIO_BIMC_MPU_XPU_CR_ADDR A:0x31080
y.create.l HWIO_BIMC_MPU_XPU_PRTN_RACR_SHADOW_ADDR A:0x31088
y.create.l HWIO_BIMC_MPU_XPU_PRTN_WACR_SHADOW_ADDR A:0x3108c
y.create.l HWIO_BIMC_MPU_XPU_PRTN_START_SHADOW0_ADDR A:0x31090
y.create.l HWIO_BIMC_MPU_XPU_PRTN_END_SHADOW0_ADDR A:0x31098
y.create.l HWIO_BIMC_MPU_XPU_RPU_ACR0_ADDR A:0x310a0
y.create.l HWIO_BIMC_MPU_XPU_EAR0_ADDR A:0x310c0
y.create.l HWIO_BIMC_MPU_XPU_ESR_ADDR A:0x310c8
y.create.l HWIO_BIMC_MPU_XPU_ESRRESTORE_ADDR A:0x310cc
y.create.l HWIO_BIMC_MPU_XPU_ESYNR0_ADDR A:0x310d0
y.create.l HWIO_BIMC_MPU_XPU_ESYNR1_ADDR A:0x310d4
y.create.l HWIO_BIMC_MPU_XPU_ESYNR2_ADDR A:0x310d8
y.create.l HWIO_BIMC_MPU_XPU_UMR_RACR_ADDR A:0x310e0
y.create.l HWIO_BIMC_MPU_XPU_UMR_WACR_ADDR A:0x310e4
y.create.l HWIO_BIMC_MPU_XPU_UMR_CNTL_ADDR A:0x310f0
y.create.l HWIO_BIMC_MPU_XPU_IDR0_ADDR A:0x31074
y.create.l HWIO_BIMC_MPU_XPU_IDR1_ADDR A:0x31078
y.create.l HWIO_BIMC_MPU_XPU_REV_ADDR A:0x3107c
y.create.l HWIO_BIMC_MPU_XPU_PRT0_RACR0_ADDR A:0x31200
y.create.l HWIO_BIMC_MPU_XPU_PRT1_RACR0_ADDR A:0x31280
y.create.l HWIO_BIMC_MPU_XPU_PRT2_RACR0_ADDR A:0x31300
y.create.l HWIO_BIMC_MPU_XPU_PRT3_RACR0_ADDR A:0x31380
y.create.l HWIO_BIMC_MPU_XPU_PRT4_RACR0_ADDR A:0x31400
y.create.l HWIO_BIMC_MPU_XPU_PRT5_RACR0_ADDR A:0x31480
y.create.l HWIO_BIMC_MPU_XPU_PRT6_RACR0_ADDR A:0x31500
y.create.l HWIO_BIMC_MPU_XPU_PRT7_RACR0_ADDR A:0x31580
y.create.l HWIO_BIMC_MPU_XPU_PRT8_RACR0_ADDR A:0x31600
y.create.l HWIO_BIMC_MPU_XPU_PRT9_RACR0_ADDR A:0x31680
y.create.l HWIO_BIMC_MPU_XPU_PRT0_WACR0_ADDR A:0x31220
y.create.l HWIO_BIMC_MPU_XPU_PRT1_WACR0_ADDR A:0x312a0
y.create.l HWIO_BIMC_MPU_XPU_PRT2_WACR0_ADDR A:0x31320
y.create.l HWIO_BIMC_MPU_XPU_PRT3_WACR0_ADDR A:0x313a0
y.create.l HWIO_BIMC_MPU_XPU_PRT4_WACR0_ADDR A:0x31420
y.create.l HWIO_BIMC_MPU_XPU_PRT5_WACR0_ADDR A:0x314a0
y.create.l HWIO_BIMC_MPU_XPU_PRT6_WACR0_ADDR A:0x31520
y.create.l HWIO_BIMC_MPU_XPU_PRT7_WACR0_ADDR A:0x315a0
y.create.l HWIO_BIMC_MPU_XPU_PRT8_WACR0_ADDR A:0x31620
y.create.l HWIO_BIMC_MPU_XPU_PRT9_WACR0_ADDR A:0x316a0
y.create.l HWIO_BIMC_MPU_XPU_PRT0_START0_ADDR A:0x31240
y.create.l HWIO_BIMC_MPU_XPU_PRT1_START0_ADDR A:0x312c0
y.create.l HWIO_BIMC_MPU_XPU_PRT2_START0_ADDR A:0x31340
y.create.l HWIO_BIMC_MPU_XPU_PRT3_START0_ADDR A:0x313c0
y.create.l HWIO_BIMC_MPU_XPU_PRT4_START0_ADDR A:0x31440
y.create.l HWIO_BIMC_MPU_XPU_PRT5_START0_ADDR A:0x314c0
y.create.l HWIO_BIMC_MPU_XPU_PRT6_START0_ADDR A:0x31540
y.create.l HWIO_BIMC_MPU_XPU_PRT7_START0_ADDR A:0x315c0
y.create.l HWIO_BIMC_MPU_XPU_PRT8_START0_ADDR A:0x31640
y.create.l HWIO_BIMC_MPU_XPU_PRT9_START0_ADDR A:0x316c0
y.create.l HWIO_BIMC_MPU_XPU_PRT0_END0_ADDR A:0x31248
y.create.l HWIO_BIMC_MPU_XPU_PRT1_END0_ADDR A:0x312c8
y.create.l HWIO_BIMC_MPU_XPU_PRT2_END0_ADDR A:0x31348
y.create.l HWIO_BIMC_MPU_XPU_PRT3_END0_ADDR A:0x313c8
y.create.l HWIO_BIMC_MPU_XPU_PRT4_END0_ADDR A:0x31448
y.create.l HWIO_BIMC_MPU_XPU_PRT5_END0_ADDR A:0x314c8
y.create.l HWIO_BIMC_MPU_XPU_PRT6_END0_ADDR A:0x31548
y.create.l HWIO_BIMC_MPU_XPU_PRT7_END0_ADDR A:0x315c8
y.create.l HWIO_BIMC_MPU_XPU_PRT8_END0_ADDR A:0x31648
y.create.l HWIO_BIMC_MPU_XPU_PRT9_END0_ADDR A:0x316c8
y.create.l HWIO_BIMC_MPU_XPU_PRT0_SCR_ADDR A:0x31250
y.create.l HWIO_BIMC_MPU_XPU_PRT1_SCR_ADDR A:0x312d0
y.create.l HWIO_BIMC_MPU_XPU_PRT2_SCR_ADDR A:0x31350
y.create.l HWIO_BIMC_MPU_XPU_PRT3_SCR_ADDR A:0x313d0
y.create.l HWIO_BIMC_MPU_XPU_PRT4_SCR_ADDR A:0x31450
y.create.l HWIO_BIMC_MPU_XPU_PRT5_SCR_ADDR A:0x314d0
y.create.l HWIO_BIMC_MPU_XPU_PRT6_SCR_ADDR A:0x31550
y.create.l HWIO_BIMC_MPU_XPU_PRT7_SCR_ADDR A:0x315d0
y.create.l HWIO_BIMC_MPU_XPU_PRT8_SCR_ADDR A:0x31650
y.create.l HWIO_BIMC_MPU_XPU_PRT9_SCR_ADDR A:0x316d0
y.create.l HWIO_BIMC_MPU_XPU_PRT0_MCR_ADDR A:0x31254
y.create.l HWIO_BIMC_MPU_XPU_PRT1_MCR_ADDR A:0x312d4
y.create.l HWIO_BIMC_MPU_XPU_PRT2_MCR_ADDR A:0x31354
y.create.l HWIO_BIMC_MPU_XPU_PRT3_MCR_ADDR A:0x313d4
y.create.l HWIO_BIMC_MPU_XPU_PRT4_MCR_ADDR A:0x31454
y.create.l HWIO_BIMC_MPU_XPU_PRT5_MCR_ADDR A:0x314d4
y.create.l HWIO_BIMC_MPU_XPU_PRT6_MCR_ADDR A:0x31554
y.create.l HWIO_BIMC_MPU_XPU_PRT7_MCR_ADDR A:0x315d4
y.create.l HWIO_BIMC_MPU_XPU_PRT8_MCR_ADDR A:0x31654
y.create.l HWIO_BIMC_MPU_XPU_PRT9_MCR_ADDR A:0x316d4
y.create.l HWIO_BIMC_MPU_XPU_PRT0_CNTL0_ADDR A:0x31258
y.create.l HWIO_BIMC_MPU_XPU_PRT1_CNTL0_ADDR A:0x312d8
y.create.l HWIO_BIMC_MPU_XPU_PRT2_CNTL0_ADDR A:0x31358
y.create.l HWIO_BIMC_MPU_XPU_PRT3_CNTL0_ADDR A:0x313d8
y.create.l HWIO_BIMC_MPU_XPU_PRT4_CNTL0_ADDR A:0x31458
y.create.l HWIO_BIMC_MPU_XPU_PRT5_CNTL0_ADDR A:0x314d8
y.create.l HWIO_BIMC_MPU_XPU_PRT6_CNTL0_ADDR A:0x31558
y.create.l HWIO_BIMC_MPU_XPU_PRT7_CNTL0_ADDR A:0x315d8
y.create.l HWIO_BIMC_MPU_XPU_PRT8_CNTL0_ADDR A:0x31658
y.create.l HWIO_BIMC_MPU_XPU_PRT9_CNTL0_ADDR A:0x316d8
y.create.l HWIO_BIMC_MPU_XPU_PRT0_CNTL1_ADDR A:0x3125c
y.create.l HWIO_BIMC_MPU_XPU_PRT1_CNTL1_ADDR A:0x312dc
y.create.l HWIO_BIMC_MPU_XPU_PRT2_CNTL1_ADDR A:0x3135c
y.create.l HWIO_BIMC_MPU_XPU_PRT3_CNTL1_ADDR A:0x313dc
y.create.l HWIO_BIMC_MPU_XPU_PRT4_CNTL1_ADDR A:0x3145c
y.create.l HWIO_BIMC_MPU_XPU_PRT5_CNTL1_ADDR A:0x314dc
y.create.l HWIO_BIMC_MPU_XPU_PRT6_CNTL1_ADDR A:0x3155c
y.create.l HWIO_BIMC_MPU_XPU_PRT7_CNTL1_ADDR A:0x315dc
y.create.l HWIO_BIMC_MPU_XPU_PRT8_CNTL1_ADDR A:0x3165c
y.create.l HWIO_BIMC_MPU_XPU_PRT9_CNTL1_ADDR A:0x316dc
y.create.l HWIO_BLSP1_BLSP_BAM_REG_BASE_START_ADDR A:0x7884000
y.create.l HWIO_BLSP1_BLSP_BAM_REG_BASE_LAST_ADDR A:0x78a6934
y.create.l HWIO_BLSP1_BLSP_BAM_REG_BASE_END_ADDR A:0x78a7000
y.create.l HWIO_BLSP1_BLSP_BAM_BAM_CTRL_ADDR A:0x7884000
y.create.l HWIO_BLSP1_BLSP_BAM_BAM_TIMER_ADDR A:0x7884040
y.create.l HWIO_BLSP1_BLSP_BAM_BAM_TIMER_CTRL_ADDR A:0x7884044
y.create.l HWIO_BLSP1_BLSP_BAM_BAM_DESC_CNT_TRSHLD_ADDR A:0x7884008
y.create.l HWIO_BLSP1_BLSP_BAM_BAM_IRQ_STTS_ADDR A:0x7884014
y.create.l HWIO_BLSP1_BLSP_BAM_BAM_IRQ_CLR_ADDR A:0x7884018
y.create.l HWIO_BLSP1_BLSP_BAM_BAM_IRQ_EN_ADDR A:0x788401c
y.create.l HWIO_BLSP1_BLSP_BAM_BAM_CNFG_BITS_ADDR A:0x788407c
y.create.l HWIO_BLSP1_BLSP_BAM_BAM_CNFG_BITS_2_ADDR A:0x7884084
y.create.l HWIO_BLSP1_BLSP_BAM_BAM_REVISION_ADDR A:0x7885000
y.create.l HWIO_BLSP1_BLSP_BAM_BAM_SW_VERSION_ADDR A:0x7885004
y.create.l HWIO_BLSP1_BLSP_BAM_BAM_NUM_PIPES_ADDR A:0x7885008
y.create.l HWIO_BLSP1_BLSP_BAM_BAM_TEST_BUS_SEL_ADDR A:0x7885010
y.create.l HWIO_BLSP1_BLSP_BAM_BAM_TEST_BUS_REG_ADDR A:0x7885014
y.create.l HWIO_BLSP1_BLSP_BAM_BAM_AHB_MASTER_ERR_CTRLS_ADDR A:0x7885024
y.create.l HWIO_BLSP1_BLSP_BAM_BAM_AHB_MASTER_ERR_ADDR_ADDR A:0x7885028
y.create.l HWIO_BLSP1_BLSP_BAM_BAM_AHB_MASTER_ERR_DATA_ADDR A:0x788502c
y.create.l HWIO_BLSP1_BLSP_BAM_BAM_AHB_MASTER_ERR_ADDR_LSB_ADDR A:0x7885100
y.create.l HWIO_BLSP1_BLSP_BAM_BAM_AHB_MASTER_ERR_ADDR_MSB_ADDR A:0x7885104
y.create.l HWIO_BLSP1_BLSP_BAM_BAM_TRUST_REG_ADDR A:0x7886000
y.create.l HWIO_BLSP1_BLSP_BAM_BAM_P_TRUST_REG0_ADDR A:0x7886020
y.create.l HWIO_BLSP1_BLSP_BAM_BAM_P_TRUST_REG1_ADDR A:0x7886024
y.create.l HWIO_BLSP1_BLSP_BAM_BAM_P_TRUST_REG2_ADDR A:0x7886028
y.create.l HWIO_BLSP1_BLSP_BAM_BAM_P_TRUST_REG3_ADDR A:0x788602c
y.create.l HWIO_BLSP1_BLSP_BAM_BAM_P_TRUST_REG4_ADDR A:0x7886030
y.create.l HWIO_BLSP1_BLSP_BAM_BAM_P_TRUST_REG5_ADDR A:0x7886034
y.create.l HWIO_BLSP1_BLSP_BAM_BAM_P_TRUST_REG6_ADDR A:0x7886038
y.create.l HWIO_BLSP1_BLSP_BAM_BAM_P_TRUST_REG7_ADDR A:0x788603c
y.create.l HWIO_BLSP1_BLSP_BAM_BAM_P_TRUST_REG8_ADDR A:0x7886040
y.create.l HWIO_BLSP1_BLSP_BAM_BAM_P_TRUST_REG9_ADDR A:0x7886044
y.create.l HWIO_BLSP1_BLSP_BAM_BAM_IRQ_SRCS_EE0_ADDR A:0x7887000
y.create.l HWIO_BLSP1_BLSP_BAM_BAM_IRQ_SRCS_EE1_ADDR A:0x7888000
y.create.l HWIO_BLSP1_BLSP_BAM_BAM_IRQ_SRCS_EE2_ADDR A:0x7889000
y.create.l HWIO_BLSP1_BLSP_BAM_BAM_IRQ_SRCS_EE3_ADDR A:0x788a000
y.create.l HWIO_BLSP1_BLSP_BAM_BAM_IRQ_SRCS_MSK_EE0_ADDR A:0x7887004
y.create.l HWIO_BLSP1_BLSP_BAM_BAM_IRQ_SRCS_MSK_EE1_ADDR A:0x7888004
y.create.l HWIO_BLSP1_BLSP_BAM_BAM_IRQ_SRCS_MSK_EE2_ADDR A:0x7889004
y.create.l HWIO_BLSP1_BLSP_BAM_BAM_IRQ_SRCS_MSK_EE3_ADDR A:0x788a004
y.create.l HWIO_BLSP1_BLSP_BAM_BAM_IRQ_SRCS_UNMASKED_EE0_ADDR A:0x7887008
y.create.l HWIO_BLSP1_BLSP_BAM_BAM_IRQ_SRCS_UNMASKED_EE1_ADDR A:0x7888008
y.create.l HWIO_BLSP1_BLSP_BAM_BAM_IRQ_SRCS_UNMASKED_EE2_ADDR A:0x7889008
y.create.l HWIO_BLSP1_BLSP_BAM_BAM_IRQ_SRCS_UNMASKED_EE3_ADDR A:0x788a008
y.create.l HWIO_BLSP1_BLSP_BAM_BAM_PIPE_ATTR_EE0_ADDR A:0x788700c
y.create.l HWIO_BLSP1_BLSP_BAM_BAM_PIPE_ATTR_EE1_ADDR A:0x788800c
y.create.l HWIO_BLSP1_BLSP_BAM_BAM_PIPE_ATTR_EE2_ADDR A:0x788900c
y.create.l HWIO_BLSP1_BLSP_BAM_BAM_PIPE_ATTR_EE3_ADDR A:0x788a00c
y.create.l HWIO_BLSP1_BLSP_BAM_BAM_IRQ_SRCS_ADDR A:0x7887010
y.create.l HWIO_BLSP1_BLSP_BAM_BAM_IRQ_SRCS_MSK_ADDR A:0x7887014
y.create.l HWIO_BLSP1_BLSP_BAM_BAM_IRQ_SRCS_UNMASKED_ADDR A:0x7887018
y.create.l HWIO_BLSP1_BLSP_BAM_BAM_P_CTRL0_ADDR A:0x7897000
y.create.l HWIO_BLSP1_BLSP_BAM_BAM_P_CTRL1_ADDR A:0x7898000
y.create.l HWIO_BLSP1_BLSP_BAM_BAM_P_CTRL2_ADDR A:0x7899000
y.create.l HWIO_BLSP1_BLSP_BAM_BAM_P_CTRL3_ADDR A:0x789a000
y.create.l HWIO_BLSP1_BLSP_BAM_BAM_P_CTRL4_ADDR A:0x789b000
y.create.l HWIO_BLSP1_BLSP_BAM_BAM_P_CTRL5_ADDR A:0x789c000
y.create.l HWIO_BLSP1_BLSP_BAM_BAM_P_CTRL6_ADDR A:0x789d000
y.create.l HWIO_BLSP1_BLSP_BAM_BAM_P_CTRL7_ADDR A:0x789e000
y.create.l HWIO_BLSP1_BLSP_BAM_BAM_P_CTRL8_ADDR A:0x789f000
y.create.l HWIO_BLSP1_BLSP_BAM_BAM_P_CTRL9_ADDR A:0x78a0000
y.create.l HWIO_BLSP1_BLSP_BAM_BAM_P_RST0_ADDR A:0x7897004
y.create.l HWIO_BLSP1_BLSP_BAM_BAM_P_RST1_ADDR A:0x7898004
y.create.l HWIO_BLSP1_BLSP_BAM_BAM_P_RST2_ADDR A:0x7899004
y.create.l HWIO_BLSP1_BLSP_BAM_BAM_P_RST3_ADDR A:0x789a004
y.create.l HWIO_BLSP1_BLSP_BAM_BAM_P_RST4_ADDR A:0x789b004
y.create.l HWIO_BLSP1_BLSP_BAM_BAM_P_RST5_ADDR A:0x789c004
y.create.l HWIO_BLSP1_BLSP_BAM_BAM_P_RST6_ADDR A:0x789d004
y.create.l HWIO_BLSP1_BLSP_BAM_BAM_P_RST7_ADDR A:0x789e004
y.create.l HWIO_BLSP1_BLSP_BAM_BAM_P_RST8_ADDR A:0x789f004
y.create.l HWIO_BLSP1_BLSP_BAM_BAM_P_RST9_ADDR A:0x78a0004
y.create.l HWIO_BLSP1_BLSP_BAM_BAM_P_HALT0_ADDR A:0x7897008
y.create.l HWIO_BLSP1_BLSP_BAM_BAM_P_HALT1_ADDR A:0x7898008
y.create.l HWIO_BLSP1_BLSP_BAM_BAM_P_HALT2_ADDR A:0x7899008
y.create.l HWIO_BLSP1_BLSP_BAM_BAM_P_HALT3_ADDR A:0x789a008
y.create.l HWIO_BLSP1_BLSP_BAM_BAM_P_HALT4_ADDR A:0x789b008
y.create.l HWIO_BLSP1_BLSP_BAM_BAM_P_HALT5_ADDR A:0x789c008
y.create.l HWIO_BLSP1_BLSP_BAM_BAM_P_HALT6_ADDR A:0x789d008
y.create.l HWIO_BLSP1_BLSP_BAM_BAM_P_HALT7_ADDR A:0x789e008
y.create.l HWIO_BLSP1_BLSP_BAM_BAM_P_HALT8_ADDR A:0x789f008
y.create.l HWIO_BLSP1_BLSP_BAM_BAM_P_HALT9_ADDR A:0x78a0008
y.create.l HWIO_BLSP1_BLSP_BAM_BAM_P_IRQ_STTS0_ADDR A:0x7897010
y.create.l HWIO_BLSP1_BLSP_BAM_BAM_P_IRQ_STTS1_ADDR A:0x7898010
y.create.l HWIO_BLSP1_BLSP_BAM_BAM_P_IRQ_STTS2_ADDR A:0x7899010
y.create.l HWIO_BLSP1_BLSP_BAM_BAM_P_IRQ_STTS3_ADDR A:0x789a010
y.create.l HWIO_BLSP1_BLSP_BAM_BAM_P_IRQ_STTS4_ADDR A:0x789b010
y.create.l HWIO_BLSP1_BLSP_BAM_BAM_P_IRQ_STTS5_ADDR A:0x789c010
y.create.l HWIO_BLSP1_BLSP_BAM_BAM_P_IRQ_STTS6_ADDR A:0x789d010
y.create.l HWIO_BLSP1_BLSP_BAM_BAM_P_IRQ_STTS7_ADDR A:0x789e010
y.create.l HWIO_BLSP1_BLSP_BAM_BAM_P_IRQ_STTS8_ADDR A:0x789f010
y.create.l HWIO_BLSP1_BLSP_BAM_BAM_P_IRQ_STTS9_ADDR A:0x78a0010
y.create.l HWIO_BLSP1_BLSP_BAM_BAM_P_IRQ_CLR0_ADDR A:0x7897014
y.create.l HWIO_BLSP1_BLSP_BAM_BAM_P_IRQ_CLR1_ADDR A:0x7898014
y.create.l HWIO_BLSP1_BLSP_BAM_BAM_P_IRQ_CLR2_ADDR A:0x7899014
y.create.l HWIO_BLSP1_BLSP_BAM_BAM_P_IRQ_CLR3_ADDR A:0x789a014
y.create.l HWIO_BLSP1_BLSP_BAM_BAM_P_IRQ_CLR4_ADDR A:0x789b014
y.create.l HWIO_BLSP1_BLSP_BAM_BAM_P_IRQ_CLR5_ADDR A:0x789c014
y.create.l HWIO_BLSP1_BLSP_BAM_BAM_P_IRQ_CLR6_ADDR A:0x789d014
y.create.l HWIO_BLSP1_BLSP_BAM_BAM_P_IRQ_CLR7_ADDR A:0x789e014
y.create.l HWIO_BLSP1_BLSP_BAM_BAM_P_IRQ_CLR8_ADDR A:0x789f014
y.create.l HWIO_BLSP1_BLSP_BAM_BAM_P_IRQ_CLR9_ADDR A:0x78a0014
y.create.l HWIO_BLSP1_BLSP_BAM_BAM_P_IRQ_EN0_ADDR A:0x7897018
y.create.l HWIO_BLSP1_BLSP_BAM_BAM_P_IRQ_EN1_ADDR A:0x7898018
y.create.l HWIO_BLSP1_BLSP_BAM_BAM_P_IRQ_EN2_ADDR A:0x7899018
y.create.l HWIO_BLSP1_BLSP_BAM_BAM_P_IRQ_EN3_ADDR A:0x789a018
y.create.l HWIO_BLSP1_BLSP_BAM_BAM_P_IRQ_EN4_ADDR A:0x789b018
y.create.l HWIO_BLSP1_BLSP_BAM_BAM_P_IRQ_EN5_ADDR A:0x789c018
y.create.l HWIO_BLSP1_BLSP_BAM_BAM_P_IRQ_EN6_ADDR A:0x789d018
y.create.l HWIO_BLSP1_BLSP_BAM_BAM_P_IRQ_EN7_ADDR A:0x789e018
y.create.l HWIO_BLSP1_BLSP_BAM_BAM_P_IRQ_EN8_ADDR A:0x789f018
y.create.l HWIO_BLSP1_BLSP_BAM_BAM_P_IRQ_EN9_ADDR A:0x78a0018
y.create.l HWIO_BLSP1_BLSP_BAM_BAM_P_TIMER0_ADDR A:0x789701c
y.create.l HWIO_BLSP1_BLSP_BAM_BAM_P_TIMER1_ADDR A:0x789801c
y.create.l HWIO_BLSP1_BLSP_BAM_BAM_P_TIMER2_ADDR A:0x789901c
y.create.l HWIO_BLSP1_BLSP_BAM_BAM_P_TIMER3_ADDR A:0x789a01c
y.create.l HWIO_BLSP1_BLSP_BAM_BAM_P_TIMER4_ADDR A:0x789b01c
y.create.l HWIO_BLSP1_BLSP_BAM_BAM_P_TIMER5_ADDR A:0x789c01c
y.create.l HWIO_BLSP1_BLSP_BAM_BAM_P_TIMER6_ADDR A:0x789d01c
y.create.l HWIO_BLSP1_BLSP_BAM_BAM_P_TIMER7_ADDR A:0x789e01c
y.create.l HWIO_BLSP1_BLSP_BAM_BAM_P_TIMER8_ADDR A:0x789f01c
y.create.l HWIO_BLSP1_BLSP_BAM_BAM_P_TIMER9_ADDR A:0x78a001c
y.create.l HWIO_BLSP1_BLSP_BAM_BAM_P_TIMER_CTRL0_ADDR A:0x7897020
y.create.l HWIO_BLSP1_BLSP_BAM_BAM_P_TIMER_CTRL1_ADDR A:0x7898020
y.create.l HWIO_BLSP1_BLSP_BAM_BAM_P_TIMER_CTRL2_ADDR A:0x7899020
y.create.l HWIO_BLSP1_BLSP_BAM_BAM_P_TIMER_CTRL3_ADDR A:0x789a020
y.create.l HWIO_BLSP1_BLSP_BAM_BAM_P_TIMER_CTRL4_ADDR A:0x789b020
y.create.l HWIO_BLSP1_BLSP_BAM_BAM_P_TIMER_CTRL5_ADDR A:0x789c020
y.create.l HWIO_BLSP1_BLSP_BAM_BAM_P_TIMER_CTRL6_ADDR A:0x789d020
y.create.l HWIO_BLSP1_BLSP_BAM_BAM_P_TIMER_CTRL7_ADDR A:0x789e020
y.create.l HWIO_BLSP1_BLSP_BAM_BAM_P_TIMER_CTRL8_ADDR A:0x789f020
y.create.l HWIO_BLSP1_BLSP_BAM_BAM_P_TIMER_CTRL9_ADDR A:0x78a0020
y.create.l HWIO_BLSP1_BLSP_BAM_BAM_P_PRDCR_SDBND0_ADDR A:0x7897024
y.create.l HWIO_BLSP1_BLSP_BAM_BAM_P_PRDCR_SDBND1_ADDR A:0x7898024
y.create.l HWIO_BLSP1_BLSP_BAM_BAM_P_PRDCR_SDBND2_ADDR A:0x7899024
y.create.l HWIO_BLSP1_BLSP_BAM_BAM_P_PRDCR_SDBND3_ADDR A:0x789a024
y.create.l HWIO_BLSP1_BLSP_BAM_BAM_P_PRDCR_SDBND4_ADDR A:0x789b024
y.create.l HWIO_BLSP1_BLSP_BAM_BAM_P_PRDCR_SDBND5_ADDR A:0x789c024
y.create.l HWIO_BLSP1_BLSP_BAM_BAM_P_PRDCR_SDBND6_ADDR A:0x789d024
y.create.l HWIO_BLSP1_BLSP_BAM_BAM_P_PRDCR_SDBND7_ADDR A:0x789e024
y.create.l HWIO_BLSP1_BLSP_BAM_BAM_P_PRDCR_SDBND8_ADDR A:0x789f024
y.create.l HWIO_BLSP1_BLSP_BAM_BAM_P_PRDCR_SDBND9_ADDR A:0x78a0024
y.create.l HWIO_BLSP1_BLSP_BAM_BAM_P_CNSMR_SDBND0_ADDR A:0x7897028
y.create.l HWIO_BLSP1_BLSP_BAM_BAM_P_CNSMR_SDBND1_ADDR A:0x7898028
y.create.l HWIO_BLSP1_BLSP_BAM_BAM_P_CNSMR_SDBND2_ADDR A:0x7899028
y.create.l HWIO_BLSP1_BLSP_BAM_BAM_P_CNSMR_SDBND3_ADDR A:0x789a028
y.create.l HWIO_BLSP1_BLSP_BAM_BAM_P_CNSMR_SDBND4_ADDR A:0x789b028
y.create.l HWIO_BLSP1_BLSP_BAM_BAM_P_CNSMR_SDBND5_ADDR A:0x789c028
y.create.l HWIO_BLSP1_BLSP_BAM_BAM_P_CNSMR_SDBND6_ADDR A:0x789d028
y.create.l HWIO_BLSP1_BLSP_BAM_BAM_P_CNSMR_SDBND7_ADDR A:0x789e028
y.create.l HWIO_BLSP1_BLSP_BAM_BAM_P_CNSMR_SDBND8_ADDR A:0x789f028
y.create.l HWIO_BLSP1_BLSP_BAM_BAM_P_CNSMR_SDBND9_ADDR A:0x78a0028
y.create.l HWIO_BLSP1_BLSP_BAM_BAM_P_SW_OFSTS0_ADDR A:0x7897800
y.create.l HWIO_BLSP1_BLSP_BAM_BAM_P_SW_OFSTS1_ADDR A:0x7898800
y.create.l HWIO_BLSP1_BLSP_BAM_BAM_P_SW_OFSTS2_ADDR A:0x7899800
y.create.l HWIO_BLSP1_BLSP_BAM_BAM_P_SW_OFSTS3_ADDR A:0x789a800
y.create.l HWIO_BLSP1_BLSP_BAM_BAM_P_SW_OFSTS4_ADDR A:0x789b800
y.create.l HWIO_BLSP1_BLSP_BAM_BAM_P_SW_OFSTS5_ADDR A:0x789c800
y.create.l HWIO_BLSP1_BLSP_BAM_BAM_P_SW_OFSTS6_ADDR A:0x789d800
y.create.l HWIO_BLSP1_BLSP_BAM_BAM_P_SW_OFSTS7_ADDR A:0x789e800
y.create.l HWIO_BLSP1_BLSP_BAM_BAM_P_SW_OFSTS8_ADDR A:0x789f800
y.create.l HWIO_BLSP1_BLSP_BAM_BAM_P_SW_OFSTS9_ADDR A:0x78a0800
y.create.l HWIO_BLSP1_BLSP_BAM_BAM_P_AU_PSM_CNTXT_1_0_ADDR A:0x7897804
y.create.l HWIO_BLSP1_BLSP_BAM_BAM_P_AU_PSM_CNTXT_1_1_ADDR A:0x7898804
y.create.l HWIO_BLSP1_BLSP_BAM_BAM_P_AU_PSM_CNTXT_1_2_ADDR A:0x7899804
y.create.l HWIO_BLSP1_BLSP_BAM_BAM_P_AU_PSM_CNTXT_1_3_ADDR A:0x789a804
y.create.l HWIO_BLSP1_BLSP_BAM_BAM_P_AU_PSM_CNTXT_1_4_ADDR A:0x789b804
y.create.l HWIO_BLSP1_BLSP_BAM_BAM_P_AU_PSM_CNTXT_1_5_ADDR A:0x789c804
y.create.l HWIO_BLSP1_BLSP_BAM_BAM_P_AU_PSM_CNTXT_1_6_ADDR A:0x789d804
y.create.l HWIO_BLSP1_BLSP_BAM_BAM_P_AU_PSM_CNTXT_1_7_ADDR A:0x789e804
y.create.l HWIO_BLSP1_BLSP_BAM_BAM_P_AU_PSM_CNTXT_1_8_ADDR A:0x789f804
y.create.l HWIO_BLSP1_BLSP_BAM_BAM_P_AU_PSM_CNTXT_1_9_ADDR A:0x78a0804
y.create.l HWIO_BLSP1_BLSP_BAM_BAM_P_PSM_CNTXT_2_0_ADDR A:0x7897808
y.create.l HWIO_BLSP1_BLSP_BAM_BAM_P_PSM_CNTXT_2_1_ADDR A:0x7898808
y.create.l HWIO_BLSP1_BLSP_BAM_BAM_P_PSM_CNTXT_2_2_ADDR A:0x7899808
y.create.l HWIO_BLSP1_BLSP_BAM_BAM_P_PSM_CNTXT_2_3_ADDR A:0x789a808
y.create.l HWIO_BLSP1_BLSP_BAM_BAM_P_PSM_CNTXT_2_4_ADDR A:0x789b808
y.create.l HWIO_BLSP1_BLSP_BAM_BAM_P_PSM_CNTXT_2_5_ADDR A:0x789c808
y.create.l HWIO_BLSP1_BLSP_BAM_BAM_P_PSM_CNTXT_2_6_ADDR A:0x789d808
y.create.l HWIO_BLSP1_BLSP_BAM_BAM_P_PSM_CNTXT_2_7_ADDR A:0x789e808
y.create.l HWIO_BLSP1_BLSP_BAM_BAM_P_PSM_CNTXT_2_8_ADDR A:0x789f808
y.create.l HWIO_BLSP1_BLSP_BAM_BAM_P_PSM_CNTXT_2_9_ADDR A:0x78a0808
y.create.l HWIO_BLSP1_BLSP_BAM_BAM_P_PSM_CNTXT_3_0_ADDR A:0x789780c
y.create.l HWIO_BLSP1_BLSP_BAM_BAM_P_PSM_CNTXT_3_1_ADDR A:0x789880c
y.create.l HWIO_BLSP1_BLSP_BAM_BAM_P_PSM_CNTXT_3_2_ADDR A:0x789980c
y.create.l HWIO_BLSP1_BLSP_BAM_BAM_P_PSM_CNTXT_3_3_ADDR A:0x789a80c
y.create.l HWIO_BLSP1_BLSP_BAM_BAM_P_PSM_CNTXT_3_4_ADDR A:0x789b80c
y.create.l HWIO_BLSP1_BLSP_BAM_BAM_P_PSM_CNTXT_3_5_ADDR A:0x789c80c
y.create.l HWIO_BLSP1_BLSP_BAM_BAM_P_PSM_CNTXT_3_6_ADDR A:0x789d80c
y.create.l HWIO_BLSP1_BLSP_BAM_BAM_P_PSM_CNTXT_3_7_ADDR A:0x789e80c
y.create.l HWIO_BLSP1_BLSP_BAM_BAM_P_PSM_CNTXT_3_8_ADDR A:0x789f80c
y.create.l HWIO_BLSP1_BLSP_BAM_BAM_P_PSM_CNTXT_3_9_ADDR A:0x78a080c
y.create.l HWIO_BLSP1_BLSP_BAM_BAM_P_PSM_CNTXT_4_0_ADDR A:0x7897810
y.create.l HWIO_BLSP1_BLSP_BAM_BAM_P_PSM_CNTXT_4_1_ADDR A:0x7898810
y.create.l HWIO_BLSP1_BLSP_BAM_BAM_P_PSM_CNTXT_4_2_ADDR A:0x7899810
y.create.l HWIO_BLSP1_BLSP_BAM_BAM_P_PSM_CNTXT_4_3_ADDR A:0x789a810
y.create.l HWIO_BLSP1_BLSP_BAM_BAM_P_PSM_CNTXT_4_4_ADDR A:0x789b810
y.create.l HWIO_BLSP1_BLSP_BAM_BAM_P_PSM_CNTXT_4_5_ADDR A:0x789c810
y.create.l HWIO_BLSP1_BLSP_BAM_BAM_P_PSM_CNTXT_4_6_ADDR A:0x789d810
y.create.l HWIO_BLSP1_BLSP_BAM_BAM_P_PSM_CNTXT_4_7_ADDR A:0x789e810
y.create.l HWIO_BLSP1_BLSP_BAM_BAM_P_PSM_CNTXT_4_8_ADDR A:0x789f810
y.create.l HWIO_BLSP1_BLSP_BAM_BAM_P_PSM_CNTXT_4_9_ADDR A:0x78a0810
y.create.l HWIO_BLSP1_BLSP_BAM_BAM_P_PSM_CNTXT_5_0_ADDR A:0x7897814
y.create.l HWIO_BLSP1_BLSP_BAM_BAM_P_PSM_CNTXT_5_1_ADDR A:0x7898814
y.create.l HWIO_BLSP1_BLSP_BAM_BAM_P_PSM_CNTXT_5_2_ADDR A:0x7899814
y.create.l HWIO_BLSP1_BLSP_BAM_BAM_P_PSM_CNTXT_5_3_ADDR A:0x789a814
y.create.l HWIO_BLSP1_BLSP_BAM_BAM_P_PSM_CNTXT_5_4_ADDR A:0x789b814
y.create.l HWIO_BLSP1_BLSP_BAM_BAM_P_PSM_CNTXT_5_5_ADDR A:0x789c814
y.create.l HWIO_BLSP1_BLSP_BAM_BAM_P_PSM_CNTXT_5_6_ADDR A:0x789d814
y.create.l HWIO_BLSP1_BLSP_BAM_BAM_P_PSM_CNTXT_5_7_ADDR A:0x789e814
y.create.l HWIO_BLSP1_BLSP_BAM_BAM_P_PSM_CNTXT_5_8_ADDR A:0x789f814
y.create.l HWIO_BLSP1_BLSP_BAM_BAM_P_PSM_CNTXT_5_9_ADDR A:0x78a0814
y.create.l HWIO_BLSP1_BLSP_BAM_BAM_P_EVNT_REG0_ADDR A:0x7897818
y.create.l HWIO_BLSP1_BLSP_BAM_BAM_P_EVNT_REG1_ADDR A:0x7898818
y.create.l HWIO_BLSP1_BLSP_BAM_BAM_P_EVNT_REG2_ADDR A:0x7899818
y.create.l HWIO_BLSP1_BLSP_BAM_BAM_P_EVNT_REG3_ADDR A:0x789a818
y.create.l HWIO_BLSP1_BLSP_BAM_BAM_P_EVNT_REG4_ADDR A:0x789b818
y.create.l HWIO_BLSP1_BLSP_BAM_BAM_P_EVNT_REG5_ADDR A:0x789c818
y.create.l HWIO_BLSP1_BLSP_BAM_BAM_P_EVNT_REG6_ADDR A:0x789d818
y.create.l HWIO_BLSP1_BLSP_BAM_BAM_P_EVNT_REG7_ADDR A:0x789e818
y.create.l HWIO_BLSP1_BLSP_BAM_BAM_P_EVNT_REG8_ADDR A:0x789f818
y.create.l HWIO_BLSP1_BLSP_BAM_BAM_P_EVNT_REG9_ADDR A:0x78a0818
y.create.l HWIO_BLSP1_BLSP_BAM_BAM_P_DESC_FIFO_ADDR0_ADDR A:0x789781c
y.create.l HWIO_BLSP1_BLSP_BAM_BAM_P_DESC_FIFO_ADDR1_ADDR A:0x789881c
y.create.l HWIO_BLSP1_BLSP_BAM_BAM_P_DESC_FIFO_ADDR2_ADDR A:0x789981c
y.create.l HWIO_BLSP1_BLSP_BAM_BAM_P_DESC_FIFO_ADDR3_ADDR A:0x789a81c
y.create.l HWIO_BLSP1_BLSP_BAM_BAM_P_DESC_FIFO_ADDR4_ADDR A:0x789b81c
y.create.l HWIO_BLSP1_BLSP_BAM_BAM_P_DESC_FIFO_ADDR5_ADDR A:0x789c81c
y.create.l HWIO_BLSP1_BLSP_BAM_BAM_P_DESC_FIFO_ADDR6_ADDR A:0x789d81c
y.create.l HWIO_BLSP1_BLSP_BAM_BAM_P_DESC_FIFO_ADDR7_ADDR A:0x789e81c
y.create.l HWIO_BLSP1_BLSP_BAM_BAM_P_DESC_FIFO_ADDR8_ADDR A:0x789f81c
y.create.l HWIO_BLSP1_BLSP_BAM_BAM_P_DESC_FIFO_ADDR9_ADDR A:0x78a081c
y.create.l HWIO_BLSP1_BLSP_BAM_BAM_P_FIFO_SIZES0_ADDR A:0x7897820
y.create.l HWIO_BLSP1_BLSP_BAM_BAM_P_FIFO_SIZES1_ADDR A:0x7898820
y.create.l HWIO_BLSP1_BLSP_BAM_BAM_P_FIFO_SIZES2_ADDR A:0x7899820
y.create.l HWIO_BLSP1_BLSP_BAM_BAM_P_FIFO_SIZES3_ADDR A:0x789a820
y.create.l HWIO_BLSP1_BLSP_BAM_BAM_P_FIFO_SIZES4_ADDR A:0x789b820
y.create.l HWIO_BLSP1_BLSP_BAM_BAM_P_FIFO_SIZES5_ADDR A:0x789c820
y.create.l HWIO_BLSP1_BLSP_BAM_BAM_P_FIFO_SIZES6_ADDR A:0x789d820
y.create.l HWIO_BLSP1_BLSP_BAM_BAM_P_FIFO_SIZES7_ADDR A:0x789e820
y.create.l HWIO_BLSP1_BLSP_BAM_BAM_P_FIFO_SIZES8_ADDR A:0x789f820
y.create.l HWIO_BLSP1_BLSP_BAM_BAM_P_FIFO_SIZES9_ADDR A:0x78a0820
y.create.l HWIO_BLSP1_BLSP_BAM_BAM_P_DATA_FIFO_ADDR0_ADDR A:0x7897824
y.create.l HWIO_BLSP1_BLSP_BAM_BAM_P_DATA_FIFO_ADDR1_ADDR A:0x7898824
y.create.l HWIO_BLSP1_BLSP_BAM_BAM_P_DATA_FIFO_ADDR2_ADDR A:0x7899824
y.create.l HWIO_BLSP1_BLSP_BAM_BAM_P_DATA_FIFO_ADDR3_ADDR A:0x789a824
y.create.l HWIO_BLSP1_BLSP_BAM_BAM_P_DATA_FIFO_ADDR4_ADDR A:0x789b824
y.create.l HWIO_BLSP1_BLSP_BAM_BAM_P_DATA_FIFO_ADDR5_ADDR A:0x789c824
y.create.l HWIO_BLSP1_BLSP_BAM_BAM_P_DATA_FIFO_ADDR6_ADDR A:0x789d824
y.create.l HWIO_BLSP1_BLSP_BAM_BAM_P_DATA_FIFO_ADDR7_ADDR A:0x789e824
y.create.l HWIO_BLSP1_BLSP_BAM_BAM_P_DATA_FIFO_ADDR8_ADDR A:0x789f824
y.create.l HWIO_BLSP1_BLSP_BAM_BAM_P_DATA_FIFO_ADDR9_ADDR A:0x78a0824
y.create.l HWIO_BLSP1_BLSP_BAM_BAM_P_EVNT_GEN_TRSHLD0_ADDR A:0x7897828
y.create.l HWIO_BLSP1_BLSP_BAM_BAM_P_EVNT_GEN_TRSHLD1_ADDR A:0x7898828
y.create.l HWIO_BLSP1_BLSP_BAM_BAM_P_EVNT_GEN_TRSHLD2_ADDR A:0x7899828
y.create.l HWIO_BLSP1_BLSP_BAM_BAM_P_EVNT_GEN_TRSHLD3_ADDR A:0x789a828
y.create.l HWIO_BLSP1_BLSP_BAM_BAM_P_EVNT_GEN_TRSHLD4_ADDR A:0x789b828
y.create.l HWIO_BLSP1_BLSP_BAM_BAM_P_EVNT_GEN_TRSHLD5_ADDR A:0x789c828
y.create.l HWIO_BLSP1_BLSP_BAM_BAM_P_EVNT_GEN_TRSHLD6_ADDR A:0x789d828
y.create.l HWIO_BLSP1_BLSP_BAM_BAM_P_EVNT_GEN_TRSHLD7_ADDR A:0x789e828
y.create.l HWIO_BLSP1_BLSP_BAM_BAM_P_EVNT_GEN_TRSHLD8_ADDR A:0x789f828
y.create.l HWIO_BLSP1_BLSP_BAM_BAM_P_EVNT_GEN_TRSHLD9_ADDR A:0x78a0828
y.create.l HWIO_BLSP1_BLSP_BAM_BAM_P_EVNT_DEST_ADDR0_ADDR A:0x789782c
y.create.l HWIO_BLSP1_BLSP_BAM_BAM_P_EVNT_DEST_ADDR1_ADDR A:0x789882c
y.create.l HWIO_BLSP1_BLSP_BAM_BAM_P_EVNT_DEST_ADDR2_ADDR A:0x789982c
y.create.l HWIO_BLSP1_BLSP_BAM_BAM_P_EVNT_DEST_ADDR3_ADDR A:0x789a82c
y.create.l HWIO_BLSP1_BLSP_BAM_BAM_P_EVNT_DEST_ADDR4_ADDR A:0x789b82c
y.create.l HWIO_BLSP1_BLSP_BAM_BAM_P_EVNT_DEST_ADDR5_ADDR A:0x789c82c
y.create.l HWIO_BLSP1_BLSP_BAM_BAM_P_EVNT_DEST_ADDR6_ADDR A:0x789d82c
y.create.l HWIO_BLSP1_BLSP_BAM_BAM_P_EVNT_DEST_ADDR7_ADDR A:0x789e82c
y.create.l HWIO_BLSP1_BLSP_BAM_BAM_P_EVNT_DEST_ADDR8_ADDR A:0x789f82c
y.create.l HWIO_BLSP1_BLSP_BAM_BAM_P_EVNT_DEST_ADDR9_ADDR A:0x78a082c
y.create.l HWIO_BLSP1_BLSP_BAM_BAM_P_DF_CNTXT_0_ADDR A:0x7897830
y.create.l HWIO_BLSP1_BLSP_BAM_BAM_P_DF_CNTXT_1_ADDR A:0x7898830
y.create.l HWIO_BLSP1_BLSP_BAM_BAM_P_DF_CNTXT_2_ADDR A:0x7899830
y.create.l HWIO_BLSP1_BLSP_BAM_BAM_P_DF_CNTXT_3_ADDR A:0x789a830
y.create.l HWIO_BLSP1_BLSP_BAM_BAM_P_DF_CNTXT_4_ADDR A:0x789b830
y.create.l HWIO_BLSP1_BLSP_BAM_BAM_P_DF_CNTXT_5_ADDR A:0x789c830
y.create.l HWIO_BLSP1_BLSP_BAM_BAM_P_DF_CNTXT_6_ADDR A:0x789d830
y.create.l HWIO_BLSP1_BLSP_BAM_BAM_P_DF_CNTXT_7_ADDR A:0x789e830
y.create.l HWIO_BLSP1_BLSP_BAM_BAM_P_DF_CNTXT_8_ADDR A:0x789f830
y.create.l HWIO_BLSP1_BLSP_BAM_BAM_P_DF_CNTXT_9_ADDR A:0x78a0830
y.create.l HWIO_BLSP1_BLSP_BAM_BAM_P_RETR_CNTXT_0_ADDR A:0x7897834
y.create.l HWIO_BLSP1_BLSP_BAM_BAM_P_RETR_CNTXT_1_ADDR A:0x7898834
y.create.l HWIO_BLSP1_BLSP_BAM_BAM_P_RETR_CNTXT_2_ADDR A:0x7899834
y.create.l HWIO_BLSP1_BLSP_BAM_BAM_P_RETR_CNTXT_3_ADDR A:0x789a834
y.create.l HWIO_BLSP1_BLSP_BAM_BAM_P_RETR_CNTXT_4_ADDR A:0x789b834
y.create.l HWIO_BLSP1_BLSP_BAM_BAM_P_RETR_CNTXT_5_ADDR A:0x789c834
y.create.l HWIO_BLSP1_BLSP_BAM_BAM_P_RETR_CNTXT_6_ADDR A:0x789d834
y.create.l HWIO_BLSP1_BLSP_BAM_BAM_P_RETR_CNTXT_7_ADDR A:0x789e834
y.create.l HWIO_BLSP1_BLSP_BAM_BAM_P_RETR_CNTXT_8_ADDR A:0x789f834
y.create.l HWIO_BLSP1_BLSP_BAM_BAM_P_RETR_CNTXT_9_ADDR A:0x78a0834
y.create.l HWIO_BLSP1_BLSP_BAM_BAM_P_SI_CNTXT_0_ADDR A:0x7897838
y.create.l HWIO_BLSP1_BLSP_BAM_BAM_P_SI_CNTXT_1_ADDR A:0x7898838
y.create.l HWIO_BLSP1_BLSP_BAM_BAM_P_SI_CNTXT_2_ADDR A:0x7899838
y.create.l HWIO_BLSP1_BLSP_BAM_BAM_P_SI_CNTXT_3_ADDR A:0x789a838
y.create.l HWIO_BLSP1_BLSP_BAM_BAM_P_SI_CNTXT_4_ADDR A:0x789b838
y.create.l HWIO_BLSP1_BLSP_BAM_BAM_P_SI_CNTXT_5_ADDR A:0x789c838
y.create.l HWIO_BLSP1_BLSP_BAM_BAM_P_SI_CNTXT_6_ADDR A:0x789d838
y.create.l HWIO_BLSP1_BLSP_BAM_BAM_P_SI_CNTXT_7_ADDR A:0x789e838
y.create.l HWIO_BLSP1_BLSP_BAM_BAM_P_SI_CNTXT_8_ADDR A:0x789f838
y.create.l HWIO_BLSP1_BLSP_BAM_BAM_P_SI_CNTXT_9_ADDR A:0x78a0838
y.create.l HWIO_BLSP1_BLSP_BAM_BAM_P_PSM_CNTXT_3_LSB0_ADDR A:0x7897900
y.create.l HWIO_BLSP1_BLSP_BAM_BAM_P_PSM_CNTXT_3_LSB1_ADDR A:0x7898900
y.create.l HWIO_BLSP1_BLSP_BAM_BAM_P_PSM_CNTXT_3_LSB2_ADDR A:0x7899900
y.create.l HWIO_BLSP1_BLSP_BAM_BAM_P_PSM_CNTXT_3_LSB3_ADDR A:0x789a900
y.create.l HWIO_BLSP1_BLSP_BAM_BAM_P_PSM_CNTXT_3_LSB4_ADDR A:0x789b900
y.create.l HWIO_BLSP1_BLSP_BAM_BAM_P_PSM_CNTXT_3_LSB5_ADDR A:0x789c900
y.create.l HWIO_BLSP1_BLSP_BAM_BAM_P_PSM_CNTXT_3_LSB6_ADDR A:0x789d900
y.create.l HWIO_BLSP1_BLSP_BAM_BAM_P_PSM_CNTXT_3_LSB7_ADDR A:0x789e900
y.create.l HWIO_BLSP1_BLSP_BAM_BAM_P_PSM_CNTXT_3_LSB8_ADDR A:0x789f900
y.create.l HWIO_BLSP1_BLSP_BAM_BAM_P_PSM_CNTXT_3_LSB9_ADDR A:0x78a0900
y.create.l HWIO_BLSP1_BLSP_BAM_BAM_P_PSM_CNTXT_3_MSB0_ADDR A:0x7897904
y.create.l HWIO_BLSP1_BLSP_BAM_BAM_P_PSM_CNTXT_3_MSB1_ADDR A:0x7898904
y.create.l HWIO_BLSP1_BLSP_BAM_BAM_P_PSM_CNTXT_3_MSB2_ADDR A:0x7899904
y.create.l HWIO_BLSP1_BLSP_BAM_BAM_P_PSM_CNTXT_3_MSB3_ADDR A:0x789a904
y.create.l HWIO_BLSP1_BLSP_BAM_BAM_P_PSM_CNTXT_3_MSB4_ADDR A:0x789b904
y.create.l HWIO_BLSP1_BLSP_BAM_BAM_P_PSM_CNTXT_3_MSB5_ADDR A:0x789c904
y.create.l HWIO_BLSP1_BLSP_BAM_BAM_P_PSM_CNTXT_3_MSB6_ADDR A:0x789d904
y.create.l HWIO_BLSP1_BLSP_BAM_BAM_P_PSM_CNTXT_3_MSB7_ADDR A:0x789e904
y.create.l HWIO_BLSP1_BLSP_BAM_BAM_P_PSM_CNTXT_3_MSB8_ADDR A:0x789f904
y.create.l HWIO_BLSP1_BLSP_BAM_BAM_P_PSM_CNTXT_3_MSB9_ADDR A:0x78a0904
y.create.l HWIO_BLSP1_BLSP_BAM_BAM_P_DESC_FIFO_ADDR_LSB0_ADDR A:0x7897910
y.create.l HWIO_BLSP1_BLSP_BAM_BAM_P_DESC_FIFO_ADDR_LSB1_ADDR A:0x7898910
y.create.l HWIO_BLSP1_BLSP_BAM_BAM_P_DESC_FIFO_ADDR_LSB2_ADDR A:0x7899910
y.create.l HWIO_BLSP1_BLSP_BAM_BAM_P_DESC_FIFO_ADDR_LSB3_ADDR A:0x789a910
y.create.l HWIO_BLSP1_BLSP_BAM_BAM_P_DESC_FIFO_ADDR_LSB4_ADDR A:0x789b910
y.create.l HWIO_BLSP1_BLSP_BAM_BAM_P_DESC_FIFO_ADDR_LSB5_ADDR A:0x789c910
y.create.l HWIO_BLSP1_BLSP_BAM_BAM_P_DESC_FIFO_ADDR_LSB6_ADDR A:0x789d910
y.create.l HWIO_BLSP1_BLSP_BAM_BAM_P_DESC_FIFO_ADDR_LSB7_ADDR A:0x789e910
y.create.l HWIO_BLSP1_BLSP_BAM_BAM_P_DESC_FIFO_ADDR_LSB8_ADDR A:0x789f910
y.create.l HWIO_BLSP1_BLSP_BAM_BAM_P_DESC_FIFO_ADDR_LSB9_ADDR A:0x78a0910
y.create.l HWIO_BLSP1_BLSP_BAM_BAM_P_DESC_FIFO_ADDR_MSB0_ADDR A:0x7897914
y.create.l HWIO_BLSP1_BLSP_BAM_BAM_P_DESC_FIFO_ADDR_MSB1_ADDR A:0x7898914
y.create.l HWIO_BLSP1_BLSP_BAM_BAM_P_DESC_FIFO_ADDR_MSB2_ADDR A:0x7899914
y.create.l HWIO_BLSP1_BLSP_BAM_BAM_P_DESC_FIFO_ADDR_MSB3_ADDR A:0x789a914
y.create.l HWIO_BLSP1_BLSP_BAM_BAM_P_DESC_FIFO_ADDR_MSB4_ADDR A:0x789b914
y.create.l HWIO_BLSP1_BLSP_BAM_BAM_P_DESC_FIFO_ADDR_MSB5_ADDR A:0x789c914
y.create.l HWIO_BLSP1_BLSP_BAM_BAM_P_DESC_FIFO_ADDR_MSB6_ADDR A:0x789d914
y.create.l HWIO_BLSP1_BLSP_BAM_BAM_P_DESC_FIFO_ADDR_MSB7_ADDR A:0x789e914
y.create.l HWIO_BLSP1_BLSP_BAM_BAM_P_DESC_FIFO_ADDR_MSB8_ADDR A:0x789f914
y.create.l HWIO_BLSP1_BLSP_BAM_BAM_P_DESC_FIFO_ADDR_MSB9_ADDR A:0x78a0914
y.create.l HWIO_BLSP1_BLSP_BAM_BAM_P_DATA_FIFO_ADDR_LSB0_ADDR A:0x7897920
y.create.l HWIO_BLSP1_BLSP_BAM_BAM_P_DATA_FIFO_ADDR_LSB1_ADDR A:0x7898920
y.create.l HWIO_BLSP1_BLSP_BAM_BAM_P_DATA_FIFO_ADDR_LSB2_ADDR A:0x7899920
y.create.l HWIO_BLSP1_BLSP_BAM_BAM_P_DATA_FIFO_ADDR_LSB3_ADDR A:0x789a920
y.create.l HWIO_BLSP1_BLSP_BAM_BAM_P_DATA_FIFO_ADDR_LSB4_ADDR A:0x789b920
y.create.l HWIO_BLSP1_BLSP_BAM_BAM_P_DATA_FIFO_ADDR_LSB5_ADDR A:0x789c920
y.create.l HWIO_BLSP1_BLSP_BAM_BAM_P_DATA_FIFO_ADDR_LSB6_ADDR A:0x789d920
y.create.l HWIO_BLSP1_BLSP_BAM_BAM_P_DATA_FIFO_ADDR_LSB7_ADDR A:0x789e920
y.create.l HWIO_BLSP1_BLSP_BAM_BAM_P_DATA_FIFO_ADDR_LSB8_ADDR A:0x789f920
y.create.l HWIO_BLSP1_BLSP_BAM_BAM_P_DATA_FIFO_ADDR_LSB9_ADDR A:0x78a0920
y.create.l HWIO_BLSP1_BLSP_BAM_BAM_P_DATA_FIFO_ADDR_MSB0_ADDR A:0x7897924
y.create.l HWIO_BLSP1_BLSP_BAM_BAM_P_DATA_FIFO_ADDR_MSB1_ADDR A:0x7898924
y.create.l HWIO_BLSP1_BLSP_BAM_BAM_P_DATA_FIFO_ADDR_MSB2_ADDR A:0x7899924
y.create.l HWIO_BLSP1_BLSP_BAM_BAM_P_DATA_FIFO_ADDR_MSB3_ADDR A:0x789a924
y.create.l HWIO_BLSP1_BLSP_BAM_BAM_P_DATA_FIFO_ADDR_MSB4_ADDR A:0x789b924
y.create.l HWIO_BLSP1_BLSP_BAM_BAM_P_DATA_FIFO_ADDR_MSB5_ADDR A:0x789c924
y.create.l HWIO_BLSP1_BLSP_BAM_BAM_P_DATA_FIFO_ADDR_MSB6_ADDR A:0x789d924
y.create.l HWIO_BLSP1_BLSP_BAM_BAM_P_DATA_FIFO_ADDR_MSB7_ADDR A:0x789e924
y.create.l HWIO_BLSP1_BLSP_BAM_BAM_P_DATA_FIFO_ADDR_MSB8_ADDR A:0x789f924
y.create.l HWIO_BLSP1_BLSP_BAM_BAM_P_DATA_FIFO_ADDR_MSB9_ADDR A:0x78a0924
y.create.l HWIO_BLSP1_BLSP_BAM_BAM_P_EVNT_DEST_ADDR_LSB0_ADDR A:0x7897930
y.create.l HWIO_BLSP1_BLSP_BAM_BAM_P_EVNT_DEST_ADDR_LSB1_ADDR A:0x7898930
y.create.l HWIO_BLSP1_BLSP_BAM_BAM_P_EVNT_DEST_ADDR_LSB2_ADDR A:0x7899930
y.create.l HWIO_BLSP1_BLSP_BAM_BAM_P_EVNT_DEST_ADDR_LSB3_ADDR A:0x789a930
y.create.l HWIO_BLSP1_BLSP_BAM_BAM_P_EVNT_DEST_ADDR_LSB4_ADDR A:0x789b930
y.create.l HWIO_BLSP1_BLSP_BAM_BAM_P_EVNT_DEST_ADDR_LSB5_ADDR A:0x789c930
y.create.l HWIO_BLSP1_BLSP_BAM_BAM_P_EVNT_DEST_ADDR_LSB6_ADDR A:0x789d930
y.create.l HWIO_BLSP1_BLSP_BAM_BAM_P_EVNT_DEST_ADDR_LSB7_ADDR A:0x789e930
y.create.l HWIO_BLSP1_BLSP_BAM_BAM_P_EVNT_DEST_ADDR_LSB8_ADDR A:0x789f930
y.create.l HWIO_BLSP1_BLSP_BAM_BAM_P_EVNT_DEST_ADDR_LSB9_ADDR A:0x78a0930
y.create.l HWIO_BLSP1_BLSP_BAM_BAM_P_EVNT_DEST_ADDR_MSB0_ADDR A:0x7897934
y.create.l HWIO_BLSP1_BLSP_BAM_BAM_P_EVNT_DEST_ADDR_MSB1_ADDR A:0x7898934
y.create.l HWIO_BLSP1_BLSP_BAM_BAM_P_EVNT_DEST_ADDR_MSB2_ADDR A:0x7899934
y.create.l HWIO_BLSP1_BLSP_BAM_BAM_P_EVNT_DEST_ADDR_MSB3_ADDR A:0x789a934
y.create.l HWIO_BLSP1_BLSP_BAM_BAM_P_EVNT_DEST_ADDR_MSB4_ADDR A:0x789b934
y.create.l HWIO_BLSP1_BLSP_BAM_BAM_P_EVNT_DEST_ADDR_MSB5_ADDR A:0x789c934
y.create.l HWIO_BLSP1_BLSP_BAM_BAM_P_EVNT_DEST_ADDR_MSB6_ADDR A:0x789d934
y.create.l HWIO_BLSP1_BLSP_BAM_BAM_P_EVNT_DEST_ADDR_MSB7_ADDR A:0x789e934
y.create.l HWIO_BLSP1_BLSP_BAM_BAM_P_EVNT_DEST_ADDR_MSB8_ADDR A:0x789f934
y.create.l HWIO_BLSP1_BLSP_BAM_BAM_P_EVNT_DEST_ADDR_MSB9_ADDR A:0x78a0934
y.create.l HWIO_BLSP1_BLSP_BAM_XPU2_REG_BASE_START_ADDR A:0x7882000
y.create.l HWIO_BLSP1_BLSP_BAM_XPU2_REG_BASE_LAST_ADDR A:0x7883154
y.create.l HWIO_BLSP1_BLSP_BAM_XPU2_REG_BASE_END_ADDR A:0x7884000
y.create.l HWIO_BLSP1_BLSP_BAM_XPU_SCR_ADDR A:0x7882000
y.create.l HWIO_BLSP1_BLSP_BAM_XPU_SWDR_ADDR A:0x7882004
y.create.l HWIO_BLSP1_BLSP_BAM_XPU_SEAR0_ADDR A:0x7882040
y.create.l HWIO_BLSP1_BLSP_BAM_XPU_SESR_ADDR A:0x7882048
y.create.l HWIO_BLSP1_BLSP_BAM_XPU_SESRRESTORE_ADDR A:0x788204c
y.create.l HWIO_BLSP1_BLSP_BAM_XPU_SESYNR0_ADDR A:0x7882050
y.create.l HWIO_BLSP1_BLSP_BAM_XPU_SESYNR1_ADDR A:0x7882054
y.create.l HWIO_BLSP1_BLSP_BAM_XPU_SESYNR2_ADDR A:0x7882058
y.create.l HWIO_BLSP1_BLSP_BAM_XPU_MCR_ADDR A:0x7882100
y.create.l HWIO_BLSP1_BLSP_BAM_XPU_MEAR0_ADDR A:0x7882140
y.create.l HWIO_BLSP1_BLSP_BAM_XPU_MESR_ADDR A:0x7882148
y.create.l HWIO_BLSP1_BLSP_BAM_XPU_MESRRESTORE_ADDR A:0x788214c
y.create.l HWIO_BLSP1_BLSP_BAM_XPU_MESYNR0_ADDR A:0x7882150
y.create.l HWIO_BLSP1_BLSP_BAM_XPU_MESYNR1_ADDR A:0x7882154
y.create.l HWIO_BLSP1_BLSP_BAM_XPU_MESYNR2_ADDR A:0x7882158
y.create.l HWIO_BLSP1_BLSP_BAM_XPU_CR_ADDR A:0x7882080
y.create.l HWIO_BLSP1_BLSP_BAM_XPU_RPU_ACR0_ADDR A:0x78820a0
y.create.l HWIO_BLSP1_BLSP_BAM_XPU_EAR0_ADDR A:0x78820c0
y.create.l HWIO_BLSP1_BLSP_BAM_XPU_ESR_ADDR A:0x78820c8
y.create.l HWIO_BLSP1_BLSP_BAM_XPU_ESRRESTORE_ADDR A:0x78820cc
y.create.l HWIO_BLSP1_BLSP_BAM_XPU_ESYNR0_ADDR A:0x78820d0
y.create.l HWIO_BLSP1_BLSP_BAM_XPU_ESYNR1_ADDR A:0x78820d4
y.create.l HWIO_BLSP1_BLSP_BAM_XPU_ESYNR2_ADDR A:0x78820d8
y.create.l HWIO_BLSP1_BLSP_BAM_XPU_IDR0_ADDR A:0x7882074
y.create.l HWIO_BLSP1_BLSP_BAM_XPU_IDR1_ADDR A:0x7882078
y.create.l HWIO_BLSP1_BLSP_BAM_XPU_REV_ADDR A:0x788207c
y.create.l HWIO_BLSP1_BLSP_BAM_XPU_RG0_RACR0_ADDR A:0x7882200
y.create.l HWIO_BLSP1_BLSP_BAM_XPU_RG1_RACR0_ADDR A:0x7882280
y.create.l HWIO_BLSP1_BLSP_BAM_XPU_RG2_RACR0_ADDR A:0x7882300
y.create.l HWIO_BLSP1_BLSP_BAM_XPU_RG3_RACR0_ADDR A:0x7882380
y.create.l HWIO_BLSP1_BLSP_BAM_XPU_RG4_RACR0_ADDR A:0x7882400
y.create.l HWIO_BLSP1_BLSP_BAM_XPU_RG5_RACR0_ADDR A:0x7882480
y.create.l HWIO_BLSP1_BLSP_BAM_XPU_RG6_RACR0_ADDR A:0x7882500
y.create.l HWIO_BLSP1_BLSP_BAM_XPU_RG7_RACR0_ADDR A:0x7882580
y.create.l HWIO_BLSP1_BLSP_BAM_XPU_RG8_RACR0_ADDR A:0x7882600
y.create.l HWIO_BLSP1_BLSP_BAM_XPU_RG9_RACR0_ADDR A:0x7882680
y.create.l HWIO_BLSP1_BLSP_BAM_XPU_RG0_SCR_ADDR A:0x7882250
y.create.l HWIO_BLSP1_BLSP_BAM_XPU_RG1_SCR_ADDR A:0x78822d0
y.create.l HWIO_BLSP1_BLSP_BAM_XPU_RG2_SCR_ADDR A:0x7882350
y.create.l HWIO_BLSP1_BLSP_BAM_XPU_RG3_SCR_ADDR A:0x78823d0
y.create.l HWIO_BLSP1_BLSP_BAM_XPU_RG4_SCR_ADDR A:0x7882450
y.create.l HWIO_BLSP1_BLSP_BAM_XPU_RG5_SCR_ADDR A:0x78824d0
y.create.l HWIO_BLSP1_BLSP_BAM_XPU_RG6_SCR_ADDR A:0x7882550
y.create.l HWIO_BLSP1_BLSP_BAM_XPU_RG7_SCR_ADDR A:0x78825d0
y.create.l HWIO_BLSP1_BLSP_BAM_XPU_RG8_SCR_ADDR A:0x7882650
y.create.l HWIO_BLSP1_BLSP_BAM_XPU_RG9_SCR_ADDR A:0x78826d0
y.create.l HWIO_BLSP1_BLSP_BAM_XPU_RG0_MCR_ADDR A:0x7882254
y.create.l HWIO_BLSP1_BLSP_BAM_XPU_RG1_MCR_ADDR A:0x78822d4
y.create.l HWIO_BLSP1_BLSP_BAM_XPU_RG2_MCR_ADDR A:0x7882354
y.create.l HWIO_BLSP1_BLSP_BAM_XPU_RG3_MCR_ADDR A:0x78823d4
y.create.l HWIO_BLSP1_BLSP_BAM_XPU_RG4_MCR_ADDR A:0x7882454
y.create.l HWIO_BLSP1_BLSP_BAM_XPU_RG5_MCR_ADDR A:0x78824d4
y.create.l HWIO_BLSP1_BLSP_BAM_XPU_RG6_MCR_ADDR A:0x7882554
y.create.l HWIO_BLSP1_BLSP_BAM_XPU_RG7_MCR_ADDR A:0x78825d4
y.create.l HWIO_BLSP1_BLSP_BAM_XPU_RG8_MCR_ADDR A:0x7882654
y.create.l HWIO_BLSP1_BLSP_BAM_XPU_RG9_MCR_ADDR A:0x78826d4
y.create.l HWIO_BLSP1_BLSP_BAM_VMIDMT_REG_BASE_START_ADDR A:0x7880000
y.create.l HWIO_BLSP1_BLSP_BAM_VMIDMT_REG_BASE_LAST_ADDR A:0x7880e40
y.create.l HWIO_BLSP1_BLSP_BAM_VMIDMT_REG_BASE_END_ADDR A:0x7881000
y.create.l HWIO_BLSP1_BLSP_BAM_VMIDMT_SCR0_ADDR A:0x7880000
y.create.l HWIO_BLSP1_BLSP_BAM_VMIDMT_SCR1_ADDR A:0x7880004
y.create.l HWIO_BLSP1_BLSP_BAM_VMIDMT_SCR2_ADDR A:0x7880008
y.create.l HWIO_BLSP1_BLSP_BAM_VMIDMT_SACR_ADDR A:0x7880010
y.create.l HWIO_BLSP1_BLSP_BAM_VMIDMT_SIDR0_ADDR A:0x7880020
y.create.l HWIO_BLSP1_BLSP_BAM_VMIDMT_SIDR1_ADDR A:0x7880024
y.create.l HWIO_BLSP1_BLSP_BAM_VMIDMT_SIDR2_ADDR A:0x7880028
y.create.l HWIO_BLSP1_BLSP_BAM_VMIDMT_SIDR4_ADDR A:0x7880030
y.create.l HWIO_BLSP1_BLSP_BAM_VMIDMT_SIDR5_ADDR A:0x7880034
y.create.l HWIO_BLSP1_BLSP_BAM_VMIDMT_SIDR7_ADDR A:0x788003c
y.create.l HWIO_BLSP1_BLSP_BAM_VMIDMT_SGFAR0_ADDR A:0x7880040
y.create.l HWIO_BLSP1_BLSP_BAM_VMIDMT_SGFSR_ADDR A:0x7880048
y.create.l HWIO_BLSP1_BLSP_BAM_VMIDMT_SGFSRRESTORE_ADDR A:0x788004c
y.create.l HWIO_BLSP1_BLSP_BAM_VMIDMT_SGFSYNDR0_ADDR A:0x7880050
y.create.l HWIO_BLSP1_BLSP_BAM_VMIDMT_SGFSYNDR1_ADDR A:0x7880054
y.create.l HWIO_BLSP1_BLSP_BAM_VMIDMT_SGFSYNDR2_ADDR A:0x7880058
y.create.l HWIO_BLSP1_BLSP_BAM_VMIDMT_VMIDMTSCR0_ADDR A:0x7880090
y.create.l HWIO_BLSP1_BLSP_BAM_VMIDMT_CR0_ADDR A:0x7880000
y.create.l HWIO_BLSP1_BLSP_BAM_VMIDMT_CR2_ADDR A:0x7880008
y.create.l HWIO_BLSP1_BLSP_BAM_VMIDMT_ACR_ADDR A:0x7880010
y.create.l HWIO_BLSP1_BLSP_BAM_VMIDMT_IDR0_ADDR A:0x7880020
y.create.l HWIO_BLSP1_BLSP_BAM_VMIDMT_IDR1_ADDR A:0x7880024
y.create.l HWIO_BLSP1_BLSP_BAM_VMIDMT_IDR2_ADDR A:0x7880028
y.create.l HWIO_BLSP1_BLSP_BAM_VMIDMT_IDR4_ADDR A:0x7880030
y.create.l HWIO_BLSP1_BLSP_BAM_VMIDMT_IDR5_ADDR A:0x7880034
y.create.l HWIO_BLSP1_BLSP_BAM_VMIDMT_IDR7_ADDR A:0x788003c
y.create.l HWIO_BLSP1_BLSP_BAM_VMIDMT_GFAR0_ADDR A:0x7880040
y.create.l HWIO_BLSP1_BLSP_BAM_VMIDMT_GFSR_ADDR A:0x7880048
y.create.l HWIO_BLSP1_BLSP_BAM_VMIDMT_GFSRRESTORE_ADDR A:0x788004c
y.create.l HWIO_BLSP1_BLSP_BAM_VMIDMT_GFSYNDR0_ADDR A:0x7880050
y.create.l HWIO_BLSP1_BLSP_BAM_VMIDMT_GFSYNDR1_ADDR A:0x7880054
y.create.l HWIO_BLSP1_BLSP_BAM_VMIDMT_GFSYNDR2_ADDR A:0x7880058
y.create.l HWIO_BLSP1_BLSP_BAM_VMIDMT_VMIDMTCR0_ADDR A:0x7880090
y.create.l HWIO_BLSP1_BLSP_BAM_VMIDMT_VMIDMTACR_ADDR A:0x788009c
y.create.l HWIO_BLSP1_BLSP_BAM_VMIDMT_NSCR0_ADDR A:0x7880400
y.create.l HWIO_BLSP1_BLSP_BAM_VMIDMT_NSCR2_ADDR A:0x7880408
y.create.l HWIO_BLSP1_BLSP_BAM_VMIDMT_NSACR_ADDR A:0x7880410
y.create.l HWIO_BLSP1_BLSP_BAM_VMIDMT_NSGFAR0_ADDR A:0x7880440
y.create.l HWIO_BLSP1_BLSP_BAM_VMIDMT_NSGFSR_ADDR A:0x7880448
y.create.l HWIO_BLSP1_BLSP_BAM_VMIDMT_NSGFSRRESTORE_ADDR A:0x788044c
y.create.l HWIO_BLSP1_BLSP_BAM_VMIDMT_NSGFSYNDR0_ADDR A:0x7880450
y.create.l HWIO_BLSP1_BLSP_BAM_VMIDMT_NSGFSYNDR1_ADDR A:0x7880454
y.create.l HWIO_BLSP1_BLSP_BAM_VMIDMT_NSGFSYNDR2_ADDR A:0x7880458
y.create.l HWIO_BLSP1_BLSP_BAM_VMIDMT_NSVMIDMTCR0_ADDR A:0x7880490
y.create.l HWIO_BLSP1_BLSP_BAM_VMIDMT_SSDR0_ADDR A:0x7880080
y.create.l HWIO_BLSP1_BLSP_BAM_VMIDMT_MSDR0_ADDR A:0x7880480
y.create.l HWIO_BLSP1_BLSP_BAM_VMIDMT_MCR_ADDR A:0x7880494
y.create.l HWIO_BLSP1_BLSP_BAM_VMIDMT_S2VR0_ADDR A:0x7880c00
y.create.l HWIO_BLSP1_BLSP_BAM_VMIDMT_S2VR1_ADDR A:0x7880c04
y.create.l HWIO_BLSP1_BLSP_BAM_VMIDMT_S2VR2_ADDR A:0x7880c08
y.create.l HWIO_BLSP1_BLSP_BAM_VMIDMT_S2VR3_ADDR A:0x7880c0c
y.create.l HWIO_BLSP1_BLSP_BAM_VMIDMT_S2VR4_ADDR A:0x7880c10
y.create.l HWIO_BLSP1_BLSP_BAM_VMIDMT_S2VR5_ADDR A:0x7880c14
y.create.l HWIO_BLSP1_BLSP_BAM_VMIDMT_S2VR6_ADDR A:0x7880c18
y.create.l HWIO_BLSP1_BLSP_BAM_VMIDMT_S2VR7_ADDR A:0x7880c1c
y.create.l HWIO_BLSP1_BLSP_BAM_VMIDMT_S2VR8_ADDR A:0x7880c20
y.create.l HWIO_BLSP1_BLSP_BAM_VMIDMT_S2VR9_ADDR A:0x7880c24
y.create.l HWIO_BLSP1_BLSP_BAM_VMIDMT_AS2VR0_ADDR A:0x7880e00
y.create.l HWIO_BLSP1_BLSP_BAM_VMIDMT_AS2VR1_ADDR A:0x7880e04
y.create.l HWIO_BLSP1_BLSP_BAM_VMIDMT_AS2VR2_ADDR A:0x7880e08
y.create.l HWIO_BLSP1_BLSP_BAM_VMIDMT_AS2VR3_ADDR A:0x7880e0c
y.create.l HWIO_BLSP1_BLSP_BAM_VMIDMT_AS2VR4_ADDR A:0x7880e10
y.create.l HWIO_BLSP1_BLSP_BAM_VMIDMT_AS2VR5_ADDR A:0x7880e14
y.create.l HWIO_BLSP1_BLSP_BAM_VMIDMT_AS2VR6_ADDR A:0x7880e18
y.create.l HWIO_BLSP1_BLSP_BAM_VMIDMT_AS2VR7_ADDR A:0x7880e1c
y.create.l HWIO_BLSP1_BLSP_BAM_VMIDMT_AS2VR8_ADDR A:0x7880e20
y.create.l HWIO_BLSP1_BLSP_BAM_VMIDMT_AS2VR9_ADDR A:0x7880e24
y.create.l HWIO_BLSP1_BLSP_BAM_VMIDMT_SMR0_ADDR A:0x7880800
y.create.l HWIO_BLSP1_BLSP_BAM_VMIDMT_SMR1_ADDR A:0x7880804
y.create.l HWIO_BLSP1_BLSP_BAM_VMIDMT_SMR2_ADDR A:0x7880808
y.create.l HWIO_BLSP1_BLSP_BAM_VMIDMT_SMR3_ADDR A:0x788080c
y.create.l HWIO_BLSP1_BLSP_BAM_VMIDMT_SMR4_ADDR A:0x7880810
y.create.l HWIO_BLSP1_BLSP_BAM_VMIDMT_SMR5_ADDR A:0x7880814
y.create.l HWIO_BLSP1_BLSP_BAM_VMIDMT_SMR6_ADDR A:0x7880818
y.create.l HWIO_BLSP1_BLSP_BAM_VMIDMT_SMR7_ADDR A:0x788081c
y.create.l HWIO_BLSP1_BLSP_BAM_VMIDMT_SMR8_ADDR A:0x7880820
y.create.l HWIO_BLSP1_BLSP_BAM_VMIDMT_SMR9_ADDR A:0x7880824
y.create.l HWIO_BLSP1_BLSP_UART0_UART0_DM_REG_BASE_START_ADDR A:0x78af000
y.create.l HWIO_BLSP1_BLSP_UART0_UART0_DM_REG_BASE_LAST_ADDR A:0x78af1a0
y.create.l HWIO_BLSP1_BLSP_UART0_UART0_DM_REG_BASE_END_ADDR A:0x78af200
y.create.l HWIO_BLSP1_BLSP_UART0_UART_DM_MR1_ADDR A:0x78af000
y.create.l HWIO_BLSP1_BLSP_UART0_UART_DM_MR2_ADDR A:0x78af004
y.create.l HWIO_BLSP1_BLSP_UART0_UART_DM_CSR_SR_DEPRECATED_ADDR A:0x78af008
y.create.l HWIO_BLSP1_BLSP_UART0_UART_DM_CR_MISR_DEPRECATED_ADDR A:0x78af010
y.create.l HWIO_BLSP1_BLSP_UART0_UART_DM_IMR_ISR_DEPRECATED_ADDR A:0x78af014
y.create.l HWIO_BLSP1_BLSP_UART0_UART_DM_IPR_ADDR A:0x78af018
y.create.l HWIO_BLSP1_BLSP_UART0_UART_DM_TFWR_ADDR A:0x78af01c
y.create.l HWIO_BLSP1_BLSP_UART0_UART_DM_RFWR_ADDR A:0x78af020
y.create.l HWIO_BLSP1_BLSP_UART0_UART_DM_HCR_ADDR A:0x78af024
y.create.l HWIO_BLSP1_BLSP_UART0_UART_DM_DMRX_ADDR A:0x78af034
y.create.l HWIO_BLSP1_BLSP_UART0_UART_DM_IRDA_RX_TOTAL_SNAP_DEPRECATED_ADDR A:0x78af038
y.create.l HWIO_BLSP1_BLSP_UART0_UART_DM_DMEN_ADDR A:0x78af03c
y.create.l HWIO_BLSP1_BLSP_UART0_UART_DM_NO_CHARS_FOR_TX_ADDR A:0x78af040
y.create.l HWIO_BLSP1_BLSP_UART0_UART_DM_BADR_ADDR A:0x78af044
y.create.l HWIO_BLSP1_BLSP_UART0_UART_DM_TESTSL_ADDR A:0x78af048
y.create.l HWIO_BLSP1_BLSP_UART0_UART_DM_TXFS_ADDR A:0x78af04c
y.create.l HWIO_BLSP1_BLSP_UART0_UART_DM_RXFS_ADDR A:0x78af050
y.create.l HWIO_BLSP1_BLSP_UART0_UART_DM_MISR_MODE_ADDR A:0x78af060
y.create.l HWIO_BLSP1_BLSP_UART0_UART_DM_MISR_RESET_ADDR A:0x78af064
y.create.l HWIO_BLSP1_BLSP_UART0_UART_DM_MISR_EXPORT_ADDR A:0x78af068
y.create.l HWIO_BLSP1_BLSP_UART0_UART_DM_MISR_VAL_ADDR A:0x78af06c
y.create.l HWIO_BLSP1_BLSP_UART0_UART_DM_TF_RF_DEPRECATED_ADDR A:0x78af070
y.create.l HWIO_BLSP1_BLSP_UART0_UART_DM_TF_RF_2_DEPRECATED_ADDR A:0x78af074
y.create.l HWIO_BLSP1_BLSP_UART0_UART_DM_TF_RF_3_DEPRECATED_ADDR A:0x78af078
y.create.l HWIO_BLSP1_BLSP_UART0_UART_DM_TF_RF_4_DEPRECATED_ADDR A:0x78af07c
y.create.l HWIO_BLSP1_BLSP_UART0_UART_DM_SIM_CFG_ADDR A:0x78af080
y.create.l HWIO_BLSP1_BLSP_UART0_UART_DM_TEST_WR_ADDR_ADDR A:0x78af084
y.create.l HWIO_BLSP1_BLSP_UART0_UART_DM_TEST_WR_DATA_ADDR A:0x78af088
y.create.l HWIO_BLSP1_BLSP_UART0_UART_DM_TEST_RD_ADDR_ADDR A:0x78af08c
y.create.l HWIO_BLSP1_BLSP_UART0_UART_DM_TEST_RD_DATA_ADDR A:0x78af090
y.create.l HWIO_BLSP1_BLSP_UART0_UART_DM_CSR_ADDR A:0x78af0a0
y.create.l HWIO_BLSP1_BLSP_UART0_UART_DM_SR_ADDR A:0x78af0a4
y.create.l HWIO_BLSP1_BLSP_UART0_UART_DM_CR_ADDR A:0x78af0a8
y.create.l HWIO_BLSP1_BLSP_UART0_UART_DM_MISR_ADDR A:0x78af0ac
y.create.l HWIO_BLSP1_BLSP_UART0_UART_DM_IMR_ADDR A:0x78af0b0
y.create.l HWIO_BLSP1_BLSP_UART0_UART_DM_ISR_ADDR A:0x78af0b4
y.create.l HWIO_BLSP1_BLSP_UART0_UART_DM_IRDA_ADDR A:0x78af0b8
y.create.l HWIO_BLSP1_BLSP_UART0_UART_DM_RX_TOTAL_SNAP_ADDR A:0x78af0bc
y.create.l HWIO_BLSP1_BLSP_UART0_UART_DM_WWT_TIMEOUT_ADDR A:0x78af0c0
y.create.l HWIO_BLSP1_BLSP_UART0_UART_DM_CLK_CTRL_ADDR A:0x78af0c4
y.create.l HWIO_BLSP1_BLSP_UART0_UART_DM_BCR_ADDR A:0x78af0c8
y.create.l HWIO_BLSP1_BLSP_UART0_UART_DM_RX_TRANS_CTRL_ADDR A:0x78af0cc
y.create.l HWIO_BLSP1_BLSP_UART0_UART_DM_DMRX_DBG_ADDR A:0x78af0d0
y.create.l HWIO_BLSP1_BLSP_UART0_UART_DM_FSM_STATUS_ADDR A:0x78af0d4
y.create.l HWIO_BLSP1_BLSP_UART0_UART_DM_HW_VERSION_ADDR A:0x78af0d8
y.create.l HWIO_BLSP1_BLSP_UART0_UART_DM_GENERICS_ADDR A:0x78af0dc
y.create.l HWIO_BLSP1_BLSP_UART0_UART_DM_ISR_CLR_ADDR A:0x78af0e0
y.create.l HWIO_BLSP1_BLSP_UART0_UART_DM_TF_ADDR A:0x78af100
y.create.l HWIO_BLSP1_BLSP_UART0_UART_DM_TF_2_ADDR A:0x78af104
y.create.l HWIO_BLSP1_BLSP_UART0_UART_DM_TF_3_ADDR A:0x78af108
y.create.l HWIO_BLSP1_BLSP_UART0_UART_DM_TF_4_ADDR A:0x78af10c
y.create.l HWIO_BLSP1_BLSP_UART0_UART_DM_TF_5_ADDR A:0x78af110
y.create.l HWIO_BLSP1_BLSP_UART0_UART_DM_TF_6_ADDR A:0x78af114
y.create.l HWIO_BLSP1_BLSP_UART0_UART_DM_TF_7_ADDR A:0x78af118
y.create.l HWIO_BLSP1_BLSP_UART0_UART_DM_TF_8_ADDR A:0x78af11c
y.create.l HWIO_BLSP1_BLSP_UART0_UART_DM_TF_9_ADDR A:0x78af120
y.create.l HWIO_BLSP1_BLSP_UART0_UART_DM_TF_10_ADDR A:0x78af124
y.create.l HWIO_BLSP1_BLSP_UART0_UART_DM_TF_11_ADDR A:0x78af128
y.create.l HWIO_BLSP1_BLSP_UART0_UART_DM_TF_12_ADDR A:0x78af12c
y.create.l HWIO_BLSP1_BLSP_UART0_UART_DM_TF_13_ADDR A:0x78af130
y.create.l HWIO_BLSP1_BLSP_UART0_UART_DM_TF_14_ADDR A:0x78af134
y.create.l HWIO_BLSP1_BLSP_UART0_UART_DM_TF_15_ADDR A:0x78af138
y.create.l HWIO_BLSP1_BLSP_UART0_UART_DM_TF_16_ADDR A:0x78af13c
y.create.l HWIO_BLSP1_BLSP_UART0_UART_DM_RF_ADDR A:0x78af140
y.create.l HWIO_BLSP1_BLSP_UART0_UART_DM_RF_2_ADDR A:0x78af144
y.create.l HWIO_BLSP1_BLSP_UART0_UART_DM_RF_3_ADDR A:0x78af148
y.create.l HWIO_BLSP1_BLSP_UART0_UART_DM_RF_4_ADDR A:0x78af14c
y.create.l HWIO_BLSP1_BLSP_UART0_UART_DM_RF_5_ADDR A:0x78af150
y.create.l HWIO_BLSP1_BLSP_UART0_UART_DM_RF_6_ADDR A:0x78af154
y.create.l HWIO_BLSP1_BLSP_UART0_UART_DM_RF_7_ADDR A:0x78af158
y.create.l HWIO_BLSP1_BLSP_UART0_UART_DM_RF_8_ADDR A:0x78af15c
y.create.l HWIO_BLSP1_BLSP_UART0_UART_DM_RF_9_ADDR A:0x78af160
y.create.l HWIO_BLSP1_BLSP_UART0_UART_DM_RF_10_ADDR A:0x78af164
y.create.l HWIO_BLSP1_BLSP_UART0_UART_DM_RF_11_ADDR A:0x78af168
y.create.l HWIO_BLSP1_BLSP_UART0_UART_DM_RF_12_ADDR A:0x78af16c
y.create.l HWIO_BLSP1_BLSP_UART0_UART_DM_RF_13_ADDR A:0x78af170
y.create.l HWIO_BLSP1_BLSP_UART0_UART_DM_RF_14_ADDR A:0x78af174
y.create.l HWIO_BLSP1_BLSP_UART0_UART_DM_RF_15_ADDR A:0x78af178
y.create.l HWIO_BLSP1_BLSP_UART0_UART_DM_RF_16_ADDR A:0x78af17c
y.create.l HWIO_BLSP1_BLSP_UART0_UART_DM_UIM_CFG_ADDR A:0x78af180
y.create.l HWIO_BLSP1_BLSP_UART0_UART_DM_UIM_CMD_ADDR A:0x78af184
y.create.l HWIO_BLSP1_BLSP_UART0_UART_DM_UIM_IO_STATUS_ADDR A:0x78af188
y.create.l HWIO_BLSP1_BLSP_UART0_UART_DM_UIM_IRQ_ISR_ADDR A:0x78af18c
y.create.l HWIO_BLSP1_BLSP_UART0_UART_DM_UIM_IRQ_MISR_ADDR A:0x78af190
y.create.l HWIO_BLSP1_BLSP_UART0_UART_DM_UIM_IRQ_CLR_ADDR A:0x78af194
y.create.l HWIO_BLSP1_BLSP_UART0_UART_DM_UIM_IRQ_IMR_ADDR A:0x78af198
y.create.l HWIO_BLSP1_BLSP_UART0_UART_DM_UIM_IRQ_IMR_SET_ADDR A:0x78af19c
y.create.l HWIO_BLSP1_BLSP_UART0_UART_DM_UIM_IRQ_IMR_CLR_ADDR A:0x78af1a0
y.create.l HWIO_BLSP1_BLSP_UART1_UART1_DM_REG_BASE_START_ADDR A:0x78b0000
y.create.l HWIO_BLSP1_BLSP_UART1_UART1_DM_REG_BASE_LAST_ADDR A:0x78b01a0
y.create.l HWIO_BLSP1_BLSP_UART1_UART1_DM_REG_BASE_END_ADDR A:0x78b0200
y.create.l HWIO_BLSP1_BLSP_UART1_UART_DM_MR1_ADDR A:0x78b0000
y.create.l HWIO_BLSP1_BLSP_UART1_UART_DM_MR2_ADDR A:0x78b0004
y.create.l HWIO_BLSP1_BLSP_UART1_UART_DM_CSR_SR_DEPRECATED_ADDR A:0x78b0008
y.create.l HWIO_BLSP1_BLSP_UART1_UART_DM_CR_MISR_DEPRECATED_ADDR A:0x78b0010
y.create.l HWIO_BLSP1_BLSP_UART1_UART_DM_IMR_ISR_DEPRECATED_ADDR A:0x78b0014
y.create.l HWIO_BLSP1_BLSP_UART1_UART_DM_IPR_ADDR A:0x78b0018
y.create.l HWIO_BLSP1_BLSP_UART1_UART_DM_TFWR_ADDR A:0x78b001c
y.create.l HWIO_BLSP1_BLSP_UART1_UART_DM_RFWR_ADDR A:0x78b0020
y.create.l HWIO_BLSP1_BLSP_UART1_UART_DM_HCR_ADDR A:0x78b0024
y.create.l HWIO_BLSP1_BLSP_UART1_UART_DM_DMRX_ADDR A:0x78b0034
y.create.l HWIO_BLSP1_BLSP_UART1_UART_DM_IRDA_RX_TOTAL_SNAP_DEPRECATED_ADDR A:0x78b0038
y.create.l HWIO_BLSP1_BLSP_UART1_UART_DM_DMEN_ADDR A:0x78b003c
y.create.l HWIO_BLSP1_BLSP_UART1_UART_DM_NO_CHARS_FOR_TX_ADDR A:0x78b0040
y.create.l HWIO_BLSP1_BLSP_UART1_UART_DM_BADR_ADDR A:0x78b0044
y.create.l HWIO_BLSP1_BLSP_UART1_UART_DM_TESTSL_ADDR A:0x78b0048
y.create.l HWIO_BLSP1_BLSP_UART1_UART_DM_TXFS_ADDR A:0x78b004c
y.create.l HWIO_BLSP1_BLSP_UART1_UART_DM_RXFS_ADDR A:0x78b0050
y.create.l HWIO_BLSP1_BLSP_UART1_UART_DM_MISR_MODE_ADDR A:0x78b0060
y.create.l HWIO_BLSP1_BLSP_UART1_UART_DM_MISR_RESET_ADDR A:0x78b0064
y.create.l HWIO_BLSP1_BLSP_UART1_UART_DM_MISR_EXPORT_ADDR A:0x78b0068
y.create.l HWIO_BLSP1_BLSP_UART1_UART_DM_MISR_VAL_ADDR A:0x78b006c
y.create.l HWIO_BLSP1_BLSP_UART1_UART_DM_TF_RF_DEPRECATED_ADDR A:0x78b0070
y.create.l HWIO_BLSP1_BLSP_UART1_UART_DM_TF_RF_2_DEPRECATED_ADDR A:0x78b0074
y.create.l HWIO_BLSP1_BLSP_UART1_UART_DM_TF_RF_3_DEPRECATED_ADDR A:0x78b0078
y.create.l HWIO_BLSP1_BLSP_UART1_UART_DM_TF_RF_4_DEPRECATED_ADDR A:0x78b007c
y.create.l HWIO_BLSP1_BLSP_UART1_UART_DM_SIM_CFG_ADDR A:0x78b0080
y.create.l HWIO_BLSP1_BLSP_UART1_UART_DM_TEST_WR_ADDR_ADDR A:0x78b0084
y.create.l HWIO_BLSP1_BLSP_UART1_UART_DM_TEST_WR_DATA_ADDR A:0x78b0088
y.create.l HWIO_BLSP1_BLSP_UART1_UART_DM_TEST_RD_ADDR_ADDR A:0x78b008c
y.create.l HWIO_BLSP1_BLSP_UART1_UART_DM_TEST_RD_DATA_ADDR A:0x78b0090
y.create.l HWIO_BLSP1_BLSP_UART1_UART_DM_CSR_ADDR A:0x78b00a0
y.create.l HWIO_BLSP1_BLSP_UART1_UART_DM_SR_ADDR A:0x78b00a4
y.create.l HWIO_BLSP1_BLSP_UART1_UART_DM_CR_ADDR A:0x78b00a8
y.create.l HWIO_BLSP1_BLSP_UART1_UART_DM_MISR_ADDR A:0x78b00ac
y.create.l HWIO_BLSP1_BLSP_UART1_UART_DM_IMR_ADDR A:0x78b00b0
y.create.l HWIO_BLSP1_BLSP_UART1_UART_DM_ISR_ADDR A:0x78b00b4
y.create.l HWIO_BLSP1_BLSP_UART1_UART_DM_IRDA_ADDR A:0x78b00b8
y.create.l HWIO_BLSP1_BLSP_UART1_UART_DM_RX_TOTAL_SNAP_ADDR A:0x78b00bc
y.create.l HWIO_BLSP1_BLSP_UART1_UART_DM_WWT_TIMEOUT_ADDR A:0x78b00c0
y.create.l HWIO_BLSP1_BLSP_UART1_UART_DM_CLK_CTRL_ADDR A:0x78b00c4
y.create.l HWIO_BLSP1_BLSP_UART1_UART_DM_BCR_ADDR A:0x78b00c8
y.create.l HWIO_BLSP1_BLSP_UART1_UART_DM_RX_TRANS_CTRL_ADDR A:0x78b00cc
y.create.l HWIO_BLSP1_BLSP_UART1_UART_DM_DMRX_DBG_ADDR A:0x78b00d0
y.create.l HWIO_BLSP1_BLSP_UART1_UART_DM_FSM_STATUS_ADDR A:0x78b00d4
y.create.l HWIO_BLSP1_BLSP_UART1_UART_DM_HW_VERSION_ADDR A:0x78b00d8
y.create.l HWIO_BLSP1_BLSP_UART1_UART_DM_GENERICS_ADDR A:0x78b00dc
y.create.l HWIO_BLSP1_BLSP_UART1_UART_DM_ISR_CLR_ADDR A:0x78b00e0
y.create.l HWIO_BLSP1_BLSP_UART1_UART_DM_TF_ADDR A:0x78b0100
y.create.l HWIO_BLSP1_BLSP_UART1_UART_DM_TF_2_ADDR A:0x78b0104
y.create.l HWIO_BLSP1_BLSP_UART1_UART_DM_TF_3_ADDR A:0x78b0108
y.create.l HWIO_BLSP1_BLSP_UART1_UART_DM_TF_4_ADDR A:0x78b010c
y.create.l HWIO_BLSP1_BLSP_UART1_UART_DM_TF_5_ADDR A:0x78b0110
y.create.l HWIO_BLSP1_BLSP_UART1_UART_DM_TF_6_ADDR A:0x78b0114
y.create.l HWIO_BLSP1_BLSP_UART1_UART_DM_TF_7_ADDR A:0x78b0118
y.create.l HWIO_BLSP1_BLSP_UART1_UART_DM_TF_8_ADDR A:0x78b011c
y.create.l HWIO_BLSP1_BLSP_UART1_UART_DM_TF_9_ADDR A:0x78b0120
y.create.l HWIO_BLSP1_BLSP_UART1_UART_DM_TF_10_ADDR A:0x78b0124
y.create.l HWIO_BLSP1_BLSP_UART1_UART_DM_TF_11_ADDR A:0x78b0128
y.create.l HWIO_BLSP1_BLSP_UART1_UART_DM_TF_12_ADDR A:0x78b012c
y.create.l HWIO_BLSP1_BLSP_UART1_UART_DM_TF_13_ADDR A:0x78b0130
y.create.l HWIO_BLSP1_BLSP_UART1_UART_DM_TF_14_ADDR A:0x78b0134
y.create.l HWIO_BLSP1_BLSP_UART1_UART_DM_TF_15_ADDR A:0x78b0138
y.create.l HWIO_BLSP1_BLSP_UART1_UART_DM_TF_16_ADDR A:0x78b013c
y.create.l HWIO_BLSP1_BLSP_UART1_UART_DM_RF_ADDR A:0x78b0140
y.create.l HWIO_BLSP1_BLSP_UART1_UART_DM_RF_2_ADDR A:0x78b0144
y.create.l HWIO_BLSP1_BLSP_UART1_UART_DM_RF_3_ADDR A:0x78b0148
y.create.l HWIO_BLSP1_BLSP_UART1_UART_DM_RF_4_ADDR A:0x78b014c
y.create.l HWIO_BLSP1_BLSP_UART1_UART_DM_RF_5_ADDR A:0x78b0150
y.create.l HWIO_BLSP1_BLSP_UART1_UART_DM_RF_6_ADDR A:0x78b0154
y.create.l HWIO_BLSP1_BLSP_UART1_UART_DM_RF_7_ADDR A:0x78b0158
y.create.l HWIO_BLSP1_BLSP_UART1_UART_DM_RF_8_ADDR A:0x78b015c
y.create.l HWIO_BLSP1_BLSP_UART1_UART_DM_RF_9_ADDR A:0x78b0160
y.create.l HWIO_BLSP1_BLSP_UART1_UART_DM_RF_10_ADDR A:0x78b0164
y.create.l HWIO_BLSP1_BLSP_UART1_UART_DM_RF_11_ADDR A:0x78b0168
y.create.l HWIO_BLSP1_BLSP_UART1_UART_DM_RF_12_ADDR A:0x78b016c
y.create.l HWIO_BLSP1_BLSP_UART1_UART_DM_RF_13_ADDR A:0x78b0170
y.create.l HWIO_BLSP1_BLSP_UART1_UART_DM_RF_14_ADDR A:0x78b0174
y.create.l HWIO_BLSP1_BLSP_UART1_UART_DM_RF_15_ADDR A:0x78b0178
y.create.l HWIO_BLSP1_BLSP_UART1_UART_DM_RF_16_ADDR A:0x78b017c
y.create.l HWIO_BLSP1_BLSP_UART1_UART_DM_UIM_CFG_ADDR A:0x78b0180
y.create.l HWIO_BLSP1_BLSP_UART1_UART_DM_UIM_CMD_ADDR A:0x78b0184
y.create.l HWIO_BLSP1_BLSP_UART1_UART_DM_UIM_IO_STATUS_ADDR A:0x78b0188
y.create.l HWIO_BLSP1_BLSP_UART1_UART_DM_UIM_IRQ_ISR_ADDR A:0x78b018c
y.create.l HWIO_BLSP1_BLSP_UART1_UART_DM_UIM_IRQ_MISR_ADDR A:0x78b0190
y.create.l HWIO_BLSP1_BLSP_UART1_UART_DM_UIM_IRQ_CLR_ADDR A:0x78b0194
y.create.l HWIO_BLSP1_BLSP_UART1_UART_DM_UIM_IRQ_IMR_ADDR A:0x78b0198
y.create.l HWIO_BLSP1_BLSP_UART1_UART_DM_UIM_IRQ_IMR_SET_ADDR A:0x78b019c
y.create.l HWIO_BLSP1_BLSP_UART1_UART_DM_UIM_IRQ_IMR_CLR_ADDR A:0x78b01a0
y.create.l HWIO_BLSP1_BLSP_UART2_UART2_DM_REG_BASE_START_ADDR A:0x78b1000
y.create.l HWIO_BLSP1_BLSP_UART2_UART2_DM_REG_BASE_LAST_ADDR A:0x78b11a0
y.create.l HWIO_BLSP1_BLSP_UART2_UART2_DM_REG_BASE_END_ADDR A:0x78b1200
y.create.l HWIO_BLSP1_BLSP_UART2_UART_DM_MR1_ADDR A:0x78b1000
y.create.l HWIO_BLSP1_BLSP_UART2_UART_DM_MR2_ADDR A:0x78b1004
y.create.l HWIO_BLSP1_BLSP_UART2_UART_DM_CSR_SR_DEPRECATED_ADDR A:0x78b1008
y.create.l HWIO_BLSP1_BLSP_UART2_UART_DM_CR_MISR_DEPRECATED_ADDR A:0x78b1010
y.create.l HWIO_BLSP1_BLSP_UART2_UART_DM_IMR_ISR_DEPRECATED_ADDR A:0x78b1014
y.create.l HWIO_BLSP1_BLSP_UART2_UART_DM_IPR_ADDR A:0x78b1018
y.create.l HWIO_BLSP1_BLSP_UART2_UART_DM_TFWR_ADDR A:0x78b101c
y.create.l HWIO_BLSP1_BLSP_UART2_UART_DM_RFWR_ADDR A:0x78b1020
y.create.l HWIO_BLSP1_BLSP_UART2_UART_DM_HCR_ADDR A:0x78b1024
y.create.l HWIO_BLSP1_BLSP_UART2_UART_DM_DMRX_ADDR A:0x78b1034
y.create.l HWIO_BLSP1_BLSP_UART2_UART_DM_IRDA_RX_TOTAL_SNAP_DEPRECATED_ADDR A:0x78b1038
y.create.l HWIO_BLSP1_BLSP_UART2_UART_DM_DMEN_ADDR A:0x78b103c
y.create.l HWIO_BLSP1_BLSP_UART2_UART_DM_NO_CHARS_FOR_TX_ADDR A:0x78b1040
y.create.l HWIO_BLSP1_BLSP_UART2_UART_DM_BADR_ADDR A:0x78b1044
y.create.l HWIO_BLSP1_BLSP_UART2_UART_DM_TESTSL_ADDR A:0x78b1048
y.create.l HWIO_BLSP1_BLSP_UART2_UART_DM_TXFS_ADDR A:0x78b104c
y.create.l HWIO_BLSP1_BLSP_UART2_UART_DM_RXFS_ADDR A:0x78b1050
y.create.l HWIO_BLSP1_BLSP_UART2_UART_DM_MISR_MODE_ADDR A:0x78b1060
y.create.l HWIO_BLSP1_BLSP_UART2_UART_DM_MISR_RESET_ADDR A:0x78b1064
y.create.l HWIO_BLSP1_BLSP_UART2_UART_DM_MISR_EXPORT_ADDR A:0x78b1068
y.create.l HWIO_BLSP1_BLSP_UART2_UART_DM_MISR_VAL_ADDR A:0x78b106c
y.create.l HWIO_BLSP1_BLSP_UART2_UART_DM_TF_RF_DEPRECATED_ADDR A:0x78b1070
y.create.l HWIO_BLSP1_BLSP_UART2_UART_DM_TF_RF_2_DEPRECATED_ADDR A:0x78b1074
y.create.l HWIO_BLSP1_BLSP_UART2_UART_DM_TF_RF_3_DEPRECATED_ADDR A:0x78b1078
y.create.l HWIO_BLSP1_BLSP_UART2_UART_DM_TF_RF_4_DEPRECATED_ADDR A:0x78b107c
y.create.l HWIO_BLSP1_BLSP_UART2_UART_DM_SIM_CFG_ADDR A:0x78b1080
y.create.l HWIO_BLSP1_BLSP_UART2_UART_DM_TEST_WR_ADDR_ADDR A:0x78b1084
y.create.l HWIO_BLSP1_BLSP_UART2_UART_DM_TEST_WR_DATA_ADDR A:0x78b1088
y.create.l HWIO_BLSP1_BLSP_UART2_UART_DM_TEST_RD_ADDR_ADDR A:0x78b108c
y.create.l HWIO_BLSP1_BLSP_UART2_UART_DM_TEST_RD_DATA_ADDR A:0x78b1090
y.create.l HWIO_BLSP1_BLSP_UART2_UART_DM_CSR_ADDR A:0x78b10a0
y.create.l HWIO_BLSP1_BLSP_UART2_UART_DM_SR_ADDR A:0x78b10a4
y.create.l HWIO_BLSP1_BLSP_UART2_UART_DM_CR_ADDR A:0x78b10a8
y.create.l HWIO_BLSP1_BLSP_UART2_UART_DM_MISR_ADDR A:0x78b10ac
y.create.l HWIO_BLSP1_BLSP_UART2_UART_DM_IMR_ADDR A:0x78b10b0
y.create.l HWIO_BLSP1_BLSP_UART2_UART_DM_ISR_ADDR A:0x78b10b4
y.create.l HWIO_BLSP1_BLSP_UART2_UART_DM_IRDA_ADDR A:0x78b10b8
y.create.l HWIO_BLSP1_BLSP_UART2_UART_DM_RX_TOTAL_SNAP_ADDR A:0x78b10bc
y.create.l HWIO_BLSP1_BLSP_UART2_UART_DM_WWT_TIMEOUT_ADDR A:0x78b10c0
y.create.l HWIO_BLSP1_BLSP_UART2_UART_DM_CLK_CTRL_ADDR A:0x78b10c4
y.create.l HWIO_BLSP1_BLSP_UART2_UART_DM_BCR_ADDR A:0x78b10c8
y.create.l HWIO_BLSP1_BLSP_UART2_UART_DM_RX_TRANS_CTRL_ADDR A:0x78b10cc
y.create.l HWIO_BLSP1_BLSP_UART2_UART_DM_DMRX_DBG_ADDR A:0x78b10d0
y.create.l HWIO_BLSP1_BLSP_UART2_UART_DM_FSM_STATUS_ADDR A:0x78b10d4
y.create.l HWIO_BLSP1_BLSP_UART2_UART_DM_HW_VERSION_ADDR A:0x78b10d8
y.create.l HWIO_BLSP1_BLSP_UART2_UART_DM_GENERICS_ADDR A:0x78b10dc
y.create.l HWIO_BLSP1_BLSP_UART2_UART_DM_ISR_CLR_ADDR A:0x78b10e0
y.create.l HWIO_BLSP1_BLSP_UART2_UART_DM_TF_ADDR A:0x78b1100
y.create.l HWIO_BLSP1_BLSP_UART2_UART_DM_TF_2_ADDR A:0x78b1104
y.create.l HWIO_BLSP1_BLSP_UART2_UART_DM_TF_3_ADDR A:0x78b1108
y.create.l HWIO_BLSP1_BLSP_UART2_UART_DM_TF_4_ADDR A:0x78b110c
y.create.l HWIO_BLSP1_BLSP_UART2_UART_DM_TF_5_ADDR A:0x78b1110
y.create.l HWIO_BLSP1_BLSP_UART2_UART_DM_TF_6_ADDR A:0x78b1114
y.create.l HWIO_BLSP1_BLSP_UART2_UART_DM_TF_7_ADDR A:0x78b1118
y.create.l HWIO_BLSP1_BLSP_UART2_UART_DM_TF_8_ADDR A:0x78b111c
y.create.l HWIO_BLSP1_BLSP_UART2_UART_DM_TF_9_ADDR A:0x78b1120
y.create.l HWIO_BLSP1_BLSP_UART2_UART_DM_TF_10_ADDR A:0x78b1124
y.create.l HWIO_BLSP1_BLSP_UART2_UART_DM_TF_11_ADDR A:0x78b1128
y.create.l HWIO_BLSP1_BLSP_UART2_UART_DM_TF_12_ADDR A:0x78b112c
y.create.l HWIO_BLSP1_BLSP_UART2_UART_DM_TF_13_ADDR A:0x78b1130
y.create.l HWIO_BLSP1_BLSP_UART2_UART_DM_TF_14_ADDR A:0x78b1134
y.create.l HWIO_BLSP1_BLSP_UART2_UART_DM_TF_15_ADDR A:0x78b1138
y.create.l HWIO_BLSP1_BLSP_UART2_UART_DM_TF_16_ADDR A:0x78b113c
y.create.l HWIO_BLSP1_BLSP_UART2_UART_DM_RF_ADDR A:0x78b1140
y.create.l HWIO_BLSP1_BLSP_UART2_UART_DM_RF_2_ADDR A:0x78b1144
y.create.l HWIO_BLSP1_BLSP_UART2_UART_DM_RF_3_ADDR A:0x78b1148
y.create.l HWIO_BLSP1_BLSP_UART2_UART_DM_RF_4_ADDR A:0x78b114c
y.create.l HWIO_BLSP1_BLSP_UART2_UART_DM_RF_5_ADDR A:0x78b1150
y.create.l HWIO_BLSP1_BLSP_UART2_UART_DM_RF_6_ADDR A:0x78b1154
y.create.l HWIO_BLSP1_BLSP_UART2_UART_DM_RF_7_ADDR A:0x78b1158
y.create.l HWIO_BLSP1_BLSP_UART2_UART_DM_RF_8_ADDR A:0x78b115c
y.create.l HWIO_BLSP1_BLSP_UART2_UART_DM_RF_9_ADDR A:0x78b1160
y.create.l HWIO_BLSP1_BLSP_UART2_UART_DM_RF_10_ADDR A:0x78b1164
y.create.l HWIO_BLSP1_BLSP_UART2_UART_DM_RF_11_ADDR A:0x78b1168
y.create.l HWIO_BLSP1_BLSP_UART2_UART_DM_RF_12_ADDR A:0x78b116c
y.create.l HWIO_BLSP1_BLSP_UART2_UART_DM_RF_13_ADDR A:0x78b1170
y.create.l HWIO_BLSP1_BLSP_UART2_UART_DM_RF_14_ADDR A:0x78b1174
y.create.l HWIO_BLSP1_BLSP_UART2_UART_DM_RF_15_ADDR A:0x78b1178
y.create.l HWIO_BLSP1_BLSP_UART2_UART_DM_RF_16_ADDR A:0x78b117c
y.create.l HWIO_BLSP1_BLSP_UART2_UART_DM_UIM_CFG_ADDR A:0x78b1180
y.create.l HWIO_BLSP1_BLSP_UART2_UART_DM_UIM_CMD_ADDR A:0x78b1184
y.create.l HWIO_BLSP1_BLSP_UART2_UART_DM_UIM_IO_STATUS_ADDR A:0x78b1188
y.create.l HWIO_BLSP1_BLSP_UART2_UART_DM_UIM_IRQ_ISR_ADDR A:0x78b118c
y.create.l HWIO_BLSP1_BLSP_UART2_UART_DM_UIM_IRQ_MISR_ADDR A:0x78b1190
y.create.l HWIO_BLSP1_BLSP_UART2_UART_DM_UIM_IRQ_CLR_ADDR A:0x78b1194
y.create.l HWIO_BLSP1_BLSP_UART2_UART_DM_UIM_IRQ_IMR_ADDR A:0x78b1198
y.create.l HWIO_BLSP1_BLSP_UART2_UART_DM_UIM_IRQ_IMR_SET_ADDR A:0x78b119c
y.create.l HWIO_BLSP1_BLSP_UART2_UART_DM_UIM_IRQ_IMR_CLR_ADDR A:0x78b11a0
y.create.l HWIO_BLSP1_BLSP_UART3_UART3_DM_REG_BASE_START_ADDR A:0x78b2000
y.create.l HWIO_BLSP1_BLSP_UART3_UART3_DM_REG_BASE_LAST_ADDR A:0x78b21a0
y.create.l HWIO_BLSP1_BLSP_UART3_UART3_DM_REG_BASE_END_ADDR A:0x78b2200
y.create.l HWIO_BLSP1_BLSP_UART3_UART_DM_MR1_ADDR A:0x78b2000
y.create.l HWIO_BLSP1_BLSP_UART3_UART_DM_MR2_ADDR A:0x78b2004
y.create.l HWIO_BLSP1_BLSP_UART3_UART_DM_CSR_SR_DEPRECATED_ADDR A:0x78b2008
y.create.l HWIO_BLSP1_BLSP_UART3_UART_DM_CR_MISR_DEPRECATED_ADDR A:0x78b2010
y.create.l HWIO_BLSP1_BLSP_UART3_UART_DM_IMR_ISR_DEPRECATED_ADDR A:0x78b2014
y.create.l HWIO_BLSP1_BLSP_UART3_UART_DM_IPR_ADDR A:0x78b2018
y.create.l HWIO_BLSP1_BLSP_UART3_UART_DM_TFWR_ADDR A:0x78b201c
y.create.l HWIO_BLSP1_BLSP_UART3_UART_DM_RFWR_ADDR A:0x78b2020
y.create.l HWIO_BLSP1_BLSP_UART3_UART_DM_HCR_ADDR A:0x78b2024
y.create.l HWIO_BLSP1_BLSP_UART3_UART_DM_DMRX_ADDR A:0x78b2034
y.create.l HWIO_BLSP1_BLSP_UART3_UART_DM_IRDA_RX_TOTAL_SNAP_DEPRECATED_ADDR A:0x78b2038
y.create.l HWIO_BLSP1_BLSP_UART3_UART_DM_DMEN_ADDR A:0x78b203c
y.create.l HWIO_BLSP1_BLSP_UART3_UART_DM_NO_CHARS_FOR_TX_ADDR A:0x78b2040
y.create.l HWIO_BLSP1_BLSP_UART3_UART_DM_BADR_ADDR A:0x78b2044
y.create.l HWIO_BLSP1_BLSP_UART3_UART_DM_TESTSL_ADDR A:0x78b2048
y.create.l HWIO_BLSP1_BLSP_UART3_UART_DM_TXFS_ADDR A:0x78b204c
y.create.l HWIO_BLSP1_BLSP_UART3_UART_DM_RXFS_ADDR A:0x78b2050
y.create.l HWIO_BLSP1_BLSP_UART3_UART_DM_MISR_MODE_ADDR A:0x78b2060
y.create.l HWIO_BLSP1_BLSP_UART3_UART_DM_MISR_RESET_ADDR A:0x78b2064
y.create.l HWIO_BLSP1_BLSP_UART3_UART_DM_MISR_EXPORT_ADDR A:0x78b2068
y.create.l HWIO_BLSP1_BLSP_UART3_UART_DM_MISR_VAL_ADDR A:0x78b206c
y.create.l HWIO_BLSP1_BLSP_UART3_UART_DM_TF_RF_DEPRECATED_ADDR A:0x78b2070
y.create.l HWIO_BLSP1_BLSP_UART3_UART_DM_TF_RF_2_DEPRECATED_ADDR A:0x78b2074
y.create.l HWIO_BLSP1_BLSP_UART3_UART_DM_TF_RF_3_DEPRECATED_ADDR A:0x78b2078
y.create.l HWIO_BLSP1_BLSP_UART3_UART_DM_TF_RF_4_DEPRECATED_ADDR A:0x78b207c
y.create.l HWIO_BLSP1_BLSP_UART3_UART_DM_SIM_CFG_ADDR A:0x78b2080
y.create.l HWIO_BLSP1_BLSP_UART3_UART_DM_TEST_WR_ADDR_ADDR A:0x78b2084
y.create.l HWIO_BLSP1_BLSP_UART3_UART_DM_TEST_WR_DATA_ADDR A:0x78b2088
y.create.l HWIO_BLSP1_BLSP_UART3_UART_DM_TEST_RD_ADDR_ADDR A:0x78b208c
y.create.l HWIO_BLSP1_BLSP_UART3_UART_DM_TEST_RD_DATA_ADDR A:0x78b2090
y.create.l HWIO_BLSP1_BLSP_UART3_UART_DM_CSR_ADDR A:0x78b20a0
y.create.l HWIO_BLSP1_BLSP_UART3_UART_DM_SR_ADDR A:0x78b20a4
y.create.l HWIO_BLSP1_BLSP_UART3_UART_DM_CR_ADDR A:0x78b20a8
y.create.l HWIO_BLSP1_BLSP_UART3_UART_DM_MISR_ADDR A:0x78b20ac
y.create.l HWIO_BLSP1_BLSP_UART3_UART_DM_IMR_ADDR A:0x78b20b0
y.create.l HWIO_BLSP1_BLSP_UART3_UART_DM_ISR_ADDR A:0x78b20b4
y.create.l HWIO_BLSP1_BLSP_UART3_UART_DM_IRDA_ADDR A:0x78b20b8
y.create.l HWIO_BLSP1_BLSP_UART3_UART_DM_RX_TOTAL_SNAP_ADDR A:0x78b20bc
y.create.l HWIO_BLSP1_BLSP_UART3_UART_DM_WWT_TIMEOUT_ADDR A:0x78b20c0
y.create.l HWIO_BLSP1_BLSP_UART3_UART_DM_CLK_CTRL_ADDR A:0x78b20c4
y.create.l HWIO_BLSP1_BLSP_UART3_UART_DM_BCR_ADDR A:0x78b20c8
y.create.l HWIO_BLSP1_BLSP_UART3_UART_DM_RX_TRANS_CTRL_ADDR A:0x78b20cc
y.create.l HWIO_BLSP1_BLSP_UART3_UART_DM_DMRX_DBG_ADDR A:0x78b20d0
y.create.l HWIO_BLSP1_BLSP_UART3_UART_DM_FSM_STATUS_ADDR A:0x78b20d4
y.create.l HWIO_BLSP1_BLSP_UART3_UART_DM_HW_VERSION_ADDR A:0x78b20d8
y.create.l HWIO_BLSP1_BLSP_UART3_UART_DM_GENERICS_ADDR A:0x78b20dc
y.create.l HWIO_BLSP1_BLSP_UART3_UART_DM_ISR_CLR_ADDR A:0x78b20e0
y.create.l HWIO_BLSP1_BLSP_UART3_UART_DM_TF_ADDR A:0x78b2100
y.create.l HWIO_BLSP1_BLSP_UART3_UART_DM_TF_2_ADDR A:0x78b2104
y.create.l HWIO_BLSP1_BLSP_UART3_UART_DM_TF_3_ADDR A:0x78b2108
y.create.l HWIO_BLSP1_BLSP_UART3_UART_DM_TF_4_ADDR A:0x78b210c
y.create.l HWIO_BLSP1_BLSP_UART3_UART_DM_TF_5_ADDR A:0x78b2110
y.create.l HWIO_BLSP1_BLSP_UART3_UART_DM_TF_6_ADDR A:0x78b2114
y.create.l HWIO_BLSP1_BLSP_UART3_UART_DM_TF_7_ADDR A:0x78b2118
y.create.l HWIO_BLSP1_BLSP_UART3_UART_DM_TF_8_ADDR A:0x78b211c
y.create.l HWIO_BLSP1_BLSP_UART3_UART_DM_TF_9_ADDR A:0x78b2120
y.create.l HWIO_BLSP1_BLSP_UART3_UART_DM_TF_10_ADDR A:0x78b2124
y.create.l HWIO_BLSP1_BLSP_UART3_UART_DM_TF_11_ADDR A:0x78b2128
y.create.l HWIO_BLSP1_BLSP_UART3_UART_DM_TF_12_ADDR A:0x78b212c
y.create.l HWIO_BLSP1_BLSP_UART3_UART_DM_TF_13_ADDR A:0x78b2130
y.create.l HWIO_BLSP1_BLSP_UART3_UART_DM_TF_14_ADDR A:0x78b2134
y.create.l HWIO_BLSP1_BLSP_UART3_UART_DM_TF_15_ADDR A:0x78b2138
y.create.l HWIO_BLSP1_BLSP_UART3_UART_DM_TF_16_ADDR A:0x78b213c
y.create.l HWIO_BLSP1_BLSP_UART3_UART_DM_RF_ADDR A:0x78b2140
y.create.l HWIO_BLSP1_BLSP_UART3_UART_DM_RF_2_ADDR A:0x78b2144
y.create.l HWIO_BLSP1_BLSP_UART3_UART_DM_RF_3_ADDR A:0x78b2148
y.create.l HWIO_BLSP1_BLSP_UART3_UART_DM_RF_4_ADDR A:0x78b214c
y.create.l HWIO_BLSP1_BLSP_UART3_UART_DM_RF_5_ADDR A:0x78b2150
y.create.l HWIO_BLSP1_BLSP_UART3_UART_DM_RF_6_ADDR A:0x78b2154
y.create.l HWIO_BLSP1_BLSP_UART3_UART_DM_RF_7_ADDR A:0x78b2158
y.create.l HWIO_BLSP1_BLSP_UART3_UART_DM_RF_8_ADDR A:0x78b215c
y.create.l HWIO_BLSP1_BLSP_UART3_UART_DM_RF_9_ADDR A:0x78b2160
y.create.l HWIO_BLSP1_BLSP_UART3_UART_DM_RF_10_ADDR A:0x78b2164
y.create.l HWIO_BLSP1_BLSP_UART3_UART_DM_RF_11_ADDR A:0x78b2168
y.create.l HWIO_BLSP1_BLSP_UART3_UART_DM_RF_12_ADDR A:0x78b216c
y.create.l HWIO_BLSP1_BLSP_UART3_UART_DM_RF_13_ADDR A:0x78b2170
y.create.l HWIO_BLSP1_BLSP_UART3_UART_DM_RF_14_ADDR A:0x78b2174
y.create.l HWIO_BLSP1_BLSP_UART3_UART_DM_RF_15_ADDR A:0x78b2178
y.create.l HWIO_BLSP1_BLSP_UART3_UART_DM_RF_16_ADDR A:0x78b217c
y.create.l HWIO_BLSP1_BLSP_UART3_UART_DM_UIM_CFG_ADDR A:0x78b2180
y.create.l HWIO_BLSP1_BLSP_UART3_UART_DM_UIM_CMD_ADDR A:0x78b2184
y.create.l HWIO_BLSP1_BLSP_UART3_UART_DM_UIM_IO_STATUS_ADDR A:0x78b2188
y.create.l HWIO_BLSP1_BLSP_UART3_UART_DM_UIM_IRQ_ISR_ADDR A:0x78b218c
y.create.l HWIO_BLSP1_BLSP_UART3_UART_DM_UIM_IRQ_MISR_ADDR A:0x78b2190
y.create.l HWIO_BLSP1_BLSP_UART3_UART_DM_UIM_IRQ_CLR_ADDR A:0x78b2194
y.create.l HWIO_BLSP1_BLSP_UART3_UART_DM_UIM_IRQ_IMR_ADDR A:0x78b2198
y.create.l HWIO_BLSP1_BLSP_UART3_UART_DM_UIM_IRQ_IMR_SET_ADDR A:0x78b219c
y.create.l HWIO_BLSP1_BLSP_UART3_UART_DM_UIM_IRQ_IMR_CLR_ADDR A:0x78b21a0
y.create.l HWIO_BLSP1_BLSP_QUP0_REG_BASE_START_ADDR A:0x78b5000
y.create.l HWIO_BLSP1_BLSP_QUP0_REG_BASE_LAST_ADDR A:0x78b5414
y.create.l HWIO_BLSP1_BLSP_QUP0_REG_BASE_END_ADDR A:0x78b5600
y.create.l HWIO_BLSP1_BLSP_QUP0_QUP_CONFIG_ADDR A:0x78b5000
y.create.l HWIO_BLSP1_BLSP_QUP0_QUP_STATE_ADDR A:0x78b5004
y.create.l HWIO_BLSP1_BLSP_QUP0_QUP_IO_MODES_ADDR A:0x78b5008
y.create.l HWIO_BLSP1_BLSP_QUP0_QUP_SW_RESET_ADDR A:0x78b500c
y.create.l HWIO_BLSP1_BLSP_QUP0_QUP_TRANSFER_CANCEL_ADDR A:0x78b5014
y.create.l HWIO_BLSP1_BLSP_QUP0_QUP_OPERATIONAL_ADDR A:0x78b5018
y.create.l HWIO_BLSP1_BLSP_QUP0_QUP_ERROR_FLAGS_ADDR A:0x78b501c
y.create.l HWIO_BLSP1_BLSP_QUP0_QUP_ERROR_FLAGS_EN_ADDR A:0x78b5020
y.create.l HWIO_BLSP1_BLSP_QUP0_QUP_TEST_CTRL_ADDR A:0x78b5024
y.create.l HWIO_BLSP1_BLSP_QUP0_QUP_OPERATIONAL_MASK_ADDR A:0x78b5028
y.create.l HWIO_BLSP1_BLSP_QUP0_QUP_HW_VERSION_ADDR A:0x78b5030
y.create.l HWIO_BLSP1_BLSP_QUP0_QUP_MX_OUTPUT_COUNT_ADDR A:0x78b5100
y.create.l HWIO_BLSP1_BLSP_QUP0_QUP_MX_OUTPUT_CNT_CURRENT_ADDR A:0x78b5104
y.create.l HWIO_BLSP1_BLSP_QUP0_QUP_OUTPUT_DEBUG_ADDR A:0x78b5108
y.create.l HWIO_BLSP1_BLSP_QUP0_QUP_OUTPUT_FIFO_WORD_CNT_ADDR A:0x78b510c
y.create.l HWIO_BLSP1_BLSP_QUP0_QUP_OUTPUT_FIFO0_ADDR A:0x78b5110
y.create.l HWIO_BLSP1_BLSP_QUP0_QUP_OUTPUT_FIFO1_ADDR A:0x78b5114
y.create.l HWIO_BLSP1_BLSP_QUP0_QUP_OUTPUT_FIFO2_ADDR A:0x78b5118
y.create.l HWIO_BLSP1_BLSP_QUP0_QUP_OUTPUT_FIFO3_ADDR A:0x78b511c
y.create.l HWIO_BLSP1_BLSP_QUP0_QUP_OUTPUT_FIFO4_ADDR A:0x78b5120
y.create.l HWIO_BLSP1_BLSP_QUP0_QUP_OUTPUT_FIFO5_ADDR A:0x78b5124
y.create.l HWIO_BLSP1_BLSP_QUP0_QUP_OUTPUT_FIFO6_ADDR A:0x78b5128
y.create.l HWIO_BLSP1_BLSP_QUP0_QUP_OUTPUT_FIFO7_ADDR A:0x78b512c
y.create.l HWIO_BLSP1_BLSP_QUP0_QUP_OUTPUT_FIFO8_ADDR A:0x78b5130
y.create.l HWIO_BLSP1_BLSP_QUP0_QUP_OUTPUT_FIFO9_ADDR A:0x78b5134
y.create.l HWIO_BLSP1_BLSP_QUP0_QUP_MX_WRITE_COUNT_ADDR A:0x78b5150
y.create.l HWIO_BLSP1_BLSP_QUP0_QUP_MX_WRITE_CNT_CURRENT_ADDR A:0x78b5154
y.create.l HWIO_BLSP1_BLSP_QUP0_QUP_MX_INPUT_COUNT_ADDR A:0x78b5200
y.create.l HWIO_BLSP1_BLSP_QUP0_QUP_MX_INPUT_CNT_CURRENT_ADDR A:0x78b5204
y.create.l HWIO_BLSP1_BLSP_QUP0_QUP_MX_READ_COUNT_ADDR A:0x78b5208
y.create.l HWIO_BLSP1_BLSP_QUP0_QUP_MX_READ_CNT_CURRENT_ADDR A:0x78b520c
y.create.l HWIO_BLSP1_BLSP_QUP0_QUP_INPUT_DEBUG_ADDR A:0x78b5210
y.create.l HWIO_BLSP1_BLSP_QUP0_QUP_INPUT_FIFO_WORD_CNT_ADDR A:0x78b5214
y.create.l HWIO_BLSP1_BLSP_QUP0_QUP_INPUT_FIFO0_ADDR A:0x78b5218
y.create.l HWIO_BLSP1_BLSP_QUP0_QUP_INPUT_FIFO1_ADDR A:0x78b521c
y.create.l HWIO_BLSP1_BLSP_QUP0_QUP_INPUT_FIFO2_ADDR A:0x78b5220
y.create.l HWIO_BLSP1_BLSP_QUP0_QUP_INPUT_FIFO3_ADDR A:0x78b5224
y.create.l HWIO_BLSP1_BLSP_QUP0_QUP_INPUT_FIFO4_ADDR A:0x78b5228
y.create.l HWIO_BLSP1_BLSP_QUP0_QUP_INPUT_FIFO5_ADDR A:0x78b522c
y.create.l HWIO_BLSP1_BLSP_QUP0_QUP_INPUT_FIFO6_ADDR A:0x78b5230
y.create.l HWIO_BLSP1_BLSP_QUP0_QUP_INPUT_FIFO7_ADDR A:0x78b5234
y.create.l HWIO_BLSP1_BLSP_QUP0_QUP_INPUT_FIFO8_ADDR A:0x78b5238
y.create.l HWIO_BLSP1_BLSP_QUP0_QUP_INPUT_FIFO9_ADDR A:0x78b523c
y.create.l HWIO_BLSP1_BLSP_QUP0_SPI_CONFIG_ADDR A:0x78b5300
y.create.l HWIO_BLSP1_BLSP_QUP0_SPI_IO_CONTROL_ADDR A:0x78b5304
y.create.l HWIO_BLSP1_BLSP_QUP0_SPI_ERROR_FLAGS_ADDR A:0x78b5308
y.create.l HWIO_BLSP1_BLSP_QUP0_SPI_ERROR_FLAGS_EN_ADDR A:0x78b530c
y.create.l HWIO_BLSP1_BLSP_QUP0_SPI_DEASSERT_WAIT_ADDR A:0x78b5310
y.create.l HWIO_BLSP1_BLSP_QUP0_SPI_MASTER_LOCAL_ID_ADDR A:0x78b5314
y.create.l HWIO_BLSP1_BLSP_QUP0_SPI_MASTER_COMMAND_ADDR A:0x78b5318
y.create.l HWIO_BLSP1_BLSP_QUP0_SPI_MASTER_STATUS_ADDR A:0x78b531c
y.create.l HWIO_BLSP1_BLSP_QUP0_SPI_CHAR_CFG_ADDR A:0x78b5320
y.create.l HWIO_BLSP1_BLSP_QUP0_SPI_CHAR_DATA_SPI_CS_ADDR A:0x78b5324
y.create.l HWIO_BLSP1_BLSP_QUP0_SPI_CHAR_DATA_SPI_MOSI_ADDR A:0x78b5328
y.create.l HWIO_BLSP1_BLSP_QUP0_SPI_CHAR_DATA_SPI_MISO_ADDR A:0x78b532c
y.create.l HWIO_BLSP1_BLSP_QUP0_SPI_SLAVE_IRQ_STATUS_ADDR A:0x78b5330
y.create.l HWIO_BLSP1_BLSP_QUP0_SPI_SLAVE_IRQ_EN_ADDR A:0x78b5334
y.create.l HWIO_BLSP1_BLSP_QUP0_SPI_SLAVE_CFG_ADDR A:0x78b5338
y.create.l HWIO_BLSP1_BLSP_QUP0_SPI_SLAVE_DEBUG_ADDR A:0x78b533c
y.create.l HWIO_BLSP1_BLSP_QUP0_I2C_MASTER_CLK_CTL_ADDR A:0x78b5400
y.create.l HWIO_BLSP1_BLSP_QUP0_I2C_MASTER_STATUS_ADDR A:0x78b5404
y.create.l HWIO_BLSP1_BLSP_QUP0_I2C_MASTER_CONFIG_ADDR A:0x78b5408
y.create.l HWIO_BLSP1_BLSP_QUP0_I2C_MASTER_BUS_CLEAR_ADDR A:0x78b540c
y.create.l HWIO_BLSP1_BLSP_QUP0_I2C_MASTER_LOCAL_ID_ADDR A:0x78b5410
y.create.l HWIO_BLSP1_BLSP_QUP0_I2C_MASTER_COMMAND_ADDR A:0x78b5414
y.create.l HWIO_BLSP1_BLSP_QUP1_REG_BASE_START_ADDR A:0x78b6000
y.create.l HWIO_BLSP1_BLSP_QUP1_REG_BASE_LAST_ADDR A:0x78b6414
y.create.l HWIO_BLSP1_BLSP_QUP1_REG_BASE_END_ADDR A:0x78b6600
y.create.l HWIO_BLSP1_BLSP_QUP1_QUP_CONFIG_ADDR A:0x78b6000
y.create.l HWIO_BLSP1_BLSP_QUP1_QUP_STATE_ADDR A:0x78b6004
y.create.l HWIO_BLSP1_BLSP_QUP1_QUP_IO_MODES_ADDR A:0x78b6008
y.create.l HWIO_BLSP1_BLSP_QUP1_QUP_SW_RESET_ADDR A:0x78b600c
y.create.l HWIO_BLSP1_BLSP_QUP1_QUP_TRANSFER_CANCEL_ADDR A:0x78b6014
y.create.l HWIO_BLSP1_BLSP_QUP1_QUP_OPERATIONAL_ADDR A:0x78b6018
y.create.l HWIO_BLSP1_BLSP_QUP1_QUP_ERROR_FLAGS_ADDR A:0x78b601c
y.create.l HWIO_BLSP1_BLSP_QUP1_QUP_ERROR_FLAGS_EN_ADDR A:0x78b6020
y.create.l HWIO_BLSP1_BLSP_QUP1_QUP_TEST_CTRL_ADDR A:0x78b6024
y.create.l HWIO_BLSP1_BLSP_QUP1_QUP_OPERATIONAL_MASK_ADDR A:0x78b6028
y.create.l HWIO_BLSP1_BLSP_QUP1_QUP_HW_VERSION_ADDR A:0x78b6030
y.create.l HWIO_BLSP1_BLSP_QUP1_QUP_MX_OUTPUT_COUNT_ADDR A:0x78b6100
y.create.l HWIO_BLSP1_BLSP_QUP1_QUP_MX_OUTPUT_CNT_CURRENT_ADDR A:0x78b6104
y.create.l HWIO_BLSP1_BLSP_QUP1_QUP_OUTPUT_DEBUG_ADDR A:0x78b6108
y.create.l HWIO_BLSP1_BLSP_QUP1_QUP_OUTPUT_FIFO_WORD_CNT_ADDR A:0x78b610c
y.create.l HWIO_BLSP1_BLSP_QUP1_QUP_OUTPUT_FIFO0_ADDR A:0x78b6110
y.create.l HWIO_BLSP1_BLSP_QUP1_QUP_OUTPUT_FIFO1_ADDR A:0x78b6114
y.create.l HWIO_BLSP1_BLSP_QUP1_QUP_OUTPUT_FIFO2_ADDR A:0x78b6118
y.create.l HWIO_BLSP1_BLSP_QUP1_QUP_OUTPUT_FIFO3_ADDR A:0x78b611c
y.create.l HWIO_BLSP1_BLSP_QUP1_QUP_OUTPUT_FIFO4_ADDR A:0x78b6120
y.create.l HWIO_BLSP1_BLSP_QUP1_QUP_OUTPUT_FIFO5_ADDR A:0x78b6124
y.create.l HWIO_BLSP1_BLSP_QUP1_QUP_OUTPUT_FIFO6_ADDR A:0x78b6128
y.create.l HWIO_BLSP1_BLSP_QUP1_QUP_OUTPUT_FIFO7_ADDR A:0x78b612c
y.create.l HWIO_BLSP1_BLSP_QUP1_QUP_OUTPUT_FIFO8_ADDR A:0x78b6130
y.create.l HWIO_BLSP1_BLSP_QUP1_QUP_OUTPUT_FIFO9_ADDR A:0x78b6134
y.create.l HWIO_BLSP1_BLSP_QUP1_QUP_MX_WRITE_COUNT_ADDR A:0x78b6150
y.create.l HWIO_BLSP1_BLSP_QUP1_QUP_MX_WRITE_CNT_CURRENT_ADDR A:0x78b6154
y.create.l HWIO_BLSP1_BLSP_QUP1_QUP_MX_INPUT_COUNT_ADDR A:0x78b6200
y.create.l HWIO_BLSP1_BLSP_QUP1_QUP_MX_INPUT_CNT_CURRENT_ADDR A:0x78b6204
y.create.l HWIO_BLSP1_BLSP_QUP1_QUP_MX_READ_COUNT_ADDR A:0x78b6208
y.create.l HWIO_BLSP1_BLSP_QUP1_QUP_MX_READ_CNT_CURRENT_ADDR A:0x78b620c
y.create.l HWIO_BLSP1_BLSP_QUP1_QUP_INPUT_DEBUG_ADDR A:0x78b6210
y.create.l HWIO_BLSP1_BLSP_QUP1_QUP_INPUT_FIFO_WORD_CNT_ADDR A:0x78b6214
y.create.l HWIO_BLSP1_BLSP_QUP1_QUP_INPUT_FIFO0_ADDR A:0x78b6218
y.create.l HWIO_BLSP1_BLSP_QUP1_QUP_INPUT_FIFO1_ADDR A:0x78b621c
y.create.l HWIO_BLSP1_BLSP_QUP1_QUP_INPUT_FIFO2_ADDR A:0x78b6220
y.create.l HWIO_BLSP1_BLSP_QUP1_QUP_INPUT_FIFO3_ADDR A:0x78b6224
y.create.l HWIO_BLSP1_BLSP_QUP1_QUP_INPUT_FIFO4_ADDR A:0x78b6228
y.create.l HWIO_BLSP1_BLSP_QUP1_QUP_INPUT_FIFO5_ADDR A:0x78b622c
y.create.l HWIO_BLSP1_BLSP_QUP1_QUP_INPUT_FIFO6_ADDR A:0x78b6230
y.create.l HWIO_BLSP1_BLSP_QUP1_QUP_INPUT_FIFO7_ADDR A:0x78b6234
y.create.l HWIO_BLSP1_BLSP_QUP1_QUP_INPUT_FIFO8_ADDR A:0x78b6238
y.create.l HWIO_BLSP1_BLSP_QUP1_QUP_INPUT_FIFO9_ADDR A:0x78b623c
y.create.l HWIO_BLSP1_BLSP_QUP1_SPI_CONFIG_ADDR A:0x78b6300
y.create.l HWIO_BLSP1_BLSP_QUP1_SPI_IO_CONTROL_ADDR A:0x78b6304
y.create.l HWIO_BLSP1_BLSP_QUP1_SPI_ERROR_FLAGS_ADDR A:0x78b6308
y.create.l HWIO_BLSP1_BLSP_QUP1_SPI_ERROR_FLAGS_EN_ADDR A:0x78b630c
y.create.l HWIO_BLSP1_BLSP_QUP1_SPI_DEASSERT_WAIT_ADDR A:0x78b6310
y.create.l HWIO_BLSP1_BLSP_QUP1_SPI_MASTER_LOCAL_ID_ADDR A:0x78b6314
y.create.l HWIO_BLSP1_BLSP_QUP1_SPI_MASTER_COMMAND_ADDR A:0x78b6318
y.create.l HWIO_BLSP1_BLSP_QUP1_SPI_MASTER_STATUS_ADDR A:0x78b631c
y.create.l HWIO_BLSP1_BLSP_QUP1_SPI_CHAR_CFG_ADDR A:0x78b6320
y.create.l HWIO_BLSP1_BLSP_QUP1_SPI_CHAR_DATA_SPI_CS_ADDR A:0x78b6324
y.create.l HWIO_BLSP1_BLSP_QUP1_SPI_CHAR_DATA_SPI_MOSI_ADDR A:0x78b6328
y.create.l HWIO_BLSP1_BLSP_QUP1_SPI_CHAR_DATA_SPI_MISO_ADDR A:0x78b632c
y.create.l HWIO_BLSP1_BLSP_QUP1_SPI_SLAVE_IRQ_STATUS_ADDR A:0x78b6330
y.create.l HWIO_BLSP1_BLSP_QUP1_SPI_SLAVE_IRQ_EN_ADDR A:0x78b6334
y.create.l HWIO_BLSP1_BLSP_QUP1_SPI_SLAVE_CFG_ADDR A:0x78b6338
y.create.l HWIO_BLSP1_BLSP_QUP1_SPI_SLAVE_DEBUG_ADDR A:0x78b633c
y.create.l HWIO_BLSP1_BLSP_QUP1_I2C_MASTER_CLK_CTL_ADDR A:0x78b6400
y.create.l HWIO_BLSP1_BLSP_QUP1_I2C_MASTER_STATUS_ADDR A:0x78b6404
y.create.l HWIO_BLSP1_BLSP_QUP1_I2C_MASTER_CONFIG_ADDR A:0x78b6408
y.create.l HWIO_BLSP1_BLSP_QUP1_I2C_MASTER_BUS_CLEAR_ADDR A:0x78b640c
y.create.l HWIO_BLSP1_BLSP_QUP1_I2C_MASTER_LOCAL_ID_ADDR A:0x78b6410
y.create.l HWIO_BLSP1_BLSP_QUP1_I2C_MASTER_COMMAND_ADDR A:0x78b6414
y.create.l HWIO_BLSP1_BLSP_QUP2_REG_BASE_START_ADDR A:0x78b7000
y.create.l HWIO_BLSP1_BLSP_QUP2_REG_BASE_LAST_ADDR A:0x78b7414
y.create.l HWIO_BLSP1_BLSP_QUP2_REG_BASE_END_ADDR A:0x78b7600
y.create.l HWIO_BLSP1_BLSP_QUP2_QUP_CONFIG_ADDR A:0x78b7000
y.create.l HWIO_BLSP1_BLSP_QUP2_QUP_STATE_ADDR A:0x78b7004
y.create.l HWIO_BLSP1_BLSP_QUP2_QUP_IO_MODES_ADDR A:0x78b7008
y.create.l HWIO_BLSP1_BLSP_QUP2_QUP_SW_RESET_ADDR A:0x78b700c
y.create.l HWIO_BLSP1_BLSP_QUP2_QUP_TRANSFER_CANCEL_ADDR A:0x78b7014
y.create.l HWIO_BLSP1_BLSP_QUP2_QUP_OPERATIONAL_ADDR A:0x78b7018
y.create.l HWIO_BLSP1_BLSP_QUP2_QUP_ERROR_FLAGS_ADDR A:0x78b701c
y.create.l HWIO_BLSP1_BLSP_QUP2_QUP_ERROR_FLAGS_EN_ADDR A:0x78b7020
y.create.l HWIO_BLSP1_BLSP_QUP2_QUP_TEST_CTRL_ADDR A:0x78b7024
y.create.l HWIO_BLSP1_BLSP_QUP2_QUP_OPERATIONAL_MASK_ADDR A:0x78b7028
y.create.l HWIO_BLSP1_BLSP_QUP2_QUP_HW_VERSION_ADDR A:0x78b7030
y.create.l HWIO_BLSP1_BLSP_QUP2_QUP_MX_OUTPUT_COUNT_ADDR A:0x78b7100
y.create.l HWIO_BLSP1_BLSP_QUP2_QUP_MX_OUTPUT_CNT_CURRENT_ADDR A:0x78b7104
y.create.l HWIO_BLSP1_BLSP_QUP2_QUP_OUTPUT_DEBUG_ADDR A:0x78b7108
y.create.l HWIO_BLSP1_BLSP_QUP2_QUP_OUTPUT_FIFO_WORD_CNT_ADDR A:0x78b710c
y.create.l HWIO_BLSP1_BLSP_QUP2_QUP_OUTPUT_FIFO0_ADDR A:0x78b7110
y.create.l HWIO_BLSP1_BLSP_QUP2_QUP_OUTPUT_FIFO1_ADDR A:0x78b7114
y.create.l HWIO_BLSP1_BLSP_QUP2_QUP_OUTPUT_FIFO2_ADDR A:0x78b7118
y.create.l HWIO_BLSP1_BLSP_QUP2_QUP_OUTPUT_FIFO3_ADDR A:0x78b711c
y.create.l HWIO_BLSP1_BLSP_QUP2_QUP_OUTPUT_FIFO4_ADDR A:0x78b7120
y.create.l HWIO_BLSP1_BLSP_QUP2_QUP_OUTPUT_FIFO5_ADDR A:0x78b7124
y.create.l HWIO_BLSP1_BLSP_QUP2_QUP_OUTPUT_FIFO6_ADDR A:0x78b7128
y.create.l HWIO_BLSP1_BLSP_QUP2_QUP_OUTPUT_FIFO7_ADDR A:0x78b712c
y.create.l HWIO_BLSP1_BLSP_QUP2_QUP_OUTPUT_FIFO8_ADDR A:0x78b7130
y.create.l HWIO_BLSP1_BLSP_QUP2_QUP_OUTPUT_FIFO9_ADDR A:0x78b7134
y.create.l HWIO_BLSP1_BLSP_QUP2_QUP_MX_WRITE_COUNT_ADDR A:0x78b7150
y.create.l HWIO_BLSP1_BLSP_QUP2_QUP_MX_WRITE_CNT_CURRENT_ADDR A:0x78b7154
y.create.l HWIO_BLSP1_BLSP_QUP2_QUP_MX_INPUT_COUNT_ADDR A:0x78b7200
y.create.l HWIO_BLSP1_BLSP_QUP2_QUP_MX_INPUT_CNT_CURRENT_ADDR A:0x78b7204
y.create.l HWIO_BLSP1_BLSP_QUP2_QUP_MX_READ_COUNT_ADDR A:0x78b7208
y.create.l HWIO_BLSP1_BLSP_QUP2_QUP_MX_READ_CNT_CURRENT_ADDR A:0x78b720c
y.create.l HWIO_BLSP1_BLSP_QUP2_QUP_INPUT_DEBUG_ADDR A:0x78b7210
y.create.l HWIO_BLSP1_BLSP_QUP2_QUP_INPUT_FIFO_WORD_CNT_ADDR A:0x78b7214
y.create.l HWIO_BLSP1_BLSP_QUP2_QUP_INPUT_FIFO0_ADDR A:0x78b7218
y.create.l HWIO_BLSP1_BLSP_QUP2_QUP_INPUT_FIFO1_ADDR A:0x78b721c
y.create.l HWIO_BLSP1_BLSP_QUP2_QUP_INPUT_FIFO2_ADDR A:0x78b7220
y.create.l HWIO_BLSP1_BLSP_QUP2_QUP_INPUT_FIFO3_ADDR A:0x78b7224
y.create.l HWIO_BLSP1_BLSP_QUP2_QUP_INPUT_FIFO4_ADDR A:0x78b7228
y.create.l HWIO_BLSP1_BLSP_QUP2_QUP_INPUT_FIFO5_ADDR A:0x78b722c
y.create.l HWIO_BLSP1_BLSP_QUP2_QUP_INPUT_FIFO6_ADDR A:0x78b7230
y.create.l HWIO_BLSP1_BLSP_QUP2_QUP_INPUT_FIFO7_ADDR A:0x78b7234
y.create.l HWIO_BLSP1_BLSP_QUP2_QUP_INPUT_FIFO8_ADDR A:0x78b7238
y.create.l HWIO_BLSP1_BLSP_QUP2_QUP_INPUT_FIFO9_ADDR A:0x78b723c
y.create.l HWIO_BLSP1_BLSP_QUP2_SPI_CONFIG_ADDR A:0x78b7300
y.create.l HWIO_BLSP1_BLSP_QUP2_SPI_IO_CONTROL_ADDR A:0x78b7304
y.create.l HWIO_BLSP1_BLSP_QUP2_SPI_ERROR_FLAGS_ADDR A:0x78b7308
y.create.l HWIO_BLSP1_BLSP_QUP2_SPI_ERROR_FLAGS_EN_ADDR A:0x78b730c
y.create.l HWIO_BLSP1_BLSP_QUP2_SPI_DEASSERT_WAIT_ADDR A:0x78b7310
y.create.l HWIO_BLSP1_BLSP_QUP2_SPI_MASTER_LOCAL_ID_ADDR A:0x78b7314
y.create.l HWIO_BLSP1_BLSP_QUP2_SPI_MASTER_COMMAND_ADDR A:0x78b7318
y.create.l HWIO_BLSP1_BLSP_QUP2_SPI_MASTER_STATUS_ADDR A:0x78b731c
y.create.l HWIO_BLSP1_BLSP_QUP2_SPI_CHAR_CFG_ADDR A:0x78b7320
y.create.l HWIO_BLSP1_BLSP_QUP2_SPI_CHAR_DATA_SPI_CS_ADDR A:0x78b7324
y.create.l HWIO_BLSP1_BLSP_QUP2_SPI_CHAR_DATA_SPI_MOSI_ADDR A:0x78b7328
y.create.l HWIO_BLSP1_BLSP_QUP2_SPI_CHAR_DATA_SPI_MISO_ADDR A:0x78b732c
y.create.l HWIO_BLSP1_BLSP_QUP2_SPI_SLAVE_IRQ_STATUS_ADDR A:0x78b7330
y.create.l HWIO_BLSP1_BLSP_QUP2_SPI_SLAVE_IRQ_EN_ADDR A:0x78b7334
y.create.l HWIO_BLSP1_BLSP_QUP2_SPI_SLAVE_CFG_ADDR A:0x78b7338
y.create.l HWIO_BLSP1_BLSP_QUP2_SPI_SLAVE_DEBUG_ADDR A:0x78b733c
y.create.l HWIO_BLSP1_BLSP_QUP2_I2C_MASTER_CLK_CTL_ADDR A:0x78b7400
y.create.l HWIO_BLSP1_BLSP_QUP2_I2C_MASTER_STATUS_ADDR A:0x78b7404
y.create.l HWIO_BLSP1_BLSP_QUP2_I2C_MASTER_CONFIG_ADDR A:0x78b7408
y.create.l HWIO_BLSP1_BLSP_QUP2_I2C_MASTER_BUS_CLEAR_ADDR A:0x78b740c
y.create.l HWIO_BLSP1_BLSP_QUP2_I2C_MASTER_LOCAL_ID_ADDR A:0x78b7410
y.create.l HWIO_BLSP1_BLSP_QUP2_I2C_MASTER_COMMAND_ADDR A:0x78b7414
y.create.l HWIO_BLSP1_BLSP_QUP3_REG_BASE_START_ADDR A:0x78b8000
y.create.l HWIO_BLSP1_BLSP_QUP3_REG_BASE_LAST_ADDR A:0x78b8414
y.create.l HWIO_BLSP1_BLSP_QUP3_REG_BASE_END_ADDR A:0x78b8600
y.create.l HWIO_BLSP1_BLSP_QUP3_QUP_CONFIG_ADDR A:0x78b8000
y.create.l HWIO_BLSP1_BLSP_QUP3_QUP_STATE_ADDR A:0x78b8004
y.create.l HWIO_BLSP1_BLSP_QUP3_QUP_IO_MODES_ADDR A:0x78b8008
y.create.l HWIO_BLSP1_BLSP_QUP3_QUP_SW_RESET_ADDR A:0x78b800c
y.create.l HWIO_BLSP1_BLSP_QUP3_QUP_TRANSFER_CANCEL_ADDR A:0x78b8014
y.create.l HWIO_BLSP1_BLSP_QUP3_QUP_OPERATIONAL_ADDR A:0x78b8018
y.create.l HWIO_BLSP1_BLSP_QUP3_QUP_ERROR_FLAGS_ADDR A:0x78b801c
y.create.l HWIO_BLSP1_BLSP_QUP3_QUP_ERROR_FLAGS_EN_ADDR A:0x78b8020
y.create.l HWIO_BLSP1_BLSP_QUP3_QUP_TEST_CTRL_ADDR A:0x78b8024
y.create.l HWIO_BLSP1_BLSP_QUP3_QUP_OPERATIONAL_MASK_ADDR A:0x78b8028
y.create.l HWIO_BLSP1_BLSP_QUP3_QUP_HW_VERSION_ADDR A:0x78b8030
y.create.l HWIO_BLSP1_BLSP_QUP3_QUP_MX_OUTPUT_COUNT_ADDR A:0x78b8100
y.create.l HWIO_BLSP1_BLSP_QUP3_QUP_MX_OUTPUT_CNT_CURRENT_ADDR A:0x78b8104
y.create.l HWIO_BLSP1_BLSP_QUP3_QUP_OUTPUT_DEBUG_ADDR A:0x78b8108
y.create.l HWIO_BLSP1_BLSP_QUP3_QUP_OUTPUT_FIFO_WORD_CNT_ADDR A:0x78b810c
y.create.l HWIO_BLSP1_BLSP_QUP3_QUP_OUTPUT_FIFO0_ADDR A:0x78b8110
y.create.l HWIO_BLSP1_BLSP_QUP3_QUP_OUTPUT_FIFO1_ADDR A:0x78b8114
y.create.l HWIO_BLSP1_BLSP_QUP3_QUP_OUTPUT_FIFO2_ADDR A:0x78b8118
y.create.l HWIO_BLSP1_BLSP_QUP3_QUP_OUTPUT_FIFO3_ADDR A:0x78b811c
y.create.l HWIO_BLSP1_BLSP_QUP3_QUP_OUTPUT_FIFO4_ADDR A:0x78b8120
y.create.l HWIO_BLSP1_BLSP_QUP3_QUP_OUTPUT_FIFO5_ADDR A:0x78b8124
y.create.l HWIO_BLSP1_BLSP_QUP3_QUP_OUTPUT_FIFO6_ADDR A:0x78b8128
y.create.l HWIO_BLSP1_BLSP_QUP3_QUP_OUTPUT_FIFO7_ADDR A:0x78b812c
y.create.l HWIO_BLSP1_BLSP_QUP3_QUP_OUTPUT_FIFO8_ADDR A:0x78b8130
y.create.l HWIO_BLSP1_BLSP_QUP3_QUP_OUTPUT_FIFO9_ADDR A:0x78b8134
y.create.l HWIO_BLSP1_BLSP_QUP3_QUP_MX_WRITE_COUNT_ADDR A:0x78b8150
y.create.l HWIO_BLSP1_BLSP_QUP3_QUP_MX_WRITE_CNT_CURRENT_ADDR A:0x78b8154
y.create.l HWIO_BLSP1_BLSP_QUP3_QUP_MX_INPUT_COUNT_ADDR A:0x78b8200
y.create.l HWIO_BLSP1_BLSP_QUP3_QUP_MX_INPUT_CNT_CURRENT_ADDR A:0x78b8204
y.create.l HWIO_BLSP1_BLSP_QUP3_QUP_MX_READ_COUNT_ADDR A:0x78b8208
y.create.l HWIO_BLSP1_BLSP_QUP3_QUP_MX_READ_CNT_CURRENT_ADDR A:0x78b820c
y.create.l HWIO_BLSP1_BLSP_QUP3_QUP_INPUT_DEBUG_ADDR A:0x78b8210
y.create.l HWIO_BLSP1_BLSP_QUP3_QUP_INPUT_FIFO_WORD_CNT_ADDR A:0x78b8214
y.create.l HWIO_BLSP1_BLSP_QUP3_QUP_INPUT_FIFO0_ADDR A:0x78b8218
y.create.l HWIO_BLSP1_BLSP_QUP3_QUP_INPUT_FIFO1_ADDR A:0x78b821c
y.create.l HWIO_BLSP1_BLSP_QUP3_QUP_INPUT_FIFO2_ADDR A:0x78b8220
y.create.l HWIO_BLSP1_BLSP_QUP3_QUP_INPUT_FIFO3_ADDR A:0x78b8224
y.create.l HWIO_BLSP1_BLSP_QUP3_QUP_INPUT_FIFO4_ADDR A:0x78b8228
y.create.l HWIO_BLSP1_BLSP_QUP3_QUP_INPUT_FIFO5_ADDR A:0x78b822c
y.create.l HWIO_BLSP1_BLSP_QUP3_QUP_INPUT_FIFO6_ADDR A:0x78b8230
y.create.l HWIO_BLSP1_BLSP_QUP3_QUP_INPUT_FIFO7_ADDR A:0x78b8234
y.create.l HWIO_BLSP1_BLSP_QUP3_QUP_INPUT_FIFO8_ADDR A:0x78b8238
y.create.l HWIO_BLSP1_BLSP_QUP3_QUP_INPUT_FIFO9_ADDR A:0x78b823c
y.create.l HWIO_BLSP1_BLSP_QUP3_SPI_CONFIG_ADDR A:0x78b8300
y.create.l HWIO_BLSP1_BLSP_QUP3_SPI_IO_CONTROL_ADDR A:0x78b8304
y.create.l HWIO_BLSP1_BLSP_QUP3_SPI_ERROR_FLAGS_ADDR A:0x78b8308
y.create.l HWIO_BLSP1_BLSP_QUP3_SPI_ERROR_FLAGS_EN_ADDR A:0x78b830c
y.create.l HWIO_BLSP1_BLSP_QUP3_SPI_DEASSERT_WAIT_ADDR A:0x78b8310
y.create.l HWIO_BLSP1_BLSP_QUP3_SPI_MASTER_LOCAL_ID_ADDR A:0x78b8314
y.create.l HWIO_BLSP1_BLSP_QUP3_SPI_MASTER_COMMAND_ADDR A:0x78b8318
y.create.l HWIO_BLSP1_BLSP_QUP3_SPI_MASTER_STATUS_ADDR A:0x78b831c
y.create.l HWIO_BLSP1_BLSP_QUP3_SPI_CHAR_CFG_ADDR A:0x78b8320
y.create.l HWIO_BLSP1_BLSP_QUP3_SPI_CHAR_DATA_SPI_CS_ADDR A:0x78b8324
y.create.l HWIO_BLSP1_BLSP_QUP3_SPI_CHAR_DATA_SPI_MOSI_ADDR A:0x78b8328
y.create.l HWIO_BLSP1_BLSP_QUP3_SPI_CHAR_DATA_SPI_MISO_ADDR A:0x78b832c
y.create.l HWIO_BLSP1_BLSP_QUP3_SPI_SLAVE_IRQ_STATUS_ADDR A:0x78b8330
y.create.l HWIO_BLSP1_BLSP_QUP3_SPI_SLAVE_IRQ_EN_ADDR A:0x78b8334
y.create.l HWIO_BLSP1_BLSP_QUP3_SPI_SLAVE_CFG_ADDR A:0x78b8338
y.create.l HWIO_BLSP1_BLSP_QUP3_SPI_SLAVE_DEBUG_ADDR A:0x78b833c
y.create.l HWIO_BLSP1_BLSP_QUP3_I2C_MASTER_CLK_CTL_ADDR A:0x78b8400
y.create.l HWIO_BLSP1_BLSP_QUP3_I2C_MASTER_STATUS_ADDR A:0x78b8404
y.create.l HWIO_BLSP1_BLSP_QUP3_I2C_MASTER_CONFIG_ADDR A:0x78b8408
y.create.l HWIO_BLSP1_BLSP_QUP3_I2C_MASTER_BUS_CLEAR_ADDR A:0x78b840c
y.create.l HWIO_BLSP1_BLSP_QUP3_I2C_MASTER_LOCAL_ID_ADDR A:0x78b8410
y.create.l HWIO_BLSP1_BLSP_QUP3_I2C_MASTER_COMMAND_ADDR A:0x78b8414
y.create.l HWIO_BOOT_ROM_MPU1032_3_M20L12_AHB_REG_BASE_START_ADDR A:0x1ff000
y.create.l HWIO_BOOT_ROM_MPU1032_3_M20L12_AHB_REG_BASE_LAST_ADDR A:0x1ff35c
y.create.l HWIO_BOOT_ROM_MPU1032_3_M20L12_AHB_REG_BASE_END_ADDR A:0x1ff380
y.create.l HWIO_BOOT_ROM_XPU_SCR_ADDR A:0x1ff000
y.create.l HWIO_BOOT_ROM_XPU_SWDR_ADDR A:0x1ff004
y.create.l HWIO_BOOT_ROM_XPU_PRTN_RACR_SSHADOW_ADDR A:0x1ff008
y.create.l HWIO_BOOT_ROM_XPU_PRTN_START_SSHADOW0_ADDR A:0x1ff010
y.create.l HWIO_BOOT_ROM_XPU_PRTN_END_SSHADOW0_ADDR A:0x1ff018
y.create.l HWIO_BOOT_ROM_XPU_SEAR0_ADDR A:0x1ff040
y.create.l HWIO_BOOT_ROM_XPU_SESR_ADDR A:0x1ff048
y.create.l HWIO_BOOT_ROM_XPU_SESRRESTORE_ADDR A:0x1ff04c
y.create.l HWIO_BOOT_ROM_XPU_SESYNR0_ADDR A:0x1ff050
y.create.l HWIO_BOOT_ROM_XPU_SESYNR1_ADDR A:0x1ff054
y.create.l HWIO_BOOT_ROM_XPU_SESYNR2_ADDR A:0x1ff058
y.create.l HWIO_BOOT_ROM_XPU_MCR_ADDR A:0x1ff100
y.create.l HWIO_BOOT_ROM_XPU_MEAR0_ADDR A:0x1ff140
y.create.l HWIO_BOOT_ROM_XPU_MESR_ADDR A:0x1ff148
y.create.l HWIO_BOOT_ROM_XPU_MESRRESTORE_ADDR A:0x1ff14c
y.create.l HWIO_BOOT_ROM_XPU_MESYNR0_ADDR A:0x1ff150
y.create.l HWIO_BOOT_ROM_XPU_MESYNR1_ADDR A:0x1ff154
y.create.l HWIO_BOOT_ROM_XPU_MESYNR2_ADDR A:0x1ff158
y.create.l HWIO_BOOT_ROM_XPU_CR_ADDR A:0x1ff080
y.create.l HWIO_BOOT_ROM_XPU_PRTN_RACR_SHADOW_ADDR A:0x1ff088
y.create.l HWIO_BOOT_ROM_XPU_PRTN_START_SHADOW0_ADDR A:0x1ff090
y.create.l HWIO_BOOT_ROM_XPU_PRTN_END_SHADOW0_ADDR A:0x1ff098
y.create.l HWIO_BOOT_ROM_XPU_RPU_ACR0_ADDR A:0x1ff0a0
y.create.l HWIO_BOOT_ROM_XPU_EAR0_ADDR A:0x1ff0c0
y.create.l HWIO_BOOT_ROM_XPU_ESR_ADDR A:0x1ff0c8
y.create.l HWIO_BOOT_ROM_XPU_ESRRESTORE_ADDR A:0x1ff0cc
y.create.l HWIO_BOOT_ROM_XPU_ESYNR0_ADDR A:0x1ff0d0
y.create.l HWIO_BOOT_ROM_XPU_ESYNR1_ADDR A:0x1ff0d4
y.create.l HWIO_BOOT_ROM_XPU_ESYNR2_ADDR A:0x1ff0d8
y.create.l HWIO_BOOT_ROM_XPU_UMR_RACR_ADDR A:0x1ff0e0
y.create.l HWIO_BOOT_ROM_XPU_UMR_WACR_ADDR A:0x1ff0e4
y.create.l HWIO_BOOT_ROM_XPU_UMR_CNTL_ADDR A:0x1ff0f0
y.create.l HWIO_BOOT_ROM_XPU_IDR0_ADDR A:0x1ff074
y.create.l HWIO_BOOT_ROM_XPU_IDR1_ADDR A:0x1ff078
y.create.l HWIO_BOOT_ROM_XPU_REV_ADDR A:0x1ff07c
y.create.l HWIO_BOOT_ROM_XPU_PRT0_RACR0_ADDR A:0x1ff200
y.create.l HWIO_BOOT_ROM_XPU_PRT1_RACR0_ADDR A:0x1ff280
y.create.l HWIO_BOOT_ROM_XPU_PRT2_RACR0_ADDR A:0x1ff300
y.create.l HWIO_BOOT_ROM_XPU_PRT0_START0_ADDR A:0x1ff240
y.create.l HWIO_BOOT_ROM_XPU_PRT1_START0_ADDR A:0x1ff2c0
y.create.l HWIO_BOOT_ROM_XPU_PRT2_START0_ADDR A:0x1ff340
y.create.l HWIO_BOOT_ROM_XPU_PRT0_END0_ADDR A:0x1ff248
y.create.l HWIO_BOOT_ROM_XPU_PRT1_END0_ADDR A:0x1ff2c8
y.create.l HWIO_BOOT_ROM_XPU_PRT2_END0_ADDR A:0x1ff348
y.create.l HWIO_BOOT_ROM_XPU_PRT0_SCR_ADDR A:0x1ff250
y.create.l HWIO_BOOT_ROM_XPU_PRT1_SCR_ADDR A:0x1ff2d0
y.create.l HWIO_BOOT_ROM_XPU_PRT2_SCR_ADDR A:0x1ff350
y.create.l HWIO_BOOT_ROM_XPU_PRT0_MCR_ADDR A:0x1ff254
y.create.l HWIO_BOOT_ROM_XPU_PRT1_MCR_ADDR A:0x1ff2d4
y.create.l HWIO_BOOT_ROM_XPU_PRT2_MCR_ADDR A:0x1ff354
y.create.l HWIO_BOOT_ROM_XPU_PRT0_CNTL0_ADDR A:0x1ff258
y.create.l HWIO_BOOT_ROM_XPU_PRT1_CNTL0_ADDR A:0x1ff2d8
y.create.l HWIO_BOOT_ROM_XPU_PRT2_CNTL0_ADDR A:0x1ff358
y.create.l HWIO_BOOT_ROM_XPU_PRT0_CNTL1_ADDR A:0x1ff25c
y.create.l HWIO_BOOT_ROM_XPU_PRT1_CNTL1_ADDR A:0x1ff2dc
y.create.l HWIO_BOOT_ROM_XPU_PRT2_CNTL1_ADDR A:0x1ff35c
y.create.l HWIO_GCC_CLK_CTL_REG_REG_BASE_START_ADDR A:0x1800000
y.create.l HWIO_GCC_CLK_CTL_REG_REG_BASE_LAST_ADDR A:0x187f000
y.create.l HWIO_GCC_CLK_CTL_REG_REG_BASE_END_ADDR A:0x1880000
y.create.l HWIO_GCC_GPLL0_MODE_ADDR A:0x1821000
y.create.l HWIO_GCC_GPLL0_L_VAL_ADDR A:0x1821004
y.create.l HWIO_GCC_GPLL0_ALPHA_VAL_ADDR A:0x1821008
y.create.l HWIO_GCC_GPLL0_ALPHA_VAL_U_ADDR A:0x182100c
y.create.l HWIO_GCC_GPLL0_USER_CTL_ADDR A:0x1821010
y.create.l HWIO_GCC_GPLL0_USER_CTL_U_ADDR A:0x1821014
y.create.l HWIO_GCC_GPLL0_CONFIG_CTL_ADDR A:0x1821018
y.create.l HWIO_GCC_GPLL0_TEST_CTL_ADDR A:0x182101c
y.create.l HWIO_GCC_GPLL0_TEST_CTL_U_ADDR A:0x1821020
y.create.l HWIO_GCC_GPLL0_STATUS_ADDR A:0x1821024
y.create.l HWIO_GCC_GPLL0_FREQ_CTL_ADDR A:0x1821028
y.create.l HWIO_GCC_GPLL0_SSC_UPDATE_RATE_ADDR A:0x182102c
y.create.l HWIO_GCC_GPLL0_SSC_DELTA_ALPHA_ADDR A:0x1821030
y.create.l HWIO_GCC_GPLL0_SSC_NUM_STEPS_ADDR A:0x1821034
y.create.l HWIO_GCC_GPLL1_MODE_ADDR A:0x1820000
y.create.l HWIO_GCC_GPLL1_L_VAL_ADDR A:0x1820004
y.create.l HWIO_GCC_GPLL1_M_VAL_ADDR A:0x1820008
y.create.l HWIO_GCC_GPLL1_N_VAL_ADDR A:0x182000c
y.create.l HWIO_GCC_GPLL1_USER_CTL_ADDR A:0x1820010
y.create.l HWIO_GCC_GPLL1_CONFIG_CTL_ADDR A:0x1820014
y.create.l HWIO_GCC_GPLL1_TEST_CTL_ADDR A:0x1820018
y.create.l HWIO_GCC_GPLL1_STATUS_ADDR A:0x182001c
y.create.l HWIO_GCC_GPLL2_MODE_ADDR A:0x1825000
y.create.l HWIO_GCC_GPLL2_L_VAL_ADDR A:0x1825004
y.create.l HWIO_GCC_GPLL2_ALPHA_VAL_ADDR A:0x1825008
y.create.l HWIO_GCC_GPLL2_ALPHA_VAL_U_ADDR A:0x182500c
y.create.l HWIO_GCC_GPLL2_USER_CTL_ADDR A:0x1825010
y.create.l HWIO_GCC_GPLL2_USER_CTL_U_ADDR A:0x1825014
y.create.l HWIO_GCC_GPLL2_CONFIG_CTL_ADDR A:0x1825018
y.create.l HWIO_GCC_GPLL2_TEST_CTL_ADDR A:0x182501c
y.create.l HWIO_GCC_GPLL2_TEST_CTL_U_ADDR A:0x1825020
y.create.l HWIO_GCC_GPLL2_STATUS_ADDR A:0x1825024
y.create.l HWIO_GCC_GPLL2_FREQ_CTL_ADDR A:0x1825028
y.create.l HWIO_GCC_GPLL2_SSC_UPDATE_RATE_ADDR A:0x182502c
y.create.l HWIO_GCC_GPLL2_SSC_DELTA_ALPHA_ADDR A:0x1825030
y.create.l HWIO_GCC_GPLL2_SSC_NUM_STEPS_ADDR A:0x1825034
y.create.l HWIO_GCC_BIMC_PLL_MODE_ADDR A:0x1823000
y.create.l HWIO_GCC_BIMC_PLL_L_VAL_ADDR A:0x1823004
y.create.l HWIO_GCC_BIMC_PLL_ALPHA_VAL_ADDR A:0x1823008
y.create.l HWIO_GCC_BIMC_PLL_ALPHA_VAL_U_ADDR A:0x182300c
y.create.l HWIO_GCC_BIMC_PLL_USER_CTL_ADDR A:0x1823010
y.create.l HWIO_GCC_BIMC_PLL_USER_CTL_U_ADDR A:0x1823014
y.create.l HWIO_GCC_BIMC_PLL_CONFIG_CTL_ADDR A:0x1823018
y.create.l HWIO_GCC_BIMC_PLL_TEST_CTL_ADDR A:0x182301c
y.create.l HWIO_GCC_BIMC_PLL_TEST_CTL_U_ADDR A:0x1823020
y.create.l HWIO_GCC_BIMC_PLL_STATUS_ADDR A:0x1823024
y.create.l HWIO_GCC_BIMC_PLL_FREQ_CTL_ADDR A:0x1823028
y.create.l HWIO_GCC_BIMC_PLL_SSC_UPDATE_RATE_ADDR A:0x182302c
y.create.l HWIO_GCC_BIMC_PLL_SSC_DELTA_ALPHA_ADDR A:0x1823030
y.create.l HWIO_GCC_BIMC_PLL_SSC_NUM_STEPS_ADDR A:0x1823034
y.create.l HWIO_GCC_PCNOC_BFDCD_CMD_RCGR_ADDR A:0x1827000
y.create.l HWIO_GCC_PCNOC_BFDCD_CFG_RCGR_ADDR A:0x1827004
y.create.l HWIO_GCC_PCNOC_BCR_ADDR A:0x1827018
y.create.l HWIO_GCC_PCNOC_AHB_CBCR_ADDR A:0x182701c
y.create.l HWIO_GCC_PCNOC_DDR_CFG_CBCR_ADDR A:0x1832024
y.create.l HWIO_GCC_PCNOC_RPM_AHB_CBCR_ADDR A:0x1827024
y.create.l HWIO_GCC_PCNOC_AT_CBCR_ADDR A:0x1827028
y.create.l HWIO_GCC_PCNOC_QDSS_STM_AXI_CBCR_ADDR A:0x182702c
y.create.l HWIO_GCC_PCNOC_APSS_AHB_CBCR_ADDR A:0x1827030
y.create.l HWIO_GCC_PCNOC_USB_CBCR_ADDR A:0x1827034
y.create.l HWIO_GCC_PCNOC_XO_CBCR_ADDR A:0x1827038
y.create.l HWIO_GCC_PCNOC_EXTREF_CTL_ADDR A:0x182703c
y.create.l HWIO_GCC_NOC_CONF_XPU_AHB_CBCR_ADDR A:0x1817000
y.create.l HWIO_GCC_IMEM_BCR_ADDR A:0x180e000
y.create.l HWIO_GCC_IMEM_AXI_CBCR_ADDR A:0x180e004
y.create.l HWIO_GCC_IMEM_CFG_AHB_CBCR_ADDR A:0x180e008
y.create.l HWIO_GCC_MSS_CFG_AHB_CBCR_ADDR A:0x1849000
y.create.l HWIO_GCC_MSS_Q6_BIMC_AXI_CBCR_ADDR A:0x1849004
y.create.l HWIO_GCC_MSS_Q6SS_AXIS_CBCR_ADDR A:0x1849008
y.create.l HWIO_GCC_MSS_Q6SS_BOOT_GPLL0_ADDR A:0x184900c
y.create.l HWIO_GCC_RPM_CFG_XPU_CBCR_ADDR A:0x1817004
y.create.l HWIO_GCC_QDSS_BCR_ADDR A:0x1829000
y.create.l HWIO_GCC_QDSS_DAP_AHB_CBCR_ADDR A:0x1829004
y.create.l HWIO_GCC_QDSS_CFG_AHB_CBCR_ADDR A:0x1829008
y.create.l HWIO_GCC_QDSS_AT_CMD_RCGR_ADDR A:0x182900c
y.create.l HWIO_GCC_QDSS_AT_CFG_RCGR_ADDR A:0x1829010
y.create.l HWIO_GCC_QDSS_AT_CBCR_ADDR A:0x1829024
y.create.l HWIO_GCC_QDSS_ETR_USB_CBCR_ADDR A:0x1829028
y.create.l HWIO_GCC_QDSS_STM_CMD_RCGR_ADDR A:0x182902c
y.create.l HWIO_GCC_QDSS_STM_CFG_RCGR_ADDR A:0x1829030
y.create.l HWIO_GCC_QDSS_STM_CBCR_ADDR A:0x1829044
y.create.l HWIO_GCC_QDSS_TRACECLKIN_CMD_RCGR_ADDR A:0x1829048
y.create.l HWIO_GCC_QDSS_TRACECLKIN_CFG_RCGR_ADDR A:0x182904c
y.create.l HWIO_GCC_QDSS_TRACECLKIN_CBCR_ADDR A:0x1829060
y.create.l HWIO_GCC_QDSS_APB_TSCTR_CMD_RCGR_ADDR A:0x1829064
y.create.l HWIO_GCC_QDSS_APB_TSCTR_CFG_RCGR_ADDR A:0x1829068
y.create.l HWIO_GCC_QDSS_TSCTR_CBCR_ADDR A:0x182907c
y.create.l HWIO_GCC_QDSS_DAP_CBCR_ADDR A:0x1829084
y.create.l HWIO_GCC_QDSS_TRIG_CMD_RCGR_ADDR A:0x1829090
y.create.l HWIO_GCC_QDSS_TRIG_CFG_RCGR_ADDR A:0x1829094
y.create.l HWIO_GCC_QDSS_TRIG_CBCR_ADDR A:0x1829098
y.create.l HWIO_GCC_QPIC_BCR_ADDR A:0x183f000
y.create.l HWIO_GCC_QPIC_CMD_RCGR_ADDR A:0x183f004
y.create.l HWIO_GCC_QPIC_CFG_RCGR_ADDR A:0x183f008
y.create.l HWIO_GCC_QPIC_M_ADDR A:0x183f00c
y.create.l HWIO_GCC_QPIC_N_ADDR A:0x183f010
y.create.l HWIO_GCC_QPIC_D_ADDR A:0x183f014
y.create.l HWIO_GCC_QPIC_CBCR_ADDR A:0x183f018
y.create.l HWIO_GCC_QPIC_AHB_CBCR_ADDR A:0x183f01c
y.create.l HWIO_GCC_QPIC_SYSTEM_CBCR_ADDR A:0x183f020
y.create.l HWIO_GCC_QPIC_IO_MACRO_CBCR_ADDR A:0x183f024
y.create.l HWIO_GCC_QPIC_IO_MACRO_CMD_RCGR_ADDR A:0x183f028
y.create.l HWIO_GCC_QPIC_IO_MACRO_CFG_RCGR_ADDR A:0x183f02c
y.create.l HWIO_GCC_QPIC_IO_MACRO_M_ADDR A:0x183f030
y.create.l HWIO_GCC_QPIC_IO_MACRO_N_ADDR A:0x183f034
y.create.l HWIO_GCC_QPIC_IO_MACRO_D_ADDR A:0x183f038
y.create.l HWIO_GCC_GCC_SLEEP_CMD_RCGR_ADDR A:0x1830000
y.create.l HWIO_GCC_USB_HS_BCR_ADDR A:0x1841000
y.create.l HWIO_GCC_USB_HS_SYSTEM_CBCR_ADDR A:0x1841004
y.create.l HWIO_GCC_USB_HS_PHY_CFG_AHB_CBCR_ADDR A:0x1841030
y.create.l HWIO_GCC_USB_HS_INACTIVITY_TIMERS_CBCR_ADDR A:0x184100c
y.create.l HWIO_GCC_USB_HS_SYSTEM_CMD_RCGR_ADDR A:0x1841010
y.create.l HWIO_GCC_USB_HS_SYSTEM_CFG_RCGR_ADDR A:0x1841014
y.create.l HWIO_GCC_USB2A_PHY_BCR_ADDR A:0x1841028
y.create.l HWIO_GCC_USB2_HS_PHY_ONLY_BCR_ADDR A:0x1841034
y.create.l HWIO_GCC_USB_HS_PHY_CFG_AHB_BCR_ADDR A:0x1841038
y.create.l HWIO_GCC_QUSB2_PHY_BCR_ADDR A:0x184103c
y.create.l HWIO_GCC_USB2A_PHY_SLEEP_CBCR_ADDR A:0x184102c
y.create.l HWIO_GCC_BLSP1_BCR_ADDR A:0x1801000
y.create.l HWIO_GCC_BLSP1_SLEEP_CBCR_ADDR A:0x1801004
y.create.l HWIO_GCC_BLSP1_AHB_CBCR_ADDR A:0x1801008
y.create.l HWIO_GCC_BLSP1_QUP1_BCR_ADDR A:0x1802000
y.create.l HWIO_GCC_BLSP1_QUP1_SPI_APPS_CBCR_ADDR A:0x1802004
y.create.l HWIO_GCC_BLSP1_QUP1_I2C_APPS_CBCR_ADDR A:0x1802008
y.create.l HWIO_GCC_BLSP1_QUP1_I2C_APPS_CMD_RCGR_ADDR A:0x180200c
y.create.l HWIO_GCC_BLSP1_QUP1_I2C_APPS_CFG_RCGR_ADDR A:0x1802010
y.create.l HWIO_GCC_BLSP1_QUP2_I2C_APPS_CMD_RCGR_ADDR A:0x1803000
y.create.l HWIO_GCC_BLSP1_QUP2_I2C_APPS_CFG_RCGR_ADDR A:0x1803004
y.create.l HWIO_GCC_BLSP1_QUP3_I2C_APPS_CMD_RCGR_ADDR A:0x1804000
y.create.l HWIO_GCC_BLSP1_QUP3_I2C_APPS_CFG_RCGR_ADDR A:0x1804004
y.create.l HWIO_GCC_BLSP1_QUP4_I2C_APPS_CMD_RCGR_ADDR A:0x1805000
y.create.l HWIO_GCC_BLSP1_QUP4_I2C_APPS_CFG_RCGR_ADDR A:0x1805004
y.create.l HWIO_GCC_BLSP1_QUP1_SPI_APPS_CMD_RCGR_ADDR A:0x1802024
y.create.l HWIO_GCC_BLSP1_QUP1_SPI_APPS_CFG_RCGR_ADDR A:0x1802028
y.create.l HWIO_GCC_BLSP1_QUP1_SPI_APPS_M_ADDR A:0x180202c
y.create.l HWIO_GCC_BLSP1_QUP1_SPI_APPS_N_ADDR A:0x1802030
y.create.l HWIO_GCC_BLSP1_QUP1_SPI_APPS_D_ADDR A:0x1802034
y.create.l HWIO_GCC_BLSP1_UART1_BCR_ADDR A:0x1802038
y.create.l HWIO_GCC_BLSP1_UART1_APPS_CBCR_ADDR A:0x180203c
y.create.l HWIO_GCC_BLSP1_UART1_SIM_CBCR_ADDR A:0x1802040
y.create.l HWIO_GCC_BLSP1_UART1_APPS_CMD_RCGR_ADDR A:0x1802044
y.create.l HWIO_GCC_BLSP1_UART1_APPS_CFG_RCGR_ADDR A:0x1802048
y.create.l HWIO_GCC_BLSP1_UART1_APPS_M_ADDR A:0x180204c
y.create.l HWIO_GCC_BLSP1_UART1_APPS_N_ADDR A:0x1802050
y.create.l HWIO_GCC_BLSP1_UART1_APPS_D_ADDR A:0x1802054
y.create.l HWIO_GCC_BLSP1_QUP2_BCR_ADDR A:0x1803008
y.create.l HWIO_GCC_BLSP1_QUP2_SPI_APPS_CBCR_ADDR A:0x180300c
y.create.l HWIO_GCC_BLSP1_QUP2_I2C_APPS_CBCR_ADDR A:0x1803010
y.create.l HWIO_GCC_BLSP1_QUP2_SPI_APPS_CMD_RCGR_ADDR A:0x1803014
y.create.l HWIO_GCC_BLSP1_QUP2_SPI_APPS_CFG_RCGR_ADDR A:0x1803018
y.create.l HWIO_GCC_BLSP1_QUP2_SPI_APPS_M_ADDR A:0x180301c
y.create.l HWIO_GCC_BLSP1_QUP2_SPI_APPS_N_ADDR A:0x1803020
y.create.l HWIO_GCC_BLSP1_QUP2_SPI_APPS_D_ADDR A:0x1803024
y.create.l HWIO_GCC_BLSP1_UART2_BCR_ADDR A:0x1803028
y.create.l HWIO_GCC_BLSP1_UART2_APPS_CBCR_ADDR A:0x180302c
y.create.l HWIO_GCC_BLSP1_UART2_SIM_CBCR_ADDR A:0x1803030
y.create.l HWIO_GCC_BLSP1_UART2_APPS_CMD_RCGR_ADDR A:0x1803034
y.create.l HWIO_GCC_BLSP1_UART2_APPS_CFG_RCGR_ADDR A:0x1803038
y.create.l HWIO_GCC_BLSP1_UART2_APPS_M_ADDR A:0x180303c
y.create.l HWIO_GCC_BLSP1_UART2_APPS_N_ADDR A:0x1803040
y.create.l HWIO_GCC_BLSP1_UART2_APPS_D_ADDR A:0x1803044
y.create.l HWIO_GCC_BLSP1_QUP3_BCR_ADDR A:0x1804018
y.create.l HWIO_GCC_BLSP1_QUP3_SPI_APPS_CBCR_ADDR A:0x180401c
y.create.l HWIO_GCC_BLSP1_QUP3_I2C_APPS_CBCR_ADDR A:0x1804020
y.create.l HWIO_GCC_BLSP1_QUP3_SPI_APPS_CMD_RCGR_ADDR A:0x1804024
y.create.l HWIO_GCC_BLSP1_QUP3_SPI_APPS_CFG_RCGR_ADDR A:0x1804028
y.create.l HWIO_GCC_BLSP1_QUP3_SPI_APPS_M_ADDR A:0x180402c
y.create.l HWIO_GCC_BLSP1_QUP3_SPI_APPS_N_ADDR A:0x1804030
y.create.l HWIO_GCC_BLSP1_QUP3_SPI_APPS_D_ADDR A:0x1804034
y.create.l HWIO_GCC_BLSP1_UART3_BCR_ADDR A:0x1804038
y.create.l HWIO_GCC_BLSP1_UART3_APPS_CBCR_ADDR A:0x180403c
y.create.l HWIO_GCC_BLSP1_UART3_SIM_CBCR_ADDR A:0x1804040
y.create.l HWIO_GCC_BLSP1_UART3_APPS_CMD_RCGR_ADDR A:0x1804044
y.create.l HWIO_GCC_BLSP1_UART3_APPS_CFG_RCGR_ADDR A:0x1804048
y.create.l HWIO_GCC_BLSP1_UART3_APPS_M_ADDR A:0x180404c
y.create.l HWIO_GCC_BLSP1_UART3_APPS_N_ADDR A:0x1804050
y.create.l HWIO_GCC_BLSP1_UART3_APPS_D_ADDR A:0x1804054
y.create.l HWIO_GCC_BLSP1_QUP4_BCR_ADDR A:0x1805018
y.create.l HWIO_GCC_BLSP1_QUP4_SPI_APPS_CBCR_ADDR A:0x180501c
y.create.l HWIO_GCC_BLSP1_QUP4_I2C_APPS_CBCR_ADDR A:0x1805020
y.create.l HWIO_GCC_BLSP1_QUP4_SPI_APPS_CMD_RCGR_ADDR A:0x1805024
y.create.l HWIO_GCC_BLSP1_QUP4_SPI_APPS_CFG_RCGR_ADDR A:0x1805028
y.create.l HWIO_GCC_BLSP1_QUP4_SPI_APPS_M_ADDR A:0x180502c
y.create.l HWIO_GCC_BLSP1_QUP4_SPI_APPS_N_ADDR A:0x1805030
y.create.l HWIO_GCC_BLSP1_QUP4_SPI_APPS_D_ADDR A:0x1805034
y.create.l HWIO_GCC_BLSP1_UART4_BCR_ADDR A:0x1805038
y.create.l HWIO_GCC_BLSP1_UART4_APPS_CBCR_ADDR A:0x180503c
y.create.l HWIO_GCC_BLSP1_UART4_SIM_CBCR_ADDR A:0x1805040
y.create.l HWIO_GCC_BLSP1_UART4_APPS_CMD_RCGR_ADDR A:0x1805044
y.create.l HWIO_GCC_BLSP1_UART4_APPS_CFG_RCGR_ADDR A:0x1805048
y.create.l HWIO_GCC_BLSP1_UART4_APPS_M_ADDR A:0x180504c
y.create.l HWIO_GCC_BLSP1_UART4_APPS_N_ADDR A:0x1805050
y.create.l HWIO_GCC_BLSP1_UART4_APPS_D_ADDR A:0x1805054
y.create.l HWIO_GCC_BLSP_UART_SIM_CMD_RCGR_ADDR A:0x180100c
y.create.l HWIO_GCC_BLSP_UART_SIM_CFG_RCGR_ADDR A:0x1801010
y.create.l HWIO_GCC_PRNG_XPU_CFG_AHB_CBCR_ADDR A:0x1817008
y.create.l HWIO_GCC_PDM_BCR_ADDR A:0x1844000
y.create.l HWIO_GCC_PDM_AHB_CBCR_ADDR A:0x1844004
y.create.l HWIO_GCC_PDM_XO4_CBCR_ADDR A:0x1844008
y.create.l HWIO_GCC_PDM2_CBCR_ADDR A:0x184400c
y.create.l HWIO_GCC_PDM2_CMD_RCGR_ADDR A:0x1844010
y.create.l HWIO_GCC_PDM2_CFG_RCGR_ADDR A:0x1844014
y.create.l HWIO_GCC_PWM0_XO512_CBCR_ADDR A:0x1844018
y.create.l HWIO_GCC_PRNG_BCR_ADDR A:0x1813000
y.create.l HWIO_GCC_PRNG_AHB_CBCR_ADDR A:0x1813004
y.create.l HWIO_GCC_PRNG_CMD_RCGR_ADDR A:0x1813020
y.create.l HWIO_GCC_PRNG_CFG_RCGR_ADDR A:0x1813024
y.create.l HWIO_GCC_PRNG_AHB_BRIDGE_CBCR_ADDR A:0x1813028
y.create.l HWIO_GCC_TCSR_BCR_ADDR A:0x1828000
y.create.l HWIO_GCC_TCSR_AHB_CBCR_ADDR A:0x1828004
y.create.l HWIO_GCC_BOOT_ROM_BCR_ADDR A:0x1813008
y.create.l HWIO_GCC_BOOT_ROM_AHB_CBCR_ADDR A:0x181300c
y.create.l HWIO_GCC_MSG_RAM_BCR_ADDR A:0x182b000
y.create.l HWIO_GCC_MSG_RAM_AHB_CBCR_ADDR A:0x182b004
y.create.l HWIO_GCC_TLMM_BCR_ADDR A:0x1834000
y.create.l HWIO_GCC_TLMM_AHB_CBCR_ADDR A:0x1834004
y.create.l HWIO_GCC_TLMM_CBCR_ADDR A:0x1834008
y.create.l HWIO_GCC_MPM_BCR_ADDR A:0x182c000
y.create.l HWIO_GCC_MPM_MISC_ADDR A:0x182c004
y.create.l HWIO_GCC_MPM_AHB_CBCR_ADDR A:0x182c008
y.create.l HWIO_GCC_RPM_PROC_HCLK_CBCR_ADDR A:0x182d000
y.create.l HWIO_GCC_RPM_BUS_AHB_CBCR_ADDR A:0x182d004
y.create.l HWIO_GCC_RPM_SLEEP_CBCR_ADDR A:0x182d008
y.create.l HWIO_GCC_RPM_TIMER_CBCR_ADDR A:0x182d00c
y.create.l HWIO_GCC_RPM_CMD_RCGR_ADDR A:0x182d010
y.create.l HWIO_GCC_RPM_CFG_RCGR_ADDR A:0x182d014
y.create.l HWIO_GCC_RPM_MISC_ADDR A:0x182d028
y.create.l HWIO_GCC_SEC_CTRL_BCR_ADDR A:0x181a000
y.create.l HWIO_GCC_ACC_CMD_RCGR_ADDR A:0x181a004
y.create.l HWIO_GCC_ACC_CFG_RCGR_ADDR A:0x181a008
y.create.l HWIO_GCC_ACC_MISC_ADDR A:0x181a01c
y.create.l HWIO_GCC_SEC_CTRL_ACC_CBCR_ADDR A:0x181a020
y.create.l HWIO_GCC_SEC_CTRL_AHB_CBCR_ADDR A:0x181a024
y.create.l HWIO_GCC_SEC_CTRL_CBCR_ADDR A:0x181a028
y.create.l HWIO_GCC_SEC_CTRL_SENSE_CBCR_ADDR A:0x181a02c
y.create.l HWIO_GCC_SEC_CTRL_BOOT_ROM_PATCH_CBCR_ADDR A:0x181a030
y.create.l HWIO_GCC_SEC_CTRL_CMD_RCGR_ADDR A:0x181a034
y.create.l HWIO_GCC_SEC_CTRL_CFG_RCGR_ADDR A:0x181a038
y.create.l HWIO_GCC_SPMI_BCR_ADDR A:0x182e000
y.create.l HWIO_GCC_SPMI_SER_CMD_RCGR_ADDR A:0x182e004
y.create.l HWIO_GCC_SPMI_SER_CFG_RCGR_ADDR A:0x182e008
y.create.l HWIO_GCC_SPMI_SER_CBCR_ADDR A:0x182e01c
y.create.l HWIO_GCC_SPMI_PCNOC_AHB_CBCR_ADDR A:0x182e020
y.create.l HWIO_GCC_SPMI_AHB_CMD_RCGR_ADDR A:0x182e024
y.create.l HWIO_GCC_SPMI_AHB_CFG_RCGR_ADDR A:0x182e028
y.create.l HWIO_GCC_SPMI_AHB_CBCR_ADDR A:0x182e03c
y.create.l HWIO_GCC_SPDM_BCR_ADDR A:0x182f000
y.create.l HWIO_GCC_SPDM_CFG_AHB_CBCR_ADDR A:0x182f004
y.create.l HWIO_GCC_SPDM_MSTR_AHB_CBCR_ADDR A:0x182f008
y.create.l HWIO_GCC_SPDM_FF_CBCR_ADDR A:0x182f00c
y.create.l HWIO_GCC_SPDM_BIMC_CY_CBCR_ADDR A:0x182f010
y.create.l HWIO_GCC_SPDM_DEBUG_CY_CBCR_ADDR A:0x182f018
y.create.l HWIO_GCC_SPDM_PCNOC_CY_CBCR_ADDR A:0x182f01c
y.create.l HWIO_GCC_SPDM_RPM_CY_CBCR_ADDR A:0x182f020
y.create.l HWIO_GCC_CRYPTO_BCR_ADDR A:0x1816000
y.create.l HWIO_GCC_CRYPTO_CMD_RCGR_ADDR A:0x1816004
y.create.l HWIO_GCC_CRYPTO_CFG_RCGR_ADDR A:0x1816008
y.create.l HWIO_GCC_CRYPTO_CBCR_ADDR A:0x181601c
y.create.l HWIO_GCC_CRYPTO_AXI_CBCR_ADDR A:0x1816020
y.create.l HWIO_GCC_CRYPTO_AHB_CBCR_ADDR A:0x1816024
y.create.l HWIO_GCC_GCC_AHB_CBCR_ADDR A:0x1830014
y.create.l HWIO_GCC_GCC_XO_CMD_RCGR_ADDR A:0x1830018
y.create.l HWIO_GCC_GCC_XO_CBCR_ADDR A:0x1830030
y.create.l HWIO_GCC_GCC_XO_DIV4_CBCR_ADDR A:0x1830034
y.create.l HWIO_GCC_GCC_IM_SLEEP_CBCR_ADDR A:0x1830038
y.create.l HWIO_GCC_BIMC_BCR_ADDR A:0x1831000
y.create.l HWIO_GCC_BIMC_GDSCR_ADDR A:0x1831004
y.create.l HWIO_GCC_BIMC_DDR_XO_CMD_RCGR_ADDR A:0x1832000
y.create.l HWIO_GCC_BIMC_XO_CBCR_ADDR A:0x1831008
y.create.l HWIO_GCC_BIMC_CFG_AHB_CBCR_ADDR A:0x183100c
y.create.l HWIO_GCC_BIMC_SLEEP_CBCR_ADDR A:0x1831010
y.create.l HWIO_GCC_BIMC_PCNOC_AXI_CBCR_ADDR A:0x1831024
y.create.l HWIO_GCC_BIMC_DDR_CMD_RCGR_ADDR A:0x1832004
y.create.l HWIO_GCC_BIMC_DDR_CFG_RCGR_ADDR A:0x1832008
y.create.l HWIO_GCC_BIMC_MISC_ADDR A:0x1831018
y.create.l HWIO_GCC_BIMC_CBCR_ADDR A:0x183101c
y.create.l HWIO_GCC_BIMC_APSS_AXI_CBCR_ADDR A:0x1831020
y.create.l HWIO_GCC_DDR_DIM_CFG_CBCR_ADDR A:0x183201c
y.create.l HWIO_GCC_DDR_DIM_SLEEP_CBCR_ADDR A:0x1832020
y.create.l HWIO_GCC_APSS_AXI_CMD_RCGR_ADDR A:0x1831050
y.create.l HWIO_GCC_APSS_AXI_CFG_RCGR_ADDR A:0x1831054
y.create.l HWIO_GCC_ULTAUDIO_PCNOC_MPORT_CBCR_ADDR A:0x181c000
y.create.l HWIO_GCC_ULTAUDIO_PCNOC_SWAY_CBCR_ADDR A:0x181c004
y.create.l HWIO_GCC_ULT_AUDIO_BCR_ADDR A:0x181c0b4
y.create.l HWIO_GCC_APSS_AHB_CMD_RCGR_ADDR A:0x1846000
y.create.l HWIO_GCC_APSS_AHB_CFG_RCGR_ADDR A:0x1846004
y.create.l HWIO_GCC_APSS_AHB_MISC_ADDR A:0x1846018
y.create.l HWIO_GCC_APSS_AHB_CBCR_ADDR A:0x184601c
y.create.l HWIO_GCC_APSS_AXI_CBCR_ADDR A:0x1846020
y.create.l HWIO_GCC_A7SS_BOOT_GPLL0_ADDR A:0x1846024
y.create.l HWIO_GCC_SNOC_BUS_TIMEOUT0_BCR_ADDR A:0x1847000
y.create.l HWIO_GCC_SNOC_BUS_TIMEOUT0_AHB_CBCR_ADDR A:0x1847004
y.create.l HWIO_GCC_PCNOC_BUS_TIMEOUT0_BCR_ADDR A:0x1848000
y.create.l HWIO_GCC_PCNOC_BUS_TIMEOUT0_AHB_CBCR_ADDR A:0x1848004
y.create.l HWIO_GCC_PCNOC_BUS_TIMEOUT1_BCR_ADDR A:0x1848008
y.create.l HWIO_GCC_PCNOC_BUS_TIMEOUT1_AHB_CBCR_ADDR A:0x184800c
y.create.l HWIO_GCC_PCNOC_BUS_TIMEOUT2_BCR_ADDR A:0x1848010
y.create.l HWIO_GCC_PCNOC_BUS_TIMEOUT2_AHB_CBCR_ADDR A:0x1848014
y.create.l HWIO_GCC_PCNOC_BUS_TIMEOUT3_BCR_ADDR A:0x1848018
y.create.l HWIO_GCC_PCNOC_BUS_TIMEOUT3_AHB_CBCR_ADDR A:0x184801c
y.create.l HWIO_GCC_PCNOC_BUS_TIMEOUT4_BCR_ADDR A:0x1848020
y.create.l HWIO_GCC_PCNOC_BUS_TIMEOUT4_AHB_CBCR_ADDR A:0x1848024
y.create.l HWIO_GCC_PCNOC_BUS_TIMEOUT5_BCR_ADDR A:0x1848028
y.create.l HWIO_GCC_PCNOC_BUS_TIMEOUT5_AHB_CBCR_ADDR A:0x184802c
y.create.l HWIO_GCC_PCNOC_BUS_TIMEOUT6_BCR_ADDR A:0x1848030
y.create.l HWIO_GCC_PCNOC_BUS_TIMEOUT6_AHB_CBCR_ADDR A:0x1848034
y.create.l HWIO_GCC_PCNOC_BUS_TIMEOUT7_BCR_ADDR A:0x1848038
y.create.l HWIO_GCC_PCNOC_BUS_TIMEOUT7_AHB_CBCR_ADDR A:0x184803c
y.create.l HWIO_GCC_PCNOC_BUS_TIMEOUT8_BCR_ADDR A:0x1848040
y.create.l HWIO_GCC_PCNOC_BUS_TIMEOUT8_AHB_CBCR_ADDR A:0x1848044
y.create.l HWIO_GCC_PCNOC_BUS_TIMEOUT9_BCR_ADDR A:0x1848048
y.create.l HWIO_GCC_PCNOC_BUS_TIMEOUT9_AHB_CBCR_ADDR A:0x184804c
y.create.l HWIO_GCC_PCNOC_BUS_TIMEOUT10_BCR_ADDR A:0x1848050
y.create.l HWIO_GCC_PCNOC_BUS_TIMEOUT10_AHB_CBCR_ADDR A:0x1848054
y.create.l HWIO_GCC_DEHR_BCR_ADDR A:0x181f000
y.create.l HWIO_GCC_DEHR_CBCR_ADDR A:0x181f004
y.create.l HWIO_GCC_PCNOC_MPU_CFG_AHB_CBCR_ADDR A:0x181700c
y.create.l HWIO_GCC_BIMC_NOC_MPU_AHB_CBCR_ADDR A:0x1812100
y.create.l HWIO_GCC_Q6_MPU_AHB_CBCR_ADDR A:0x1812104
y.create.l HWIO_GCC_MSS_NAV_CE_MPU_AHB_CBCR_ADDR A:0x1812108
y.create.l HWIO_GCC_PCNOC_SNOC_MPU_AHB_CBCR_ADDR A:0x181210c
y.create.l HWIO_GCC_SNOC_BOOT_IMEM_MPU_AHB_CBCR_ADDR A:0x1812110
y.create.l HWIO_GCC_Q6_VMIDMT_AHB_CBCR_ADDR A:0x1812114
y.create.l HWIO_GCC_MSS_NAV_CE_VMIDMT_AHB_CBCR_ADDR A:0x1812118
y.create.l HWIO_GCC_PCNOC_SNOC_VMIDMT1_AHB_CBCR_ADDR A:0x181211c
y.create.l HWIO_GCC_PCNOC_SNOC_VMIDMT2_AHB_CBCR_ADDR A:0x1812120
y.create.l HWIO_GCC_PCNOC_SNOC_VMIDMT3_AHB_CBCR_ADDR A:0x1812124
y.create.l HWIO_GCC_PCNOC_SNOC_VMIDMT4_AHB_CBCR_ADDR A:0x1812128
y.create.l HWIO_GCC_RBCPR_BCR_ADDR A:0x1833000
y.create.l HWIO_GCC_RBCPR_CBCR_ADDR A:0x1833004
y.create.l HWIO_GCC_RBCPR_AHB_CBCR_ADDR A:0x1833008
y.create.l HWIO_GCC_RBCPR_CMD_RCGR_ADDR A:0x183300c
y.create.l HWIO_GCC_RBCPR_CFG_RCGR_ADDR A:0x1833010
y.create.l HWIO_GCC_RPM_GPLL_ENA_VOTE_ADDR A:0x1836000
y.create.l HWIO_GCC_RPM_CLOCK_BRANCH_ENA_VOTE_ADDR A:0x1836004
y.create.l HWIO_GCC_RPM_CLOCK_SLEEP_ENA_VOTE_ADDR A:0x1836008
y.create.l HWIO_GCC_APCS_GPLL_ENA_VOTE_ADDR A:0x1845000
y.create.l HWIO_GCC_APCS_CLOCK_BRANCH_ENA_VOTE_ADDR A:0x1845004
y.create.l HWIO_GCC_APCS_CLOCK_SLEEP_ENA_VOTE_ADDR A:0x1845008
y.create.l HWIO_GCC_APCS_TZ_GPLL_ENA_VOTE_ADDR A:0x1813010
y.create.l HWIO_GCC_APCS_TZ_CLOCK_BRANCH_ENA_VOTE_ADDR A:0x1813014
y.create.l HWIO_GCC_APCS_TZ_CLOCK_SLEEP_ENA_VOTE_ADDR A:0x1813018
y.create.l HWIO_GCC_APCS_HYP_GPLL_ENA_VOTE_ADDR A:0x1861000
y.create.l HWIO_GCC_APCS_HYP_CLOCK_BRANCH_ENA_VOTE_ADDR A:0x1861004
y.create.l HWIO_GCC_APCS_HYP_CLOCK_SLEEP_ENA_VOTE_ADDR A:0x1861008
y.create.l HWIO_GCC_MSS_Q6_GPLL_ENA_VOTE_ADDR A:0x181b000
y.create.l HWIO_GCC_MSS_Q6_CLOCK_BRANCH_ENA_VOTE_ADDR A:0x181b004
y.create.l HWIO_GCC_MSS_Q6_CLOCK_SLEEP_ENA_VOTE_ADDR A:0x181b008
y.create.l HWIO_GCC_SPARE_GPLL_ENA_VOTE_ADDR A:0x1800000
y.create.l HWIO_GCC_SPARE_CLOCK_BRANCH_ENA_VOTE_ADDR A:0x1800004
y.create.l HWIO_GCC_MSS_RESTART_ADDR A:0x183e000
y.create.l HWIO_GCC_RESET_DEBUG_ADDR A:0x1814000
y.create.l HWIO_GCC_FLUSH_ETR_DEBUG_TIMER_ADDR A:0x1815000
y.create.l HWIO_GCC_STOP_CAPTURE_DEBUG_TIMER_ADDR A:0x1815004
y.create.l HWIO_GCC_RESET_STATUS_ADDR A:0x1815008
y.create.l HWIO_GCC_SW_SRST_ADDR A:0x181500c
y.create.l HWIO_GCC_PRE_PREP_DEBUG_TIMER_ADDR A:0x1815014
y.create.l HWIO_GCC_PRE_PREP_SELECT_ADDR A:0x1815018
y.create.l HWIO_GCC_VIRTUAL_SRST_TIMER_VAL_ADDR A:0x181501c
y.create.l HWIO_GCC_PROC_HALT_ADDR A:0x181301c
y.create.l HWIO_GCC_GCC_DEBUG_CLK_CTL_ADDR A:0x1874000
y.create.l HWIO_GCC_CLOCK_FRQ_MEASURE_CTL_ADDR A:0x1874004
y.create.l HWIO_GCC_CLOCK_FRQ_MEASURE_STATUS_ADDR A:0x1874008
y.create.l HWIO_GCC_PLLTEST_PAD_CFG_ADDR A:0x187400c
y.create.l HWIO_GCC_JITTER_PROBE_CFG_ADDR A:0x1874010
y.create.l HWIO_GCC_JITTER_PROBE_VAL_ADDR A:0x1874014
y.create.l HWIO_GCC_GP1_CBCR_ADDR A:0x1808000
y.create.l HWIO_GCC_GP1_CMD_RCGR_ADDR A:0x1808004
y.create.l HWIO_GCC_GP1_CFG_RCGR_ADDR A:0x1808008
y.create.l HWIO_GCC_GP1_M_ADDR A:0x180800c
y.create.l HWIO_GCC_GP1_N_ADDR A:0x1808010
y.create.l HWIO_GCC_GP1_D_ADDR A:0x1808014
y.create.l HWIO_GCC_GP2_CBCR_ADDR A:0x1809000
y.create.l HWIO_GCC_GP2_CMD_RCGR_ADDR A:0x1809004
y.create.l HWIO_GCC_GP2_CFG_RCGR_ADDR A:0x1809008
y.create.l HWIO_GCC_GP2_M_ADDR A:0x180900c
y.create.l HWIO_GCC_GP2_N_ADDR A:0x1809010
y.create.l HWIO_GCC_GP2_D_ADDR A:0x1809014
y.create.l HWIO_GCC_GP3_CBCR_ADDR A:0x180a000
y.create.l HWIO_GCC_GP3_CMD_RCGR_ADDR A:0x180a004
y.create.l HWIO_GCC_GP3_CFG_RCGR_ADDR A:0x180a008
y.create.l HWIO_GCC_GP3_M_ADDR A:0x180a00c
y.create.l HWIO_GCC_GP3_N_ADDR A:0x180a010
y.create.l HWIO_GCC_GP3_D_ADDR A:0x180a014
y.create.l HWIO_GCC_APSS_MISC_ADDR A:0x1860000
y.create.l HWIO_GCC_TIC_MODE_APSS_BOOT_ADDR A:0x187f000
y.create.l HWIO_GCC_USB_BOOT_CLOCK_CTL_ADDR A:0x1840000
y.create.l HWIO_GCC_RAW_SLEEP_CLK_CTRL_ADDR A:0x1835000
y.create.l HWIO_GCC_S1LM_MODEM_DIV_VOTE_ADDR A:0x1800008
y.create.l HWIO_GCC_GCC_SPARE1_REG_ADDR A:0x180000c
y.create.l HWIO_GCC_S1LM_APPS_DIV_VOTE_ADDR A:0x187e000
y.create.l HWIO_GCC_GCC_SPARE3_REG_ADDR A:0x187e004
y.create.l HWIO_GCC_AUDIO_CORE_BCR_ADDR A:0x181c008
y.create.l HWIO_GCC_ULTAUDIO_LPAIF_PRI_I2S_CMD_RCGR_ADDR A:0x181c054
y.create.l HWIO_GCC_ULTAUDIO_LPAIF_PRI_I2S_CFG_RCGR_ADDR A:0x181c058
y.create.l HWIO_GCC_ULTAUDIO_LPAIF_PRI_I2S_M_ADDR A:0x181c05c
y.create.l HWIO_GCC_ULTAUDIO_LPAIF_PRI_I2S_N_ADDR A:0x181c060
y.create.l HWIO_GCC_ULTAUDIO_LPAIF_PRI_I2S_D_ADDR A:0x181c064
y.create.l HWIO_GCC_ULTAUDIO_LPAIF_PRI_I2S_CBCR_ADDR A:0x181c068
y.create.l HWIO_GCC_ULTAUDIO_LPAIF_SEC_I2S_CMD_RCGR_ADDR A:0x181c06c
y.create.l HWIO_GCC_ULTAUDIO_LPAIF_SEC_I2S_CFG_RCGR_ADDR A:0x181c070
y.create.l HWIO_GCC_ULTAUDIO_LPAIF_SEC_I2S_M_ADDR A:0x181c074
y.create.l HWIO_GCC_ULTAUDIO_LPAIF_SEC_I2S_N_ADDR A:0x181c078
y.create.l HWIO_GCC_ULTAUDIO_LPAIF_SEC_I2S_D_ADDR A:0x181c07c
y.create.l HWIO_GCC_ULTAUDIO_LPAIF_SEC_I2S_CBCR_ADDR A:0x181c080
y.create.l HWIO_GCC_ULTAUDIO_XO_CMD_RCGR_ADDR A:0x181c034
y.create.l HWIO_GCC_ULTAUDIO_XO_CFG_RCGR_ADDR A:0x181c038
y.create.l HWIO_GCC_ULTAUDIO_AHBFABRIC_CMD_RCGR_ADDR A:0x181c010
y.create.l HWIO_GCC_ULTAUDIO_AHBFABRIC_CFG_RCGR_ADDR A:0x181c014
y.create.l HWIO_GCC_ULTAUDIO_AHBFABRIC_M_ADDR A:0x181c018
y.create.l HWIO_GCC_ULTAUDIO_AHBFABRIC_N_ADDR A:0x181c01c
y.create.l HWIO_GCC_ULTAUDIO_AHBFABRIC_D_ADDR A:0x181c020
y.create.l HWIO_GCC_ULTAUDIO_AHBFABRIC_IXFABRIC_LPM_CBCR_ADDR A:0x181c024
y.create.l HWIO_GCC_ULTAUDIO_AHBFABRIC_IXFABRIC_CBCR_ADDR A:0x181c028
y.create.l HWIO_GCC_ULTAUDIO_AVSYNC_XO_CBCR_ADDR A:0x181c04c
y.create.l HWIO_GCC_ULTAUDIO_STC_XO_CBCR_ADDR A:0x181c050
y.create.l HWIO_GCC_ULTAUDIO_AHBFABRIC_EFABRIC_SPDM_CBCR_ADDR A:0x181c030
y.create.l HWIO_GCC_ULTAUDIO_LPAIF_AUX_I2S_CMD_RCGR_ADDR A:0x181c084
y.create.l HWIO_GCC_ULTAUDIO_LPAIF_AUX_I2S_CFG_RCGR_ADDR A:0x181c088
y.create.l HWIO_GCC_ULTAUDIO_LPAIF_AUX_I2S_M_ADDR A:0x181c08c
y.create.l HWIO_GCC_ULTAUDIO_LPAIF_AUX_I2S_N_ADDR A:0x181c090
y.create.l HWIO_GCC_ULTAUDIO_LPAIF_AUX_I2S_D_ADDR A:0x181c094
y.create.l HWIO_GCC_ULTAUDIO_LPAIF_AUX_I2S_CBCR_ADDR A:0x181c098
y.create.l HWIO_GCC_ULTAUDIO_PCM_DATA_OE_CMD_RCGR_ADDR A:0x181c0f0
y.create.l HWIO_GCC_ULTAUDIO_PCM_DATA_OE_CFG_RCGR_ADDR A:0x181c0f4
y.create.l HWIO_GCC_ULTAUDIO_PCM_DATA_OE_M_ADDR A:0x181c0f8
y.create.l HWIO_GCC_ULTAUDIO_PCM_DATA_OE_N_ADDR A:0x181c0fc
y.create.l HWIO_GCC_ULTAUDIO_PCM_DATA_OE_D_ADDR A:0x181c100
y.create.l HWIO_GCC_ULTAUDIO_PCM_DATA_OE_CBCR_ADDR A:0x181c104
y.create.l HWIO_GCC_ULTAUDIO_SEC_PCM_DATA_OE_CMD_RCGR_ADDR A:0x181c108
y.create.l HWIO_GCC_ULTAUDIO_SEC_PCM_DATA_OE_CFG_RCGR_ADDR A:0x181c10c
y.create.l HWIO_GCC_ULTAUDIO_SEC_PCM_DATA_OE_M_ADDR A:0x181c110
y.create.l HWIO_GCC_ULTAUDIO_SEC_PCM_DATA_OE_N_ADDR A:0x181c114
y.create.l HWIO_GCC_ULTAUDIO_SEC_PCM_DATA_OE_D_ADDR A:0x181c118
y.create.l HWIO_GCC_ULTAUDIO_SEC_PCM_DATA_OE_CBCR_ADDR A:0x181c11c
y.create.l HWIO_GCC_ULTAUDIO_TER_PCM_DATA_OE_CMD_RCGR_ADDR A:0x181c120
y.create.l HWIO_GCC_ULTAUDIO_TER_PCM_DATA_OE_CFG_RCGR_ADDR A:0x181c124
y.create.l HWIO_GCC_ULTAUDIO_TER_PCM_DATA_OE_M_ADDR A:0x181c128
y.create.l HWIO_GCC_ULTAUDIO_TER_PCM_DATA_OE_N_ADDR A:0x181c12c
y.create.l HWIO_GCC_ULTAUDIO_TER_PCM_DATA_OE_D_ADDR A:0x181c130
y.create.l HWIO_GCC_ULTAUDIO_TER_PCM_DATA_OE_CBCR_ADDR A:0x181c134
y.create.l HWIO_GCC_ULTAUDIO_EXT_MCLK2_CMD_RCGR_ADDR A:0x181c0d8
y.create.l HWIO_GCC_ULTAUDIO_EXT_MCLK2_CFG_RCGR_ADDR A:0x181c0dc
y.create.l HWIO_GCC_ULTAUDIO_EXT_MCLK2_M_ADDR A:0x181c0e0
y.create.l HWIO_GCC_ULTAUDIO_EXT_MCLK2_N_ADDR A:0x181c0e4
y.create.l HWIO_GCC_ULTAUDIO_EXT_MCLK2_D_ADDR A:0x181c0e8
y.create.l HWIO_GCC_ULTAUDIO_EXT_MCLK2_CBCR_ADDR A:0x181c0ec
y.create.l HWIO_GCC_AUDIO_REF_CLOCK_SEL_ADDR A:0x181c0b8
y.create.l HWIO_GCC_ECC_BCR_ADDR A:0x1851000
y.create.l HWIO_GCC_ECC_CMD_RCGR_ADDR A:0x1851004
y.create.l HWIO_GCC_ECC_CFG_RCGR_ADDR A:0x1851008
y.create.l HWIO_GCC_ECC_CORE_CBCR_ADDR A:0x185100c
y.create.l HWIO_GCC_ECC_CBCR_ADDR A:0x1851010
y.create.l HWIO_GCC_DCC_BCR_ADDR A:0x1852000
y.create.l HWIO_GCC_DCC_CBCR_ADDR A:0x1852004
y.create.l HWIO_GCC_DCC_XO_CBCR_ADDR A:0x1852008
y.create.l HWIO_GCC_QZIP_CBCR_ADDR A:0x1853000
y.create.l HWIO_GCC_SPARE1_REG_ADDR A:0x1854000
y.create.l HWIO_GCC_SPARE2_REG_ADDR A:0x1855000
y.create.l HWIO_GCC_SPARE3_REG_ADDR A:0x1856000
y.create.l HWIO_GCC_RPU_RPU1132_32_L12_REG_BASE_START_ADDR A:0x1880000
y.create.l HWIO_GCC_RPU_RPU1132_32_L12_REG_BASE_LAST_ADDR A:0x18811d4
y.create.l HWIO_GCC_RPU_RPU1132_32_L12_REG_BASE_END_ADDR A:0x1881200
y.create.l HWIO_GCC_RPU_XPU_SCR_ADDR A:0x1880000
y.create.l HWIO_GCC_RPU_XPU_SWDR_ADDR A:0x1880004
y.create.l HWIO_GCC_RPU_XPU_SEAR0_ADDR A:0x1880040
y.create.l HWIO_GCC_RPU_XPU_SESR_ADDR A:0x1880048
y.create.l HWIO_GCC_RPU_XPU_SESRRESTORE_ADDR A:0x188004c
y.create.l HWIO_GCC_RPU_XPU_SESYNR0_ADDR A:0x1880050
y.create.l HWIO_GCC_RPU_XPU_SESYNR1_ADDR A:0x1880054
y.create.l HWIO_GCC_RPU_XPU_SESYNR2_ADDR A:0x1880058
y.create.l HWIO_GCC_RPU_XPU_MCR_ADDR A:0x1880100
y.create.l HWIO_GCC_RPU_XPU_MEAR0_ADDR A:0x1880140
y.create.l HWIO_GCC_RPU_XPU_MESR_ADDR A:0x1880148
y.create.l HWIO_GCC_RPU_XPU_MESRRESTORE_ADDR A:0x188014c
y.create.l HWIO_GCC_RPU_XPU_MESYNR0_ADDR A:0x1880150
y.create.l HWIO_GCC_RPU_XPU_MESYNR1_ADDR A:0x1880154
y.create.l HWIO_GCC_RPU_XPU_MESYNR2_ADDR A:0x1880158
y.create.l HWIO_GCC_RPU_XPU_CR_ADDR A:0x1880080
y.create.l HWIO_GCC_RPU_XPU_RPU_ACR0_ADDR A:0x18800a0
y.create.l HWIO_GCC_RPU_XPU_EAR0_ADDR A:0x18800c0
y.create.l HWIO_GCC_RPU_XPU_ESR_ADDR A:0x18800c8
y.create.l HWIO_GCC_RPU_XPU_ESRRESTORE_ADDR A:0x18800cc
y.create.l HWIO_GCC_RPU_XPU_ESYNR0_ADDR A:0x18800d0
y.create.l HWIO_GCC_RPU_XPU_ESYNR1_ADDR A:0x18800d4
y.create.l HWIO_GCC_RPU_XPU_ESYNR2_ADDR A:0x18800d8
y.create.l HWIO_GCC_RPU_XPU_IDR0_ADDR A:0x1880074
y.create.l HWIO_GCC_RPU_XPU_IDR1_ADDR A:0x1880078
y.create.l HWIO_GCC_RPU_XPU_REV_ADDR A:0x188007c
y.create.l HWIO_GCC_RPU_XPU_RG0_RACR0_ADDR A:0x1880200
y.create.l HWIO_GCC_RPU_XPU_RG1_RACR0_ADDR A:0x1880280
y.create.l HWIO_GCC_RPU_XPU_RG2_RACR0_ADDR A:0x1880300
y.create.l HWIO_GCC_RPU_XPU_RG3_RACR0_ADDR A:0x1880380
y.create.l HWIO_GCC_RPU_XPU_RG4_RACR0_ADDR A:0x1880400
y.create.l HWIO_GCC_RPU_XPU_RG5_RACR0_ADDR A:0x1880480
y.create.l HWIO_GCC_RPU_XPU_RG6_RACR0_ADDR A:0x1880500
y.create.l HWIO_GCC_RPU_XPU_RG7_RACR0_ADDR A:0x1880580
y.create.l HWIO_GCC_RPU_XPU_RG8_RACR0_ADDR A:0x1880600
y.create.l HWIO_GCC_RPU_XPU_RG9_RACR0_ADDR A:0x1880680
y.create.l HWIO_GCC_RPU_XPU_RG0_WACR0_ADDR A:0x1880220
y.create.l HWIO_GCC_RPU_XPU_RG1_WACR0_ADDR A:0x18802a0
y.create.l HWIO_GCC_RPU_XPU_RG2_WACR0_ADDR A:0x1880320
y.create.l HWIO_GCC_RPU_XPU_RG3_WACR0_ADDR A:0x18803a0
y.create.l HWIO_GCC_RPU_XPU_RG4_WACR0_ADDR A:0x1880420
y.create.l HWIO_GCC_RPU_XPU_RG5_WACR0_ADDR A:0x18804a0
y.create.l HWIO_GCC_RPU_XPU_RG6_WACR0_ADDR A:0x1880520
y.create.l HWIO_GCC_RPU_XPU_RG7_WACR0_ADDR A:0x18805a0
y.create.l HWIO_GCC_RPU_XPU_RG8_WACR0_ADDR A:0x1880620
y.create.l HWIO_GCC_RPU_XPU_RG9_WACR0_ADDR A:0x18806a0
y.create.l HWIO_GCC_RPU_XPU_RG0_SCR_ADDR A:0x1880250
y.create.l HWIO_GCC_RPU_XPU_RG1_SCR_ADDR A:0x18802d0
y.create.l HWIO_GCC_RPU_XPU_RG2_SCR_ADDR A:0x1880350
y.create.l HWIO_GCC_RPU_XPU_RG3_SCR_ADDR A:0x18803d0
y.create.l HWIO_GCC_RPU_XPU_RG4_SCR_ADDR A:0x1880450
y.create.l HWIO_GCC_RPU_XPU_RG5_SCR_ADDR A:0x18804d0
y.create.l HWIO_GCC_RPU_XPU_RG6_SCR_ADDR A:0x1880550
y.create.l HWIO_GCC_RPU_XPU_RG7_SCR_ADDR A:0x18805d0
y.create.l HWIO_GCC_RPU_XPU_RG8_SCR_ADDR A:0x1880650
y.create.l HWIO_GCC_RPU_XPU_RG9_SCR_ADDR A:0x18806d0
y.create.l HWIO_GCC_RPU_XPU_RG0_MCR_ADDR A:0x1880254
y.create.l HWIO_GCC_RPU_XPU_RG1_MCR_ADDR A:0x18802d4
y.create.l HWIO_GCC_RPU_XPU_RG2_MCR_ADDR A:0x1880354
y.create.l HWIO_GCC_RPU_XPU_RG3_MCR_ADDR A:0x18803d4
y.create.l HWIO_GCC_RPU_XPU_RG4_MCR_ADDR A:0x1880454
y.create.l HWIO_GCC_RPU_XPU_RG5_MCR_ADDR A:0x18804d4
y.create.l HWIO_GCC_RPU_XPU_RG6_MCR_ADDR A:0x1880554
y.create.l HWIO_GCC_RPU_XPU_RG7_MCR_ADDR A:0x18805d4
y.create.l HWIO_GCC_RPU_XPU_RG8_MCR_ADDR A:0x1880654
y.create.l HWIO_GCC_RPU_XPU_RG9_MCR_ADDR A:0x18806d4
y.create.l HWIO_TCSR_TCSR_MUTEX_REG_BASE_START_ADDR A:0x1905000
y.create.l HWIO_TCSR_TCSR_MUTEX_REG_BASE_LAST_ADDR A:0x1924000
y.create.l HWIO_TCSR_TCSR_MUTEX_REG_BASE_END_ADDR A:0x1925000
y.create.l HWIO_TCSR_MUTEX_REG_0_ADDR A:0x1905000
y.create.l HWIO_TCSR_MUTEX_REG_1_ADDR A:0x1906000
y.create.l HWIO_TCSR_MUTEX_REG_2_ADDR A:0x1907000
y.create.l HWIO_TCSR_MUTEX_REG_3_ADDR A:0x1908000
y.create.l HWIO_TCSR_MUTEX_REG_4_ADDR A:0x1909000
y.create.l HWIO_TCSR_MUTEX_REG_5_ADDR A:0x190a000
y.create.l HWIO_TCSR_MUTEX_REG_6_ADDR A:0x190b000
y.create.l HWIO_TCSR_MUTEX_REG_7_ADDR A:0x190c000
y.create.l HWIO_TCSR_MUTEX_REG_8_ADDR A:0x190d000
y.create.l HWIO_TCSR_MUTEX_REG_9_ADDR A:0x190e000
y.create.l HWIO_TCSR_REGS_APU1132_16_REG_BASE_START_ADDR A:0x1936000
y.create.l HWIO_TCSR_REGS_APU1132_16_REG_BASE_LAST_ADDR A:0x19369d4
y.create.l HWIO_TCSR_REGS_APU1132_16_REG_BASE_END_ADDR A:0x1936a00
y.create.l HWIO_TCSR_REGS_XPU_SCR_ADDR A:0x1936000
y.create.l HWIO_TCSR_REGS_XPU_SWDR_ADDR A:0x1936004
y.create.l HWIO_TCSR_REGS_XPU_SEAR0_ADDR A:0x1936040
y.create.l HWIO_TCSR_REGS_XPU_SESR_ADDR A:0x1936048
y.create.l HWIO_TCSR_REGS_XPU_SESRRESTORE_ADDR A:0x193604c
y.create.l HWIO_TCSR_REGS_XPU_SESYNR0_ADDR A:0x1936050
y.create.l HWIO_TCSR_REGS_XPU_SESYNR1_ADDR A:0x1936054
y.create.l HWIO_TCSR_REGS_XPU_SESYNR2_ADDR A:0x1936058
y.create.l HWIO_TCSR_REGS_XPU_MCR_ADDR A:0x1936100
y.create.l HWIO_TCSR_REGS_XPU_MEAR0_ADDR A:0x1936140
y.create.l HWIO_TCSR_REGS_XPU_MESR_ADDR A:0x1936148
y.create.l HWIO_TCSR_REGS_XPU_MESRRESTORE_ADDR A:0x193614c
y.create.l HWIO_TCSR_REGS_XPU_MESYNR0_ADDR A:0x1936150
y.create.l HWIO_TCSR_REGS_XPU_MESYNR1_ADDR A:0x1936154
y.create.l HWIO_TCSR_REGS_XPU_MESYNR2_ADDR A:0x1936158
y.create.l HWIO_TCSR_REGS_XPU_CR_ADDR A:0x1936080
y.create.l HWIO_TCSR_REGS_XPU_RPU_ACR0_ADDR A:0x19360a0
y.create.l HWIO_TCSR_REGS_XPU_EAR0_ADDR A:0x19360c0
y.create.l HWIO_TCSR_REGS_XPU_ESR_ADDR A:0x19360c8
y.create.l HWIO_TCSR_REGS_XPU_ESRRESTORE_ADDR A:0x19360cc
y.create.l HWIO_TCSR_REGS_XPU_ESYNR0_ADDR A:0x19360d0
y.create.l HWIO_TCSR_REGS_XPU_ESYNR1_ADDR A:0x19360d4
y.create.l HWIO_TCSR_REGS_XPU_ESYNR2_ADDR A:0x19360d8
y.create.l HWIO_TCSR_REGS_XPU_IDR0_ADDR A:0x1936074
y.create.l HWIO_TCSR_REGS_XPU_IDR1_ADDR A:0x1936078
y.create.l HWIO_TCSR_REGS_XPU_REV_ADDR A:0x193607c
y.create.l HWIO_TCSR_REGS_XPU_RG0_RACR0_ADDR A:0x1936200
y.create.l HWIO_TCSR_REGS_XPU_RG1_RACR0_ADDR A:0x1936280
y.create.l HWIO_TCSR_REGS_XPU_RG2_RACR0_ADDR A:0x1936300
y.create.l HWIO_TCSR_REGS_XPU_RG3_RACR0_ADDR A:0x1936380
y.create.l HWIO_TCSR_REGS_XPU_RG4_RACR0_ADDR A:0x1936400
y.create.l HWIO_TCSR_REGS_XPU_RG5_RACR0_ADDR A:0x1936480
y.create.l HWIO_TCSR_REGS_XPU_RG6_RACR0_ADDR A:0x1936500
y.create.l HWIO_TCSR_REGS_XPU_RG7_RACR0_ADDR A:0x1936580
y.create.l HWIO_TCSR_REGS_XPU_RG8_RACR0_ADDR A:0x1936600
y.create.l HWIO_TCSR_REGS_XPU_RG9_RACR0_ADDR A:0x1936680
y.create.l HWIO_TCSR_REGS_XPU_RG0_WACR0_ADDR A:0x1936220
y.create.l HWIO_TCSR_REGS_XPU_RG1_WACR0_ADDR A:0x19362a0
y.create.l HWIO_TCSR_REGS_XPU_RG2_WACR0_ADDR A:0x1936320
y.create.l HWIO_TCSR_REGS_XPU_RG3_WACR0_ADDR A:0x19363a0
y.create.l HWIO_TCSR_REGS_XPU_RG4_WACR0_ADDR A:0x1936420
y.create.l HWIO_TCSR_REGS_XPU_RG5_WACR0_ADDR A:0x19364a0
y.create.l HWIO_TCSR_REGS_XPU_RG6_WACR0_ADDR A:0x1936520
y.create.l HWIO_TCSR_REGS_XPU_RG7_WACR0_ADDR A:0x19365a0
y.create.l HWIO_TCSR_REGS_XPU_RG8_WACR0_ADDR A:0x1936620
y.create.l HWIO_TCSR_REGS_XPU_RG9_WACR0_ADDR A:0x19366a0
y.create.l HWIO_TCSR_REGS_XPU_RG0_SCR_ADDR A:0x1936250
y.create.l HWIO_TCSR_REGS_XPU_RG1_SCR_ADDR A:0x19362d0
y.create.l HWIO_TCSR_REGS_XPU_RG2_SCR_ADDR A:0x1936350
y.create.l HWIO_TCSR_REGS_XPU_RG3_SCR_ADDR A:0x19363d0
y.create.l HWIO_TCSR_REGS_XPU_RG4_SCR_ADDR A:0x1936450
y.create.l HWIO_TCSR_REGS_XPU_RG5_SCR_ADDR A:0x19364d0
y.create.l HWIO_TCSR_REGS_XPU_RG6_SCR_ADDR A:0x1936550
y.create.l HWIO_TCSR_REGS_XPU_RG7_SCR_ADDR A:0x19365d0
y.create.l HWIO_TCSR_REGS_XPU_RG8_SCR_ADDR A:0x1936650
y.create.l HWIO_TCSR_REGS_XPU_RG9_SCR_ADDR A:0x19366d0
y.create.l HWIO_TCSR_REGS_XPU_RG0_MCR_ADDR A:0x1936254
y.create.l HWIO_TCSR_REGS_XPU_RG1_MCR_ADDR A:0x19362d4
y.create.l HWIO_TCSR_REGS_XPU_RG2_MCR_ADDR A:0x1936354
y.create.l HWIO_TCSR_REGS_XPU_RG3_MCR_ADDR A:0x19363d4
y.create.l HWIO_TCSR_REGS_XPU_RG4_MCR_ADDR A:0x1936454
y.create.l HWIO_TCSR_REGS_XPU_RG5_MCR_ADDR A:0x19364d4
y.create.l HWIO_TCSR_REGS_XPU_RG6_MCR_ADDR A:0x1936554
y.create.l HWIO_TCSR_REGS_XPU_RG7_MCR_ADDR A:0x19365d4
y.create.l HWIO_TCSR_REGS_XPU_RG8_MCR_ADDR A:0x1936654
y.create.l HWIO_TCSR_REGS_XPU_RG9_MCR_ADDR A:0x19366d4
y.create.l HWIO_TCSR_TCSR_REGS_REG_BASE_START_ADDR A:0x1937000
y.create.l HWIO_TCSR_TCSR_REGS_REG_BASE_LAST_ADDR A:0x1957000
y.create.l HWIO_TCSR_TCSR_REGS_REG_BASE_END_ADDR A:0x1958000
y.create.l HWIO_TCSR_BIMC_CFG_QRIB_XPU2_INIT_ADDR A:0x1937100
y.create.l HWIO_TCSR_BIMC_QXS0_QRIB_XPU2_INIT_ADDR A:0x1937104
y.create.l HWIO_TCSR_MMSS_VENUS0_VBIF_QRIB_XPU2_INIT_ADDR A:0x1937380
y.create.l HWIO_TCSR_MMSS_VENUS0_WRAPPER_QRIB_XPU2_INIT_ADDR A:0x1937384
y.create.l HWIO_TCSR_BIMC_CFG_QRIB_XPU2_ACR_ADDR A:0x1938000
y.create.l HWIO_TCSR_BIMC_CFG_QRIB_XPU2_VMIDEN_INIT_ADDR A:0x1938004
y.create.l HWIO_TCSR_BIMC_QXS0_QRIB_XPU2_ACR_ADDR A:0x1938008
y.create.l HWIO_TCSR_BIMC_QXS0_QRIB_XPU2_VMIDEN_INIT_ADDR A:0x193800c
y.create.l HWIO_TCSR_MMSS_VENUS0_VBIF_QRIB_XPU2_ACR_ADDR A:0x1938380
y.create.l HWIO_TCSR_MMSS_VENUS0_VBIF_QRIB_XPU2_VMIDEN_INIT_ADDR A:0x1938384
y.create.l HWIO_TCSR_MMSS_VENUS0_WRAPPER_QRIB_XPU2_ACR_ADDR A:0x1938390
y.create.l HWIO_TCSR_MMSS_VENUS0_WRAPPER_QRIB_XPU2_VMIDEN_INIT_ADDR A:0x1938394
y.create.l HWIO_TCSR_SS_XPU2_NON_SEC_INTR0_ADDR A:0x1939000
y.create.l HWIO_TCSR_SS_XPU2_NON_SEC_INTR0_ENABLE_ADDR A:0x1939040
y.create.l HWIO_TCSR_SS_VMIDMT_CLIENT_NON_SEC_INTR_ADDR A:0x1939010
y.create.l HWIO_TCSR_SS_VMIDMT_CLIENT_NON_SEC_INTR_ENABLE_ADDR A:0x1939050
y.create.l HWIO_TCSR_SS_VMIDMT_CFG_NON_SEC_INTR_ADDR A:0x1939090
y.create.l HWIO_TCSR_SS_VMIDMT_CFG_NON_SEC_INTR_ENABLE_ADDR A:0x19390d0
y.create.l HWIO_TCSR_MUTEX_REG_RESET_ADDR A:0x1939800
y.create.l HWIO_TCSR_SS_XPU2_SEC_INTR0_ADDR A:0x1939400
y.create.l HWIO_TCSR_SS_XPU2_SEC_INTR0_ENABLE_ADDR A:0x1939440
y.create.l HWIO_TCSR_SS_VMIDMT_CLIENT_SEC_INTR_ADDR A:0x1939410
y.create.l HWIO_TCSR_SS_VMIDMT_CLIENT_SEC_INTR_ENABLE_ADDR A:0x1939450
y.create.l HWIO_TCSR_SS_VMIDMT_CFG_SEC_INTR_ADDR A:0x1939490
y.create.l HWIO_TCSR_SS_VMIDMT_CFG_SEC_INTR_ENABLE_ADDR A:0x19394d0
y.create.l HWIO_TCSR_SS_XPU2_MSA_INTR0_ADDR A:0x193a000
y.create.l HWIO_TCSR_SS_XPU2_MSA_INTR0_ENABLE_ADDR A:0x193a010
y.create.l HWIO_TCSR_MSA_BIT_REG_ADDR A:0x193a100
y.create.l HWIO_TCSR_TCSR_CLK_EN_ADDR A:0x193b07c
y.create.l HWIO_TCSR_TIMEOUT_SLAVE_GLB_EN_ADDR A:0x193c000
y.create.l HWIO_TCSR_XPU_NSEN_STATUS_ADDR A:0x193c004
y.create.l HWIO_TCSR_XPU_VMIDEN_STATUS_ADDR A:0x193c008
y.create.l HWIO_TCSR_XPU_MSAEN_STATUS_ADDR A:0x193c00c
y.create.l HWIO_TCSR_MDP3_TIMEOUT_VAL_0_ADDR_ADDR A:0x193c014
y.create.l HWIO_TCSR_MDP3_TIMEOUT_VAL_1_ADDR_ADDR A:0x193c018
y.create.l HWIO_TCSR_MDP3_TIMEOUT_EN_ADDR A:0x193c01c
y.create.l HWIO_TCSR_TZ_WONCE_0_ADDR A:0x193d000
y.create.l HWIO_TCSR_TZ_WONCE_1_ADDR A:0x193d004
y.create.l HWIO_TCSR_TZ_WONCE_2_ADDR A:0x193d008
y.create.l HWIO_TCSR_TZ_WONCE_3_ADDR A:0x193d00c
y.create.l HWIO_TCSR_TZ_WONCE_4_ADDR A:0x193d010
y.create.l HWIO_TCSR_TZ_WONCE_5_ADDR A:0x193d014
y.create.l HWIO_TCSR_TZ_WONCE_6_ADDR A:0x193d018
y.create.l HWIO_TCSR_TZ_WONCE_7_ADDR A:0x193d01c
y.create.l HWIO_TCSR_TZ_WONCE_8_ADDR A:0x193d020
y.create.l HWIO_TCSR_TZ_WONCE_9_ADDR A:0x193d024
y.create.l HWIO_TCSR_GCC_CLK_MUX_SEL_ADDR A:0x193d0f0
y.create.l HWIO_TCSR_BOOT_MISC_DETECT_ADDR A:0x193d100
y.create.l HWIO_TCSR_APSS_VMID_ADDR A:0x193d110
y.create.l HWIO_TCSR_MMSS_RPM_IRQ_EN_ADDR A:0x193e000
y.create.l HWIO_TCSR_MMSS_RPM_IRQ_CLEAR_ADDR A:0x193e004
y.create.l HWIO_TCSR_MMSS_RPM_IRQ_STATUS_ADDR A:0x193e008
y.create.l HWIO_TCSR_MMSS_OXILI_GC_SYS_AHB_STATUS_ADDR A:0x193e010
y.create.l HWIO_TCSR_MMSS_OXILI_CMD_REG_ADDR A:0x193e014
y.create.l HWIO_TCSR_MMSS_DSI_ULP_CLAMP_CTRL_ADDR A:0x193e020
y.create.l HWIO_TCSR_MMSS_DSI_PHYRESET_CTRL_ADDR A:0x193e024
y.create.l HWIO_TCSR_MMSS_IMEM_FSCGC_TIMERS_ADDR A:0x193e030
y.create.l HWIO_TCSR_MMSS_IMEM_EX_FSCGC_CONTROL_ADDR A:0x193e034
y.create.l HWIO_TCSR_MMSS_IMEM_RAM_CONFIG_ADDR A:0x193e038
y.create.l HWIO_TCSR_TBU_BYPASS_ENABLE_ADDR A:0x193f000
y.create.l HWIO_TCSR_SPARE_REG8_ADDR A:0x193f004
y.create.l HWIO_TCSR_RESET_DEBUG_SW_ENTRY_ADDR A:0x1940000
y.create.l HWIO_TCSR_QPDI_DISABLE_CFG_ADDR A:0x1941000
y.create.l HWIO_TCSR_COMPILER_VDDCX_ACC_0_ADDR A:0x1942080
y.create.l HWIO_TCSR_COMPILER_VDDCX_ACC_1_ADDR A:0x1942084
y.create.l HWIO_TCSR_CUSTOM_VDDCX_ACC_0_ADDR A:0x1942090
y.create.l HWIO_TCSR_CUSTOM_VDDCX_ACC_1_ADDR A:0x1942094
y.create.l HWIO_TCSR_MEM_ACC_SEL_VDDCX_ADDR A:0x1942100
y.create.l HWIO_TCSR_TCSR_S1LM_MODEM_TO_APPS_INT_ADDR A:0x1946000
y.create.l HWIO_TCSR_TCSR_S1LM_MODEM_TO_APPS_INT_DATA_ADDR A:0x1946004
y.create.l HWIO_TCSR_SPARE_APU_REG2_ADDR A:0x1946008
y.create.l HWIO_TCSR_SPARE_APU_REG3_ADDR A:0x194600c
y.create.l HWIO_TCSR_SPARE_REG4_ADDR A:0x1945000
y.create.l HWIO_TCSR_SPARE_REG5_ADDR A:0x1945004
y.create.l HWIO_TCSR_SPARE_REG6_ADDR A:0x1945008
y.create.l HWIO_TCSR_SPARE_REG7_ADDR A:0x194500c
y.create.l HWIO_TCSR_SYS_POWER_CTRL_ADDR A:0x1947000
y.create.l HWIO_TCSR_USB_CORE_ID_ADDR A:0x1947004
y.create.l HWIO_TCSR_TEST_SPARE_CFG_REG_ADDR_ADDR A:0x1947508
y.create.l HWIO_TCSR_COMPILER_VDDMSS_ACC_0_ADDR A:0x1942104
y.create.l HWIO_TCSR_COMPILER_VDDMSS_ACC_1_ADDR A:0x1942108
y.create.l HWIO_TCSR_COMPILER_VDDAPC_ACC_0_ADDR A:0x194210c
y.create.l HWIO_TCSR_COMPILER_VDDAPC_ACC_1_ADDR A:0x1942110
y.create.l HWIO_TCSR_CUSTOM_VDDAPC_ACC_0_ADDR A:0x1942120
y.create.l HWIO_TCSR_CUSTOM_VDDAPC_ACC_1_ADDR A:0x1942124
y.create.l HWIO_TCSR_CUSTOM_VDDAPC_ACC_2_ADDR A:0x1942128
y.create.l HWIO_TCSR_MEM_ACC_SEL_VDDMSS_ADDR A:0x194212c
y.create.l HWIO_TCSR_MEM_ACC_SEL_VDDAPC_ADDR A:0x1942130
y.create.l HWIO_TCSR_CUSTOM_VDDCX_ACC_2_ADDR A:0x1942134
y.create.l HWIO_TCSR_LDO_SLEEP_CTRL_ADDR A:0x1948000
y.create.l HWIO_TCSR_LDO_UPDATE_STATE_CTRL_ADDR A:0x1948004
y.create.l HWIO_TCSR_LDO_OBIAS_CTRL_ADDR A:0x1948008
y.create.l HWIO_TCSR_LDO_VREF_CONFIG_ADDR A:0x194800c
y.create.l HWIO_TCSR_LDO_IB_CONFIG_ADDR A:0x1948010
y.create.l HWIO_TCSR_LDO_BGC_CONFIG_ADDR A:0x1948014
y.create.l HWIO_TCSR_LDO_VREF_CTRL_ADDR A:0x1948018
y.create.l HWIO_TCSR_LDO_LD_EN_ADDR A:0x194801c
y.create.l HWIO_TCSR_LDO_LD_CTRL_ADDR A:0x1948020
y.create.l HWIO_TCSR_LDO_OSC_RESETB_ADDR A:0x1948024
y.create.l HWIO_TCSR_LDO_OSC_CTRL_ADDR A:0x1948028
y.create.l HWIO_TCSR_LDO_DFT_EN_CTRL_ADDR A:0x194802c
y.create.l HWIO_TCSR_LDO_DFT_CTRL_ADDR A:0x1948030
y.create.l HWIO_TCSR_SPDM_CNT_CLK_CTRL_ADDR A:0x194a000
y.create.l HWIO_TCSR_SPDM_DLY_FIFO_EN_ADDR A:0x194a004
y.create.l HWIO_TCSR_SPDM_STG1_MUX_SEL_ADDR A:0x194a008
y.create.l HWIO_TCSR_SPDM_STG2_A_MUX_SEL_ADDR A:0x194a00c
y.create.l HWIO_TCSR_SPDM_STG2_B_MUX_SEL_ADDR A:0x194a010
y.create.l HWIO_TCSR_SPDM_STG3_A_MUX_SEL_ADDR A:0x194a014
y.create.l HWIO_TCSR_SPDM_STG3_B_MUX_SEL_ADDR A:0x194a018
y.create.l HWIO_TCSR_SPDM_WRP_CTI_CTL0_ADDR A:0x194a01c
y.create.l HWIO_TCSR_SPDM_WRP_CTI_CTL1_ADDR A:0x194a020
y.create.l HWIO_TCSR_SPDM_WRP_RT_CTI_CTL_ADDR A:0x194a024
y.create.l HWIO_TCSR_PHSS_USB2_PHY_SEL_ADDR A:0x194b000
y.create.l HWIO_TCSR_PHSS_ATEST_USB2_PHY_SEL_ADDR A:0x194b004
y.create.l HWIO_TCSR_PHSS_TEST_BUS_SEL_ADDR A:0x194b008
y.create.l HWIO_TCSR_PHSS_UART_PRONTO_INT_SEL_0_ADDR A:0x194b080
y.create.l HWIO_TCSR_PHSS_UART_PRONTO_INT_SEL_1_ADDR A:0x194b090
y.create.l HWIO_TCSR_PHSS_UART_MSS_INT_SEL_0_ADDR A:0x194b0c0
y.create.l HWIO_TCSR_PHSS_UART_MSS_INT_SEL_1_ADDR A:0x194b0d0
y.create.l HWIO_TCSR_PHSS_QUP_PRONTO_INT_SEL_0_ADDR A:0x194b100
y.create.l HWIO_TCSR_PHSS_QUP_PRONTO_INT_SEL_1_ADDR A:0x194b110
y.create.l HWIO_TCSR_PHSS_QUP_MSS_INT_SEL_0_ADDR A:0x194b140
y.create.l HWIO_TCSR_PHSS_QUP_MSS_INT_SEL_1_ADDR A:0x194b150
y.create.l HWIO_TCSR_MEM_ARRY_STBY_ADDR A:0x194c180
y.create.l HWIO_TCSR_SOC_HW_VERSION_ADDR A:0x194d000
y.create.l HWIO_TCSR_TIMEOUT_INTR_STATUS_ADDR A:0x194d020
y.create.l HWIO_TCSR_TIMEOUT_INTR_RPM_ENABLE_ADDR A:0x194d030
y.create.l HWIO_TCSR_TIMEOUT_INTR_APSS_ENABLE_ADDR A:0x194d040
y.create.l HWIO_TCSR_TIMEOUT_INTR_MSS_ENABLE_ADDR A:0x194d060
y.create.l HWIO_TCSR_PRONTO_BUS_TIMEOUT_RESET_ADDR A:0x194d070
y.create.l HWIO_TCSR_CRYPTO0_HALTREQ_ADDR A:0x194e000
y.create.l HWIO_TCSR_CRYPTO0_HALTACK_ADDR A:0x194e004
y.create.l HWIO_TCSR_CRYPTO0_MASTER_IDLE_ADDR A:0x194e008
y.create.l HWIO_TCSR_MSSQ6_HALTREQ_ADDR A:0x194f000
y.create.l HWIO_TCSR_MSSQ6_HALTACK_ADDR A:0x194f004
y.create.l HWIO_TCSR_MSSQ6_MASTER_IDLE_ADDR A:0x194f008
y.create.l HWIO_TCSR_MSSQ6_POWER_STATE_ADDR A:0x194f010
y.create.l HWIO_TCSR_MSS_MODEM_HALTREQ_ADDR A:0x1950000
y.create.l HWIO_TCSR_MSS_MODEM_HALTACK_ADDR A:0x1950004
y.create.l HWIO_TCSR_MSS_MODEM_MASTER_IDLE_ADDR A:0x1950008
y.create.l HWIO_TCSR_MSS_NC_HALTREQ_ADDR A:0x1951000
y.create.l HWIO_TCSR_MSS_NC_HALTACK_ADDR A:0x1951004
y.create.l HWIO_TCSR_MSS_NC_MASTER_IDLE_ADDR A:0x1951008
y.create.l HWIO_TCSR_WCSS_HALTREQ_ADDR A:0x1952000
y.create.l HWIO_TCSR_WCSS_HALTACK_ADDR A:0x1952004
y.create.l HWIO_TCSR_WCSS_MASTER_IDLE_ADDR A:0x1952008
y.create.l HWIO_TCSR_SDC1_HALTREQ_ADDR A:0x1953000
y.create.l HWIO_TCSR_SDC1_HALTACK_ADDR A:0x1953004
y.create.l HWIO_TCSR_SDC1_MASTER_IDLE_ADDR A:0x1953008
y.create.l HWIO_TCSR_SDC2_HALTREQ_ADDR A:0x1954000
y.create.l HWIO_TCSR_SDC2_HALTACK_ADDR A:0x1954004
y.create.l HWIO_TCSR_SDC2_MASTER_IDLE_ADDR A:0x1954008
y.create.l HWIO_TCSR_ULT_AUDIO_CORE_ABORT_REQ_ADDR A:0x1955000
y.create.l HWIO_TCSR_ULT_AUDIO_CORE_ABORT_ACK_ADDR A:0x1955004
y.create.l HWIO_TCSR_TCSR_S1LM_APPS_TO_MODEM_INT_ADDR A:0x1956000
y.create.l HWIO_TCSR_TCSR_S1LM_APPS_TO_MODEM_INT_DATA_ADDR A:0x1956004
y.create.l HWIO_TCSR_SPARE_REG2_ADDR A:0x1956008
y.create.l HWIO_TCSR_SPARE_REG3_ADDR A:0x195600c
y.create.l HWIO_TCSR_PNOC_SNOC_MEMTYPE_ADDR A:0x1957000
y.create.l HWIO_TCSR_BOOT_IMEM_ENABLE_ADDR A:0x19450f4
y.create.l HWIO_TCSR_BOOT_IMEM_START_ADDRESS_ADDR A:0x19450f8
y.create.l HWIO_TCSR_BOOT_IMEM_SIZE_ADDR A:0x19450fc
y.create.l HWIO_TCSR_QTIC_CTL_ST_ADDR A:0x1941008
y.create.l HWIO_CRYPTO0_CRYPTO_REG_BASE_START_ADDR A:0x73a000
y.create.l HWIO_CRYPTO0_CRYPTO_REG_BASE_LAST_ADDR A:0x73f014
y.create.l HWIO_CRYPTO0_CRYPTO_REG_BASE_END_ADDR A:0x740000
y.create.l HWIO_CRYPTO0_CRYPTO_VERSION_ADDR A:0x73a000
y.create.l HWIO_CRYPTO0_CRYPTO_LIB_VERSION_ADDR A:0x73a004
y.create.l HWIO_CRYPTO0_CRYPTO_DATA_IN0_ADDR A:0x73a010
y.create.l HWIO_CRYPTO0_CRYPTO_DATA_IN1_ADDR A:0x73a014
y.create.l HWIO_CRYPTO0_CRYPTO_DATA_IN2_ADDR A:0x73a018
y.create.l HWIO_CRYPTO0_CRYPTO_DATA_IN3_ADDR A:0x73a01c
y.create.l HWIO_CRYPTO0_CRYPTO_DATA_OUT0_ADDR A:0x73a020
y.create.l HWIO_CRYPTO0_CRYPTO_DATA_OUT1_ADDR A:0x73a024
y.create.l HWIO_CRYPTO0_CRYPTO_DATA_OUT2_ADDR A:0x73a028
y.create.l HWIO_CRYPTO0_CRYPTO_DATA_OUT3_ADDR A:0x73a02c
y.create.l HWIO_CRYPTO0_CRYPTO_STATUS_ADDR A:0x73a100
y.create.l HWIO_CRYPTO0_CRYPTO_STATUS2_ADDR A:0x73a104
y.create.l HWIO_CRYPTO0_CRYPTO_STATUS3_ADDR A:0x73a11c
y.create.l HWIO_CRYPTO0_CRYPTO_STATUS4_ADDR A:0x73a124
y.create.l HWIO_CRYPTO0_CRYPTO_PIPE_GLOBAL_TIMER_EN_MIRROR_ADDR A:0x73a130
y.create.l HWIO_CRYPTO0_CRYPTO_PIPE_GLOBAL_TIMER_LO_MIRROR_ADDR A:0x73a134
y.create.l HWIO_CRYPTO0_CRYPTO_PIPE_GLOBAL_TIMER_HI_MIRROR_ADDR A:0x73a138
y.create.l HWIO_CRYPTO0_CRYPTO_BIST_STATUS_ADDR A:0x73a114
y.create.l HWIO_CRYPTO0_CRYPTO_BIST_FINISH_ADDR A:0x73a118
y.create.l HWIO_CRYPTO0_CRYPTO_ENGINES_AVAIL_ADDR A:0x73a108
y.create.l HWIO_CRYPTO0_CRYPTO_FIFO_SIZES_ADDR A:0x73a10c
y.create.l HWIO_CRYPTO0_CRYPTO_SEG_SIZE_ADDR A:0x73a110
y.create.l HWIO_CRYPTO0_CRYPTO_GOPROC_ADDR A:0x73a120
y.create.l HWIO_CRYPTO0_CRYPTO_GOPROC_QC_KEY_ADDR A:0x73b000
y.create.l HWIO_CRYPTO0_CRYPTO_GOPROC_OEM_KEY_ADDR A:0x73c000
y.create.l HWIO_CRYPTO0_CRYPTO_ENCR_SEG_CFG_ADDR A:0x73a200
y.create.l HWIO_CRYPTO0_CRYPTO_ENCR_SEG_SIZE_ADDR A:0x73a204
y.create.l HWIO_CRYPTO0_CRYPTO_ENCR_SEG_START_ADDR A:0x73a208
y.create.l HWIO_CRYPTO0_CRYPTO_ENCR_KEY0_ADDR A:0x73d000
y.create.l HWIO_CRYPTO0_CRYPTO_ENCR_KEY1_ADDR A:0x73d004
y.create.l HWIO_CRYPTO0_CRYPTO_ENCR_KEY2_ADDR A:0x73d008
y.create.l HWIO_CRYPTO0_CRYPTO_ENCR_KEY3_ADDR A:0x73d00c
y.create.l HWIO_CRYPTO0_CRYPTO_ENCR_KEY4_ADDR A:0x73d010
y.create.l HWIO_CRYPTO0_CRYPTO_ENCR_KEY5_ADDR A:0x73d014
y.create.l HWIO_CRYPTO0_CRYPTO_ENCR_KEY6_ADDR A:0x73d018
y.create.l HWIO_CRYPTO0_CRYPTO_ENCR_KEY7_ADDR A:0x73d01c
y.create.l HWIO_CRYPTO0_CRYPTO_ENCR_PIPE0_KEY0_ADDR A:0x73e000
y.create.l HWIO_CRYPTO0_CRYPTO_ENCR_PIPE0_KEY1_ADDR A:0x73e004
y.create.l HWIO_CRYPTO0_CRYPTO_ENCR_PIPE0_KEY2_ADDR A:0x73e008
y.create.l HWIO_CRYPTO0_CRYPTO_ENCR_PIPE0_KEY3_ADDR A:0x73e00c
y.create.l HWIO_CRYPTO0_CRYPTO_ENCR_PIPE1_KEY0_ADDR A:0x73e020
y.create.l HWIO_CRYPTO0_CRYPTO_ENCR_PIPE1_KEY1_ADDR A:0x73e024
y.create.l HWIO_CRYPTO0_CRYPTO_ENCR_PIPE1_KEY2_ADDR A:0x73e028
y.create.l HWIO_CRYPTO0_CRYPTO_ENCR_PIPE1_KEY3_ADDR A:0x73e02c
y.create.l HWIO_CRYPTO0_CRYPTO_ENCR_PIPE2_KEY0_ADDR A:0x73e040
y.create.l HWIO_CRYPTO0_CRYPTO_ENCR_PIPE2_KEY1_ADDR A:0x73e044
y.create.l HWIO_CRYPTO0_CRYPTO_ENCR_PIPE2_KEY2_ADDR A:0x73e048
y.create.l HWIO_CRYPTO0_CRYPTO_ENCR_PIPE2_KEY3_ADDR A:0x73e04c
y.create.l HWIO_CRYPTO0_CRYPTO_ENCR_PIPE3_KEY0_ADDR A:0x73e060
y.create.l HWIO_CRYPTO0_CRYPTO_ENCR_PIPE3_KEY1_ADDR A:0x73e064
y.create.l HWIO_CRYPTO0_CRYPTO_ENCR_PIPE3_KEY2_ADDR A:0x73e068
y.create.l HWIO_CRYPTO0_CRYPTO_ENCR_PIPE3_KEY3_ADDR A:0x73e06c
y.create.l HWIO_CRYPTO0_CRYPTO_ENCR_PIPE4_KEY0_ADDR A:0x73e080
y.create.l HWIO_CRYPTO0_CRYPTO_ENCR_PIPE4_KEY1_ADDR A:0x73e084
y.create.l HWIO_CRYPTO0_CRYPTO_ENCR_PIPE4_KEY2_ADDR A:0x73e088
y.create.l HWIO_CRYPTO0_CRYPTO_ENCR_PIPE4_KEY3_ADDR A:0x73e08c
y.create.l HWIO_CRYPTO0_CRYPTO_ENCR_PIPE5_KEY0_ADDR A:0x73e0a0
y.create.l HWIO_CRYPTO0_CRYPTO_ENCR_PIPE5_KEY1_ADDR A:0x73e0a4
y.create.l HWIO_CRYPTO0_CRYPTO_ENCR_PIPE5_KEY2_ADDR A:0x73e0a8
y.create.l HWIO_CRYPTO0_CRYPTO_ENCR_PIPE5_KEY3_ADDR A:0x73e0ac
y.create.l HWIO_CRYPTO0_CRYPTO_ENCR_PIPE6_KEY0_ADDR A:0x73e0c0
y.create.l HWIO_CRYPTO0_CRYPTO_ENCR_PIPE6_KEY1_ADDR A:0x73e0c4
y.create.l HWIO_CRYPTO0_CRYPTO_ENCR_PIPE6_KEY2_ADDR A:0x73e0c8
y.create.l HWIO_CRYPTO0_CRYPTO_ENCR_PIPE6_KEY3_ADDR A:0x73e0cc
y.create.l HWIO_CRYPTO0_CRYPTO_ENCR_PIPE7_KEY0_ADDR A:0x73e0e0
y.create.l HWIO_CRYPTO0_CRYPTO_ENCR_PIPE7_KEY1_ADDR A:0x73e0e4
y.create.l HWIO_CRYPTO0_CRYPTO_ENCR_PIPE7_KEY2_ADDR A:0x73e0e8
y.create.l HWIO_CRYPTO0_CRYPTO_ENCR_PIPE7_KEY3_ADDR A:0x73e0ec
y.create.l HWIO_CRYPTO0_CRYPTO_ENCR_PIPE0_KEY_USAGE_RULES_ADDR A:0x73e100
y.create.l HWIO_CRYPTO0_CRYPTO_ENCR_PIPE1_KEY_USAGE_RULES_ADDR A:0x73e120
y.create.l HWIO_CRYPTO0_CRYPTO_ENCR_PIPE2_KEY_USAGE_RULES_ADDR A:0x73e140
y.create.l HWIO_CRYPTO0_CRYPTO_ENCR_PIPE3_KEY_USAGE_RULES_ADDR A:0x73e160
y.create.l HWIO_CRYPTO0_CRYPTO_ENCR_PIPE4_KEY_USAGE_RULES_ADDR A:0x73e180
y.create.l HWIO_CRYPTO0_CRYPTO_ENCR_PIPE5_KEY_USAGE_RULES_ADDR A:0x73e1a0
y.create.l HWIO_CRYPTO0_CRYPTO_ENCR_PIPE6_KEY_USAGE_RULES_ADDR A:0x73e1c0
y.create.l HWIO_CRYPTO0_CRYPTO_ENCR_PIPE7_KEY_USAGE_RULES_ADDR A:0x73e1e0
y.create.l HWIO_CRYPTO0_CRYPTO_PIPE0_KEY_TIMER_EN_ADDR A:0x73e104
y.create.l HWIO_CRYPTO0_CRYPTO_PIPE1_KEY_TIMER_EN_ADDR A:0x73e124
y.create.l HWIO_CRYPTO0_CRYPTO_PIPE2_KEY_TIMER_EN_ADDR A:0x73e144
y.create.l HWIO_CRYPTO0_CRYPTO_PIPE3_KEY_TIMER_EN_ADDR A:0x73e164
y.create.l HWIO_CRYPTO0_CRYPTO_PIPE4_KEY_TIMER_EN_ADDR A:0x73e184
y.create.l HWIO_CRYPTO0_CRYPTO_PIPE5_KEY_TIMER_EN_ADDR A:0x73e1a4
y.create.l HWIO_CRYPTO0_CRYPTO_PIPE6_KEY_TIMER_EN_ADDR A:0x73e1c4
y.create.l HWIO_CRYPTO0_CRYPTO_PIPE7_KEY_TIMER_EN_ADDR A:0x73e1e4
y.create.l HWIO_CRYPTO0_CRYPTO_PIPE0_KEY_TIMER_LIMIT_LO_ADDR A:0x73e108
y.create.l HWIO_CRYPTO0_CRYPTO_PIPE1_KEY_TIMER_LIMIT_LO_ADDR A:0x73e128
y.create.l HWIO_CRYPTO0_CRYPTO_PIPE2_KEY_TIMER_LIMIT_LO_ADDR A:0x73e148
y.create.l HWIO_CRYPTO0_CRYPTO_PIPE3_KEY_TIMER_LIMIT_LO_ADDR A:0x73e168
y.create.l HWIO_CRYPTO0_CRYPTO_PIPE4_KEY_TIMER_LIMIT_LO_ADDR A:0x73e188
y.create.l HWIO_CRYPTO0_CRYPTO_PIPE5_KEY_TIMER_LIMIT_LO_ADDR A:0x73e1a8
y.create.l HWIO_CRYPTO0_CRYPTO_PIPE6_KEY_TIMER_LIMIT_LO_ADDR A:0x73e1c8
y.create.l HWIO_CRYPTO0_CRYPTO_PIPE7_KEY_TIMER_LIMIT_LO_ADDR A:0x73e1e8
y.create.l HWIO_CRYPTO0_CRYPTO_PIPE0_KEY_TIMER_LIMIT_HI_ADDR A:0x73e10c
y.create.l HWIO_CRYPTO0_CRYPTO_PIPE1_KEY_TIMER_LIMIT_HI_ADDR A:0x73e12c
y.create.l HWIO_CRYPTO0_CRYPTO_PIPE2_KEY_TIMER_LIMIT_HI_ADDR A:0x73e14c
y.create.l HWIO_CRYPTO0_CRYPTO_PIPE3_KEY_TIMER_LIMIT_HI_ADDR A:0x73e16c
y.create.l HWIO_CRYPTO0_CRYPTO_PIPE4_KEY_TIMER_LIMIT_HI_ADDR A:0x73e18c
y.create.l HWIO_CRYPTO0_CRYPTO_PIPE5_KEY_TIMER_LIMIT_HI_ADDR A:0x73e1ac
y.create.l HWIO_CRYPTO0_CRYPTO_PIPE6_KEY_TIMER_LIMIT_HI_ADDR A:0x73e1cc
y.create.l HWIO_CRYPTO0_CRYPTO_PIPE7_KEY_TIMER_LIMIT_HI_ADDR A:0x73e1ec
y.create.l HWIO_CRYPTO0_CRYPTO_PIPE0_KEY_PAUSE_CFG_ADDR A:0x73e110
y.create.l HWIO_CRYPTO0_CRYPTO_PIPE1_KEY_PAUSE_CFG_ADDR A:0x73e130
y.create.l HWIO_CRYPTO0_CRYPTO_PIPE2_KEY_PAUSE_CFG_ADDR A:0x73e150
y.create.l HWIO_CRYPTO0_CRYPTO_PIPE3_KEY_PAUSE_CFG_ADDR A:0x73e170
y.create.l HWIO_CRYPTO0_CRYPTO_PIPE4_KEY_PAUSE_CFG_ADDR A:0x73e190
y.create.l HWIO_CRYPTO0_CRYPTO_PIPE5_KEY_PAUSE_CFG_ADDR A:0x73e1b0
y.create.l HWIO_CRYPTO0_CRYPTO_PIPE6_KEY_PAUSE_CFG_ADDR A:0x73e1d0
y.create.l HWIO_CRYPTO0_CRYPTO_PIPE7_KEY_PAUSE_CFG_ADDR A:0x73e1f0
y.create.l HWIO_CRYPTO0_CRYPTO_PIPE0_KEY_PAUSE_DET_ADDR A:0x73e114
y.create.l HWIO_CRYPTO0_CRYPTO_PIPE1_KEY_PAUSE_DET_ADDR A:0x73e134
y.create.l HWIO_CRYPTO0_CRYPTO_PIPE2_KEY_PAUSE_DET_ADDR A:0x73e154
y.create.l HWIO_CRYPTO0_CRYPTO_PIPE3_KEY_PAUSE_DET_ADDR A:0x73e174
y.create.l HWIO_CRYPTO0_CRYPTO_PIPE4_KEY_PAUSE_DET_ADDR A:0x73e194
y.create.l HWIO_CRYPTO0_CRYPTO_PIPE5_KEY_PAUSE_DET_ADDR A:0x73e1b4
y.create.l HWIO_CRYPTO0_CRYPTO_PIPE6_KEY_PAUSE_DET_ADDR A:0x73e1d4
y.create.l HWIO_CRYPTO0_CRYPTO_PIPE7_KEY_PAUSE_DET_ADDR A:0x73e1f4
y.create.l HWIO_CRYPTO0_CRYPTO_ENCR_PIPE0_KEY_USAGE_RULES_MIRROR_ADDR A:0x73a600
y.create.l HWIO_CRYPTO0_CRYPTO_ENCR_PIPE1_KEY_USAGE_RULES_MIRROR_ADDR A:0x73a620
y.create.l HWIO_CRYPTO0_CRYPTO_ENCR_PIPE2_KEY_USAGE_RULES_MIRROR_ADDR A:0x73a640
y.create.l HWIO_CRYPTO0_CRYPTO_ENCR_PIPE3_KEY_USAGE_RULES_MIRROR_ADDR A:0x73a660
y.create.l HWIO_CRYPTO0_CRYPTO_ENCR_PIPE4_KEY_USAGE_RULES_MIRROR_ADDR A:0x73a680
y.create.l HWIO_CRYPTO0_CRYPTO_ENCR_PIPE5_KEY_USAGE_RULES_MIRROR_ADDR A:0x73a6a0
y.create.l HWIO_CRYPTO0_CRYPTO_ENCR_PIPE6_KEY_USAGE_RULES_MIRROR_ADDR A:0x73a6c0
y.create.l HWIO_CRYPTO0_CRYPTO_ENCR_PIPE7_KEY_USAGE_RULES_MIRROR_ADDR A:0x73a6e0
y.create.l HWIO_CRYPTO0_CRYPTO_PIPE0_KEY_TIMER_EN_MIRROR_ADDR A:0x73a604
y.create.l HWIO_CRYPTO0_CRYPTO_PIPE1_KEY_TIMER_EN_MIRROR_ADDR A:0x73a624
y.create.l HWIO_CRYPTO0_CRYPTO_PIPE2_KEY_TIMER_EN_MIRROR_ADDR A:0x73a644
y.create.l HWIO_CRYPTO0_CRYPTO_PIPE3_KEY_TIMER_EN_MIRROR_ADDR A:0x73a664
y.create.l HWIO_CRYPTO0_CRYPTO_PIPE4_KEY_TIMER_EN_MIRROR_ADDR A:0x73a684
y.create.l HWIO_CRYPTO0_CRYPTO_PIPE5_KEY_TIMER_EN_MIRROR_ADDR A:0x73a6a4
y.create.l HWIO_CRYPTO0_CRYPTO_PIPE6_KEY_TIMER_EN_MIRROR_ADDR A:0x73a6c4
y.create.l HWIO_CRYPTO0_CRYPTO_PIPE7_KEY_TIMER_EN_MIRROR_ADDR A:0x73a6e4
y.create.l HWIO_CRYPTO0_CRYPTO_PIPE0_KEY_TIMER_LIMIT_LO_MIRROR_ADDR A:0x73a608
y.create.l HWIO_CRYPTO0_CRYPTO_PIPE1_KEY_TIMER_LIMIT_LO_MIRROR_ADDR A:0x73a628
y.create.l HWIO_CRYPTO0_CRYPTO_PIPE2_KEY_TIMER_LIMIT_LO_MIRROR_ADDR A:0x73a648
y.create.l HWIO_CRYPTO0_CRYPTO_PIPE3_KEY_TIMER_LIMIT_LO_MIRROR_ADDR A:0x73a668
y.create.l HWIO_CRYPTO0_CRYPTO_PIPE4_KEY_TIMER_LIMIT_LO_MIRROR_ADDR A:0x73a688
y.create.l HWIO_CRYPTO0_CRYPTO_PIPE5_KEY_TIMER_LIMIT_LO_MIRROR_ADDR A:0x73a6a8
y.create.l HWIO_CRYPTO0_CRYPTO_PIPE6_KEY_TIMER_LIMIT_LO_MIRROR_ADDR A:0x73a6c8
y.create.l HWIO_CRYPTO0_CRYPTO_PIPE7_KEY_TIMER_LIMIT_LO_MIRROR_ADDR A:0x73a6e8
y.create.l HWIO_CRYPTO0_CRYPTO_PIPE0_KEY_TIMER_LIMIT_HI_MIRROR_ADDR A:0x73a60c
y.create.l HWIO_CRYPTO0_CRYPTO_PIPE1_KEY_TIMER_LIMIT_HI_MIRROR_ADDR A:0x73a62c
y.create.l HWIO_CRYPTO0_CRYPTO_PIPE2_KEY_TIMER_LIMIT_HI_MIRROR_ADDR A:0x73a64c
y.create.l HWIO_CRYPTO0_CRYPTO_PIPE3_KEY_TIMER_LIMIT_HI_MIRROR_ADDR A:0x73a66c
y.create.l HWIO_CRYPTO0_CRYPTO_PIPE4_KEY_TIMER_LIMIT_HI_MIRROR_ADDR A:0x73a68c
y.create.l HWIO_CRYPTO0_CRYPTO_PIPE5_KEY_TIMER_LIMIT_HI_MIRROR_ADDR A:0x73a6ac
y.create.l HWIO_CRYPTO0_CRYPTO_PIPE6_KEY_TIMER_LIMIT_HI_MIRROR_ADDR A:0x73a6cc
y.create.l HWIO_CRYPTO0_CRYPTO_PIPE7_KEY_TIMER_LIMIT_HI_MIRROR_ADDR A:0x73a6ec
y.create.l HWIO_CRYPTO0_CRYPTO_PIPE0_KEY_PAUSE_CFG_MIRROR_ADDR A:0x73a610
y.create.l HWIO_CRYPTO0_CRYPTO_PIPE1_KEY_PAUSE_CFG_MIRROR_ADDR A:0x73a630
y.create.l HWIO_CRYPTO0_CRYPTO_PIPE2_KEY_PAUSE_CFG_MIRROR_ADDR A:0x73a650
y.create.l HWIO_CRYPTO0_CRYPTO_PIPE3_KEY_PAUSE_CFG_MIRROR_ADDR A:0x73a670
y.create.l HWIO_CRYPTO0_CRYPTO_PIPE4_KEY_PAUSE_CFG_MIRROR_ADDR A:0x73a690
y.create.l HWIO_CRYPTO0_CRYPTO_PIPE5_KEY_PAUSE_CFG_MIRROR_ADDR A:0x73a6b0
y.create.l HWIO_CRYPTO0_CRYPTO_PIPE6_KEY_PAUSE_CFG_MIRROR_ADDR A:0x73a6d0
y.create.l HWIO_CRYPTO0_CRYPTO_PIPE7_KEY_PAUSE_CFG_MIRROR_ADDR A:0x73a6f0
y.create.l HWIO_CRYPTO0_CRYPTO_ENCR_XTS_KEY0_ADDR A:0x73d020
y.create.l HWIO_CRYPTO0_CRYPTO_ENCR_XTS_KEY1_ADDR A:0x73d024
y.create.l HWIO_CRYPTO0_CRYPTO_ENCR_XTS_KEY2_ADDR A:0x73d028
y.create.l HWIO_CRYPTO0_CRYPTO_ENCR_XTS_KEY3_ADDR A:0x73d02c
y.create.l HWIO_CRYPTO0_CRYPTO_ENCR_XTS_KEY4_ADDR A:0x73d030
y.create.l HWIO_CRYPTO0_CRYPTO_ENCR_XTS_KEY5_ADDR A:0x73d034
y.create.l HWIO_CRYPTO0_CRYPTO_ENCR_XTS_KEY6_ADDR A:0x73d038
y.create.l HWIO_CRYPTO0_CRYPTO_ENCR_XTS_KEY7_ADDR A:0x73d03c
y.create.l HWIO_CRYPTO0_CRYPTO_ENCR_PIPE0_XTS_KEY0_ADDR A:0x73e200
y.create.l HWIO_CRYPTO0_CRYPTO_ENCR_PIPE0_XTS_KEY1_ADDR A:0x73e204
y.create.l HWIO_CRYPTO0_CRYPTO_ENCR_PIPE0_XTS_KEY2_ADDR A:0x73e208
y.create.l HWIO_CRYPTO0_CRYPTO_ENCR_PIPE0_XTS_KEY3_ADDR A:0x73e20c
y.create.l HWIO_CRYPTO0_CRYPTO_ENCR_PIPE1_XTS_KEY0_ADDR A:0x73e220
y.create.l HWIO_CRYPTO0_CRYPTO_ENCR_PIPE1_XTS_KEY1_ADDR A:0x73e224
y.create.l HWIO_CRYPTO0_CRYPTO_ENCR_PIPE1_XTS_KEY2_ADDR A:0x73e228
y.create.l HWIO_CRYPTO0_CRYPTO_ENCR_PIPE1_XTS_KEY3_ADDR A:0x73e22c
y.create.l HWIO_CRYPTO0_CRYPTO_ENCR_PIPE2_XTS_KEY0_ADDR A:0x73e240
y.create.l HWIO_CRYPTO0_CRYPTO_ENCR_PIPE2_XTS_KEY1_ADDR A:0x73e244
y.create.l HWIO_CRYPTO0_CRYPTO_ENCR_PIPE2_XTS_KEY2_ADDR A:0x73e248
y.create.l HWIO_CRYPTO0_CRYPTO_ENCR_PIPE2_XTS_KEY3_ADDR A:0x73e24c
y.create.l HWIO_CRYPTO0_CRYPTO_ENCR_PIPE3_XTS_KEY0_ADDR A:0x73e260
y.create.l HWIO_CRYPTO0_CRYPTO_ENCR_PIPE3_XTS_KEY1_ADDR A:0x73e264
y.create.l HWIO_CRYPTO0_CRYPTO_ENCR_PIPE3_XTS_KEY2_ADDR A:0x73e268
y.create.l HWIO_CRYPTO0_CRYPTO_ENCR_PIPE3_XTS_KEY3_ADDR A:0x73e26c
y.create.l HWIO_CRYPTO0_CRYPTO_ENCR_PIPE4_XTS_KEY0_ADDR A:0x73e280
y.create.l HWIO_CRYPTO0_CRYPTO_ENCR_PIPE4_XTS_KEY1_ADDR A:0x73e284
y.create.l HWIO_CRYPTO0_CRYPTO_ENCR_PIPE4_XTS_KEY2_ADDR A:0x73e288
y.create.l HWIO_CRYPTO0_CRYPTO_ENCR_PIPE4_XTS_KEY3_ADDR A:0x73e28c
y.create.l HWIO_CRYPTO0_CRYPTO_ENCR_PIPE5_XTS_KEY0_ADDR A:0x73e2a0
y.create.l HWIO_CRYPTO0_CRYPTO_ENCR_PIPE5_XTS_KEY1_ADDR A:0x73e2a4
y.create.l HWIO_CRYPTO0_CRYPTO_ENCR_PIPE5_XTS_KEY2_ADDR A:0x73e2a8
y.create.l HWIO_CRYPTO0_CRYPTO_ENCR_PIPE5_XTS_KEY3_ADDR A:0x73e2ac
y.create.l HWIO_CRYPTO0_CRYPTO_ENCR_PIPE6_XTS_KEY0_ADDR A:0x73e2c0
y.create.l HWIO_CRYPTO0_CRYPTO_ENCR_PIPE6_XTS_KEY1_ADDR A:0x73e2c4
y.create.l HWIO_CRYPTO0_CRYPTO_ENCR_PIPE6_XTS_KEY2_ADDR A:0x73e2c8
y.create.l HWIO_CRYPTO0_CRYPTO_ENCR_PIPE6_XTS_KEY3_ADDR A:0x73e2cc
y.create.l HWIO_CRYPTO0_CRYPTO_ENCR_PIPE7_XTS_KEY0_ADDR A:0x73e2e0
y.create.l HWIO_CRYPTO0_CRYPTO_ENCR_PIPE7_XTS_KEY1_ADDR A:0x73e2e4
y.create.l HWIO_CRYPTO0_CRYPTO_ENCR_PIPE7_XTS_KEY2_ADDR A:0x73e2e8
y.create.l HWIO_CRYPTO0_CRYPTO_ENCR_PIPE7_XTS_KEY3_ADDR A:0x73e2ec
y.create.l HWIO_CRYPTO0_CRYPTO_ENCR_PIPE0_ODD_KEY0_ADDR A:0x73e400
y.create.l HWIO_CRYPTO0_CRYPTO_ENCR_PIPE0_ODD_KEY1_ADDR A:0x73e404
y.create.l HWIO_CRYPTO0_CRYPTO_ENCR_PIPE0_ODD_KEY2_ADDR A:0x73e408
y.create.l HWIO_CRYPTO0_CRYPTO_ENCR_PIPE0_ODD_KEY3_ADDR A:0x73e40c
y.create.l HWIO_CRYPTO0_CRYPTO_ENCR_PIPE1_ODD_KEY0_ADDR A:0x73e420
y.create.l HWIO_CRYPTO0_CRYPTO_ENCR_PIPE1_ODD_KEY1_ADDR A:0x73e424
y.create.l HWIO_CRYPTO0_CRYPTO_ENCR_PIPE1_ODD_KEY2_ADDR A:0x73e428
y.create.l HWIO_CRYPTO0_CRYPTO_ENCR_PIPE1_ODD_KEY3_ADDR A:0x73e42c
y.create.l HWIO_CRYPTO0_CRYPTO_ENCR_PIPE2_ODD_KEY0_ADDR A:0x73e440
y.create.l HWIO_CRYPTO0_CRYPTO_ENCR_PIPE2_ODD_KEY1_ADDR A:0x73e444
y.create.l HWIO_CRYPTO0_CRYPTO_ENCR_PIPE2_ODD_KEY2_ADDR A:0x73e448
y.create.l HWIO_CRYPTO0_CRYPTO_ENCR_PIPE2_ODD_KEY3_ADDR A:0x73e44c
y.create.l HWIO_CRYPTO0_CRYPTO_ENCR_PIPE3_ODD_KEY0_ADDR A:0x73e460
y.create.l HWIO_CRYPTO0_CRYPTO_ENCR_PIPE3_ODD_KEY1_ADDR A:0x73e464
y.create.l HWIO_CRYPTO0_CRYPTO_ENCR_PIPE3_ODD_KEY2_ADDR A:0x73e468
y.create.l HWIO_CRYPTO0_CRYPTO_ENCR_PIPE3_ODD_KEY3_ADDR A:0x73e46c
y.create.l HWIO_CRYPTO0_CRYPTO_ENCR_PIPE4_ODD_KEY0_ADDR A:0x73e480
y.create.l HWIO_CRYPTO0_CRYPTO_ENCR_PIPE4_ODD_KEY1_ADDR A:0x73e484
y.create.l HWIO_CRYPTO0_CRYPTO_ENCR_PIPE4_ODD_KEY2_ADDR A:0x73e488
y.create.l HWIO_CRYPTO0_CRYPTO_ENCR_PIPE4_ODD_KEY3_ADDR A:0x73e48c
y.create.l HWIO_CRYPTO0_CRYPTO_ENCR_PIPE5_ODD_KEY0_ADDR A:0x73e4a0
y.create.l HWIO_CRYPTO0_CRYPTO_ENCR_PIPE5_ODD_KEY1_ADDR A:0x73e4a4
y.create.l HWIO_CRYPTO0_CRYPTO_ENCR_PIPE5_ODD_KEY2_ADDR A:0x73e4a8
y.create.l HWIO_CRYPTO0_CRYPTO_ENCR_PIPE5_ODD_KEY3_ADDR A:0x73e4ac
y.create.l HWIO_CRYPTO0_CRYPTO_ENCR_PIPE6_ODD_KEY0_ADDR A:0x73e4c0
y.create.l HWIO_CRYPTO0_CRYPTO_ENCR_PIPE6_ODD_KEY1_ADDR A:0x73e4c4
y.create.l HWIO_CRYPTO0_CRYPTO_ENCR_PIPE6_ODD_KEY2_ADDR A:0x73e4c8
y.create.l HWIO_CRYPTO0_CRYPTO_ENCR_PIPE6_ODD_KEY3_ADDR A:0x73e4cc
y.create.l HWIO_CRYPTO0_CRYPTO_ENCR_PIPE7_ODD_KEY0_ADDR A:0x73e4e0
y.create.l HWIO_CRYPTO0_CRYPTO_ENCR_PIPE7_ODD_KEY1_ADDR A:0x73e4e4
y.create.l HWIO_CRYPTO0_CRYPTO_ENCR_PIPE7_ODD_KEY2_ADDR A:0x73e4e8
y.create.l HWIO_CRYPTO0_CRYPTO_ENCR_PIPE7_ODD_KEY3_ADDR A:0x73e4ec
y.create.l HWIO_CRYPTO0_CRYPTO_ENCR_PIPE0_XTS_ODD_KEY0_ADDR A:0x73e600
y.create.l HWIO_CRYPTO0_CRYPTO_ENCR_PIPE0_XTS_ODD_KEY1_ADDR A:0x73e604
y.create.l HWIO_CRYPTO0_CRYPTO_ENCR_PIPE0_XTS_ODD_KEY2_ADDR A:0x73e608
y.create.l HWIO_CRYPTO0_CRYPTO_ENCR_PIPE0_XTS_ODD_KEY3_ADDR A:0x73e60c
y.create.l HWIO_CRYPTO0_CRYPTO_ENCR_PIPE1_XTS_ODD_KEY0_ADDR A:0x73e620
y.create.l HWIO_CRYPTO0_CRYPTO_ENCR_PIPE1_XTS_ODD_KEY1_ADDR A:0x73e624
y.create.l HWIO_CRYPTO0_CRYPTO_ENCR_PIPE1_XTS_ODD_KEY2_ADDR A:0x73e628
y.create.l HWIO_CRYPTO0_CRYPTO_ENCR_PIPE1_XTS_ODD_KEY3_ADDR A:0x73e62c
y.create.l HWIO_CRYPTO0_CRYPTO_ENCR_PIPE2_XTS_ODD_KEY0_ADDR A:0x73e640
y.create.l HWIO_CRYPTO0_CRYPTO_ENCR_PIPE2_XTS_ODD_KEY1_ADDR A:0x73e644
y.create.l HWIO_CRYPTO0_CRYPTO_ENCR_PIPE2_XTS_ODD_KEY2_ADDR A:0x73e648
y.create.l HWIO_CRYPTO0_CRYPTO_ENCR_PIPE2_XTS_ODD_KEY3_ADDR A:0x73e64c
y.create.l HWIO_CRYPTO0_CRYPTO_ENCR_PIPE3_XTS_ODD_KEY0_ADDR A:0x73e660
y.create.l HWIO_CRYPTO0_CRYPTO_ENCR_PIPE3_XTS_ODD_KEY1_ADDR A:0x73e664
y.create.l HWIO_CRYPTO0_CRYPTO_ENCR_PIPE3_XTS_ODD_KEY2_ADDR A:0x73e668
y.create.l HWIO_CRYPTO0_CRYPTO_ENCR_PIPE3_XTS_ODD_KEY3_ADDR A:0x73e66c
y.create.l HWIO_CRYPTO0_CRYPTO_ENCR_PIPE4_XTS_ODD_KEY0_ADDR A:0x73e680
y.create.l HWIO_CRYPTO0_CRYPTO_ENCR_PIPE4_XTS_ODD_KEY1_ADDR A:0x73e684
y.create.l HWIO_CRYPTO0_CRYPTO_ENCR_PIPE4_XTS_ODD_KEY2_ADDR A:0x73e688
y.create.l HWIO_CRYPTO0_CRYPTO_ENCR_PIPE4_XTS_ODD_KEY3_ADDR A:0x73e68c
y.create.l HWIO_CRYPTO0_CRYPTO_ENCR_PIPE5_XTS_ODD_KEY0_ADDR A:0x73e6a0
y.create.l HWIO_CRYPTO0_CRYPTO_ENCR_PIPE5_XTS_ODD_KEY1_ADDR A:0x73e6a4
y.create.l HWIO_CRYPTO0_CRYPTO_ENCR_PIPE5_XTS_ODD_KEY2_ADDR A:0x73e6a8
y.create.l HWIO_CRYPTO0_CRYPTO_ENCR_PIPE5_XTS_ODD_KEY3_ADDR A:0x73e6ac
y.create.l HWIO_CRYPTO0_CRYPTO_ENCR_PIPE6_XTS_ODD_KEY0_ADDR A:0x73e6c0
y.create.l HWIO_CRYPTO0_CRYPTO_ENCR_PIPE6_XTS_ODD_KEY1_ADDR A:0x73e6c4
y.create.l HWIO_CRYPTO0_CRYPTO_ENCR_PIPE6_XTS_ODD_KEY2_ADDR A:0x73e6c8
y.create.l HWIO_CRYPTO0_CRYPTO_ENCR_PIPE6_XTS_ODD_KEY3_ADDR A:0x73e6cc
y.create.l HWIO_CRYPTO0_CRYPTO_ENCR_PIPE7_XTS_ODD_KEY0_ADDR A:0x73e6e0
y.create.l HWIO_CRYPTO0_CRYPTO_ENCR_PIPE7_XTS_ODD_KEY1_ADDR A:0x73e6e4
y.create.l HWIO_CRYPTO0_CRYPTO_ENCR_PIPE7_XTS_ODD_KEY2_ADDR A:0x73e6e8
y.create.l HWIO_CRYPTO0_CRYPTO_ENCR_PIPE7_XTS_ODD_KEY3_ADDR A:0x73e6ec
y.create.l HWIO_CRYPTO0_CRYPTO_ENCR_CNTR0_IV0_ADDR A:0x73a20c
y.create.l HWIO_CRYPTO0_CRYPTO_ENCR_CNTR1_IV1_ADDR A:0x73a210
y.create.l HWIO_CRYPTO0_CRYPTO_ENCR_CNTR2_IV2_ADDR A:0x73a214
y.create.l HWIO_CRYPTO0_CRYPTO_ENCR_CNTR3_IV3_ADDR A:0x73a218
y.create.l HWIO_CRYPTO0_CRYPTO_ENCR_CNTR_MASK_ADDR A:0x73a21c
y.create.l HWIO_CRYPTO0_CRYPTO_ENCR_CNTR_MASK2_ADDR A:0x73a234
y.create.l HWIO_CRYPTO0_CRYPTO_ENCR_CNTR_MASK1_ADDR A:0x73a238
y.create.l HWIO_CRYPTO0_CRYPTO_ENCR_CNTR_MASK0_ADDR A:0x73a23c
y.create.l HWIO_CRYPTO0_CRYPTO_ENCR_CCM_INIT_CNTR0_ADDR A:0x73a220
y.create.l HWIO_CRYPTO0_CRYPTO_ENCR_CCM_INIT_CNTR1_ADDR A:0x73a224
y.create.l HWIO_CRYPTO0_CRYPTO_ENCR_CCM_INIT_CNTR2_ADDR A:0x73a228
y.create.l HWIO_CRYPTO0_CRYPTO_ENCR_CCM_INIT_CNTR3_ADDR A:0x73a22c
y.create.l HWIO_CRYPTO0_CRYPTO_ENCR_XTS_DU_SIZE_ADDR A:0x73a230
y.create.l HWIO_CRYPTO0_CRYPTO_AUTH_SEG_CFG_ADDR A:0x73a300
y.create.l HWIO_CRYPTO0_CRYPTO_AUTH_SEG_SIZE_ADDR A:0x73a304
y.create.l HWIO_CRYPTO0_CRYPTO_AUTH_SEG_START_ADDR A:0x73a308
y.create.l HWIO_CRYPTO0_CRYPTO_AUTH_KEY0_ADDR A:0x73d040
y.create.l HWIO_CRYPTO0_CRYPTO_AUTH_KEY1_ADDR A:0x73d044
y.create.l HWIO_CRYPTO0_CRYPTO_AUTH_KEY2_ADDR A:0x73d048
y.create.l HWIO_CRYPTO0_CRYPTO_AUTH_KEY3_ADDR A:0x73d04c
y.create.l HWIO_CRYPTO0_CRYPTO_AUTH_KEY4_ADDR A:0x73d050
y.create.l HWIO_CRYPTO0_CRYPTO_AUTH_KEY5_ADDR A:0x73d054
y.create.l HWIO_CRYPTO0_CRYPTO_AUTH_KEY6_ADDR A:0x73d058
y.create.l HWIO_CRYPTO0_CRYPTO_AUTH_KEY7_ADDR A:0x73d05c
y.create.l HWIO_CRYPTO0_CRYPTO_AUTH_KEY8_ADDR A:0x73d060
y.create.l HWIO_CRYPTO0_CRYPTO_AUTH_KEY9_ADDR A:0x73d064
y.create.l HWIO_CRYPTO0_CRYPTO_AUTH_PIPE0_KEY0_ADDR A:0x73e800
y.create.l HWIO_CRYPTO0_CRYPTO_AUTH_PIPE0_KEY1_ADDR A:0x73e804
y.create.l HWIO_CRYPTO0_CRYPTO_AUTH_PIPE0_KEY2_ADDR A:0x73e808
y.create.l HWIO_CRYPTO0_CRYPTO_AUTH_PIPE0_KEY3_ADDR A:0x73e80c
y.create.l HWIO_CRYPTO0_CRYPTO_AUTH_PIPE1_KEY0_ADDR A:0x73e880
y.create.l HWIO_CRYPTO0_CRYPTO_AUTH_PIPE1_KEY1_ADDR A:0x73e884
y.create.l HWIO_CRYPTO0_CRYPTO_AUTH_PIPE1_KEY2_ADDR A:0x73e888
y.create.l HWIO_CRYPTO0_CRYPTO_AUTH_PIPE1_KEY3_ADDR A:0x73e88c
y.create.l HWIO_CRYPTO0_CRYPTO_AUTH_PIPE2_KEY0_ADDR A:0x73e900
y.create.l HWIO_CRYPTO0_CRYPTO_AUTH_PIPE2_KEY1_ADDR A:0x73e904
y.create.l HWIO_CRYPTO0_CRYPTO_AUTH_PIPE2_KEY2_ADDR A:0x73e908
y.create.l HWIO_CRYPTO0_CRYPTO_AUTH_PIPE2_KEY3_ADDR A:0x73e90c
y.create.l HWIO_CRYPTO0_CRYPTO_AUTH_PIPE3_KEY0_ADDR A:0x73e980
y.create.l HWIO_CRYPTO0_CRYPTO_AUTH_PIPE3_KEY1_ADDR A:0x73e984
y.create.l HWIO_CRYPTO0_CRYPTO_AUTH_PIPE3_KEY2_ADDR A:0x73e988
y.create.l HWIO_CRYPTO0_CRYPTO_AUTH_PIPE3_KEY3_ADDR A:0x73e98c
y.create.l HWIO_CRYPTO0_CRYPTO_AUTH_PIPE4_KEY0_ADDR A:0x73ea00
y.create.l HWIO_CRYPTO0_CRYPTO_AUTH_PIPE4_KEY1_ADDR A:0x73ea04
y.create.l HWIO_CRYPTO0_CRYPTO_AUTH_PIPE4_KEY2_ADDR A:0x73ea08
y.create.l HWIO_CRYPTO0_CRYPTO_AUTH_PIPE4_KEY3_ADDR A:0x73ea0c
y.create.l HWIO_CRYPTO0_CRYPTO_AUTH_PIPE5_KEY0_ADDR A:0x73ea80
y.create.l HWIO_CRYPTO0_CRYPTO_AUTH_PIPE5_KEY1_ADDR A:0x73ea84
y.create.l HWIO_CRYPTO0_CRYPTO_AUTH_PIPE5_KEY2_ADDR A:0x73ea88
y.create.l HWIO_CRYPTO0_CRYPTO_AUTH_PIPE5_KEY3_ADDR A:0x73ea8c
y.create.l HWIO_CRYPTO0_CRYPTO_AUTH_PIPE6_KEY0_ADDR A:0x73eb00
y.create.l HWIO_CRYPTO0_CRYPTO_AUTH_PIPE6_KEY1_ADDR A:0x73eb04
y.create.l HWIO_CRYPTO0_CRYPTO_AUTH_PIPE6_KEY2_ADDR A:0x73eb08
y.create.l HWIO_CRYPTO0_CRYPTO_AUTH_PIPE6_KEY3_ADDR A:0x73eb0c
y.create.l HWIO_CRYPTO0_CRYPTO_AUTH_PIPE7_KEY0_ADDR A:0x73eb80
y.create.l HWIO_CRYPTO0_CRYPTO_AUTH_PIPE7_KEY1_ADDR A:0x73eb84
y.create.l HWIO_CRYPTO0_CRYPTO_AUTH_PIPE7_KEY2_ADDR A:0x73eb88
y.create.l HWIO_CRYPTO0_CRYPTO_AUTH_PIPE7_KEY3_ADDR A:0x73eb8c
y.create.l HWIO_CRYPTO0_CRYPTO_AUTH_IV0_ADDR A:0x73a310
y.create.l HWIO_CRYPTO0_CRYPTO_AUTH_IV1_ADDR A:0x73a314
y.create.l HWIO_CRYPTO0_CRYPTO_AUTH_IV2_ADDR A:0x73a318
y.create.l HWIO_CRYPTO0_CRYPTO_AUTH_IV3_ADDR A:0x73a31c
y.create.l HWIO_CRYPTO0_CRYPTO_AUTH_IV4_ADDR A:0x73a320
y.create.l HWIO_CRYPTO0_CRYPTO_AUTH_IV5_ADDR A:0x73a324
y.create.l HWIO_CRYPTO0_CRYPTO_AUTH_IV6_ADDR A:0x73a328
y.create.l HWIO_CRYPTO0_CRYPTO_AUTH_IV7_ADDR A:0x73a32c
y.create.l HWIO_CRYPTO0_CRYPTO_AUTH_IV8_ADDR A:0x73a330
y.create.l HWIO_CRYPTO0_CRYPTO_AUTH_IV9_ADDR A:0x73a334
y.create.l HWIO_CRYPTO0_CRYPTO_AUTH_INFO_NONCE0_ADDR A:0x73a350
y.create.l HWIO_CRYPTO0_CRYPTO_AUTH_INFO_NONCE1_ADDR A:0x73a354
y.create.l HWIO_CRYPTO0_CRYPTO_AUTH_INFO_NONCE2_ADDR A:0x73a358
y.create.l HWIO_CRYPTO0_CRYPTO_AUTH_INFO_NONCE3_ADDR A:0x73a35c
y.create.l HWIO_CRYPTO0_CRYPTO_AUTH_BYTECNT0_ADDR A:0x73a390
y.create.l HWIO_CRYPTO0_CRYPTO_AUTH_BYTECNT1_ADDR A:0x73a394
y.create.l HWIO_CRYPTO0_CRYPTO_AUTH_BYTECNT2_ADDR A:0x73a398
y.create.l HWIO_CRYPTO0_CRYPTO_AUTH_BYTECNT3_ADDR A:0x73a39c
y.create.l HWIO_CRYPTO0_CRYPTO_AUTH_EXP_MAC0_ADDR A:0x73a3a0
y.create.l HWIO_CRYPTO0_CRYPTO_AUTH_EXP_MAC1_ADDR A:0x73a3a4
y.create.l HWIO_CRYPTO0_CRYPTO_AUTH_EXP_MAC2_ADDR A:0x73a3a8
y.create.l HWIO_CRYPTO0_CRYPTO_AUTH_EXP_MAC3_ADDR A:0x73a3ac
y.create.l HWIO_CRYPTO0_CRYPTO_AUTH_EXP_MAC4_ADDR A:0x73a3b0
y.create.l HWIO_CRYPTO0_CRYPTO_AUTH_EXP_MAC5_ADDR A:0x73a3b4
y.create.l HWIO_CRYPTO0_CRYPTO_AUTH_EXP_MAC6_ADDR A:0x73a3b8
y.create.l HWIO_CRYPTO0_CRYPTO_AUTH_EXP_MAC7_ADDR A:0x73a3bc
y.create.l HWIO_CRYPTO0_CRYPTO_AUTH_EXP_MAC8_ADDR A:0x73a3c0
y.create.l HWIO_CRYPTO0_CRYPTO_AUTH_EXP_MAC9_ADDR A:0x73a3c4
y.create.l HWIO_CRYPTO0_CRYPTO_CONFIG_ADDR A:0x73a400
y.create.l HWIO_CRYPTO0_CRYPTO_PWR_CTRL_ADDR A:0x73a408
y.create.l HWIO_CRYPTO0_CRYPTO_DATA_PATT_PROC_CFG_ADDR A:0x73a500
y.create.l HWIO_CRYPTO0_CRYPTO_DATA_PARTIAL_BLOCK_PROC_CFG_ADDR A:0x73a504
y.create.l HWIO_CRYPTO0_CRYPTO_DEBUG_ENABLE_ADDR A:0x73f000
y.create.l HWIO_CRYPTO0_CRYPTO_DEBUG_ADDR A:0x73f004
y.create.l HWIO_CRYPTO0_CRYPTO_PIPE_GLOBAL_TIMER_EN_ADDR A:0x73f008
y.create.l HWIO_CRYPTO0_CRYPTO_PIPE_GLOBAL_TIMER_LO_ADDR A:0x73f00c
y.create.l HWIO_CRYPTO0_CRYPTO_PIPE_GLOBAL_TIMER_HI_ADDR A:0x73f010
y.create.l HWIO_CRYPTO0_CRYPTO_PIPE_KEY_PAUSE_SW_SRC_ADDR A:0x73f014
y.create.l HWIO_CRYPTO0_CRYPTO_BAM_REG_BASE_START_ADDR A:0x704000
y.create.l HWIO_CRYPTO0_CRYPTO_BAM_REG_BASE_LAST_ADDR A:0x726934
y.create.l HWIO_CRYPTO0_CRYPTO_BAM_REG_BASE_END_ADDR A:0x728000
y.create.l HWIO_CRYPTO0_CRYPTO_BAM_CTRL_ADDR A:0x704000
y.create.l HWIO_CRYPTO0_CRYPTO_BAM_TIMER_ADDR A:0x704040
y.create.l HWIO_CRYPTO0_CRYPTO_BAM_TIMER_CTRL_ADDR A:0x704044
y.create.l HWIO_CRYPTO0_CRYPTO_BAM_DESC_CNT_TRSHLD_ADDR A:0x704008
y.create.l HWIO_CRYPTO0_CRYPTO_BAM_IRQ_STTS_ADDR A:0x704014
y.create.l HWIO_CRYPTO0_CRYPTO_BAM_IRQ_CLR_ADDR A:0x704018
y.create.l HWIO_CRYPTO0_CRYPTO_BAM_IRQ_EN_ADDR A:0x70401c
y.create.l HWIO_CRYPTO0_CRYPTO_BAM_CNFG_BITS_ADDR A:0x70407c
y.create.l HWIO_CRYPTO0_CRYPTO_BAM_CNFG_BITS_2_ADDR A:0x704084
y.create.l HWIO_CRYPTO0_CRYPTO_BAM_REVISION_ADDR A:0x705000
y.create.l HWIO_CRYPTO0_CRYPTO_BAM_SW_VERSION_ADDR A:0x705004
y.create.l HWIO_CRYPTO0_CRYPTO_BAM_NUM_PIPES_ADDR A:0x705008
y.create.l HWIO_CRYPTO0_CRYPTO_BAM_TEST_BUS_SEL_ADDR A:0x705010
y.create.l HWIO_CRYPTO0_CRYPTO_BAM_TEST_BUS_REG_ADDR A:0x705014
y.create.l HWIO_CRYPTO0_CRYPTO_BAM_AHB_MASTER_ERR_CTRLS_ADDR A:0x705024
y.create.l HWIO_CRYPTO0_CRYPTO_BAM_AHB_MASTER_ERR_ADDR_ADDR A:0x705028
y.create.l HWIO_CRYPTO0_CRYPTO_BAM_AHB_MASTER_ERR_DATA_ADDR A:0x70502c
y.create.l HWIO_CRYPTO0_CRYPTO_BAM_AHB_MASTER_ERR_ADDR_LSB_ADDR A:0x705100
y.create.l HWIO_CRYPTO0_CRYPTO_BAM_AHB_MASTER_ERR_ADDR_MSB_ADDR A:0x705104
y.create.l HWIO_CRYPTO0_CRYPTO_BAM_TRUST_REG_ADDR A:0x706000
y.create.l HWIO_CRYPTO0_CRYPTO_BAM_P_TRUST_REG0_ADDR A:0x706020
y.create.l HWIO_CRYPTO0_CRYPTO_BAM_P_TRUST_REG1_ADDR A:0x706024
y.create.l HWIO_CRYPTO0_CRYPTO_BAM_P_TRUST_REG2_ADDR A:0x706028
y.create.l HWIO_CRYPTO0_CRYPTO_BAM_P_TRUST_REG3_ADDR A:0x70602c
y.create.l HWIO_CRYPTO0_CRYPTO_BAM_P_TRUST_REG4_ADDR A:0x706030
y.create.l HWIO_CRYPTO0_CRYPTO_BAM_P_TRUST_REG5_ADDR A:0x706034
y.create.l HWIO_CRYPTO0_CRYPTO_BAM_P_TRUST_REG6_ADDR A:0x706038
y.create.l HWIO_CRYPTO0_CRYPTO_BAM_P_TRUST_REG7_ADDR A:0x70603c
y.create.l HWIO_CRYPTO0_CRYPTO_BAM_P_TRUST_REG8_ADDR A:0x706040
y.create.l HWIO_CRYPTO0_CRYPTO_BAM_P_TRUST_REG9_ADDR A:0x706044
y.create.l HWIO_CRYPTO0_CRYPTO_BAM_IRQ_SRCS_EE0_ADDR A:0x707000
y.create.l HWIO_CRYPTO0_CRYPTO_BAM_IRQ_SRCS_EE1_ADDR A:0x708000
y.create.l HWIO_CRYPTO0_CRYPTO_BAM_IRQ_SRCS_EE2_ADDR A:0x709000
y.create.l HWIO_CRYPTO0_CRYPTO_BAM_IRQ_SRCS_EE3_ADDR A:0x70a000
y.create.l HWIO_CRYPTO0_CRYPTO_BAM_IRQ_SRCS_MSK_EE0_ADDR A:0x707004
y.create.l HWIO_CRYPTO0_CRYPTO_BAM_IRQ_SRCS_MSK_EE1_ADDR A:0x708004
y.create.l HWIO_CRYPTO0_CRYPTO_BAM_IRQ_SRCS_MSK_EE2_ADDR A:0x709004
y.create.l HWIO_CRYPTO0_CRYPTO_BAM_IRQ_SRCS_MSK_EE3_ADDR A:0x70a004
y.create.l HWIO_CRYPTO0_CRYPTO_BAM_IRQ_SRCS_UNMASKED_EE0_ADDR A:0x707008
y.create.l HWIO_CRYPTO0_CRYPTO_BAM_IRQ_SRCS_UNMASKED_EE1_ADDR A:0x708008
y.create.l HWIO_CRYPTO0_CRYPTO_BAM_IRQ_SRCS_UNMASKED_EE2_ADDR A:0x709008
y.create.l HWIO_CRYPTO0_CRYPTO_BAM_IRQ_SRCS_UNMASKED_EE3_ADDR A:0x70a008
y.create.l HWIO_CRYPTO0_CRYPTO_BAM_PIPE_ATTR_EE0_ADDR A:0x70700c
y.create.l HWIO_CRYPTO0_CRYPTO_BAM_PIPE_ATTR_EE1_ADDR A:0x70800c
y.create.l HWIO_CRYPTO0_CRYPTO_BAM_PIPE_ATTR_EE2_ADDR A:0x70900c
y.create.l HWIO_CRYPTO0_CRYPTO_BAM_PIPE_ATTR_EE3_ADDR A:0x70a00c
y.create.l HWIO_CRYPTO0_CRYPTO_BAM_IRQ_SRCS_ADDR A:0x707010
y.create.l HWIO_CRYPTO0_CRYPTO_BAM_IRQ_SRCS_MSK_ADDR A:0x707014
y.create.l HWIO_CRYPTO0_CRYPTO_BAM_IRQ_SRCS_UNMASKED_ADDR A:0x707018
y.create.l HWIO_CRYPTO0_CRYPTO_BAM_P_CTRL0_ADDR A:0x717000
y.create.l HWIO_CRYPTO0_CRYPTO_BAM_P_CTRL1_ADDR A:0x718000
y.create.l HWIO_CRYPTO0_CRYPTO_BAM_P_CTRL2_ADDR A:0x719000
y.create.l HWIO_CRYPTO0_CRYPTO_BAM_P_CTRL3_ADDR A:0x71a000
y.create.l HWIO_CRYPTO0_CRYPTO_BAM_P_CTRL4_ADDR A:0x71b000
y.create.l HWIO_CRYPTO0_CRYPTO_BAM_P_CTRL5_ADDR A:0x71c000
y.create.l HWIO_CRYPTO0_CRYPTO_BAM_P_CTRL6_ADDR A:0x71d000
y.create.l HWIO_CRYPTO0_CRYPTO_BAM_P_CTRL7_ADDR A:0x71e000
y.create.l HWIO_CRYPTO0_CRYPTO_BAM_P_CTRL8_ADDR A:0x71f000
y.create.l HWIO_CRYPTO0_CRYPTO_BAM_P_CTRL9_ADDR A:0x720000
y.create.l HWIO_CRYPTO0_CRYPTO_BAM_P_RST0_ADDR A:0x717004
y.create.l HWIO_CRYPTO0_CRYPTO_BAM_P_RST1_ADDR A:0x718004
y.create.l HWIO_CRYPTO0_CRYPTO_BAM_P_RST2_ADDR A:0x719004
y.create.l HWIO_CRYPTO0_CRYPTO_BAM_P_RST3_ADDR A:0x71a004
y.create.l HWIO_CRYPTO0_CRYPTO_BAM_P_RST4_ADDR A:0x71b004
y.create.l HWIO_CRYPTO0_CRYPTO_BAM_P_RST5_ADDR A:0x71c004
y.create.l HWIO_CRYPTO0_CRYPTO_BAM_P_RST6_ADDR A:0x71d004
y.create.l HWIO_CRYPTO0_CRYPTO_BAM_P_RST7_ADDR A:0x71e004
y.create.l HWIO_CRYPTO0_CRYPTO_BAM_P_RST8_ADDR A:0x71f004
y.create.l HWIO_CRYPTO0_CRYPTO_BAM_P_RST9_ADDR A:0x720004
y.create.l HWIO_CRYPTO0_CRYPTO_BAM_P_HALT0_ADDR A:0x717008
y.create.l HWIO_CRYPTO0_CRYPTO_BAM_P_HALT1_ADDR A:0x718008
y.create.l HWIO_CRYPTO0_CRYPTO_BAM_P_HALT2_ADDR A:0x719008
y.create.l HWIO_CRYPTO0_CRYPTO_BAM_P_HALT3_ADDR A:0x71a008
y.create.l HWIO_CRYPTO0_CRYPTO_BAM_P_HALT4_ADDR A:0x71b008
y.create.l HWIO_CRYPTO0_CRYPTO_BAM_P_HALT5_ADDR A:0x71c008
y.create.l HWIO_CRYPTO0_CRYPTO_BAM_P_HALT6_ADDR A:0x71d008
y.create.l HWIO_CRYPTO0_CRYPTO_BAM_P_HALT7_ADDR A:0x71e008
y.create.l HWIO_CRYPTO0_CRYPTO_BAM_P_HALT8_ADDR A:0x71f008
y.create.l HWIO_CRYPTO0_CRYPTO_BAM_P_HALT9_ADDR A:0x720008
y.create.l HWIO_CRYPTO0_CRYPTO_BAM_P_IRQ_STTS0_ADDR A:0x717010
y.create.l HWIO_CRYPTO0_CRYPTO_BAM_P_IRQ_STTS1_ADDR A:0x718010
y.create.l HWIO_CRYPTO0_CRYPTO_BAM_P_IRQ_STTS2_ADDR A:0x719010
y.create.l HWIO_CRYPTO0_CRYPTO_BAM_P_IRQ_STTS3_ADDR A:0x71a010
y.create.l HWIO_CRYPTO0_CRYPTO_BAM_P_IRQ_STTS4_ADDR A:0x71b010
y.create.l HWIO_CRYPTO0_CRYPTO_BAM_P_IRQ_STTS5_ADDR A:0x71c010
y.create.l HWIO_CRYPTO0_CRYPTO_BAM_P_IRQ_STTS6_ADDR A:0x71d010
y.create.l HWIO_CRYPTO0_CRYPTO_BAM_P_IRQ_STTS7_ADDR A:0x71e010
y.create.l HWIO_CRYPTO0_CRYPTO_BAM_P_IRQ_STTS8_ADDR A:0x71f010
y.create.l HWIO_CRYPTO0_CRYPTO_BAM_P_IRQ_STTS9_ADDR A:0x720010
y.create.l HWIO_CRYPTO0_CRYPTO_BAM_P_IRQ_CLR0_ADDR A:0x717014
y.create.l HWIO_CRYPTO0_CRYPTO_BAM_P_IRQ_CLR1_ADDR A:0x718014
y.create.l HWIO_CRYPTO0_CRYPTO_BAM_P_IRQ_CLR2_ADDR A:0x719014
y.create.l HWIO_CRYPTO0_CRYPTO_BAM_P_IRQ_CLR3_ADDR A:0x71a014
y.create.l HWIO_CRYPTO0_CRYPTO_BAM_P_IRQ_CLR4_ADDR A:0x71b014
y.create.l HWIO_CRYPTO0_CRYPTO_BAM_P_IRQ_CLR5_ADDR A:0x71c014
y.create.l HWIO_CRYPTO0_CRYPTO_BAM_P_IRQ_CLR6_ADDR A:0x71d014
y.create.l HWIO_CRYPTO0_CRYPTO_BAM_P_IRQ_CLR7_ADDR A:0x71e014
y.create.l HWIO_CRYPTO0_CRYPTO_BAM_P_IRQ_CLR8_ADDR A:0x71f014
y.create.l HWIO_CRYPTO0_CRYPTO_BAM_P_IRQ_CLR9_ADDR A:0x720014
y.create.l HWIO_CRYPTO0_CRYPTO_BAM_P_IRQ_EN0_ADDR A:0x717018
y.create.l HWIO_CRYPTO0_CRYPTO_BAM_P_IRQ_EN1_ADDR A:0x718018
y.create.l HWIO_CRYPTO0_CRYPTO_BAM_P_IRQ_EN2_ADDR A:0x719018
y.create.l HWIO_CRYPTO0_CRYPTO_BAM_P_IRQ_EN3_ADDR A:0x71a018
y.create.l HWIO_CRYPTO0_CRYPTO_BAM_P_IRQ_EN4_ADDR A:0x71b018
y.create.l HWIO_CRYPTO0_CRYPTO_BAM_P_IRQ_EN5_ADDR A:0x71c018
y.create.l HWIO_CRYPTO0_CRYPTO_BAM_P_IRQ_EN6_ADDR A:0x71d018
y.create.l HWIO_CRYPTO0_CRYPTO_BAM_P_IRQ_EN7_ADDR A:0x71e018
y.create.l HWIO_CRYPTO0_CRYPTO_BAM_P_IRQ_EN8_ADDR A:0x71f018
y.create.l HWIO_CRYPTO0_CRYPTO_BAM_P_IRQ_EN9_ADDR A:0x720018
y.create.l HWIO_CRYPTO0_CRYPTO_BAM_P_TIMER0_ADDR A:0x71701c
y.create.l HWIO_CRYPTO0_CRYPTO_BAM_P_TIMER1_ADDR A:0x71801c
y.create.l HWIO_CRYPTO0_CRYPTO_BAM_P_TIMER2_ADDR A:0x71901c
y.create.l HWIO_CRYPTO0_CRYPTO_BAM_P_TIMER3_ADDR A:0x71a01c
y.create.l HWIO_CRYPTO0_CRYPTO_BAM_P_TIMER4_ADDR A:0x71b01c
y.create.l HWIO_CRYPTO0_CRYPTO_BAM_P_TIMER5_ADDR A:0x71c01c
y.create.l HWIO_CRYPTO0_CRYPTO_BAM_P_TIMER6_ADDR A:0x71d01c
y.create.l HWIO_CRYPTO0_CRYPTO_BAM_P_TIMER7_ADDR A:0x71e01c
y.create.l HWIO_CRYPTO0_CRYPTO_BAM_P_TIMER8_ADDR A:0x71f01c
y.create.l HWIO_CRYPTO0_CRYPTO_BAM_P_TIMER9_ADDR A:0x72001c
y.create.l HWIO_CRYPTO0_CRYPTO_BAM_P_TIMER_CTRL0_ADDR A:0x717020
y.create.l HWIO_CRYPTO0_CRYPTO_BAM_P_TIMER_CTRL1_ADDR A:0x718020
y.create.l HWIO_CRYPTO0_CRYPTO_BAM_P_TIMER_CTRL2_ADDR A:0x719020
y.create.l HWIO_CRYPTO0_CRYPTO_BAM_P_TIMER_CTRL3_ADDR A:0x71a020
y.create.l HWIO_CRYPTO0_CRYPTO_BAM_P_TIMER_CTRL4_ADDR A:0x71b020
y.create.l HWIO_CRYPTO0_CRYPTO_BAM_P_TIMER_CTRL5_ADDR A:0x71c020
y.create.l HWIO_CRYPTO0_CRYPTO_BAM_P_TIMER_CTRL6_ADDR A:0x71d020
y.create.l HWIO_CRYPTO0_CRYPTO_BAM_P_TIMER_CTRL7_ADDR A:0x71e020
y.create.l HWIO_CRYPTO0_CRYPTO_BAM_P_TIMER_CTRL8_ADDR A:0x71f020
y.create.l HWIO_CRYPTO0_CRYPTO_BAM_P_TIMER_CTRL9_ADDR A:0x720020
y.create.l HWIO_CRYPTO0_CRYPTO_BAM_P_PRDCR_SDBND0_ADDR A:0x717024
y.create.l HWIO_CRYPTO0_CRYPTO_BAM_P_PRDCR_SDBND1_ADDR A:0x718024
y.create.l HWIO_CRYPTO0_CRYPTO_BAM_P_PRDCR_SDBND2_ADDR A:0x719024
y.create.l HWIO_CRYPTO0_CRYPTO_BAM_P_PRDCR_SDBND3_ADDR A:0x71a024
y.create.l HWIO_CRYPTO0_CRYPTO_BAM_P_PRDCR_SDBND4_ADDR A:0x71b024
y.create.l HWIO_CRYPTO0_CRYPTO_BAM_P_PRDCR_SDBND5_ADDR A:0x71c024
y.create.l HWIO_CRYPTO0_CRYPTO_BAM_P_PRDCR_SDBND6_ADDR A:0x71d024
y.create.l HWIO_CRYPTO0_CRYPTO_BAM_P_PRDCR_SDBND7_ADDR A:0x71e024
y.create.l HWIO_CRYPTO0_CRYPTO_BAM_P_PRDCR_SDBND8_ADDR A:0x71f024
y.create.l HWIO_CRYPTO0_CRYPTO_BAM_P_PRDCR_SDBND9_ADDR A:0x720024
y.create.l HWIO_CRYPTO0_CRYPTO_BAM_P_CNSMR_SDBND0_ADDR A:0x717028
y.create.l HWIO_CRYPTO0_CRYPTO_BAM_P_CNSMR_SDBND1_ADDR A:0x718028
y.create.l HWIO_CRYPTO0_CRYPTO_BAM_P_CNSMR_SDBND2_ADDR A:0x719028
y.create.l HWIO_CRYPTO0_CRYPTO_BAM_P_CNSMR_SDBND3_ADDR A:0x71a028
y.create.l HWIO_CRYPTO0_CRYPTO_BAM_P_CNSMR_SDBND4_ADDR A:0x71b028
y.create.l HWIO_CRYPTO0_CRYPTO_BAM_P_CNSMR_SDBND5_ADDR A:0x71c028
y.create.l HWIO_CRYPTO0_CRYPTO_BAM_P_CNSMR_SDBND6_ADDR A:0x71d028
y.create.l HWIO_CRYPTO0_CRYPTO_BAM_P_CNSMR_SDBND7_ADDR A:0x71e028
y.create.l HWIO_CRYPTO0_CRYPTO_BAM_P_CNSMR_SDBND8_ADDR A:0x71f028
y.create.l HWIO_CRYPTO0_CRYPTO_BAM_P_CNSMR_SDBND9_ADDR A:0x720028
y.create.l HWIO_CRYPTO0_CRYPTO_BAM_P_SW_OFSTS0_ADDR A:0x717800
y.create.l HWIO_CRYPTO0_CRYPTO_BAM_P_SW_OFSTS1_ADDR A:0x718800
y.create.l HWIO_CRYPTO0_CRYPTO_BAM_P_SW_OFSTS2_ADDR A:0x719800
y.create.l HWIO_CRYPTO0_CRYPTO_BAM_P_SW_OFSTS3_ADDR A:0x71a800
y.create.l HWIO_CRYPTO0_CRYPTO_BAM_P_SW_OFSTS4_ADDR A:0x71b800
y.create.l HWIO_CRYPTO0_CRYPTO_BAM_P_SW_OFSTS5_ADDR A:0x71c800
y.create.l HWIO_CRYPTO0_CRYPTO_BAM_P_SW_OFSTS6_ADDR A:0x71d800
y.create.l HWIO_CRYPTO0_CRYPTO_BAM_P_SW_OFSTS7_ADDR A:0x71e800
y.create.l HWIO_CRYPTO0_CRYPTO_BAM_P_SW_OFSTS8_ADDR A:0x71f800
y.create.l HWIO_CRYPTO0_CRYPTO_BAM_P_SW_OFSTS9_ADDR A:0x720800
y.create.l HWIO_CRYPTO0_CRYPTO_BAM_P_AU_PSM_CNTXT_1_0_ADDR A:0x717804
y.create.l HWIO_CRYPTO0_CRYPTO_BAM_P_AU_PSM_CNTXT_1_1_ADDR A:0x718804
y.create.l HWIO_CRYPTO0_CRYPTO_BAM_P_AU_PSM_CNTXT_1_2_ADDR A:0x719804
y.create.l HWIO_CRYPTO0_CRYPTO_BAM_P_AU_PSM_CNTXT_1_3_ADDR A:0x71a804
y.create.l HWIO_CRYPTO0_CRYPTO_BAM_P_AU_PSM_CNTXT_1_4_ADDR A:0x71b804
y.create.l HWIO_CRYPTO0_CRYPTO_BAM_P_AU_PSM_CNTXT_1_5_ADDR A:0x71c804
y.create.l HWIO_CRYPTO0_CRYPTO_BAM_P_AU_PSM_CNTXT_1_6_ADDR A:0x71d804
y.create.l HWIO_CRYPTO0_CRYPTO_BAM_P_AU_PSM_CNTXT_1_7_ADDR A:0x71e804
y.create.l HWIO_CRYPTO0_CRYPTO_BAM_P_AU_PSM_CNTXT_1_8_ADDR A:0x71f804
y.create.l HWIO_CRYPTO0_CRYPTO_BAM_P_AU_PSM_CNTXT_1_9_ADDR A:0x720804
y.create.l HWIO_CRYPTO0_CRYPTO_BAM_P_PSM_CNTXT_2_0_ADDR A:0x717808
y.create.l HWIO_CRYPTO0_CRYPTO_BAM_P_PSM_CNTXT_2_1_ADDR A:0x718808
y.create.l HWIO_CRYPTO0_CRYPTO_BAM_P_PSM_CNTXT_2_2_ADDR A:0x719808
y.create.l HWIO_CRYPTO0_CRYPTO_BAM_P_PSM_CNTXT_2_3_ADDR A:0x71a808
y.create.l HWIO_CRYPTO0_CRYPTO_BAM_P_PSM_CNTXT_2_4_ADDR A:0x71b808
y.create.l HWIO_CRYPTO0_CRYPTO_BAM_P_PSM_CNTXT_2_5_ADDR A:0x71c808
y.create.l HWIO_CRYPTO0_CRYPTO_BAM_P_PSM_CNTXT_2_6_ADDR A:0x71d808
y.create.l HWIO_CRYPTO0_CRYPTO_BAM_P_PSM_CNTXT_2_7_ADDR A:0x71e808
y.create.l HWIO_CRYPTO0_CRYPTO_BAM_P_PSM_CNTXT_2_8_ADDR A:0x71f808
y.create.l HWIO_CRYPTO0_CRYPTO_BAM_P_PSM_CNTXT_2_9_ADDR A:0x720808
y.create.l HWIO_CRYPTO0_CRYPTO_BAM_P_PSM_CNTXT_3_0_ADDR A:0x71780c
y.create.l HWIO_CRYPTO0_CRYPTO_BAM_P_PSM_CNTXT_3_1_ADDR A:0x71880c
y.create.l HWIO_CRYPTO0_CRYPTO_BAM_P_PSM_CNTXT_3_2_ADDR A:0x71980c
y.create.l HWIO_CRYPTO0_CRYPTO_BAM_P_PSM_CNTXT_3_3_ADDR A:0x71a80c
y.create.l HWIO_CRYPTO0_CRYPTO_BAM_P_PSM_CNTXT_3_4_ADDR A:0x71b80c
y.create.l HWIO_CRYPTO0_CRYPTO_BAM_P_PSM_CNTXT_3_5_ADDR A:0x71c80c
y.create.l HWIO_CRYPTO0_CRYPTO_BAM_P_PSM_CNTXT_3_6_ADDR A:0x71d80c
y.create.l HWIO_CRYPTO0_CRYPTO_BAM_P_PSM_CNTXT_3_7_ADDR A:0x71e80c
y.create.l HWIO_CRYPTO0_CRYPTO_BAM_P_PSM_CNTXT_3_8_ADDR A:0x71f80c
y.create.l HWIO_CRYPTO0_CRYPTO_BAM_P_PSM_CNTXT_3_9_ADDR A:0x72080c
y.create.l HWIO_CRYPTO0_CRYPTO_BAM_P_PSM_CNTXT_4_0_ADDR A:0x717810
y.create.l HWIO_CRYPTO0_CRYPTO_BAM_P_PSM_CNTXT_4_1_ADDR A:0x718810
y.create.l HWIO_CRYPTO0_CRYPTO_BAM_P_PSM_CNTXT_4_2_ADDR A:0x719810
y.create.l HWIO_CRYPTO0_CRYPTO_BAM_P_PSM_CNTXT_4_3_ADDR A:0x71a810
y.create.l HWIO_CRYPTO0_CRYPTO_BAM_P_PSM_CNTXT_4_4_ADDR A:0x71b810
y.create.l HWIO_CRYPTO0_CRYPTO_BAM_P_PSM_CNTXT_4_5_ADDR A:0x71c810
y.create.l HWIO_CRYPTO0_CRYPTO_BAM_P_PSM_CNTXT_4_6_ADDR A:0x71d810
y.create.l HWIO_CRYPTO0_CRYPTO_BAM_P_PSM_CNTXT_4_7_ADDR A:0x71e810
y.create.l HWIO_CRYPTO0_CRYPTO_BAM_P_PSM_CNTXT_4_8_ADDR A:0x71f810
y.create.l HWIO_CRYPTO0_CRYPTO_BAM_P_PSM_CNTXT_4_9_ADDR A:0x720810
y.create.l HWIO_CRYPTO0_CRYPTO_BAM_P_PSM_CNTXT_5_0_ADDR A:0x717814
y.create.l HWIO_CRYPTO0_CRYPTO_BAM_P_PSM_CNTXT_5_1_ADDR A:0x718814
y.create.l HWIO_CRYPTO0_CRYPTO_BAM_P_PSM_CNTXT_5_2_ADDR A:0x719814
y.create.l HWIO_CRYPTO0_CRYPTO_BAM_P_PSM_CNTXT_5_3_ADDR A:0x71a814
y.create.l HWIO_CRYPTO0_CRYPTO_BAM_P_PSM_CNTXT_5_4_ADDR A:0x71b814
y.create.l HWIO_CRYPTO0_CRYPTO_BAM_P_PSM_CNTXT_5_5_ADDR A:0x71c814
y.create.l HWIO_CRYPTO0_CRYPTO_BAM_P_PSM_CNTXT_5_6_ADDR A:0x71d814
y.create.l HWIO_CRYPTO0_CRYPTO_BAM_P_PSM_CNTXT_5_7_ADDR A:0x71e814
y.create.l HWIO_CRYPTO0_CRYPTO_BAM_P_PSM_CNTXT_5_8_ADDR A:0x71f814
y.create.l HWIO_CRYPTO0_CRYPTO_BAM_P_PSM_CNTXT_5_9_ADDR A:0x720814
y.create.l HWIO_CRYPTO0_CRYPTO_BAM_P_EVNT_REG0_ADDR A:0x717818
y.create.l HWIO_CRYPTO0_CRYPTO_BAM_P_EVNT_REG1_ADDR A:0x718818
y.create.l HWIO_CRYPTO0_CRYPTO_BAM_P_EVNT_REG2_ADDR A:0x719818
y.create.l HWIO_CRYPTO0_CRYPTO_BAM_P_EVNT_REG3_ADDR A:0x71a818
y.create.l HWIO_CRYPTO0_CRYPTO_BAM_P_EVNT_REG4_ADDR A:0x71b818
y.create.l HWIO_CRYPTO0_CRYPTO_BAM_P_EVNT_REG5_ADDR A:0x71c818
y.create.l HWIO_CRYPTO0_CRYPTO_BAM_P_EVNT_REG6_ADDR A:0x71d818
y.create.l HWIO_CRYPTO0_CRYPTO_BAM_P_EVNT_REG7_ADDR A:0x71e818
y.create.l HWIO_CRYPTO0_CRYPTO_BAM_P_EVNT_REG8_ADDR A:0x71f818
y.create.l HWIO_CRYPTO0_CRYPTO_BAM_P_EVNT_REG9_ADDR A:0x720818
y.create.l HWIO_CRYPTO0_CRYPTO_BAM_P_DESC_FIFO_ADDR0_ADDR A:0x71781c
y.create.l HWIO_CRYPTO0_CRYPTO_BAM_P_DESC_FIFO_ADDR1_ADDR A:0x71881c
y.create.l HWIO_CRYPTO0_CRYPTO_BAM_P_DESC_FIFO_ADDR2_ADDR A:0x71981c
y.create.l HWIO_CRYPTO0_CRYPTO_BAM_P_DESC_FIFO_ADDR3_ADDR A:0x71a81c
y.create.l HWIO_CRYPTO0_CRYPTO_BAM_P_DESC_FIFO_ADDR4_ADDR A:0x71b81c
y.create.l HWIO_CRYPTO0_CRYPTO_BAM_P_DESC_FIFO_ADDR5_ADDR A:0x71c81c
y.create.l HWIO_CRYPTO0_CRYPTO_BAM_P_DESC_FIFO_ADDR6_ADDR A:0x71d81c
y.create.l HWIO_CRYPTO0_CRYPTO_BAM_P_DESC_FIFO_ADDR7_ADDR A:0x71e81c
y.create.l HWIO_CRYPTO0_CRYPTO_BAM_P_DESC_FIFO_ADDR8_ADDR A:0x71f81c
y.create.l HWIO_CRYPTO0_CRYPTO_BAM_P_DESC_FIFO_ADDR9_ADDR A:0x72081c
y.create.l HWIO_CRYPTO0_CRYPTO_BAM_P_FIFO_SIZES0_ADDR A:0x717820
y.create.l HWIO_CRYPTO0_CRYPTO_BAM_P_FIFO_SIZES1_ADDR A:0x718820
y.create.l HWIO_CRYPTO0_CRYPTO_BAM_P_FIFO_SIZES2_ADDR A:0x719820
y.create.l HWIO_CRYPTO0_CRYPTO_BAM_P_FIFO_SIZES3_ADDR A:0x71a820
y.create.l HWIO_CRYPTO0_CRYPTO_BAM_P_FIFO_SIZES4_ADDR A:0x71b820
y.create.l HWIO_CRYPTO0_CRYPTO_BAM_P_FIFO_SIZES5_ADDR A:0x71c820
y.create.l HWIO_CRYPTO0_CRYPTO_BAM_P_FIFO_SIZES6_ADDR A:0x71d820
y.create.l HWIO_CRYPTO0_CRYPTO_BAM_P_FIFO_SIZES7_ADDR A:0x71e820
y.create.l HWIO_CRYPTO0_CRYPTO_BAM_P_FIFO_SIZES8_ADDR A:0x71f820
y.create.l HWIO_CRYPTO0_CRYPTO_BAM_P_FIFO_SIZES9_ADDR A:0x720820
y.create.l HWIO_CRYPTO0_CRYPTO_BAM_P_DATA_FIFO_ADDR0_ADDR A:0x717824
y.create.l HWIO_CRYPTO0_CRYPTO_BAM_P_DATA_FIFO_ADDR1_ADDR A:0x718824
y.create.l HWIO_CRYPTO0_CRYPTO_BAM_P_DATA_FIFO_ADDR2_ADDR A:0x719824
y.create.l HWIO_CRYPTO0_CRYPTO_BAM_P_DATA_FIFO_ADDR3_ADDR A:0x71a824
y.create.l HWIO_CRYPTO0_CRYPTO_BAM_P_DATA_FIFO_ADDR4_ADDR A:0x71b824
y.create.l HWIO_CRYPTO0_CRYPTO_BAM_P_DATA_FIFO_ADDR5_ADDR A:0x71c824
y.create.l HWIO_CRYPTO0_CRYPTO_BAM_P_DATA_FIFO_ADDR6_ADDR A:0x71d824
y.create.l HWIO_CRYPTO0_CRYPTO_BAM_P_DATA_FIFO_ADDR7_ADDR A:0x71e824
y.create.l HWIO_CRYPTO0_CRYPTO_BAM_P_DATA_FIFO_ADDR8_ADDR A:0x71f824
y.create.l HWIO_CRYPTO0_CRYPTO_BAM_P_DATA_FIFO_ADDR9_ADDR A:0x720824
y.create.l HWIO_CRYPTO0_CRYPTO_BAM_P_EVNT_GEN_TRSHLD0_ADDR A:0x717828
y.create.l HWIO_CRYPTO0_CRYPTO_BAM_P_EVNT_GEN_TRSHLD1_ADDR A:0x718828
y.create.l HWIO_CRYPTO0_CRYPTO_BAM_P_EVNT_GEN_TRSHLD2_ADDR A:0x719828
y.create.l HWIO_CRYPTO0_CRYPTO_BAM_P_EVNT_GEN_TRSHLD3_ADDR A:0x71a828
y.create.l HWIO_CRYPTO0_CRYPTO_BAM_P_EVNT_GEN_TRSHLD4_ADDR A:0x71b828
y.create.l HWIO_CRYPTO0_CRYPTO_BAM_P_EVNT_GEN_TRSHLD5_ADDR A:0x71c828
y.create.l HWIO_CRYPTO0_CRYPTO_BAM_P_EVNT_GEN_TRSHLD6_ADDR A:0x71d828
y.create.l HWIO_CRYPTO0_CRYPTO_BAM_P_EVNT_GEN_TRSHLD7_ADDR A:0x71e828
y.create.l HWIO_CRYPTO0_CRYPTO_BAM_P_EVNT_GEN_TRSHLD8_ADDR A:0x71f828
y.create.l HWIO_CRYPTO0_CRYPTO_BAM_P_EVNT_GEN_TRSHLD9_ADDR A:0x720828
y.create.l HWIO_CRYPTO0_CRYPTO_BAM_P_EVNT_DEST_ADDR0_ADDR A:0x71782c
y.create.l HWIO_CRYPTO0_CRYPTO_BAM_P_EVNT_DEST_ADDR1_ADDR A:0x71882c
y.create.l HWIO_CRYPTO0_CRYPTO_BAM_P_EVNT_DEST_ADDR2_ADDR A:0x71982c
y.create.l HWIO_CRYPTO0_CRYPTO_BAM_P_EVNT_DEST_ADDR3_ADDR A:0x71a82c
y.create.l HWIO_CRYPTO0_CRYPTO_BAM_P_EVNT_DEST_ADDR4_ADDR A:0x71b82c
y.create.l HWIO_CRYPTO0_CRYPTO_BAM_P_EVNT_DEST_ADDR5_ADDR A:0x71c82c
y.create.l HWIO_CRYPTO0_CRYPTO_BAM_P_EVNT_DEST_ADDR6_ADDR A:0x71d82c
y.create.l HWIO_CRYPTO0_CRYPTO_BAM_P_EVNT_DEST_ADDR7_ADDR A:0x71e82c
y.create.l HWIO_CRYPTO0_CRYPTO_BAM_P_EVNT_DEST_ADDR8_ADDR A:0x71f82c
y.create.l HWIO_CRYPTO0_CRYPTO_BAM_P_EVNT_DEST_ADDR9_ADDR A:0x72082c
y.create.l HWIO_CRYPTO0_CRYPTO_BAM_P_DF_CNTXT_0_ADDR A:0x717830
y.create.l HWIO_CRYPTO0_CRYPTO_BAM_P_DF_CNTXT_1_ADDR A:0x718830
y.create.l HWIO_CRYPTO0_CRYPTO_BAM_P_DF_CNTXT_2_ADDR A:0x719830
y.create.l HWIO_CRYPTO0_CRYPTO_BAM_P_DF_CNTXT_3_ADDR A:0x71a830
y.create.l HWIO_CRYPTO0_CRYPTO_BAM_P_DF_CNTXT_4_ADDR A:0x71b830
y.create.l HWIO_CRYPTO0_CRYPTO_BAM_P_DF_CNTXT_5_ADDR A:0x71c830
y.create.l HWIO_CRYPTO0_CRYPTO_BAM_P_DF_CNTXT_6_ADDR A:0x71d830
y.create.l HWIO_CRYPTO0_CRYPTO_BAM_P_DF_CNTXT_7_ADDR A:0x71e830
y.create.l HWIO_CRYPTO0_CRYPTO_BAM_P_DF_CNTXT_8_ADDR A:0x71f830
y.create.l HWIO_CRYPTO0_CRYPTO_BAM_P_DF_CNTXT_9_ADDR A:0x720830
y.create.l HWIO_CRYPTO0_CRYPTO_BAM_P_RETR_CNTXT_0_ADDR A:0x717834
y.create.l HWIO_CRYPTO0_CRYPTO_BAM_P_RETR_CNTXT_1_ADDR A:0x718834
y.create.l HWIO_CRYPTO0_CRYPTO_BAM_P_RETR_CNTXT_2_ADDR A:0x719834
y.create.l HWIO_CRYPTO0_CRYPTO_BAM_P_RETR_CNTXT_3_ADDR A:0x71a834
y.create.l HWIO_CRYPTO0_CRYPTO_BAM_P_RETR_CNTXT_4_ADDR A:0x71b834
y.create.l HWIO_CRYPTO0_CRYPTO_BAM_P_RETR_CNTXT_5_ADDR A:0x71c834
y.create.l HWIO_CRYPTO0_CRYPTO_BAM_P_RETR_CNTXT_6_ADDR A:0x71d834
y.create.l HWIO_CRYPTO0_CRYPTO_BAM_P_RETR_CNTXT_7_ADDR A:0x71e834
y.create.l HWIO_CRYPTO0_CRYPTO_BAM_P_RETR_CNTXT_8_ADDR A:0x71f834
y.create.l HWIO_CRYPTO0_CRYPTO_BAM_P_RETR_CNTXT_9_ADDR A:0x720834
y.create.l HWIO_CRYPTO0_CRYPTO_BAM_P_SI_CNTXT_0_ADDR A:0x717838
y.create.l HWIO_CRYPTO0_CRYPTO_BAM_P_SI_CNTXT_1_ADDR A:0x718838
y.create.l HWIO_CRYPTO0_CRYPTO_BAM_P_SI_CNTXT_2_ADDR A:0x719838
y.create.l HWIO_CRYPTO0_CRYPTO_BAM_P_SI_CNTXT_3_ADDR A:0x71a838
y.create.l HWIO_CRYPTO0_CRYPTO_BAM_P_SI_CNTXT_4_ADDR A:0x71b838
y.create.l HWIO_CRYPTO0_CRYPTO_BAM_P_SI_CNTXT_5_ADDR A:0x71c838
y.create.l HWIO_CRYPTO0_CRYPTO_BAM_P_SI_CNTXT_6_ADDR A:0x71d838
y.create.l HWIO_CRYPTO0_CRYPTO_BAM_P_SI_CNTXT_7_ADDR A:0x71e838
y.create.l HWIO_CRYPTO0_CRYPTO_BAM_P_SI_CNTXT_8_ADDR A:0x71f838
y.create.l HWIO_CRYPTO0_CRYPTO_BAM_P_SI_CNTXT_9_ADDR A:0x720838
y.create.l HWIO_CRYPTO0_CRYPTO_BAM_P_PSM_CNTXT_3_LSB0_ADDR A:0x717900
y.create.l HWIO_CRYPTO0_CRYPTO_BAM_P_PSM_CNTXT_3_LSB1_ADDR A:0x718900
y.create.l HWIO_CRYPTO0_CRYPTO_BAM_P_PSM_CNTXT_3_LSB2_ADDR A:0x719900
y.create.l HWIO_CRYPTO0_CRYPTO_BAM_P_PSM_CNTXT_3_LSB3_ADDR A:0x71a900
y.create.l HWIO_CRYPTO0_CRYPTO_BAM_P_PSM_CNTXT_3_LSB4_ADDR A:0x71b900
y.create.l HWIO_CRYPTO0_CRYPTO_BAM_P_PSM_CNTXT_3_LSB5_ADDR A:0x71c900
y.create.l HWIO_CRYPTO0_CRYPTO_BAM_P_PSM_CNTXT_3_LSB6_ADDR A:0x71d900
y.create.l HWIO_CRYPTO0_CRYPTO_BAM_P_PSM_CNTXT_3_LSB7_ADDR A:0x71e900
y.create.l HWIO_CRYPTO0_CRYPTO_BAM_P_PSM_CNTXT_3_LSB8_ADDR A:0x71f900
y.create.l HWIO_CRYPTO0_CRYPTO_BAM_P_PSM_CNTXT_3_LSB9_ADDR A:0x720900
y.create.l HWIO_CRYPTO0_CRYPTO_BAM_P_PSM_CNTXT_3_MSB0_ADDR A:0x717904
y.create.l HWIO_CRYPTO0_CRYPTO_BAM_P_PSM_CNTXT_3_MSB1_ADDR A:0x718904
y.create.l HWIO_CRYPTO0_CRYPTO_BAM_P_PSM_CNTXT_3_MSB2_ADDR A:0x719904
y.create.l HWIO_CRYPTO0_CRYPTO_BAM_P_PSM_CNTXT_3_MSB3_ADDR A:0x71a904
y.create.l HWIO_CRYPTO0_CRYPTO_BAM_P_PSM_CNTXT_3_MSB4_ADDR A:0x71b904
y.create.l HWIO_CRYPTO0_CRYPTO_BAM_P_PSM_CNTXT_3_MSB5_ADDR A:0x71c904
y.create.l HWIO_CRYPTO0_CRYPTO_BAM_P_PSM_CNTXT_3_MSB6_ADDR A:0x71d904
y.create.l HWIO_CRYPTO0_CRYPTO_BAM_P_PSM_CNTXT_3_MSB7_ADDR A:0x71e904
y.create.l HWIO_CRYPTO0_CRYPTO_BAM_P_PSM_CNTXT_3_MSB8_ADDR A:0x71f904
y.create.l HWIO_CRYPTO0_CRYPTO_BAM_P_PSM_CNTXT_3_MSB9_ADDR A:0x720904
y.create.l HWIO_CRYPTO0_CRYPTO_BAM_P_DESC_FIFO_ADDR_LSB0_ADDR A:0x717910
y.create.l HWIO_CRYPTO0_CRYPTO_BAM_P_DESC_FIFO_ADDR_LSB1_ADDR A:0x718910
y.create.l HWIO_CRYPTO0_CRYPTO_BAM_P_DESC_FIFO_ADDR_LSB2_ADDR A:0x719910
y.create.l HWIO_CRYPTO0_CRYPTO_BAM_P_DESC_FIFO_ADDR_LSB3_ADDR A:0x71a910
y.create.l HWIO_CRYPTO0_CRYPTO_BAM_P_DESC_FIFO_ADDR_LSB4_ADDR A:0x71b910
y.create.l HWIO_CRYPTO0_CRYPTO_BAM_P_DESC_FIFO_ADDR_LSB5_ADDR A:0x71c910
y.create.l HWIO_CRYPTO0_CRYPTO_BAM_P_DESC_FIFO_ADDR_LSB6_ADDR A:0x71d910
y.create.l HWIO_CRYPTO0_CRYPTO_BAM_P_DESC_FIFO_ADDR_LSB7_ADDR A:0x71e910
y.create.l HWIO_CRYPTO0_CRYPTO_BAM_P_DESC_FIFO_ADDR_LSB8_ADDR A:0x71f910
y.create.l HWIO_CRYPTO0_CRYPTO_BAM_P_DESC_FIFO_ADDR_LSB9_ADDR A:0x720910
y.create.l HWIO_CRYPTO0_CRYPTO_BAM_P_DESC_FIFO_ADDR_MSB0_ADDR A:0x717914
y.create.l HWIO_CRYPTO0_CRYPTO_BAM_P_DESC_FIFO_ADDR_MSB1_ADDR A:0x718914
y.create.l HWIO_CRYPTO0_CRYPTO_BAM_P_DESC_FIFO_ADDR_MSB2_ADDR A:0x719914
y.create.l HWIO_CRYPTO0_CRYPTO_BAM_P_DESC_FIFO_ADDR_MSB3_ADDR A:0x71a914
y.create.l HWIO_CRYPTO0_CRYPTO_BAM_P_DESC_FIFO_ADDR_MSB4_ADDR A:0x71b914
y.create.l HWIO_CRYPTO0_CRYPTO_BAM_P_DESC_FIFO_ADDR_MSB5_ADDR A:0x71c914
y.create.l HWIO_CRYPTO0_CRYPTO_BAM_P_DESC_FIFO_ADDR_MSB6_ADDR A:0x71d914
y.create.l HWIO_CRYPTO0_CRYPTO_BAM_P_DESC_FIFO_ADDR_MSB7_ADDR A:0x71e914
y.create.l HWIO_CRYPTO0_CRYPTO_BAM_P_DESC_FIFO_ADDR_MSB8_ADDR A:0x71f914
y.create.l HWIO_CRYPTO0_CRYPTO_BAM_P_DESC_FIFO_ADDR_MSB9_ADDR A:0x720914
y.create.l HWIO_CRYPTO0_CRYPTO_BAM_P_DATA_FIFO_ADDR_LSB0_ADDR A:0x717920
y.create.l HWIO_CRYPTO0_CRYPTO_BAM_P_DATA_FIFO_ADDR_LSB1_ADDR A:0x718920
y.create.l HWIO_CRYPTO0_CRYPTO_BAM_P_DATA_FIFO_ADDR_LSB2_ADDR A:0x719920
y.create.l HWIO_CRYPTO0_CRYPTO_BAM_P_DATA_FIFO_ADDR_LSB3_ADDR A:0x71a920
y.create.l HWIO_CRYPTO0_CRYPTO_BAM_P_DATA_FIFO_ADDR_LSB4_ADDR A:0x71b920
y.create.l HWIO_CRYPTO0_CRYPTO_BAM_P_DATA_FIFO_ADDR_LSB5_ADDR A:0x71c920
y.create.l HWIO_CRYPTO0_CRYPTO_BAM_P_DATA_FIFO_ADDR_LSB6_ADDR A:0x71d920
y.create.l HWIO_CRYPTO0_CRYPTO_BAM_P_DATA_FIFO_ADDR_LSB7_ADDR A:0x71e920
y.create.l HWIO_CRYPTO0_CRYPTO_BAM_P_DATA_FIFO_ADDR_LSB8_ADDR A:0x71f920
y.create.l HWIO_CRYPTO0_CRYPTO_BAM_P_DATA_FIFO_ADDR_LSB9_ADDR A:0x720920
y.create.l HWIO_CRYPTO0_CRYPTO_BAM_P_DATA_FIFO_ADDR_MSB0_ADDR A:0x717924
y.create.l HWIO_CRYPTO0_CRYPTO_BAM_P_DATA_FIFO_ADDR_MSB1_ADDR A:0x718924
y.create.l HWIO_CRYPTO0_CRYPTO_BAM_P_DATA_FIFO_ADDR_MSB2_ADDR A:0x719924
y.create.l HWIO_CRYPTO0_CRYPTO_BAM_P_DATA_FIFO_ADDR_MSB3_ADDR A:0x71a924
y.create.l HWIO_CRYPTO0_CRYPTO_BAM_P_DATA_FIFO_ADDR_MSB4_ADDR A:0x71b924
y.create.l HWIO_CRYPTO0_CRYPTO_BAM_P_DATA_FIFO_ADDR_MSB5_ADDR A:0x71c924
y.create.l HWIO_CRYPTO0_CRYPTO_BAM_P_DATA_FIFO_ADDR_MSB6_ADDR A:0x71d924
y.create.l HWIO_CRYPTO0_CRYPTO_BAM_P_DATA_FIFO_ADDR_MSB7_ADDR A:0x71e924
y.create.l HWIO_CRYPTO0_CRYPTO_BAM_P_DATA_FIFO_ADDR_MSB8_ADDR A:0x71f924
y.create.l HWIO_CRYPTO0_CRYPTO_BAM_P_DATA_FIFO_ADDR_MSB9_ADDR A:0x720924
y.create.l HWIO_CRYPTO0_CRYPTO_BAM_P_EVNT_DEST_ADDR_LSB0_ADDR A:0x717930
y.create.l HWIO_CRYPTO0_CRYPTO_BAM_P_EVNT_DEST_ADDR_LSB1_ADDR A:0x718930
y.create.l HWIO_CRYPTO0_CRYPTO_BAM_P_EVNT_DEST_ADDR_LSB2_ADDR A:0x719930
y.create.l HWIO_CRYPTO0_CRYPTO_BAM_P_EVNT_DEST_ADDR_LSB3_ADDR A:0x71a930
y.create.l HWIO_CRYPTO0_CRYPTO_BAM_P_EVNT_DEST_ADDR_LSB4_ADDR A:0x71b930
y.create.l HWIO_CRYPTO0_CRYPTO_BAM_P_EVNT_DEST_ADDR_LSB5_ADDR A:0x71c930
y.create.l HWIO_CRYPTO0_CRYPTO_BAM_P_EVNT_DEST_ADDR_LSB6_ADDR A:0x71d930
y.create.l HWIO_CRYPTO0_CRYPTO_BAM_P_EVNT_DEST_ADDR_LSB7_ADDR A:0x71e930
y.create.l HWIO_CRYPTO0_CRYPTO_BAM_P_EVNT_DEST_ADDR_LSB8_ADDR A:0x71f930
y.create.l HWIO_CRYPTO0_CRYPTO_BAM_P_EVNT_DEST_ADDR_LSB9_ADDR A:0x720930
y.create.l HWIO_CRYPTO0_CRYPTO_BAM_P_EVNT_DEST_ADDR_MSB0_ADDR A:0x717934
y.create.l HWIO_CRYPTO0_CRYPTO_BAM_P_EVNT_DEST_ADDR_MSB1_ADDR A:0x718934
y.create.l HWIO_CRYPTO0_CRYPTO_BAM_P_EVNT_DEST_ADDR_MSB2_ADDR A:0x719934
y.create.l HWIO_CRYPTO0_CRYPTO_BAM_P_EVNT_DEST_ADDR_MSB3_ADDR A:0x71a934
y.create.l HWIO_CRYPTO0_CRYPTO_BAM_P_EVNT_DEST_ADDR_MSB4_ADDR A:0x71b934
y.create.l HWIO_CRYPTO0_CRYPTO_BAM_P_EVNT_DEST_ADDR_MSB5_ADDR A:0x71c934
y.create.l HWIO_CRYPTO0_CRYPTO_BAM_P_EVNT_DEST_ADDR_MSB6_ADDR A:0x71d934
y.create.l HWIO_CRYPTO0_CRYPTO_BAM_P_EVNT_DEST_ADDR_MSB7_ADDR A:0x71e934
y.create.l HWIO_CRYPTO0_CRYPTO_BAM_P_EVNT_DEST_ADDR_MSB8_ADDR A:0x71f934
y.create.l HWIO_CRYPTO0_CRYPTO_BAM_P_EVNT_DEST_ADDR_MSB9_ADDR A:0x720934
y.create.l HWIO_CRYPTO0_CRYPTO_BAM_XPU2_BAM_REG_BASE_START_ADDR A:0x702000
y.create.l HWIO_CRYPTO0_CRYPTO_BAM_XPU2_BAM_REG_BASE_LAST_ADDR A:0x703054
y.create.l HWIO_CRYPTO0_CRYPTO_BAM_XPU2_BAM_REG_BASE_END_ADDR A:0x704000
y.create.l HWIO_CRYPTO0_CRYPTO_BAM_XPU_SCR_ADDR A:0x702000
y.create.l HWIO_CRYPTO0_CRYPTO_BAM_XPU_SWDR_ADDR A:0x702004
y.create.l HWIO_CRYPTO0_CRYPTO_BAM_XPU_SEAR0_ADDR A:0x702040
y.create.l HWIO_CRYPTO0_CRYPTO_BAM_XPU_SESR_ADDR A:0x702048
y.create.l HWIO_CRYPTO0_CRYPTO_BAM_XPU_SESRRESTORE_ADDR A:0x70204c
y.create.l HWIO_CRYPTO0_CRYPTO_BAM_XPU_SESYNR0_ADDR A:0x702050
y.create.l HWIO_CRYPTO0_CRYPTO_BAM_XPU_SESYNR1_ADDR A:0x702054
y.create.l HWIO_CRYPTO0_CRYPTO_BAM_XPU_SESYNR2_ADDR A:0x702058
y.create.l HWIO_CRYPTO0_CRYPTO_BAM_XPU_MCR_ADDR A:0x702100
y.create.l HWIO_CRYPTO0_CRYPTO_BAM_XPU_MEAR0_ADDR A:0x702140
y.create.l HWIO_CRYPTO0_CRYPTO_BAM_XPU_MESR_ADDR A:0x702148
y.create.l HWIO_CRYPTO0_CRYPTO_BAM_XPU_MESRRESTORE_ADDR A:0x70214c
y.create.l HWIO_CRYPTO0_CRYPTO_BAM_XPU_MESYNR0_ADDR A:0x702150
y.create.l HWIO_CRYPTO0_CRYPTO_BAM_XPU_MESYNR1_ADDR A:0x702154
y.create.l HWIO_CRYPTO0_CRYPTO_BAM_XPU_MESYNR2_ADDR A:0x702158
y.create.l HWIO_CRYPTO0_CRYPTO_BAM_XPU_CR_ADDR A:0x702080
y.create.l HWIO_CRYPTO0_CRYPTO_BAM_XPU_RPU_ACR0_ADDR A:0x7020a0
y.create.l HWIO_CRYPTO0_CRYPTO_BAM_XPU_EAR0_ADDR A:0x7020c0
y.create.l HWIO_CRYPTO0_CRYPTO_BAM_XPU_ESR_ADDR A:0x7020c8
y.create.l HWIO_CRYPTO0_CRYPTO_BAM_XPU_ESRRESTORE_ADDR A:0x7020cc
y.create.l HWIO_CRYPTO0_CRYPTO_BAM_XPU_ESYNR0_ADDR A:0x7020d0
y.create.l HWIO_CRYPTO0_CRYPTO_BAM_XPU_ESYNR1_ADDR A:0x7020d4
y.create.l HWIO_CRYPTO0_CRYPTO_BAM_XPU_ESYNR2_ADDR A:0x7020d8
y.create.l HWIO_CRYPTO0_CRYPTO_BAM_XPU_IDR0_ADDR A:0x702074
y.create.l HWIO_CRYPTO0_CRYPTO_BAM_XPU_IDR1_ADDR A:0x702078
y.create.l HWIO_CRYPTO0_CRYPTO_BAM_XPU_REV_ADDR A:0x70207c
y.create.l HWIO_CRYPTO0_CRYPTO_BAM_XPU_RG0_RACR0_ADDR A:0x702200
y.create.l HWIO_CRYPTO0_CRYPTO_BAM_XPU_RG1_RACR0_ADDR A:0x702280
y.create.l HWIO_CRYPTO0_CRYPTO_BAM_XPU_RG2_RACR0_ADDR A:0x702300
y.create.l HWIO_CRYPTO0_CRYPTO_BAM_XPU_RG3_RACR0_ADDR A:0x702380
y.create.l HWIO_CRYPTO0_CRYPTO_BAM_XPU_RG4_RACR0_ADDR A:0x702400
y.create.l HWIO_CRYPTO0_CRYPTO_BAM_XPU_RG5_RACR0_ADDR A:0x702480
y.create.l HWIO_CRYPTO0_CRYPTO_BAM_XPU_RG6_RACR0_ADDR A:0x702500
y.create.l HWIO_CRYPTO0_CRYPTO_BAM_XPU_RG7_RACR0_ADDR A:0x702580
y.create.l HWIO_CRYPTO0_CRYPTO_BAM_XPU_RG8_RACR0_ADDR A:0x702600
y.create.l HWIO_CRYPTO0_CRYPTO_BAM_XPU_RG9_RACR0_ADDR A:0x702680
y.create.l HWIO_CRYPTO0_CRYPTO_BAM_XPU_RG0_SCR_ADDR A:0x702250
y.create.l HWIO_CRYPTO0_CRYPTO_BAM_XPU_RG1_SCR_ADDR A:0x7022d0
y.create.l HWIO_CRYPTO0_CRYPTO_BAM_XPU_RG2_SCR_ADDR A:0x702350
y.create.l HWIO_CRYPTO0_CRYPTO_BAM_XPU_RG3_SCR_ADDR A:0x7023d0
y.create.l HWIO_CRYPTO0_CRYPTO_BAM_XPU_RG4_SCR_ADDR A:0x702450
y.create.l HWIO_CRYPTO0_CRYPTO_BAM_XPU_RG5_SCR_ADDR A:0x7024d0
y.create.l HWIO_CRYPTO0_CRYPTO_BAM_XPU_RG6_SCR_ADDR A:0x702550
y.create.l HWIO_CRYPTO0_CRYPTO_BAM_XPU_RG7_SCR_ADDR A:0x7025d0
y.create.l HWIO_CRYPTO0_CRYPTO_BAM_XPU_RG8_SCR_ADDR A:0x702650
y.create.l HWIO_CRYPTO0_CRYPTO_BAM_XPU_RG9_SCR_ADDR A:0x7026d0
y.create.l HWIO_CRYPTO0_CRYPTO_BAM_XPU_RG0_MCR_ADDR A:0x702254
y.create.l HWIO_CRYPTO0_CRYPTO_BAM_XPU_RG1_MCR_ADDR A:0x7022d4
y.create.l HWIO_CRYPTO0_CRYPTO_BAM_XPU_RG2_MCR_ADDR A:0x702354
y.create.l HWIO_CRYPTO0_CRYPTO_BAM_XPU_RG3_MCR_ADDR A:0x7023d4
y.create.l HWIO_CRYPTO0_CRYPTO_BAM_XPU_RG4_MCR_ADDR A:0x702454
y.create.l HWIO_CRYPTO0_CRYPTO_BAM_XPU_RG5_MCR_ADDR A:0x7024d4
y.create.l HWIO_CRYPTO0_CRYPTO_BAM_XPU_RG6_MCR_ADDR A:0x702554
y.create.l HWIO_CRYPTO0_CRYPTO_BAM_XPU_RG7_MCR_ADDR A:0x7025d4
y.create.l HWIO_CRYPTO0_CRYPTO_BAM_XPU_RG8_MCR_ADDR A:0x702654
y.create.l HWIO_CRYPTO0_CRYPTO_BAM_XPU_RG9_MCR_ADDR A:0x7026d4
y.create.l HWIO_CRYPTO0_CRYPTO_BAM_VMIDMT_BAM_REG_BASE_START_ADDR A:0x700000
y.create.l HWIO_CRYPTO0_CRYPTO_BAM_VMIDMT_BAM_REG_BASE_LAST_ADDR A:0x700e40
y.create.l HWIO_CRYPTO0_CRYPTO_BAM_VMIDMT_BAM_REG_BASE_END_ADDR A:0x701000
y.create.l HWIO_CRYPTO0_CRYPTO_BAM_VMIDMT_SCR0_ADDR A:0x700000
y.create.l HWIO_CRYPTO0_CRYPTO_BAM_VMIDMT_SCR1_ADDR A:0x700004
y.create.l HWIO_CRYPTO0_CRYPTO_BAM_VMIDMT_SCR2_ADDR A:0x700008
y.create.l HWIO_CRYPTO0_CRYPTO_BAM_VMIDMT_SACR_ADDR A:0x700010
y.create.l HWIO_CRYPTO0_CRYPTO_BAM_VMIDMT_SIDR0_ADDR A:0x700020
y.create.l HWIO_CRYPTO0_CRYPTO_BAM_VMIDMT_SIDR1_ADDR A:0x700024
y.create.l HWIO_CRYPTO0_CRYPTO_BAM_VMIDMT_SIDR2_ADDR A:0x700028
y.create.l HWIO_CRYPTO0_CRYPTO_BAM_VMIDMT_SIDR4_ADDR A:0x700030
y.create.l HWIO_CRYPTO0_CRYPTO_BAM_VMIDMT_SIDR5_ADDR A:0x700034
y.create.l HWIO_CRYPTO0_CRYPTO_BAM_VMIDMT_SIDR7_ADDR A:0x70003c
y.create.l HWIO_CRYPTO0_CRYPTO_BAM_VMIDMT_SGFAR0_ADDR A:0x700040
y.create.l HWIO_CRYPTO0_CRYPTO_BAM_VMIDMT_SGFSR_ADDR A:0x700048
y.create.l HWIO_CRYPTO0_CRYPTO_BAM_VMIDMT_SGFSRRESTORE_ADDR A:0x70004c
y.create.l HWIO_CRYPTO0_CRYPTO_BAM_VMIDMT_SGFSYNDR0_ADDR A:0x700050
y.create.l HWIO_CRYPTO0_CRYPTO_BAM_VMIDMT_SGFSYNDR1_ADDR A:0x700054
y.create.l HWIO_CRYPTO0_CRYPTO_BAM_VMIDMT_SGFSYNDR2_ADDR A:0x700058
y.create.l HWIO_CRYPTO0_CRYPTO_BAM_VMIDMT_VMIDMTSCR0_ADDR A:0x700090
y.create.l HWIO_CRYPTO0_CRYPTO_BAM_VMIDMT_CR0_ADDR A:0x700000
y.create.l HWIO_CRYPTO0_CRYPTO_BAM_VMIDMT_CR2_ADDR A:0x700008
y.create.l HWIO_CRYPTO0_CRYPTO_BAM_VMIDMT_ACR_ADDR A:0x700010
y.create.l HWIO_CRYPTO0_CRYPTO_BAM_VMIDMT_IDR0_ADDR A:0x700020
y.create.l HWIO_CRYPTO0_CRYPTO_BAM_VMIDMT_IDR1_ADDR A:0x700024
y.create.l HWIO_CRYPTO0_CRYPTO_BAM_VMIDMT_IDR2_ADDR A:0x700028
y.create.l HWIO_CRYPTO0_CRYPTO_BAM_VMIDMT_IDR4_ADDR A:0x700030
y.create.l HWIO_CRYPTO0_CRYPTO_BAM_VMIDMT_IDR5_ADDR A:0x700034
y.create.l HWIO_CRYPTO0_CRYPTO_BAM_VMIDMT_IDR7_ADDR A:0x70003c
y.create.l HWIO_CRYPTO0_CRYPTO_BAM_VMIDMT_GFAR0_ADDR A:0x700040
y.create.l HWIO_CRYPTO0_CRYPTO_BAM_VMIDMT_GFSR_ADDR A:0x700048
y.create.l HWIO_CRYPTO0_CRYPTO_BAM_VMIDMT_GFSRRESTORE_ADDR A:0x70004c
y.create.l HWIO_CRYPTO0_CRYPTO_BAM_VMIDMT_GFSYNDR0_ADDR A:0x700050
y.create.l HWIO_CRYPTO0_CRYPTO_BAM_VMIDMT_GFSYNDR1_ADDR A:0x700054
y.create.l HWIO_CRYPTO0_CRYPTO_BAM_VMIDMT_GFSYNDR2_ADDR A:0x700058
y.create.l HWIO_CRYPTO0_CRYPTO_BAM_VMIDMT_VMIDMTCR0_ADDR A:0x700090
y.create.l HWIO_CRYPTO0_CRYPTO_BAM_VMIDMT_VMIDMTACR_ADDR A:0x70009c
y.create.l HWIO_CRYPTO0_CRYPTO_BAM_VMIDMT_NSCR0_ADDR A:0x700400
y.create.l HWIO_CRYPTO0_CRYPTO_BAM_VMIDMT_NSCR2_ADDR A:0x700408
y.create.l HWIO_CRYPTO0_CRYPTO_BAM_VMIDMT_NSACR_ADDR A:0x700410
y.create.l HWIO_CRYPTO0_CRYPTO_BAM_VMIDMT_NSGFAR0_ADDR A:0x700440
y.create.l HWIO_CRYPTO0_CRYPTO_BAM_VMIDMT_NSGFSR_ADDR A:0x700448
y.create.l HWIO_CRYPTO0_CRYPTO_BAM_VMIDMT_NSGFSRRESTORE_ADDR A:0x70044c
y.create.l HWIO_CRYPTO0_CRYPTO_BAM_VMIDMT_NSGFSYNDR0_ADDR A:0x700450
y.create.l HWIO_CRYPTO0_CRYPTO_BAM_VMIDMT_NSGFSYNDR1_ADDR A:0x700454
y.create.l HWIO_CRYPTO0_CRYPTO_BAM_VMIDMT_NSGFSYNDR2_ADDR A:0x700458
y.create.l HWIO_CRYPTO0_CRYPTO_BAM_VMIDMT_NSVMIDMTCR0_ADDR A:0x700490
y.create.l HWIO_CRYPTO0_CRYPTO_BAM_VMIDMT_SSDR0_ADDR A:0x700080
y.create.l HWIO_CRYPTO0_CRYPTO_BAM_VMIDMT_MSDR0_ADDR A:0x700480
y.create.l HWIO_CRYPTO0_CRYPTO_BAM_VMIDMT_MCR_ADDR A:0x700494
y.create.l HWIO_CRYPTO0_CRYPTO_BAM_VMIDMT_S2VR0_ADDR A:0x700c00
y.create.l HWIO_CRYPTO0_CRYPTO_BAM_VMIDMT_S2VR1_ADDR A:0x700c04
y.create.l HWIO_CRYPTO0_CRYPTO_BAM_VMIDMT_S2VR2_ADDR A:0x700c08
y.create.l HWIO_CRYPTO0_CRYPTO_BAM_VMIDMT_S2VR3_ADDR A:0x700c0c
y.create.l HWIO_CRYPTO0_CRYPTO_BAM_VMIDMT_S2VR4_ADDR A:0x700c10
y.create.l HWIO_CRYPTO0_CRYPTO_BAM_VMIDMT_S2VR5_ADDR A:0x700c14
y.create.l HWIO_CRYPTO0_CRYPTO_BAM_VMIDMT_S2VR6_ADDR A:0x700c18
y.create.l HWIO_CRYPTO0_CRYPTO_BAM_VMIDMT_S2VR7_ADDR A:0x700c1c
y.create.l HWIO_CRYPTO0_CRYPTO_BAM_VMIDMT_S2VR8_ADDR A:0x700c20
y.create.l HWIO_CRYPTO0_CRYPTO_BAM_VMIDMT_S2VR9_ADDR A:0x700c24
y.create.l HWIO_CRYPTO0_CRYPTO_BAM_VMIDMT_AS2VR0_ADDR A:0x700e00
y.create.l HWIO_CRYPTO0_CRYPTO_BAM_VMIDMT_AS2VR1_ADDR A:0x700e04
y.create.l HWIO_CRYPTO0_CRYPTO_BAM_VMIDMT_AS2VR2_ADDR A:0x700e08
y.create.l HWIO_CRYPTO0_CRYPTO_BAM_VMIDMT_AS2VR3_ADDR A:0x700e0c
y.create.l HWIO_CRYPTO0_CRYPTO_BAM_VMIDMT_AS2VR4_ADDR A:0x700e10
y.create.l HWIO_CRYPTO0_CRYPTO_BAM_VMIDMT_AS2VR5_ADDR A:0x700e14
y.create.l HWIO_CRYPTO0_CRYPTO_BAM_VMIDMT_AS2VR6_ADDR A:0x700e18
y.create.l HWIO_CRYPTO0_CRYPTO_BAM_VMIDMT_AS2VR7_ADDR A:0x700e1c
y.create.l HWIO_CRYPTO0_CRYPTO_BAM_VMIDMT_AS2VR8_ADDR A:0x700e20
y.create.l HWIO_CRYPTO0_CRYPTO_BAM_VMIDMT_AS2VR9_ADDR A:0x700e24
y.create.l HWIO_CRYPTO0_CRYPTO_BAM_VMIDMT_SMR0_ADDR A:0x700800
y.create.l HWIO_CRYPTO0_CRYPTO_BAM_VMIDMT_SMR1_ADDR A:0x700804
y.create.l HWIO_CRYPTO0_CRYPTO_BAM_VMIDMT_SMR2_ADDR A:0x700808
y.create.l HWIO_CRYPTO0_CRYPTO_BAM_VMIDMT_SMR3_ADDR A:0x70080c
y.create.l HWIO_CRYPTO0_CRYPTO_BAM_VMIDMT_SMR4_ADDR A:0x700810
y.create.l HWIO_CRYPTO0_CRYPTO_BAM_VMIDMT_SMR5_ADDR A:0x700814
y.create.l HWIO_CRYPTO0_CRYPTO_BAM_VMIDMT_SMR6_ADDR A:0x700818
y.create.l HWIO_CRYPTO0_CRYPTO_BAM_VMIDMT_SMR7_ADDR A:0x70081c
y.create.l HWIO_CRYPTO0_CRYPTO_BAM_VMIDMT_SMR8_ADDR A:0x700820
y.create.l HWIO_CRYPTO0_CRYPTO_BAM_VMIDMT_SMR9_ADDR A:0x700824
y.create.l HWIO_DEHR_BIMC_REG_BASE_START_ADDR A:0x4b2000
y.create.l HWIO_DEHR_BIMC_REG_BASE_LAST_ADDR A:0x4b3000
y.create.l HWIO_DEHR_BIMC_REG_BASE_END_ADDR A:0x4b4000
y.create.l HWIO_DEHR_BIMC_DEHR_HW_VERSION_ADDR A:0x4b2000
y.create.l HWIO_DEHR_BIMC_DEHR_HW_INFO_ADDR A:0x4b2004
y.create.l HWIO_DEHR_BIMC_DEHR_CGC_CFG_ADDR A:0x4b2010
y.create.l HWIO_DEHR_BIMC_DEHR_MSA_CFG_ADDR A:0x4b2104
y.create.l HWIO_DEHR_BIMC_DEHR_RAM_CFG_ADDR A:0x4b2140
y.create.l HWIO_DEHR_BIMC_DEHR_DMA_STATUS_ADDR A:0x4b2200
y.create.l HWIO_DEHR_BIMC_DEHR_DBG_CFG_ADDR A:0x4b2400
y.create.l HWIO_DEHR_BIMC_DEHR_SW_DMA_CFG_ADDR A:0x4b2404
y.create.l HWIO_DEHR_BIMC_DEHR_DBG_ADDR_ADDR A:0x4b2408
y.create.l HWIO_DEHR_BIMC_DEHR_SEC_CFG_ADDR A:0x4b3000
y.create.l HWIO_DEHR_XPU_REG_BASE_START_ADDR A:0x4b0000
y.create.l HWIO_DEHR_XPU_REG_BASE_LAST_ADDR A:0x4b02d4
y.create.l HWIO_DEHR_XPU_REG_BASE_END_ADDR A:0x4b0300
y.create.l HWIO_DEHR_XPU_SCR_ADDR A:0x4b0000
y.create.l HWIO_DEHR_XPU_SWDR_ADDR A:0x4b0004
y.create.l HWIO_DEHR_XPU_SEAR0_ADDR A:0x4b0040
y.create.l HWIO_DEHR_XPU_SESR_ADDR A:0x4b0048
y.create.l HWIO_DEHR_XPU_SESRRESTORE_ADDR A:0x4b004c
y.create.l HWIO_DEHR_XPU_SESYNR0_ADDR A:0x4b0050
y.create.l HWIO_DEHR_XPU_SESYNR1_ADDR A:0x4b0054
y.create.l HWIO_DEHR_XPU_SESYNR2_ADDR A:0x4b0058
y.create.l HWIO_DEHR_XPU_MCR_ADDR A:0x4b0100
y.create.l HWIO_DEHR_XPU_MEAR0_ADDR A:0x4b0140
y.create.l HWIO_DEHR_XPU_MESR_ADDR A:0x4b0148
y.create.l HWIO_DEHR_XPU_MESRRESTORE_ADDR A:0x4b014c
y.create.l HWIO_DEHR_XPU_MESYNR0_ADDR A:0x4b0150
y.create.l HWIO_DEHR_XPU_MESYNR1_ADDR A:0x4b0154
y.create.l HWIO_DEHR_XPU_MESYNR2_ADDR A:0x4b0158
y.create.l HWIO_DEHR_XPU_CR_ADDR A:0x4b0080
y.create.l HWIO_DEHR_XPU_RPU_ACR0_ADDR A:0x4b00a0
y.create.l HWIO_DEHR_XPU_EAR0_ADDR A:0x4b00c0
y.create.l HWIO_DEHR_XPU_ESR_ADDR A:0x4b00c8
y.create.l HWIO_DEHR_XPU_ESRRESTORE_ADDR A:0x4b00cc
y.create.l HWIO_DEHR_XPU_ESYNR0_ADDR A:0x4b00d0
y.create.l HWIO_DEHR_XPU_ESYNR1_ADDR A:0x4b00d4
y.create.l HWIO_DEHR_XPU_ESYNR2_ADDR A:0x4b00d8
y.create.l HWIO_DEHR_XPU_IDR0_ADDR A:0x4b0074
y.create.l HWIO_DEHR_XPU_IDR1_ADDR A:0x4b0078
y.create.l HWIO_DEHR_XPU_REV_ADDR A:0x4b007c
y.create.l HWIO_DEHR_XPU_RG0_RACR0_ADDR A:0x4b0200
y.create.l HWIO_DEHR_XPU_RG1_RACR0_ADDR A:0x4b0280
y.create.l HWIO_DEHR_XPU_RG0_SCR_ADDR A:0x4b0250
y.create.l HWIO_DEHR_XPU_RG1_SCR_ADDR A:0x4b02d0
y.create.l HWIO_DEHR_XPU_RG0_MCR_ADDR A:0x4b0254
y.create.l HWIO_DEHR_XPU_RG1_MCR_ADDR A:0x4b02d4
y.create.l HWIO_DEHR_VMIDMT_REG_BASE_START_ADDR A:0x4b1000
y.create.l HWIO_DEHR_VMIDMT_REG_BASE_LAST_ADDR A:0x4b1e00
y.create.l HWIO_DEHR_VMIDMT_REG_BASE_END_ADDR A:0x4b2000
y.create.l HWIO_DEHR_VMIDMT_SCR0_ADDR A:0x4b1000
y.create.l HWIO_DEHR_VMIDMT_SCR1_ADDR A:0x4b1004
y.create.l HWIO_DEHR_VMIDMT_SCR2_ADDR A:0x4b1008
y.create.l HWIO_DEHR_VMIDMT_SACR_ADDR A:0x4b1010
y.create.l HWIO_DEHR_VMIDMT_SIDR0_ADDR A:0x4b1020
y.create.l HWIO_DEHR_VMIDMT_SIDR1_ADDR A:0x4b1024
y.create.l HWIO_DEHR_VMIDMT_SIDR2_ADDR A:0x4b1028
y.create.l HWIO_DEHR_VMIDMT_SIDR4_ADDR A:0x4b1030
y.create.l HWIO_DEHR_VMIDMT_SIDR5_ADDR A:0x4b1034
y.create.l HWIO_DEHR_VMIDMT_SIDR7_ADDR A:0x4b103c
y.create.l HWIO_DEHR_VMIDMT_SGFAR0_ADDR A:0x4b1040
y.create.l HWIO_DEHR_VMIDMT_SGFSR_ADDR A:0x4b1048
y.create.l HWIO_DEHR_VMIDMT_SGFSRRESTORE_ADDR A:0x4b104c
y.create.l HWIO_DEHR_VMIDMT_SGFSYNDR0_ADDR A:0x4b1050
y.create.l HWIO_DEHR_VMIDMT_SGFSYNDR1_ADDR A:0x4b1054
y.create.l HWIO_DEHR_VMIDMT_SGFSYNDR2_ADDR A:0x4b1058
y.create.l HWIO_DEHR_VMIDMT_VMIDMTSCR0_ADDR A:0x4b1090
y.create.l HWIO_DEHR_VMIDMT_CR0_ADDR A:0x4b1000
y.create.l HWIO_DEHR_VMIDMT_CR2_ADDR A:0x4b1008
y.create.l HWIO_DEHR_VMIDMT_ACR_ADDR A:0x4b1010
y.create.l HWIO_DEHR_VMIDMT_IDR0_ADDR A:0x4b1020
y.create.l HWIO_DEHR_VMIDMT_IDR1_ADDR A:0x4b1024
y.create.l HWIO_DEHR_VMIDMT_IDR2_ADDR A:0x4b1028
y.create.l HWIO_DEHR_VMIDMT_IDR4_ADDR A:0x4b1030
y.create.l HWIO_DEHR_VMIDMT_IDR5_ADDR A:0x4b1034
y.create.l HWIO_DEHR_VMIDMT_IDR7_ADDR A:0x4b103c
y.create.l HWIO_DEHR_VMIDMT_GFAR0_ADDR A:0x4b1040
y.create.l HWIO_DEHR_VMIDMT_GFSR_ADDR A:0x4b1048
y.create.l HWIO_DEHR_VMIDMT_GFSRRESTORE_ADDR A:0x4b104c
y.create.l HWIO_DEHR_VMIDMT_GFSYNDR0_ADDR A:0x4b1050
y.create.l HWIO_DEHR_VMIDMT_GFSYNDR1_ADDR A:0x4b1054
y.create.l HWIO_DEHR_VMIDMT_GFSYNDR2_ADDR A:0x4b1058
y.create.l HWIO_DEHR_VMIDMT_VMIDMTCR0_ADDR A:0x4b1090
y.create.l HWIO_DEHR_VMIDMT_VMIDMTACR_ADDR A:0x4b109c
y.create.l HWIO_DEHR_VMIDMT_NSCR0_ADDR A:0x4b1400
y.create.l HWIO_DEHR_VMIDMT_NSCR2_ADDR A:0x4b1408
y.create.l HWIO_DEHR_VMIDMT_NSACR_ADDR A:0x4b1410
y.create.l HWIO_DEHR_VMIDMT_NSGFAR0_ADDR A:0x4b1440
y.create.l HWIO_DEHR_VMIDMT_NSGFSR_ADDR A:0x4b1448
y.create.l HWIO_DEHR_VMIDMT_NSGFSRRESTORE_ADDR A:0x4b144c
y.create.l HWIO_DEHR_VMIDMT_NSGFSYNDR0_ADDR A:0x4b1450
y.create.l HWIO_DEHR_VMIDMT_NSGFSYNDR1_ADDR A:0x4b1454
y.create.l HWIO_DEHR_VMIDMT_NSGFSYNDR2_ADDR A:0x4b1458
y.create.l HWIO_DEHR_VMIDMT_NSVMIDMTCR0_ADDR A:0x4b1490
y.create.l HWIO_DEHR_VMIDMT_SSDR0_ADDR A:0x4b1080
y.create.l HWIO_DEHR_VMIDMT_MSDR0_ADDR A:0x4b1480
y.create.l HWIO_DEHR_VMIDMT_MCR_ADDR A:0x4b1494
y.create.l HWIO_DEHR_VMIDMT_S2VR0_ADDR A:0x4b1c00
y.create.l HWIO_DEHR_VMIDMT_AS2VR0_ADDR A:0x4b1e00
y.create.l HWIO_DIM_C00_DDRPHY_CA_REG_BASE_START_ADDR A:0x480000
y.create.l HWIO_DIM_C00_DDRPHY_CA_REG_BASE_LAST_ADDR A:0x480114
y.create.l HWIO_DIM_C00_DDRPHY_CA_REG_BASE_END_ADDR A:0x480134
y.create.l HWIO_DIM_C00_DIM_CA_TOP_CFG_ADDR A:0x480000
y.create.l HWIO_DIM_C00_DIM_CA_HW_INFO_ADDR A:0x480004
y.create.l HWIO_DIM_C00_DIM_CA_HW_VERSION_ADDR A:0x480008
y.create.l HWIO_DIM_C00_DIM_CA_PAD_CFG0_ADDR A:0x480010
y.create.l HWIO_DIM_C00_DIM_CA_PAD_CFG1_ADDR A:0x480014
y.create.l HWIO_DIM_C00_DIM_CA_PAD_CFG2_ADDR A:0x480018
y.create.l HWIO_DIM_C00_DIM_CA_PAD_CFG3_ADDR A:0x48001c
y.create.l HWIO_DIM_C00_DIM_CA_PAD_CFG4_ADDR A:0x480020
y.create.l HWIO_DIM_C00_DDRPHY_CA_MISR_CFG_ADDR A:0x480024
y.create.l HWIO_DIM_C00_DDRPHY_CA_MISR_EVEN_STATUS_ADDR A:0x480028
y.create.l HWIO_DIM_C00_DDRPHY_CA_MISR_ODD_STATUS_ADDR A:0x48002c
y.create.l HWIO_DIM_C00_DIM_CA_CDC_CTLR_CFG0_ADDR A:0x480030
y.create.l HWIO_DIM_C00_DIM_CA_CDC_CTLR_CFG1_ADDR A:0x480034
y.create.l HWIO_DIM_C00_DIM_CA_CDC_CAL_TIMER_CFG0_ADDR A:0x480038
y.create.l HWIO_DIM_C00_DIM_CA_CDC_CAL_TIMER_CFG1_ADDR A:0x48003c
y.create.l HWIO_DIM_C00_DIM_CA_CDC_REFCOUNT_CFG_ADDR A:0x480040
y.create.l HWIO_DIM_C00_DIM_CA_CDC_COARSE_CAL_CFG_ADDR A:0x480044
y.create.l HWIO_DIM_C00_DIM_CA_CDC_RSVD_CFG_ADDR A:0x480048
y.create.l HWIO_DIM_C00_DIM_CA_CDC_OFFSET_CFG_ADDR A:0x48004c
y.create.l HWIO_DIM_C00_DIM_CA_CDC_DELAY_CFG_ADDR A:0x480050
y.create.l HWIO_DIM_C00_DIM_CA_CDC_SW_MODE_CFG_ADDR A:0x480054
y.create.l HWIO_DIM_C00_DIM_CA_CDC_TEST_CFG_ADDR A:0x480058
y.create.l HWIO_DIM_C00_DIM_CA_CDC_SW_OVRD_CFG_ADDR A:0x48005c
y.create.l HWIO_DIM_C00_DIM_CA_CDC_STATUS0_ADDR A:0x480070
y.create.l HWIO_DIM_C00_DIM_CA_CDC_STATUS1_ADDR A:0x480074
y.create.l HWIO_DIM_C00_DIM_CA_CDC_STATUS2_ADDR A:0x480078
y.create.l HWIO_DIM_C00_DIM_CA_CDC_STATUS3_ADDR A:0x48007c
y.create.l HWIO_DIM_C00_DIM_CA_IOC_CTLR_CFG_ADDR A:0x4800e0
y.create.l HWIO_DIM_C00_DIM_CA_IOC_CTLR_PNCNT_CFG_ADDR A:0x4800e4
y.create.l HWIO_DIM_C00_DIM_CA_IOC_CTLR_TIMER_CFG_ADDR A:0x4800e8
y.create.l HWIO_DIM_C00_DIM_CA_IOC_CTLR_TIMER_STATUS_ADDR A:0x4800ec
y.create.l HWIO_DIM_C00_DIM_CA_IOC_CTLR_CHAR_CFG_ADDR A:0x4800f0
y.create.l HWIO_DIM_C00_DIM_CA_IOC_CTLR_STATUS_ADDR A:0x4800f4
y.create.l HWIO_DIM_C00_DIM_CA_CA_IOC_SLV_CFG_ADDR A:0x480100
y.create.l HWIO_DIM_C00_DIM_CA_CA_IOC_SLV_STATUS_ADDR A:0x480104
y.create.l HWIO_DIM_C00_DIM_CA_CK_IOC_SLV_CFG_ADDR A:0x480110
y.create.l HWIO_DIM_C00_DIM_CA_CK_IOC_SLV_STATUS_ADDR A:0x480114
y.create.l HWIO_DIM_D00_DDRPHY_DQ_REG_BASE_START_ADDR A:0x480800
y.create.l HWIO_DIM_D00_DDRPHY_DQ_REG_BASE_LAST_ADDR A:0x480914
y.create.l HWIO_DIM_D00_DDRPHY_DQ_REG_BASE_END_ADDR A:0x480934
y.create.l HWIO_DIM_D00_DIM_DQ_TOP_CFG_ADDR A:0x480800
y.create.l HWIO_DIM_D00_DIM_DQ_HW_INFO_ADDR A:0x480804
y.create.l HWIO_DIM_D00_DIM_DQ_HW_VERSION_ADDR A:0x480808
y.create.l HWIO_DIM_D00_DIM_DQ_PAD_CFG0_ADDR A:0x480810
y.create.l HWIO_DIM_D00_DIM_DQ_PAD_CFG1_ADDR A:0x480814
y.create.l HWIO_DIM_D00_DIM_DQ_PAD_CFG2_ADDR A:0x480818
y.create.l HWIO_DIM_D00_DIM_DQ_DQ_SMT_STATUS_ADDR A:0x48081c
y.create.l HWIO_DIM_D00_DIM_DQ_PAD_CFG3_ADDR A:0x480820
y.create.l HWIO_DIM_D00_DDRPHY_DQ_MISR_CFG_ADDR A:0x48080c
y.create.l HWIO_DIM_D00_DDRPHY_DQ_MISR_EVEN_STATUS_ADDR A:0x480828
y.create.l HWIO_DIM_D00_DDRPHY_DQ_MISR_ODD_STATUS_ADDR A:0x48082c
y.create.l HWIO_DIM_D00_DIM_DQ_CDC_CTLR_CFG0_ADDR A:0x480830
y.create.l HWIO_DIM_D00_DIM_DQ_CDC_CTLR_CFG1_ADDR A:0x480834
y.create.l HWIO_DIM_D00_DIM_DQ_CDC_CAL_TIMER_CFG0_ADDR A:0x480838
y.create.l HWIO_DIM_D00_DIM_DQ_CDC_CAL_TIMER_CFG1_ADDR A:0x48083c
y.create.l HWIO_DIM_D00_DIM_DQ_CDC_REFCOUNT_CFG_ADDR A:0x480840
y.create.l HWIO_DIM_D00_DIM_DQ_CDC_COARSE_CAL_CFG_ADDR A:0x480844
y.create.l HWIO_DIM_D00_DIM_DQ_CDC_RSVD_CFG_ADDR A:0x480848
y.create.l HWIO_DIM_D00_DIM_DQ_RD_CDC_OFFSET_CFG_ADDR A:0x48084c
y.create.l HWIO_DIM_D00_DIM_DQ_RD_CDC_DELAY_CFG_ADDR A:0x480850
y.create.l HWIO_DIM_D00_DIM_DQ_RD_CDC_SW_MODE_CFG_ADDR A:0x480854
y.create.l HWIO_DIM_D00_DIM_DQ_RD_CDC_TEST_CFG_ADDR A:0x480858
y.create.l HWIO_DIM_D00_DIM_DQ_RD_CDC_SW_OVRD_CFG_ADDR A:0x48085c
y.create.l HWIO_DIM_D00_DIM_DQ_RD_CDC_SLAVE_DDA_CFG_ADDR A:0x480860
y.create.l HWIO_DIM_D00_DIM_DQ_RD_CDC_STATUS0_ADDR A:0x480870
y.create.l HWIO_DIM_D00_DIM_DQ_RD_CDC_STATUS1_ADDR A:0x480874
y.create.l HWIO_DIM_D00_DIM_DQ_RD_CDC_STATUS2_ADDR A:0x480878
y.create.l HWIO_DIM_D00_DIM_DQ_RD_CDC_STATUS3_ADDR A:0x48087c
y.create.l HWIO_DIM_D00_DIM_DQ_RD_CDC_STATUS4_ADDR A:0x480880
y.create.l HWIO_DIM_D00_DIM_DQ_WR_CDC_OFFSET_CFG_ADDR A:0x4808ac
y.create.l HWIO_DIM_D00_DIM_DQ_WR_CDC_DELAY_CFG_ADDR A:0x4808b0
y.create.l HWIO_DIM_D00_DIM_DQ_WR_CDC_SW_MODE_CFG_ADDR A:0x4808b4
y.create.l HWIO_DIM_D00_DIM_DQ_WR_CDC_TEST_CFG_ADDR A:0x4808b8
y.create.l HWIO_DIM_D00_DIM_DQ_WR_CDC_SW_OVRD_CFG_ADDR A:0x4808bc
y.create.l HWIO_DIM_D00_DIM_DQ_WR_CDC_STATUS0_ADDR A:0x4808d0
y.create.l HWIO_DIM_D00_DIM_DQ_WR_CDC_STATUS1_ADDR A:0x4808d4
y.create.l HWIO_DIM_D00_DIM_DQ_WR_CDC_STATUS2_ADDR A:0x4808d8
y.create.l HWIO_DIM_D00_DIM_DQ_WR_CDC_STATUS3_ADDR A:0x4808dc
y.create.l HWIO_DIM_D00_DIM_DQ_DQ_IOC_SLV_CFG_ADDR A:0x480900
y.create.l HWIO_DIM_D00_DIM_DQ_DQ_IOC_SLV_STATUS_ADDR A:0x480904
y.create.l HWIO_DIM_D00_DIM_DQ_DQS_IOC_SLV_CFG_ADDR A:0x480910
y.create.l HWIO_DIM_D00_DIM_DQ_DQS_IOC_SLV_STATUS_ADDR A:0x480914
y.create.l HWIO_DIM_D01_DDRPHY_DQ_REG_BASE_START_ADDR A:0x481000
y.create.l HWIO_DIM_D01_DDRPHY_DQ_REG_BASE_LAST_ADDR A:0x481114
y.create.l HWIO_DIM_D01_DDRPHY_DQ_REG_BASE_END_ADDR A:0x481134
y.create.l HWIO_DIM_D01_DIM_DQ_TOP_CFG_ADDR A:0x481000
y.create.l HWIO_DIM_D01_DIM_DQ_HW_INFO_ADDR A:0x481004
y.create.l HWIO_DIM_D01_DIM_DQ_HW_VERSION_ADDR A:0x481008
y.create.l HWIO_DIM_D01_DIM_DQ_PAD_CFG0_ADDR A:0x481010
y.create.l HWIO_DIM_D01_DIM_DQ_PAD_CFG1_ADDR A:0x481014
y.create.l HWIO_DIM_D01_DIM_DQ_PAD_CFG2_ADDR A:0x481018
y.create.l HWIO_DIM_D01_DIM_DQ_DQ_SMT_STATUS_ADDR A:0x48101c
y.create.l HWIO_DIM_D01_DIM_DQ_PAD_CFG3_ADDR A:0x481020
y.create.l HWIO_DIM_D01_DDRPHY_DQ_MISR_CFG_ADDR A:0x48100c
y.create.l HWIO_DIM_D01_DDRPHY_DQ_MISR_EVEN_STATUS_ADDR A:0x481028
y.create.l HWIO_DIM_D01_DDRPHY_DQ_MISR_ODD_STATUS_ADDR A:0x48102c
y.create.l HWIO_DIM_D01_DIM_DQ_CDC_CTLR_CFG0_ADDR A:0x481030
y.create.l HWIO_DIM_D01_DIM_DQ_CDC_CTLR_CFG1_ADDR A:0x481034
y.create.l HWIO_DIM_D01_DIM_DQ_CDC_CAL_TIMER_CFG0_ADDR A:0x481038
y.create.l HWIO_DIM_D01_DIM_DQ_CDC_CAL_TIMER_CFG1_ADDR A:0x48103c
y.create.l HWIO_DIM_D01_DIM_DQ_CDC_REFCOUNT_CFG_ADDR A:0x481040
y.create.l HWIO_DIM_D01_DIM_DQ_CDC_COARSE_CAL_CFG_ADDR A:0x481044
y.create.l HWIO_DIM_D01_DIM_DQ_CDC_RSVD_CFG_ADDR A:0x481048
y.create.l HWIO_DIM_D01_DIM_DQ_RD_CDC_OFFSET_CFG_ADDR A:0x48104c
y.create.l HWIO_DIM_D01_DIM_DQ_RD_CDC_DELAY_CFG_ADDR A:0x481050
y.create.l HWIO_DIM_D01_DIM_DQ_RD_CDC_SW_MODE_CFG_ADDR A:0x481054
y.create.l HWIO_DIM_D01_DIM_DQ_RD_CDC_TEST_CFG_ADDR A:0x481058
y.create.l HWIO_DIM_D01_DIM_DQ_RD_CDC_SW_OVRD_CFG_ADDR A:0x48105c
y.create.l HWIO_DIM_D01_DIM_DQ_RD_CDC_SLAVE_DDA_CFG_ADDR A:0x481060
y.create.l HWIO_DIM_D01_DIM_DQ_RD_CDC_STATUS0_ADDR A:0x481070
y.create.l HWIO_DIM_D01_DIM_DQ_RD_CDC_STATUS1_ADDR A:0x481074
y.create.l HWIO_DIM_D01_DIM_DQ_RD_CDC_STATUS2_ADDR A:0x481078
y.create.l HWIO_DIM_D01_DIM_DQ_RD_CDC_STATUS3_ADDR A:0x48107c
y.create.l HWIO_DIM_D01_DIM_DQ_RD_CDC_STATUS4_ADDR A:0x481080
y.create.l HWIO_DIM_D01_DIM_DQ_WR_CDC_OFFSET_CFG_ADDR A:0x4810ac
y.create.l HWIO_DIM_D01_DIM_DQ_WR_CDC_DELAY_CFG_ADDR A:0x4810b0
y.create.l HWIO_DIM_D01_DIM_DQ_WR_CDC_SW_MODE_CFG_ADDR A:0x4810b4
y.create.l HWIO_DIM_D01_DIM_DQ_WR_CDC_TEST_CFG_ADDR A:0x4810b8
y.create.l HWIO_DIM_D01_DIM_DQ_WR_CDC_SW_OVRD_CFG_ADDR A:0x4810bc
y.create.l HWIO_DIM_D01_DIM_DQ_WR_CDC_STATUS0_ADDR A:0x4810d0
y.create.l HWIO_DIM_D01_DIM_DQ_WR_CDC_STATUS1_ADDR A:0x4810d4
y.create.l HWIO_DIM_D01_DIM_DQ_WR_CDC_STATUS2_ADDR A:0x4810d8
y.create.l HWIO_DIM_D01_DIM_DQ_WR_CDC_STATUS3_ADDR A:0x4810dc
y.create.l HWIO_DIM_D01_DIM_DQ_DQ_IOC_SLV_CFG_ADDR A:0x481100
y.create.l HWIO_DIM_D01_DIM_DQ_DQ_IOC_SLV_STATUS_ADDR A:0x481104
y.create.l HWIO_DIM_D01_DIM_DQ_DQS_IOC_SLV_CFG_ADDR A:0x481110
y.create.l HWIO_DIM_D01_DIM_DQ_DQS_IOC_SLV_STATUS_ADDR A:0x481114
y.create.l HWIO_EBI1_AHB2PHY_SWMAN_REG_BASE_START_ADDR A:0x49f000
y.create.l HWIO_EBI1_AHB2PHY_SWMAN_REG_BASE_LAST_ADDR A:0x49f014
y.create.l HWIO_EBI1_AHB2PHY_SWMAN_REG_BASE_END_ADDR A:0x49f400
y.create.l HWIO_EBI1_HW_VERSION_ADDR A:0x49f000
y.create.l HWIO_EBI1_HW_INFO_ADDR A:0x49f004
y.create.l HWIO_EBI1_AHB2PHY_BROADCAST_EN_CFG_LOWER_ADDR A:0x49f008
y.create.l HWIO_EBI1_AHB2PHY_BROADCAST_EN_CFG_UPPER_ADDR A:0x49f00c
y.create.l HWIO_EBI1_AHB2PHY_TOP_CFG_ADDR A:0x49f010
y.create.l HWIO_EBI1_AHB2PHY_DEBUG_BUS_CFG_ADDR A:0x49f014
y.create.l HWIO_EBI1_AHB2PHY_BROADCAST_SWMAN_REG_BASE_START_ADDR A:0x49f800
y.create.l HWIO_EBI1_AHB2PHY_BROADCAST_SWMAN_REG_BASE_LAST_ADDR A:0x49fbfc
y.create.l HWIO_EBI1_AHB2PHY_BROADCAST_SWMAN_REG_BASE_END_ADDR A:0x49fc00
y.create.l HWIO_EBI1_AHB2PHY_BROADCAST_ADDRESS_SPACE_0_ADDR A:0x49f800
y.create.l HWIO_EBI1_AHB2PHY_BROADCAST_ADDRESS_SPACE_1_ADDR A:0x49f804
y.create.l HWIO_EBI1_AHB2PHY_BROADCAST_ADDRESS_SPACE_2_ADDR A:0x49f808
y.create.l HWIO_EBI1_AHB2PHY_BROADCAST_ADDRESS_SPACE_3_ADDR A:0x49f80c
y.create.l HWIO_EBI1_AHB2PHY_BROADCAST_ADDRESS_SPACE_4_ADDR A:0x49f810
y.create.l HWIO_EBI1_AHB2PHY_BROADCAST_ADDRESS_SPACE_5_ADDR A:0x49f814
y.create.l HWIO_EBI1_AHB2PHY_BROADCAST_ADDRESS_SPACE_6_ADDR A:0x49f818
y.create.l HWIO_EBI1_AHB2PHY_BROADCAST_ADDRESS_SPACE_7_ADDR A:0x49f81c
y.create.l HWIO_EBI1_AHB2PHY_BROADCAST_ADDRESS_SPACE_8_ADDR A:0x49f820
y.create.l HWIO_EBI1_AHB2PHY_BROADCAST_ADDRESS_SPACE_9_ADDR A:0x49f824
y.create.l HWIO_MPM2_MPM_REG_BASE_START_ADDR A:0x4a0000
y.create.l HWIO_MPM2_MPM_REG_BASE_LAST_ADDR A:0x4a00f8
y.create.l HWIO_MPM2_MPM_REG_BASE_END_ADDR A:0x4a1000
y.create.l HWIO_MPM2_MPM_PMIC_VDD_ON_CFG_1_ADDR A:0x4a0000
y.create.l HWIO_MPM2_MPM_PMIC_VDD_ON_CFG_2_ADDR A:0x4a0004
y.create.l HWIO_MPM2_MPM_PMIC_VDD_ON_CFG_3_ADDR A:0x4a0008
y.create.l HWIO_MPM2_MPM_PMIC_VDD_ON_CFG_4_ADDR A:0x4a000c
y.create.l HWIO_MPM2_MPM_PMIC_VDD_ON_CFG_5_ADDR A:0x4a0010
y.create.l HWIO_MPM2_MPM_PMIC_VDD_ON_CFG_6_ADDR A:0x4a0014
y.create.l HWIO_MPM2_MPM_PMIC_VDD_ON_CFG_7_ADDR A:0x4a0018
y.create.l HWIO_MPM2_MPM_PMIC_VDD_ON_CFG_8_ADDR A:0x4a001c
y.create.l HWIO_MPM2_MPM_PMIC_VDD_ON_CFG_9_ADDR A:0x4a0020
y.create.l HWIO_MPM2_MPM_PMIC_VDD_ON_CFG_10_ADDR A:0x4a0024
y.create.l HWIO_MPM2_MPM_PMIC_VDD_ON_CFG_11_ADDR A:0x4a0028
y.create.l HWIO_MPM2_MPM_PMIC_VDD_ON_CFG_12_ADDR A:0x4a002c
y.create.l HWIO_MPM2_MPM_PMIC_VDD_OFF_CFG_1_ADDR A:0x4a0030
y.create.l HWIO_MPM2_MPM_PMIC_VDD_OFF_CFG_2_ADDR A:0x4a0034
y.create.l HWIO_MPM2_MPM_PMIC_VDD_OFF_CFG_3_ADDR A:0x4a0038
y.create.l HWIO_MPM2_MPM_PMIC_VDD_OFF_CFG_4_ADDR A:0x4a003c
y.create.l HWIO_MPM2_MPM_PMIC_VDD_OFF_CFG_5_ADDR A:0x4a0040
y.create.l HWIO_MPM2_MPM_PMIC_VDD_OFF_CFG_6_ADDR A:0x4a0044
y.create.l HWIO_MPM2_MPM_PMIC_VDD_OFF_CFG_7_ADDR A:0x4a0048
y.create.l HWIO_MPM2_MPM_PMIC_VDD_OFF_CFG_8_ADDR A:0x4a004c
y.create.l HWIO_MPM2_MPM_PMIC_VDD_OFF_CFG_9_ADDR A:0x4a0050
y.create.l HWIO_MPM2_MPM_PMIC_VDD_OFF_CFG_10_ADDR A:0x4a0054
y.create.l HWIO_MPM2_MPM_PMIC_VDD_OFF_CFG_11_ADDR A:0x4a0058
y.create.l HWIO_MPM2_MPM_PMIC_VDD_OFF_CFG_12_ADDR A:0x4a005c
y.create.l HWIO_MPM2_MPM_SPMI_CMD_CFG_ADDR A:0x4a0060
y.create.l HWIO_MPM2_MPM_SPMI_CDIV_CNTRL_ADDR A:0x4a0064
y.create.l HWIO_MPM2_MPM_CXO_CTRL_ADDR A:0x4a0068
y.create.l HWIO_MPM2_MPM_PXO_OSC_CTRL_ADDR A:0x4a006c
y.create.l HWIO_MPM2_MPM_LOW_POWER_CFG_ADDR A:0x4a0070
y.create.l HWIO_MPM2_MPM_LOW_POWER_STATUS_ADDR A:0x4a0074
y.create.l HWIO_MPM2_MPM_CXO_POWER_RAMPUP_TIME_ADDR A:0x4a0078
y.create.l HWIO_MPM2_MPM_PXO_WARMUP_TIME_ADDR A:0x4a007c
y.create.l HWIO_MPM2_MPM_HARDWARE_RESTORED_ADDR A:0x4a0080
y.create.l HWIO_MPM2_MPM_INT_CLEAR_1_ADDR A:0x4a0084
y.create.l HWIO_MPM2_MPM_INT_CLEAR_2_ADDR A:0x4a0088
y.create.l HWIO_MPM2_MPM_INT_EN_1_ADDR A:0x4a008c
y.create.l HWIO_MPM2_MPM_INT_EN_2_ADDR A:0x4a0090
y.create.l HWIO_MPM2_MPM_INT_POLARITY_1_ADDR A:0x4a0094
y.create.l HWIO_MPM2_MPM_INT_POLARITY_2_ADDR A:0x4a0098
y.create.l HWIO_MPM2_MPM_DETECT_CTL_1_ADDR A:0x4a009c
y.create.l HWIO_MPM2_MPM_DETECT_CTL_2_ADDR A:0x4a00a0
y.create.l HWIO_MPM2_MPM_DETECT_CTL_3_ADDR A:0x4a00a4
y.create.l HWIO_MPM2_MPM_DETECT_CTL_4_ADDR A:0x4a00a8
y.create.l HWIO_MPM2_MPM_INT_STATUS_1_ADDR A:0x4a00ac
y.create.l HWIO_MPM2_MPM_INT_STATUS_2_ADDR A:0x4a00b0
y.create.l HWIO_MPM2_MPM_INT_WKUP_CLK_SEL_1_ADDR A:0x4a00b4
y.create.l HWIO_MPM2_MPM_INT_WKUP_CLK_SEL_2_ADDR A:0x4a00b8
y.create.l HWIO_MPM2_MPM_DEBUG_BUS_EN_ADDR A:0x4a00bc
y.create.l HWIO_MPM2_MPM_PEN_DEBOUNCE_CTL_ADDR A:0x4a00c0
y.create.l HWIO_MPM2_MPM_WARM_BOOT_CFG_ADDR A:0x4a00c4
y.create.l HWIO_MPM2_MPM_REG0_FILE_ADDR A:0x4a00c8
y.create.l HWIO_MPM2_MPM_REG1_FILE_ADDR A:0x4a00cc
y.create.l HWIO_MPM2_MPM_REG2_FILE_ADDR A:0x4a00d0
y.create.l HWIO_MPM2_MPM_REG3_FILE_ADDR A:0x4a00d4
y.create.l HWIO_MPM2_MPM_REG4_FILE_ADDR A:0x4a00d8
y.create.l HWIO_MPM2_MPM_REG5_FILE_ADDR A:0x4a00dc
y.create.l HWIO_MPM2_MPM_REG6_FILE_ADDR A:0x4a00e0
y.create.l HWIO_MPM2_MPM_REG7_FILE_ADDR A:0x4a00e4
y.create.l HWIO_MPM2_MPM_REG8_FILE_ADDR A:0x4a00e8
y.create.l HWIO_MPM2_MPM_CNTR_CLK_CONTROL_ADDR A:0x4a00ec
y.create.l HWIO_MPM2_MPM_CNTR_FRAC_ADDR A:0x4a00f0
y.create.l HWIO_MPM2_MPM_CNTR_INCR_DATA_ADDR A:0x4a00f4
y.create.l HWIO_MPM2_MPM_HW_ID_ADDR A:0x4a00f8
y.create.l HWIO_MPM2_G_CTRL_CNTR_REG_BASE_START_ADDR A:0x4a1000
y.create.l HWIO_MPM2_G_CTRL_CNTR_REG_BASE_LAST_ADDR A:0x4a1fd0
y.create.l HWIO_MPM2_G_CTRL_CNTR_REG_BASE_END_ADDR A:0x4a2000
y.create.l HWIO_MPM2_MPM_CONTROL_CNTCR_ADDR A:0x4a1000
y.create.l HWIO_MPM2_MPM_CONTROL_CNTSR_ADDR A:0x4a1004
y.create.l HWIO_MPM2_MPM_CONTROL_CNTCV_LO_ADDR A:0x4a1008
y.create.l HWIO_MPM2_MPM_CONTROL_CNTCV_HI_ADDR A:0x4a100c
y.create.l HWIO_MPM2_MPM_CONTROL_CNTFID0_ADDR A:0x4a1020
y.create.l HWIO_MPM2_MPM_CONTROL_ID_ADDR A:0x4a1fd0
y.create.l HWIO_MPM2_G_RD_CNTR_REG_BASE_START_ADDR A:0x4a2000
y.create.l HWIO_MPM2_G_RD_CNTR_REG_BASE_LAST_ADDR A:0x4a2fd0
y.create.l HWIO_MPM2_G_RD_CNTR_REG_BASE_END_ADDR A:0x4a3000
y.create.l HWIO_MPM2_MPM_READ_CNTCV_LO_ADDR A:0x4a2000
y.create.l HWIO_MPM2_MPM_READ_CNTCV_HI_ADDR A:0x4a2004
y.create.l HWIO_MPM2_MPM_READ_ID_ADDR A:0x4a2fd0
y.create.l HWIO_MPM2_SLP_CNTR_REG_BASE_START_ADDR A:0x4a3000
y.create.l HWIO_MPM2_SLP_CNTR_REG_BASE_LAST_ADDR A:0x4a3000
y.create.l HWIO_MPM2_SLP_CNTR_REG_BASE_END_ADDR A:0x4a4000
y.create.l HWIO_MPM2_MPM_SLEEP_TIMETICK_COUNT_VAL_ADDR A:0x4a3000
y.create.l HWIO_MPM2_QTIMR_AC_REG_BASE_START_ADDR A:0x4a4000
y.create.l HWIO_MPM2_QTIMR_AC_REG_BASE_LAST_ADDR A:0x4a4fd0
y.create.l HWIO_MPM2_QTIMR_AC_REG_BASE_END_ADDR A:0x4a5000
y.create.l HWIO_MPM2_QTMR_AC_CNTFRQ_ADDR A:0x4a4000
y.create.l HWIO_MPM2_QTMR_AC_CNTSR_ADDR A:0x4a4004
y.create.l HWIO_MPM2_QTMR_AC_CNTTID_ADDR A:0x4a4008
y.create.l HWIO_MPM2_QTMR_AC_CNTACR_0_ADDR A:0x4a4040
y.create.l HWIO_MPM2_QTMR_AC_CNTVOFF_LO_0_ADDR A:0x4a4080
y.create.l HWIO_MPM2_QTMR_AC_CNTVOFF_HI_0_ADDR A:0x4a4084
y.create.l HWIO_MPM2_QTMR_AC_CFG_ADDR A:0x4a4fc0
y.create.l HWIO_MPM2_QTMR_AC_VERSION_ADDR A:0x4a4fd0
y.create.l HWIO_MPM2_QTIMR_V1_REG_BASE_START_ADDR A:0x4a5000
y.create.l HWIO_MPM2_QTIMR_V1_REG_BASE_LAST_ADDR A:0x4a5fd0
y.create.l HWIO_MPM2_QTIMR_V1_REG_BASE_END_ADDR A:0x4a6000
y.create.l HWIO_MPM2_QTMR_V1_CNTPCT_LO_ADDR A:0x4a5000
y.create.l HWIO_MPM2_QTMR_V1_CNTPCT_HI_ADDR A:0x4a5004
y.create.l HWIO_MPM2_QTMR_V1_CNTVCT_LO_ADDR A:0x4a5008
y.create.l HWIO_MPM2_QTMR_V1_CNTVCT_HI_ADDR A:0x4a500c
y.create.l HWIO_MPM2_QTMR_V1_CNTFRQ_ADDR A:0x4a5010
y.create.l HWIO_MPM2_QTMR_V1_CNTPL0ACR_ADDR A:0x4a5014
y.create.l HWIO_MPM2_QTMR_V1_CNTVOFF_LO_ADDR A:0x4a5018
y.create.l HWIO_MPM2_QTMR_V1_CNTVOFF_HI_ADDR A:0x4a501c
y.create.l HWIO_MPM2_QTMR_V1_CNTP_CVAL_LO_ADDR A:0x4a5020
y.create.l HWIO_MPM2_QTMR_V1_CNTP_CVAL_HI_ADDR A:0x4a5024
y.create.l HWIO_MPM2_QTMR_V1_CNTP_TVAL_ADDR A:0x4a5028
y.create.l HWIO_MPM2_QTMR_V1_CNTP_CTL_ADDR A:0x4a502c
y.create.l HWIO_MPM2_QTMR_V1_CNTV_CVAL_LO_ADDR A:0x4a5030
y.create.l HWIO_MPM2_QTMR_V1_CNTV_CVAL_HI_ADDR A:0x4a5034
y.create.l HWIO_MPM2_QTMR_V1_CNTV_TVAL_ADDR A:0x4a5038
y.create.l HWIO_MPM2_QTMR_V1_CNTV_CTL_ADDR A:0x4a503c
y.create.l HWIO_MPM2_QTMR_V1_VERSION_ADDR A:0x4a5fd0
y.create.l HWIO_MPM2_TSYNC_REG_BASE_START_ADDR A:0x4a6000
y.create.l HWIO_MPM2_TSYNC_REG_BASE_LAST_ADDR A:0x4a6020
y.create.l HWIO_MPM2_TSYNC_REG_BASE_END_ADDR A:0x4a7000
y.create.l HWIO_MPM2_MPM_TSYNC_CTL_ADDR A:0x4a6000
y.create.l HWIO_MPM2_MPM_TSYNC_CMD_ADDR A:0x4a6004
y.create.l HWIO_MPM2_MPM_TSYNC_START_ADDR A:0x4a6008
y.create.l HWIO_MPM2_MPM_TSYNC_START_PHASE_ADDR A:0x4a600c
y.create.l HWIO_MPM2_MPM_TSYNC_PERIOD_ADDR A:0x4a6010
y.create.l HWIO_MPM2_MPM_TSYNC_PERIOD_PHASE_ADDR A:0x4a6014
y.create.l HWIO_MPM2_MPM_TSYNC_STATUS_TIME_ADDR A:0x4a6018
y.create.l HWIO_MPM2_MPM_TSYNC_STATUS_PHASE_ADDR A:0x4a601c
y.create.l HWIO_MPM2_MPM_GRFC_CXO_EN_ADDR A:0x4a6020
y.create.l HWIO_MPM2_APU_REG_BASE_START_ADDR A:0x4a7000
y.create.l HWIO_MPM2_APU_REG_BASE_LAST_ADDR A:0x4a7754
y.create.l HWIO_MPM2_APU_REG_BASE_END_ADDR A:0x4a7780
y.create.l HWIO_MPM2_XPU_SCR_ADDR A:0x4a7000
y.create.l HWIO_MPM2_XPU_SWDR_ADDR A:0x4a7004
y.create.l HWIO_MPM2_XPU_SEAR0_ADDR A:0x4a7040
y.create.l HWIO_MPM2_XPU_SESR_ADDR A:0x4a7048
y.create.l HWIO_MPM2_XPU_SESRRESTORE_ADDR A:0x4a704c
y.create.l HWIO_MPM2_XPU_SESYNR0_ADDR A:0x4a7050
y.create.l HWIO_MPM2_XPU_SESYNR1_ADDR A:0x4a7054
y.create.l HWIO_MPM2_XPU_SESYNR2_ADDR A:0x4a7058
y.create.l HWIO_MPM2_XPU_MCR_ADDR A:0x4a7100
y.create.l HWIO_MPM2_XPU_MEAR0_ADDR A:0x4a7140
y.create.l HWIO_MPM2_XPU_MESR_ADDR A:0x4a7148
y.create.l HWIO_MPM2_XPU_MESRRESTORE_ADDR A:0x4a714c
y.create.l HWIO_MPM2_XPU_MESYNR0_ADDR A:0x4a7150
y.create.l HWIO_MPM2_XPU_MESYNR1_ADDR A:0x4a7154
y.create.l HWIO_MPM2_XPU_MESYNR2_ADDR A:0x4a7158
y.create.l HWIO_MPM2_XPU_CR_ADDR A:0x4a7080
y.create.l HWIO_MPM2_XPU_RPU_ACR0_ADDR A:0x4a70a0
y.create.l HWIO_MPM2_XPU_EAR0_ADDR A:0x4a70c0
y.create.l HWIO_MPM2_XPU_ESR_ADDR A:0x4a70c8
y.create.l HWIO_MPM2_XPU_ESRRESTORE_ADDR A:0x4a70cc
y.create.l HWIO_MPM2_XPU_ESYNR0_ADDR A:0x4a70d0
y.create.l HWIO_MPM2_XPU_ESYNR1_ADDR A:0x4a70d4
y.create.l HWIO_MPM2_XPU_ESYNR2_ADDR A:0x4a70d8
y.create.l HWIO_MPM2_XPU_IDR0_ADDR A:0x4a7074
y.create.l HWIO_MPM2_XPU_IDR1_ADDR A:0x4a7078
y.create.l HWIO_MPM2_XPU_REV_ADDR A:0x4a707c
y.create.l HWIO_MPM2_XPU_RG0_RACR0_ADDR A:0x4a7200
y.create.l HWIO_MPM2_XPU_RG1_RACR0_ADDR A:0x4a7280
y.create.l HWIO_MPM2_XPU_RG2_RACR0_ADDR A:0x4a7300
y.create.l HWIO_MPM2_XPU_RG3_RACR0_ADDR A:0x4a7380
y.create.l HWIO_MPM2_XPU_RG4_RACR0_ADDR A:0x4a7400
y.create.l HWIO_MPM2_XPU_RG5_RACR0_ADDR A:0x4a7480
y.create.l HWIO_MPM2_XPU_RG6_RACR0_ADDR A:0x4a7500
y.create.l HWIO_MPM2_XPU_RG7_RACR0_ADDR A:0x4a7580
y.create.l HWIO_MPM2_XPU_RG8_RACR0_ADDR A:0x4a7600
y.create.l HWIO_MPM2_XPU_RG9_RACR0_ADDR A:0x4a7680
y.create.l HWIO_MPM2_XPU_RG0_SCR_ADDR A:0x4a7250
y.create.l HWIO_MPM2_XPU_RG1_SCR_ADDR A:0x4a72d0
y.create.l HWIO_MPM2_XPU_RG2_SCR_ADDR A:0x4a7350
y.create.l HWIO_MPM2_XPU_RG3_SCR_ADDR A:0x4a73d0
y.create.l HWIO_MPM2_XPU_RG4_SCR_ADDR A:0x4a7450
y.create.l HWIO_MPM2_XPU_RG5_SCR_ADDR A:0x4a74d0
y.create.l HWIO_MPM2_XPU_RG6_SCR_ADDR A:0x4a7550
y.create.l HWIO_MPM2_XPU_RG7_SCR_ADDR A:0x4a75d0
y.create.l HWIO_MPM2_XPU_RG8_SCR_ADDR A:0x4a7650
y.create.l HWIO_MPM2_XPU_RG9_SCR_ADDR A:0x4a76d0
y.create.l HWIO_MPM2_XPU_RG0_MCR_ADDR A:0x4a7254
y.create.l HWIO_MPM2_XPU_RG1_MCR_ADDR A:0x4a72d4
y.create.l HWIO_MPM2_XPU_RG2_MCR_ADDR A:0x4a7354
y.create.l HWIO_MPM2_XPU_RG3_MCR_ADDR A:0x4a73d4
y.create.l HWIO_MPM2_XPU_RG4_MCR_ADDR A:0x4a7454
y.create.l HWIO_MPM2_XPU_RG5_MCR_ADDR A:0x4a74d4
y.create.l HWIO_MPM2_XPU_RG6_MCR_ADDR A:0x4a7554
y.create.l HWIO_MPM2_XPU_RG7_MCR_ADDR A:0x4a75d4
y.create.l HWIO_MPM2_XPU_RG8_MCR_ADDR A:0x4a7654
y.create.l HWIO_MPM2_XPU_RG9_MCR_ADDR A:0x4a76d4
y.create.l HWIO_MPM2_TSENS_REG_BASE_START_ADDR A:0x4a8000
y.create.l HWIO_MPM2_TSENS_REG_BASE_LAST_ADDR A:0x4a8064
y.create.l HWIO_MPM2_TSENS_REG_BASE_END_ADDR A:0x4a9000
y.create.l HWIO_MPM2_TSENS_CTRL_ADDR A:0x4a8000
y.create.l HWIO_MPM2_TSENS_TEST_CTRL_ADDR A:0x4a8004
y.create.l HWIO_MPM2_TSENS_S0_MIN_MAX_STATUS_CTRL_ADDR A:0x4a8008
y.create.l HWIO_MPM2_TSENS_S1_MIN_MAX_STATUS_CTRL_ADDR A:0x4a800c
y.create.l HWIO_MPM2_TSENS_S2_MIN_MAX_STATUS_CTRL_ADDR A:0x4a8010
y.create.l HWIO_MPM2_TSENS_S3_MIN_MAX_STATUS_CTRL_ADDR A:0x4a8014
y.create.l HWIO_MPM2_TSENS_S4_MIN_MAX_STATUS_CTRL_ADDR A:0x4a8018
y.create.l HWIO_MPM2_TSENS_S5_MIN_MAX_STATUS_CTRL_ADDR A:0x4a801c
y.create.l HWIO_MPM2_TSENS_S6_MIN_MAX_STATUS_CTRL_ADDR A:0x4a8020
y.create.l HWIO_MPM2_TSENS_S7_MIN_MAX_STATUS_CTRL_ADDR A:0x4a8024
y.create.l HWIO_MPM2_TSENS_S8_MIN_MAX_STATUS_CTRL_ADDR A:0x4a8028
y.create.l HWIO_MPM2_TSENS_S9_MIN_MAX_STATUS_CTRL_ADDR A:0x4a802c
y.create.l HWIO_MPM2_TSENS_GLOBAL_CONFIG_ADDR A:0x4a8034
y.create.l HWIO_MPM2_TSENS_S0_MAIN_CONFIG_ADDR A:0x4a8038
y.create.l HWIO_MPM2_TSENS_S1_REMOTE_CONFIG_ADDR A:0x4a8040
y.create.l HWIO_MPM2_TSENS_S2_REMOTE_CONFIG_ADDR A:0x4a8044
y.create.l HWIO_MPM2_TSENS_S3_REMOTE_CONFIG_ADDR A:0x4a8048
y.create.l HWIO_MPM2_TSENS_S4_REMOTE_CONFIG_ADDR A:0x4a804c
y.create.l HWIO_MPM2_TSENS_S5_REMOTE_CONFIG_ADDR A:0x4a8050
y.create.l HWIO_MPM2_TSENS_S6_REMOTE_CONFIG_ADDR A:0x4a8054
y.create.l HWIO_MPM2_TSENS_S7_REMOTE_CONFIG_ADDR A:0x4a8058
y.create.l HWIO_MPM2_TSENS_S8_REMOTE_CONFIG_ADDR A:0x4a805c
y.create.l HWIO_MPM2_TSENS_S9_REMOTE_CONFIG_ADDR A:0x4a8060
y.create.l HWIO_MPM2_TSENS_S10_REMOTE_CONFIG_ADDR A:0x4a8064
y.create.l HWIO_MPM2_TSENS_TM_REG_BASE_START_ADDR A:0x4a9000
y.create.l HWIO_MPM2_TSENS_TM_REG_BASE_LAST_ADDR A:0x4a905c
y.create.l HWIO_MPM2_TSENS_TM_REG_BASE_END_ADDR A:0x4aa000
y.create.l HWIO_MPM2_TSENS_UPPER_LOWER_INTERRUPT_CTRL_ADDR A:0x4a9000
y.create.l HWIO_MPM2_TSENS_S0_UPPER_LOWER_STATUS_CTRL_ADDR A:0x4a9004
y.create.l HWIO_MPM2_TSENS_S1_UPPER_LOWER_STATUS_CTRL_ADDR A:0x4a9008
y.create.l HWIO_MPM2_TSENS_S2_UPPER_LOWER_STATUS_CTRL_ADDR A:0x4a900c
y.create.l HWIO_MPM2_TSENS_S3_UPPER_LOWER_STATUS_CTRL_ADDR A:0x4a9010
y.create.l HWIO_MPM2_TSENS_S4_UPPER_LOWER_STATUS_CTRL_ADDR A:0x4a9014
y.create.l HWIO_MPM2_TSENS_S5_UPPER_LOWER_STATUS_CTRL_ADDR A:0x4a9018
y.create.l HWIO_MPM2_TSENS_S6_UPPER_LOWER_STATUS_CTRL_ADDR A:0x4a901c
y.create.l HWIO_MPM2_TSENS_S7_UPPER_LOWER_STATUS_CTRL_ADDR A:0x4a9020
y.create.l HWIO_MPM2_TSENS_S8_UPPER_LOWER_STATUS_CTRL_ADDR A:0x4a9024
y.create.l HWIO_MPM2_TSENS_S9_UPPER_LOWER_STATUS_CTRL_ADDR A:0x4a9028
y.create.l HWIO_MPM2_TSENS_S0_STATUS_ADDR A:0x4a9030
y.create.l HWIO_MPM2_TSENS_S1_STATUS_ADDR A:0x4a9034
y.create.l HWIO_MPM2_TSENS_S2_STATUS_ADDR A:0x4a9038
y.create.l HWIO_MPM2_TSENS_S3_STATUS_ADDR A:0x4a903c
y.create.l HWIO_MPM2_TSENS_S4_STATUS_ADDR A:0x4a9040
y.create.l HWIO_MPM2_TSENS_S5_STATUS_ADDR A:0x4a9044
y.create.l HWIO_MPM2_TSENS_S6_STATUS_ADDR A:0x4a9048
y.create.l HWIO_MPM2_TSENS_S7_STATUS_ADDR A:0x4a904c
y.create.l HWIO_MPM2_TSENS_S8_STATUS_ADDR A:0x4a9050
y.create.l HWIO_MPM2_TSENS_S9_STATUS_ADDR A:0x4a9054
y.create.l HWIO_MPM2_TSENS_TRDY_ADDR A:0x4a905c
y.create.l HWIO_MPM2_WDOG_REG_BASE_START_ADDR A:0x4aa000
y.create.l HWIO_MPM2_WDOG_REG_BASE_LAST_ADDR A:0x4aa010
y.create.l HWIO_MPM2_WDOG_REG_BASE_END_ADDR A:0x4aa020
y.create.l HWIO_MPM2_WDOG_RESET_REG_ADDR A:0x4aa000
y.create.l HWIO_MPM2_WDOG_CTL_REG_ADDR A:0x4aa004
y.create.l HWIO_MPM2_WDOG_STATUS_REG_ADDR A:0x4aa008
y.create.l HWIO_MPM2_WDOG_BARK_VAL_REG_ADDR A:0x4aa00c
y.create.l HWIO_MPM2_WDOG_BITE_VAL_REG_ADDR A:0x4aa010
y.create.l HWIO_MPM2_PSHOLD_REG_BASE_START_ADDR A:0x4ab000
y.create.l HWIO_MPM2_PSHOLD_REG_BASE_LAST_ADDR A:0x4ab024
y.create.l HWIO_MPM2_PSHOLD_REG_BASE_END_ADDR A:0x4ac000
y.create.l HWIO_MPM2_MPM_PS_HOLD_ADDR A:0x4ab000
y.create.l HWIO_MPM2_MPM_DDR_PHY_FREEZEIO_EBI1_ADDR A:0x4ab004
y.create.l HWIO_MPM2_PONOFF_CLAMP_MEM_STATUS_ADDR_ADDR A:0x4ab020
y.create.l HWIO_MPM2_CLAMP_CTRL_PONOFF_PHY_ADDR A:0x4ab024
y.create.l HWIO_MPU_BOOT_IMEM_CFG_MPU1132A_4_M31L12_AHB_REG_BASE_START_ADDR A:0x88000
y.create.l HWIO_MPU_BOOT_IMEM_CFG_MPU1132A_4_M31L12_AHB_REG_BASE_LAST_ADDR A:0x883dc
y.create.l HWIO_MPU_BOOT_IMEM_CFG_MPU1132A_4_M31L12_AHB_REG_BASE_END_ADDR A:0x88400
y.create.l HWIO_MPU_BOOT_IMEM_CFG_XPU_SCR_ADDR A:0x88000
y.create.l HWIO_MPU_BOOT_IMEM_CFG_XPU_SWDR_ADDR A:0x88004
y.create.l HWIO_MPU_BOOT_IMEM_CFG_XPU_PRTN_RACR_SSHADOW_ADDR A:0x88008
y.create.l HWIO_MPU_BOOT_IMEM_CFG_XPU_PRTN_WACR_SSHADOW_ADDR A:0x8800c
y.create.l HWIO_MPU_BOOT_IMEM_CFG_XPU_PRTN_START_SSHADOW0_ADDR A:0x88010
y.create.l HWIO_MPU_BOOT_IMEM_CFG_XPU_PRTN_END_SSHADOW0_ADDR A:0x88018
y.create.l HWIO_MPU_BOOT_IMEM_CFG_XPU_SEAR0_ADDR A:0x88040
y.create.l HWIO_MPU_BOOT_IMEM_CFG_XPU_SESR_ADDR A:0x88048
y.create.l HWIO_MPU_BOOT_IMEM_CFG_XPU_SESRRESTORE_ADDR A:0x8804c
y.create.l HWIO_MPU_BOOT_IMEM_CFG_XPU_SESYNR0_ADDR A:0x88050
y.create.l HWIO_MPU_BOOT_IMEM_CFG_XPU_SESYNR1_ADDR A:0x88054
y.create.l HWIO_MPU_BOOT_IMEM_CFG_XPU_SESYNR2_ADDR A:0x88058
y.create.l HWIO_MPU_BOOT_IMEM_CFG_XPU_MCR_ADDR A:0x88100
y.create.l HWIO_MPU_BOOT_IMEM_CFG_XPU_MEAR0_ADDR A:0x88140
y.create.l HWIO_MPU_BOOT_IMEM_CFG_XPU_MESR_ADDR A:0x88148
y.create.l HWIO_MPU_BOOT_IMEM_CFG_XPU_MESRRESTORE_ADDR A:0x8814c
y.create.l HWIO_MPU_BOOT_IMEM_CFG_XPU_MESYNR0_ADDR A:0x88150
y.create.l HWIO_MPU_BOOT_IMEM_CFG_XPU_MESYNR1_ADDR A:0x88154
y.create.l HWIO_MPU_BOOT_IMEM_CFG_XPU_MESYNR2_ADDR A:0x88158
y.create.l HWIO_MPU_BOOT_IMEM_CFG_XPU_CR_ADDR A:0x88080
y.create.l HWIO_MPU_BOOT_IMEM_CFG_XPU_PRTN_RACR_SHADOW_ADDR A:0x88088
y.create.l HWIO_MPU_BOOT_IMEM_CFG_XPU_PRTN_WACR_SHADOW_ADDR A:0x8808c
y.create.l HWIO_MPU_BOOT_IMEM_CFG_XPU_PRTN_START_SHADOW0_ADDR A:0x88090
y.create.l HWIO_MPU_BOOT_IMEM_CFG_XPU_PRTN_END_SHADOW0_ADDR A:0x88098
y.create.l HWIO_MPU_BOOT_IMEM_CFG_XPU_RPU_ACR0_ADDR A:0x880a0
y.create.l HWIO_MPU_BOOT_IMEM_CFG_XPU_EAR0_ADDR A:0x880c0
y.create.l HWIO_MPU_BOOT_IMEM_CFG_XPU_ESR_ADDR A:0x880c8
y.create.l HWIO_MPU_BOOT_IMEM_CFG_XPU_ESRRESTORE_ADDR A:0x880cc
y.create.l HWIO_MPU_BOOT_IMEM_CFG_XPU_ESYNR0_ADDR A:0x880d0
y.create.l HWIO_MPU_BOOT_IMEM_CFG_XPU_ESYNR1_ADDR A:0x880d4
y.create.l HWIO_MPU_BOOT_IMEM_CFG_XPU_ESYNR2_ADDR A:0x880d8
y.create.l HWIO_MPU_BOOT_IMEM_CFG_XPU_UMR_RACR_ADDR A:0x880e0
y.create.l HWIO_MPU_BOOT_IMEM_CFG_XPU_UMR_WACR_ADDR A:0x880e4
y.create.l HWIO_MPU_BOOT_IMEM_CFG_XPU_UMR_CNTL_ADDR A:0x880f0
y.create.l HWIO_MPU_BOOT_IMEM_CFG_XPU_IDR0_ADDR A:0x88074
y.create.l HWIO_MPU_BOOT_IMEM_CFG_XPU_IDR1_ADDR A:0x88078
y.create.l HWIO_MPU_BOOT_IMEM_CFG_XPU_REV_ADDR A:0x8807c
y.create.l HWIO_MPU_BOOT_IMEM_CFG_XPU_PRT0_RACR0_ADDR A:0x88200
y.create.l HWIO_MPU_BOOT_IMEM_CFG_XPU_PRT1_RACR0_ADDR A:0x88280
y.create.l HWIO_MPU_BOOT_IMEM_CFG_XPU_PRT2_RACR0_ADDR A:0x88300
y.create.l HWIO_MPU_BOOT_IMEM_CFG_XPU_PRT3_RACR0_ADDR A:0x88380
y.create.l HWIO_MPU_BOOT_IMEM_CFG_XPU_PRT0_WACR0_ADDR A:0x88220
y.create.l HWIO_MPU_BOOT_IMEM_CFG_XPU_PRT1_WACR0_ADDR A:0x882a0
y.create.l HWIO_MPU_BOOT_IMEM_CFG_XPU_PRT2_WACR0_ADDR A:0x88320
y.create.l HWIO_MPU_BOOT_IMEM_CFG_XPU_PRT3_WACR0_ADDR A:0x883a0
y.create.l HWIO_MPU_BOOT_IMEM_CFG_XPU_PRT0_START0_ADDR A:0x88240
y.create.l HWIO_MPU_BOOT_IMEM_CFG_XPU_PRT1_START0_ADDR A:0x882c0
y.create.l HWIO_MPU_BOOT_IMEM_CFG_XPU_PRT2_START0_ADDR A:0x88340
y.create.l HWIO_MPU_BOOT_IMEM_CFG_XPU_PRT3_START0_ADDR A:0x883c0
y.create.l HWIO_MPU_BOOT_IMEM_CFG_XPU_PRT0_END0_ADDR A:0x88248
y.create.l HWIO_MPU_BOOT_IMEM_CFG_XPU_PRT1_END0_ADDR A:0x882c8
y.create.l HWIO_MPU_BOOT_IMEM_CFG_XPU_PRT2_END0_ADDR A:0x88348
y.create.l HWIO_MPU_BOOT_IMEM_CFG_XPU_PRT3_END0_ADDR A:0x883c8
y.create.l HWIO_MPU_BOOT_IMEM_CFG_XPU_PRT0_SCR_ADDR A:0x88250
y.create.l HWIO_MPU_BOOT_IMEM_CFG_XPU_PRT1_SCR_ADDR A:0x882d0
y.create.l HWIO_MPU_BOOT_IMEM_CFG_XPU_PRT2_SCR_ADDR A:0x88350
y.create.l HWIO_MPU_BOOT_IMEM_CFG_XPU_PRT3_SCR_ADDR A:0x883d0
y.create.l HWIO_MPU_BOOT_IMEM_CFG_XPU_PRT0_MCR_ADDR A:0x88254
y.create.l HWIO_MPU_BOOT_IMEM_CFG_XPU_PRT1_MCR_ADDR A:0x882d4
y.create.l HWIO_MPU_BOOT_IMEM_CFG_XPU_PRT2_MCR_ADDR A:0x88354
y.create.l HWIO_MPU_BOOT_IMEM_CFG_XPU_PRT3_MCR_ADDR A:0x883d4
y.create.l HWIO_MPU_BOOT_IMEM_CFG_XPU_PRT0_CNTL0_ADDR A:0x88258
y.create.l HWIO_MPU_BOOT_IMEM_CFG_XPU_PRT1_CNTL0_ADDR A:0x882d8
y.create.l HWIO_MPU_BOOT_IMEM_CFG_XPU_PRT2_CNTL0_ADDR A:0x88358
y.create.l HWIO_MPU_BOOT_IMEM_CFG_XPU_PRT3_CNTL0_ADDR A:0x883d8
y.create.l HWIO_MPU_BOOT_IMEM_CFG_XPU_PRT0_CNTL1_ADDR A:0x8825c
y.create.l HWIO_MPU_BOOT_IMEM_CFG_XPU_PRT1_CNTL1_ADDR A:0x882dc
y.create.l HWIO_MPU_BOOT_IMEM_CFG_XPU_PRT2_CNTL1_ADDR A:0x8835c
y.create.l HWIO_MPU_BOOT_IMEM_CFG_XPU_PRT3_CNTL1_ADDR A:0x883dc
y.create.l HWIO_MPU_MSS_NAV_CE_CFG_MPU1132A_10_M31L12_AXI_REG_BASE_START_ADDR A:0x8a000
y.create.l HWIO_MPU_MSS_NAV_CE_CFG_MPU1132A_10_M31L12_AXI_REG_BASE_LAST_ADDR A:0x8a6dc
y.create.l HWIO_MPU_MSS_NAV_CE_CFG_MPU1132A_10_M31L12_AXI_REG_BASE_END_ADDR A:0x8a700
y.create.l HWIO_MPU_MSS_NAV_CE_CFG_XPU_SCR_ADDR A:0x8a000
y.create.l HWIO_MPU_MSS_NAV_CE_CFG_XPU_SWDR_ADDR A:0x8a004
y.create.l HWIO_MPU_MSS_NAV_CE_CFG_XPU_PRTN_RACR_SSHADOW_ADDR A:0x8a008
y.create.l HWIO_MPU_MSS_NAV_CE_CFG_XPU_PRTN_WACR_SSHADOW_ADDR A:0x8a00c
y.create.l HWIO_MPU_MSS_NAV_CE_CFG_XPU_PRTN_START_SSHADOW0_ADDR A:0x8a010
y.create.l HWIO_MPU_MSS_NAV_CE_CFG_XPU_PRTN_END_SSHADOW0_ADDR A:0x8a018
y.create.l HWIO_MPU_MSS_NAV_CE_CFG_XPU_SEAR0_ADDR A:0x8a040
y.create.l HWIO_MPU_MSS_NAV_CE_CFG_XPU_SESR_ADDR A:0x8a048
y.create.l HWIO_MPU_MSS_NAV_CE_CFG_XPU_SESRRESTORE_ADDR A:0x8a04c
y.create.l HWIO_MPU_MSS_NAV_CE_CFG_XPU_SESYNR0_ADDR A:0x8a050
y.create.l HWIO_MPU_MSS_NAV_CE_CFG_XPU_SESYNR1_ADDR A:0x8a054
y.create.l HWIO_MPU_MSS_NAV_CE_CFG_XPU_SESYNR2_ADDR A:0x8a058
y.create.l HWIO_MPU_MSS_NAV_CE_CFG_XPU_MCR_ADDR A:0x8a100
y.create.l HWIO_MPU_MSS_NAV_CE_CFG_XPU_MEAR0_ADDR A:0x8a140
y.create.l HWIO_MPU_MSS_NAV_CE_CFG_XPU_MESR_ADDR A:0x8a148
y.create.l HWIO_MPU_MSS_NAV_CE_CFG_XPU_MESRRESTORE_ADDR A:0x8a14c
y.create.l HWIO_MPU_MSS_NAV_CE_CFG_XPU_MESYNR0_ADDR A:0x8a150
y.create.l HWIO_MPU_MSS_NAV_CE_CFG_XPU_MESYNR1_ADDR A:0x8a154
y.create.l HWIO_MPU_MSS_NAV_CE_CFG_XPU_MESYNR2_ADDR A:0x8a158
y.create.l HWIO_MPU_MSS_NAV_CE_CFG_XPU_CR_ADDR A:0x8a080
y.create.l HWIO_MPU_MSS_NAV_CE_CFG_XPU_PRTN_RACR_SHADOW_ADDR A:0x8a088
y.create.l HWIO_MPU_MSS_NAV_CE_CFG_XPU_PRTN_WACR_SHADOW_ADDR A:0x8a08c
y.create.l HWIO_MPU_MSS_NAV_CE_CFG_XPU_PRTN_START_SHADOW0_ADDR A:0x8a090
y.create.l HWIO_MPU_MSS_NAV_CE_CFG_XPU_PRTN_END_SHADOW0_ADDR A:0x8a098
y.create.l HWIO_MPU_MSS_NAV_CE_CFG_XPU_RPU_ACR0_ADDR A:0x8a0a0
y.create.l HWIO_MPU_MSS_NAV_CE_CFG_XPU_EAR0_ADDR A:0x8a0c0
y.create.l HWIO_MPU_MSS_NAV_CE_CFG_XPU_ESR_ADDR A:0x8a0c8
y.create.l HWIO_MPU_MSS_NAV_CE_CFG_XPU_ESRRESTORE_ADDR A:0x8a0cc
y.create.l HWIO_MPU_MSS_NAV_CE_CFG_XPU_ESYNR0_ADDR A:0x8a0d0
y.create.l HWIO_MPU_MSS_NAV_CE_CFG_XPU_ESYNR1_ADDR A:0x8a0d4
y.create.l HWIO_MPU_MSS_NAV_CE_CFG_XPU_ESYNR2_ADDR A:0x8a0d8
y.create.l HWIO_MPU_MSS_NAV_CE_CFG_XPU_UMR_RACR_ADDR A:0x8a0e0
y.create.l HWIO_MPU_MSS_NAV_CE_CFG_XPU_UMR_WACR_ADDR A:0x8a0e4
y.create.l HWIO_MPU_MSS_NAV_CE_CFG_XPU_UMR_CNTL_ADDR A:0x8a0f0
y.create.l HWIO_MPU_MSS_NAV_CE_CFG_XPU_IDR0_ADDR A:0x8a074
y.create.l HWIO_MPU_MSS_NAV_CE_CFG_XPU_IDR1_ADDR A:0x8a078
y.create.l HWIO_MPU_MSS_NAV_CE_CFG_XPU_REV_ADDR A:0x8a07c
y.create.l HWIO_MPU_MSS_NAV_CE_CFG_XPU_PRT0_RACR0_ADDR A:0x8a200
y.create.l HWIO_MPU_MSS_NAV_CE_CFG_XPU_PRT1_RACR0_ADDR A:0x8a280
y.create.l HWIO_MPU_MSS_NAV_CE_CFG_XPU_PRT2_RACR0_ADDR A:0x8a300
y.create.l HWIO_MPU_MSS_NAV_CE_CFG_XPU_PRT3_RACR0_ADDR A:0x8a380
y.create.l HWIO_MPU_MSS_NAV_CE_CFG_XPU_PRT4_RACR0_ADDR A:0x8a400
y.create.l HWIO_MPU_MSS_NAV_CE_CFG_XPU_PRT5_RACR0_ADDR A:0x8a480
y.create.l HWIO_MPU_MSS_NAV_CE_CFG_XPU_PRT6_RACR0_ADDR A:0x8a500
y.create.l HWIO_MPU_MSS_NAV_CE_CFG_XPU_PRT7_RACR0_ADDR A:0x8a580
y.create.l HWIO_MPU_MSS_NAV_CE_CFG_XPU_PRT8_RACR0_ADDR A:0x8a600
y.create.l HWIO_MPU_MSS_NAV_CE_CFG_XPU_PRT9_RACR0_ADDR A:0x8a680
y.create.l HWIO_MPU_MSS_NAV_CE_CFG_XPU_PRT0_WACR0_ADDR A:0x8a220
y.create.l HWIO_MPU_MSS_NAV_CE_CFG_XPU_PRT1_WACR0_ADDR A:0x8a2a0
y.create.l HWIO_MPU_MSS_NAV_CE_CFG_XPU_PRT2_WACR0_ADDR A:0x8a320
y.create.l HWIO_MPU_MSS_NAV_CE_CFG_XPU_PRT3_WACR0_ADDR A:0x8a3a0
y.create.l HWIO_MPU_MSS_NAV_CE_CFG_XPU_PRT4_WACR0_ADDR A:0x8a420
y.create.l HWIO_MPU_MSS_NAV_CE_CFG_XPU_PRT5_WACR0_ADDR A:0x8a4a0
y.create.l HWIO_MPU_MSS_NAV_CE_CFG_XPU_PRT6_WACR0_ADDR A:0x8a520
y.create.l HWIO_MPU_MSS_NAV_CE_CFG_XPU_PRT7_WACR0_ADDR A:0x8a5a0
y.create.l HWIO_MPU_MSS_NAV_CE_CFG_XPU_PRT8_WACR0_ADDR A:0x8a620
y.create.l HWIO_MPU_MSS_NAV_CE_CFG_XPU_PRT9_WACR0_ADDR A:0x8a6a0
y.create.l HWIO_MPU_MSS_NAV_CE_CFG_XPU_PRT0_START0_ADDR A:0x8a240
y.create.l HWIO_MPU_MSS_NAV_CE_CFG_XPU_PRT1_START0_ADDR A:0x8a2c0
y.create.l HWIO_MPU_MSS_NAV_CE_CFG_XPU_PRT2_START0_ADDR A:0x8a340
y.create.l HWIO_MPU_MSS_NAV_CE_CFG_XPU_PRT3_START0_ADDR A:0x8a3c0
y.create.l HWIO_MPU_MSS_NAV_CE_CFG_XPU_PRT4_START0_ADDR A:0x8a440
y.create.l HWIO_MPU_MSS_NAV_CE_CFG_XPU_PRT5_START0_ADDR A:0x8a4c0
y.create.l HWIO_MPU_MSS_NAV_CE_CFG_XPU_PRT6_START0_ADDR A:0x8a540
y.create.l HWIO_MPU_MSS_NAV_CE_CFG_XPU_PRT7_START0_ADDR A:0x8a5c0
y.create.l HWIO_MPU_MSS_NAV_CE_CFG_XPU_PRT8_START0_ADDR A:0x8a640
y.create.l HWIO_MPU_MSS_NAV_CE_CFG_XPU_PRT9_START0_ADDR A:0x8a6c0
y.create.l HWIO_MPU_MSS_NAV_CE_CFG_XPU_PRT0_END0_ADDR A:0x8a248
y.create.l HWIO_MPU_MSS_NAV_CE_CFG_XPU_PRT1_END0_ADDR A:0x8a2c8
y.create.l HWIO_MPU_MSS_NAV_CE_CFG_XPU_PRT2_END0_ADDR A:0x8a348
y.create.l HWIO_MPU_MSS_NAV_CE_CFG_XPU_PRT3_END0_ADDR A:0x8a3c8
y.create.l HWIO_MPU_MSS_NAV_CE_CFG_XPU_PRT4_END0_ADDR A:0x8a448
y.create.l HWIO_MPU_MSS_NAV_CE_CFG_XPU_PRT5_END0_ADDR A:0x8a4c8
y.create.l HWIO_MPU_MSS_NAV_CE_CFG_XPU_PRT6_END0_ADDR A:0x8a548
y.create.l HWIO_MPU_MSS_NAV_CE_CFG_XPU_PRT7_END0_ADDR A:0x8a5c8
y.create.l HWIO_MPU_MSS_NAV_CE_CFG_XPU_PRT8_END0_ADDR A:0x8a648
y.create.l HWIO_MPU_MSS_NAV_CE_CFG_XPU_PRT9_END0_ADDR A:0x8a6c8
y.create.l HWIO_MPU_MSS_NAV_CE_CFG_XPU_PRT0_SCR_ADDR A:0x8a250
y.create.l HWIO_MPU_MSS_NAV_CE_CFG_XPU_PRT1_SCR_ADDR A:0x8a2d0
y.create.l HWIO_MPU_MSS_NAV_CE_CFG_XPU_PRT2_SCR_ADDR A:0x8a350
y.create.l HWIO_MPU_MSS_NAV_CE_CFG_XPU_PRT3_SCR_ADDR A:0x8a3d0
y.create.l HWIO_MPU_MSS_NAV_CE_CFG_XPU_PRT4_SCR_ADDR A:0x8a450
y.create.l HWIO_MPU_MSS_NAV_CE_CFG_XPU_PRT5_SCR_ADDR A:0x8a4d0
y.create.l HWIO_MPU_MSS_NAV_CE_CFG_XPU_PRT6_SCR_ADDR A:0x8a550
y.create.l HWIO_MPU_MSS_NAV_CE_CFG_XPU_PRT7_SCR_ADDR A:0x8a5d0
y.create.l HWIO_MPU_MSS_NAV_CE_CFG_XPU_PRT8_SCR_ADDR A:0x8a650
y.create.l HWIO_MPU_MSS_NAV_CE_CFG_XPU_PRT9_SCR_ADDR A:0x8a6d0
y.create.l HWIO_MPU_MSS_NAV_CE_CFG_XPU_PRT0_MCR_ADDR A:0x8a254
y.create.l HWIO_MPU_MSS_NAV_CE_CFG_XPU_PRT1_MCR_ADDR A:0x8a2d4
y.create.l HWIO_MPU_MSS_NAV_CE_CFG_XPU_PRT2_MCR_ADDR A:0x8a354
y.create.l HWIO_MPU_MSS_NAV_CE_CFG_XPU_PRT3_MCR_ADDR A:0x8a3d4
y.create.l HWIO_MPU_MSS_NAV_CE_CFG_XPU_PRT4_MCR_ADDR A:0x8a454
y.create.l HWIO_MPU_MSS_NAV_CE_CFG_XPU_PRT5_MCR_ADDR A:0x8a4d4
y.create.l HWIO_MPU_MSS_NAV_CE_CFG_XPU_PRT6_MCR_ADDR A:0x8a554
y.create.l HWIO_MPU_MSS_NAV_CE_CFG_XPU_PRT7_MCR_ADDR A:0x8a5d4
y.create.l HWIO_MPU_MSS_NAV_CE_CFG_XPU_PRT8_MCR_ADDR A:0x8a654
y.create.l HWIO_MPU_MSS_NAV_CE_CFG_XPU_PRT9_MCR_ADDR A:0x8a6d4
y.create.l HWIO_MPU_MSS_NAV_CE_CFG_XPU_PRT0_CNTL0_ADDR A:0x8a258
y.create.l HWIO_MPU_MSS_NAV_CE_CFG_XPU_PRT1_CNTL0_ADDR A:0x8a2d8
y.create.l HWIO_MPU_MSS_NAV_CE_CFG_XPU_PRT2_CNTL0_ADDR A:0x8a358
y.create.l HWIO_MPU_MSS_NAV_CE_CFG_XPU_PRT3_CNTL0_ADDR A:0x8a3d8
y.create.l HWIO_MPU_MSS_NAV_CE_CFG_XPU_PRT4_CNTL0_ADDR A:0x8a458
y.create.l HWIO_MPU_MSS_NAV_CE_CFG_XPU_PRT5_CNTL0_ADDR A:0x8a4d8
y.create.l HWIO_MPU_MSS_NAV_CE_CFG_XPU_PRT6_CNTL0_ADDR A:0x8a558
y.create.l HWIO_MPU_MSS_NAV_CE_CFG_XPU_PRT7_CNTL0_ADDR A:0x8a5d8
y.create.l HWIO_MPU_MSS_NAV_CE_CFG_XPU_PRT8_CNTL0_ADDR A:0x8a658
y.create.l HWIO_MPU_MSS_NAV_CE_CFG_XPU_PRT9_CNTL0_ADDR A:0x8a6d8
y.create.l HWIO_MPU_MSS_NAV_CE_CFG_XPU_PRT0_CNTL1_ADDR A:0x8a25c
y.create.l HWIO_MPU_MSS_NAV_CE_CFG_XPU_PRT1_CNTL1_ADDR A:0x8a2dc
y.create.l HWIO_MPU_MSS_NAV_CE_CFG_XPU_PRT2_CNTL1_ADDR A:0x8a35c
y.create.l HWIO_MPU_MSS_NAV_CE_CFG_XPU_PRT3_CNTL1_ADDR A:0x8a3dc
y.create.l HWIO_MPU_MSS_NAV_CE_CFG_XPU_PRT4_CNTL1_ADDR A:0x8a45c
y.create.l HWIO_MPU_MSS_NAV_CE_CFG_XPU_PRT5_CNTL1_ADDR A:0x8a4dc
y.create.l HWIO_MPU_MSS_NAV_CE_CFG_XPU_PRT6_CNTL1_ADDR A:0x8a55c
y.create.l HWIO_MPU_MSS_NAV_CE_CFG_XPU_PRT7_CNTL1_ADDR A:0x8a5dc
y.create.l HWIO_MPU_MSS_NAV_CE_CFG_XPU_PRT8_CNTL1_ADDR A:0x8a65c
y.create.l HWIO_MPU_MSS_NAV_CE_CFG_XPU_PRT9_CNTL1_ADDR A:0x8a6dc
y.create.l HWIO_MPU_MSS_Q6_CFG_MPU1132A_20_M31L12_AXI_REG_BASE_START_ADDR A:0x8e000
y.create.l HWIO_MPU_MSS_Q6_CFG_MPU1132A_20_M31L12_AXI_REG_BASE_LAST_ADDR A:0x8ebdc
y.create.l HWIO_MPU_MSS_Q6_CFG_MPU1132A_20_M31L12_AXI_REG_BASE_END_ADDR A:0x8ec00
y.create.l HWIO_MPU_MSS_Q6_CFG_XPU_SCR_ADDR A:0x8e000
y.create.l HWIO_MPU_MSS_Q6_CFG_XPU_SWDR_ADDR A:0x8e004
y.create.l HWIO_MPU_MSS_Q6_CFG_XPU_PRTN_RACR_SSHADOW_ADDR A:0x8e008
y.create.l HWIO_MPU_MSS_Q6_CFG_XPU_PRTN_WACR_SSHADOW_ADDR A:0x8e00c
y.create.l HWIO_MPU_MSS_Q6_CFG_XPU_PRTN_START_SSHADOW0_ADDR A:0x8e010
y.create.l HWIO_MPU_MSS_Q6_CFG_XPU_PRTN_END_SSHADOW0_ADDR A:0x8e018
y.create.l HWIO_MPU_MSS_Q6_CFG_XPU_SEAR0_ADDR A:0x8e040
y.create.l HWIO_MPU_MSS_Q6_CFG_XPU_SESR_ADDR A:0x8e048
y.create.l HWIO_MPU_MSS_Q6_CFG_XPU_SESRRESTORE_ADDR A:0x8e04c
y.create.l HWIO_MPU_MSS_Q6_CFG_XPU_SESYNR0_ADDR A:0x8e050
y.create.l HWIO_MPU_MSS_Q6_CFG_XPU_SESYNR1_ADDR A:0x8e054
y.create.l HWIO_MPU_MSS_Q6_CFG_XPU_SESYNR2_ADDR A:0x8e058
y.create.l HWIO_MPU_MSS_Q6_CFG_XPU_MCR_ADDR A:0x8e100
y.create.l HWIO_MPU_MSS_Q6_CFG_XPU_MEAR0_ADDR A:0x8e140
y.create.l HWIO_MPU_MSS_Q6_CFG_XPU_MESR_ADDR A:0x8e148
y.create.l HWIO_MPU_MSS_Q6_CFG_XPU_MESRRESTORE_ADDR A:0x8e14c
y.create.l HWIO_MPU_MSS_Q6_CFG_XPU_MESYNR0_ADDR A:0x8e150
y.create.l HWIO_MPU_MSS_Q6_CFG_XPU_MESYNR1_ADDR A:0x8e154
y.create.l HWIO_MPU_MSS_Q6_CFG_XPU_MESYNR2_ADDR A:0x8e158
y.create.l HWIO_MPU_MSS_Q6_CFG_XPU_CR_ADDR A:0x8e080
y.create.l HWIO_MPU_MSS_Q6_CFG_XPU_PRTN_RACR_SHADOW_ADDR A:0x8e088
y.create.l HWIO_MPU_MSS_Q6_CFG_XPU_PRTN_WACR_SHADOW_ADDR A:0x8e08c
y.create.l HWIO_MPU_MSS_Q6_CFG_XPU_PRTN_START_SHADOW0_ADDR A:0x8e090
y.create.l HWIO_MPU_MSS_Q6_CFG_XPU_PRTN_END_SHADOW0_ADDR A:0x8e098
y.create.l HWIO_MPU_MSS_Q6_CFG_XPU_RPU_ACR0_ADDR A:0x8e0a0
y.create.l HWIO_MPU_MSS_Q6_CFG_XPU_EAR0_ADDR A:0x8e0c0
y.create.l HWIO_MPU_MSS_Q6_CFG_XPU_ESR_ADDR A:0x8e0c8
y.create.l HWIO_MPU_MSS_Q6_CFG_XPU_ESRRESTORE_ADDR A:0x8e0cc
y.create.l HWIO_MPU_MSS_Q6_CFG_XPU_ESYNR0_ADDR A:0x8e0d0
y.create.l HWIO_MPU_MSS_Q6_CFG_XPU_ESYNR1_ADDR A:0x8e0d4
y.create.l HWIO_MPU_MSS_Q6_CFG_XPU_ESYNR2_ADDR A:0x8e0d8
y.create.l HWIO_MPU_MSS_Q6_CFG_XPU_UMR_RACR_ADDR A:0x8e0e0
y.create.l HWIO_MPU_MSS_Q6_CFG_XPU_UMR_WACR_ADDR A:0x8e0e4
y.create.l HWIO_MPU_MSS_Q6_CFG_XPU_UMR_CNTL_ADDR A:0x8e0f0
y.create.l HWIO_MPU_MSS_Q6_CFG_XPU_IDR0_ADDR A:0x8e074
y.create.l HWIO_MPU_MSS_Q6_CFG_XPU_IDR1_ADDR A:0x8e078
y.create.l HWIO_MPU_MSS_Q6_CFG_XPU_REV_ADDR A:0x8e07c
y.create.l HWIO_MPU_MSS_Q6_CFG_XPU_PRT0_RACR0_ADDR A:0x8e200
y.create.l HWIO_MPU_MSS_Q6_CFG_XPU_PRT1_RACR0_ADDR A:0x8e280
y.create.l HWIO_MPU_MSS_Q6_CFG_XPU_PRT2_RACR0_ADDR A:0x8e300
y.create.l HWIO_MPU_MSS_Q6_CFG_XPU_PRT3_RACR0_ADDR A:0x8e380
y.create.l HWIO_MPU_MSS_Q6_CFG_XPU_PRT4_RACR0_ADDR A:0x8e400
y.create.l HWIO_MPU_MSS_Q6_CFG_XPU_PRT5_RACR0_ADDR A:0x8e480
y.create.l HWIO_MPU_MSS_Q6_CFG_XPU_PRT6_RACR0_ADDR A:0x8e500
y.create.l HWIO_MPU_MSS_Q6_CFG_XPU_PRT7_RACR0_ADDR A:0x8e580
y.create.l HWIO_MPU_MSS_Q6_CFG_XPU_PRT8_RACR0_ADDR A:0x8e600
y.create.l HWIO_MPU_MSS_Q6_CFG_XPU_PRT9_RACR0_ADDR A:0x8e680
y.create.l HWIO_MPU_MSS_Q6_CFG_XPU_PRT0_WACR0_ADDR A:0x8e220
y.create.l HWIO_MPU_MSS_Q6_CFG_XPU_PRT1_WACR0_ADDR A:0x8e2a0
y.create.l HWIO_MPU_MSS_Q6_CFG_XPU_PRT2_WACR0_ADDR A:0x8e320
y.create.l HWIO_MPU_MSS_Q6_CFG_XPU_PRT3_WACR0_ADDR A:0x8e3a0
y.create.l HWIO_MPU_MSS_Q6_CFG_XPU_PRT4_WACR0_ADDR A:0x8e420
y.create.l HWIO_MPU_MSS_Q6_CFG_XPU_PRT5_WACR0_ADDR A:0x8e4a0
y.create.l HWIO_MPU_MSS_Q6_CFG_XPU_PRT6_WACR0_ADDR A:0x8e520
y.create.l HWIO_MPU_MSS_Q6_CFG_XPU_PRT7_WACR0_ADDR A:0x8e5a0
y.create.l HWIO_MPU_MSS_Q6_CFG_XPU_PRT8_WACR0_ADDR A:0x8e620
y.create.l HWIO_MPU_MSS_Q6_CFG_XPU_PRT9_WACR0_ADDR A:0x8e6a0
y.create.l HWIO_MPU_MSS_Q6_CFG_XPU_PRT0_START0_ADDR A:0x8e240
y.create.l HWIO_MPU_MSS_Q6_CFG_XPU_PRT1_START0_ADDR A:0x8e2c0
y.create.l HWIO_MPU_MSS_Q6_CFG_XPU_PRT2_START0_ADDR A:0x8e340
y.create.l HWIO_MPU_MSS_Q6_CFG_XPU_PRT3_START0_ADDR A:0x8e3c0
y.create.l HWIO_MPU_MSS_Q6_CFG_XPU_PRT4_START0_ADDR A:0x8e440
y.create.l HWIO_MPU_MSS_Q6_CFG_XPU_PRT5_START0_ADDR A:0x8e4c0
y.create.l HWIO_MPU_MSS_Q6_CFG_XPU_PRT6_START0_ADDR A:0x8e540
y.create.l HWIO_MPU_MSS_Q6_CFG_XPU_PRT7_START0_ADDR A:0x8e5c0
y.create.l HWIO_MPU_MSS_Q6_CFG_XPU_PRT8_START0_ADDR A:0x8e640
y.create.l HWIO_MPU_MSS_Q6_CFG_XPU_PRT9_START0_ADDR A:0x8e6c0
y.create.l HWIO_MPU_MSS_Q6_CFG_XPU_PRT0_END0_ADDR A:0x8e248
y.create.l HWIO_MPU_MSS_Q6_CFG_XPU_PRT1_END0_ADDR A:0x8e2c8
y.create.l HWIO_MPU_MSS_Q6_CFG_XPU_PRT2_END0_ADDR A:0x8e348
y.create.l HWIO_MPU_MSS_Q6_CFG_XPU_PRT3_END0_ADDR A:0x8e3c8
y.create.l HWIO_MPU_MSS_Q6_CFG_XPU_PRT4_END0_ADDR A:0x8e448
y.create.l HWIO_MPU_MSS_Q6_CFG_XPU_PRT5_END0_ADDR A:0x8e4c8
y.create.l HWIO_MPU_MSS_Q6_CFG_XPU_PRT6_END0_ADDR A:0x8e548
y.create.l HWIO_MPU_MSS_Q6_CFG_XPU_PRT7_END0_ADDR A:0x8e5c8
y.create.l HWIO_MPU_MSS_Q6_CFG_XPU_PRT8_END0_ADDR A:0x8e648
y.create.l HWIO_MPU_MSS_Q6_CFG_XPU_PRT9_END0_ADDR A:0x8e6c8
y.create.l HWIO_MPU_MSS_Q6_CFG_XPU_PRT0_SCR_ADDR A:0x8e250
y.create.l HWIO_MPU_MSS_Q6_CFG_XPU_PRT1_SCR_ADDR A:0x8e2d0
y.create.l HWIO_MPU_MSS_Q6_CFG_XPU_PRT2_SCR_ADDR A:0x8e350
y.create.l HWIO_MPU_MSS_Q6_CFG_XPU_PRT3_SCR_ADDR A:0x8e3d0
y.create.l HWIO_MPU_MSS_Q6_CFG_XPU_PRT4_SCR_ADDR A:0x8e450
y.create.l HWIO_MPU_MSS_Q6_CFG_XPU_PRT5_SCR_ADDR A:0x8e4d0
y.create.l HWIO_MPU_MSS_Q6_CFG_XPU_PRT6_SCR_ADDR A:0x8e550
y.create.l HWIO_MPU_MSS_Q6_CFG_XPU_PRT7_SCR_ADDR A:0x8e5d0
y.create.l HWIO_MPU_MSS_Q6_CFG_XPU_PRT8_SCR_ADDR A:0x8e650
y.create.l HWIO_MPU_MSS_Q6_CFG_XPU_PRT9_SCR_ADDR A:0x8e6d0
y.create.l HWIO_MPU_MSS_Q6_CFG_XPU_PRT0_MCR_ADDR A:0x8e254
y.create.l HWIO_MPU_MSS_Q6_CFG_XPU_PRT1_MCR_ADDR A:0x8e2d4
y.create.l HWIO_MPU_MSS_Q6_CFG_XPU_PRT2_MCR_ADDR A:0x8e354
y.create.l HWIO_MPU_MSS_Q6_CFG_XPU_PRT3_MCR_ADDR A:0x8e3d4
y.create.l HWIO_MPU_MSS_Q6_CFG_XPU_PRT4_MCR_ADDR A:0x8e454
y.create.l HWIO_MPU_MSS_Q6_CFG_XPU_PRT5_MCR_ADDR A:0x8e4d4
y.create.l HWIO_MPU_MSS_Q6_CFG_XPU_PRT6_MCR_ADDR A:0x8e554
y.create.l HWIO_MPU_MSS_Q6_CFG_XPU_PRT7_MCR_ADDR A:0x8e5d4
y.create.l HWIO_MPU_MSS_Q6_CFG_XPU_PRT8_MCR_ADDR A:0x8e654
y.create.l HWIO_MPU_MSS_Q6_CFG_XPU_PRT9_MCR_ADDR A:0x8e6d4
y.create.l HWIO_MPU_MSS_Q6_CFG_XPU_PRT0_CNTL0_ADDR A:0x8e258
y.create.l HWIO_MPU_MSS_Q6_CFG_XPU_PRT1_CNTL0_ADDR A:0x8e2d8
y.create.l HWIO_MPU_MSS_Q6_CFG_XPU_PRT2_CNTL0_ADDR A:0x8e358
y.create.l HWIO_MPU_MSS_Q6_CFG_XPU_PRT3_CNTL0_ADDR A:0x8e3d8
y.create.l HWIO_MPU_MSS_Q6_CFG_XPU_PRT4_CNTL0_ADDR A:0x8e458
y.create.l HWIO_MPU_MSS_Q6_CFG_XPU_PRT5_CNTL0_ADDR A:0x8e4d8
y.create.l HWIO_MPU_MSS_Q6_CFG_XPU_PRT6_CNTL0_ADDR A:0x8e558
y.create.l HWIO_MPU_MSS_Q6_CFG_XPU_PRT7_CNTL0_ADDR A:0x8e5d8
y.create.l HWIO_MPU_MSS_Q6_CFG_XPU_PRT8_CNTL0_ADDR A:0x8e658
y.create.l HWIO_MPU_MSS_Q6_CFG_XPU_PRT9_CNTL0_ADDR A:0x8e6d8
y.create.l HWIO_MPU_MSS_Q6_CFG_XPU_PRT0_CNTL1_ADDR A:0x8e25c
y.create.l HWIO_MPU_MSS_Q6_CFG_XPU_PRT1_CNTL1_ADDR A:0x8e2dc
y.create.l HWIO_MPU_MSS_Q6_CFG_XPU_PRT2_CNTL1_ADDR A:0x8e35c
y.create.l HWIO_MPU_MSS_Q6_CFG_XPU_PRT3_CNTL1_ADDR A:0x8e3dc
y.create.l HWIO_MPU_MSS_Q6_CFG_XPU_PRT4_CNTL1_ADDR A:0x8e45c
y.create.l HWIO_MPU_MSS_Q6_CFG_XPU_PRT5_CNTL1_ADDR A:0x8e4dc
y.create.l HWIO_MPU_MSS_Q6_CFG_XPU_PRT6_CNTL1_ADDR A:0x8e55c
y.create.l HWIO_MPU_MSS_Q6_CFG_XPU_PRT7_CNTL1_ADDR A:0x8e5dc
y.create.l HWIO_MPU_MSS_Q6_CFG_XPU_PRT8_CNTL1_ADDR A:0x8e65c
y.create.l HWIO_MPU_MSS_Q6_CFG_XPU_PRT9_CNTL1_ADDR A:0x8e6dc
y.create.l HWIO_MSS_APU0132_5_REG_BASE_START_ADDR A:0x4000000
y.create.l HWIO_MSS_APU0132_5_REG_BASE_LAST_ADDR A:0x4000454
y.create.l HWIO_MSS_APU0132_5_REG_BASE_END_ADDR A:0x4000480
y.create.l HWIO_MSS_XPU_SCR_ADDR A:0x4000000
y.create.l HWIO_MSS_XPU_SWDR_ADDR A:0x4000004
y.create.l HWIO_MSS_XPU_SEAR0_ADDR A:0x4000040
y.create.l HWIO_MSS_XPU_SESR_ADDR A:0x4000048
y.create.l HWIO_MSS_XPU_SESRRESTORE_ADDR A:0x400004c
y.create.l HWIO_MSS_XPU_SESYNR0_ADDR A:0x4000050
y.create.l HWIO_MSS_XPU_SESYNR1_ADDR A:0x4000054
y.create.l HWIO_MSS_XPU_SESYNR2_ADDR A:0x4000058
y.create.l HWIO_MSS_XPU_MCR_ADDR A:0x4000100
y.create.l HWIO_MSS_XPU_MEAR0_ADDR A:0x4000140
y.create.l HWIO_MSS_XPU_MESR_ADDR A:0x4000148
y.create.l HWIO_MSS_XPU_MESRRESTORE_ADDR A:0x400014c
y.create.l HWIO_MSS_XPU_MESYNR0_ADDR A:0x4000150
y.create.l HWIO_MSS_XPU_MESYNR1_ADDR A:0x4000154
y.create.l HWIO_MSS_XPU_MESYNR2_ADDR A:0x4000158
y.create.l HWIO_MSS_XPU_CR_ADDR A:0x4000080
y.create.l HWIO_MSS_XPU_RPU_ACR0_ADDR A:0x40000a0
y.create.l HWIO_MSS_XPU_EAR0_ADDR A:0x40000c0
y.create.l HWIO_MSS_XPU_ESR_ADDR A:0x40000c8
y.create.l HWIO_MSS_XPU_ESRRESTORE_ADDR A:0x40000cc
y.create.l HWIO_MSS_XPU_ESYNR0_ADDR A:0x40000d0
y.create.l HWIO_MSS_XPU_ESYNR1_ADDR A:0x40000d4
y.create.l HWIO_MSS_XPU_ESYNR2_ADDR A:0x40000d8
y.create.l HWIO_MSS_XPU_IDR0_ADDR A:0x4000074
y.create.l HWIO_MSS_XPU_IDR1_ADDR A:0x4000078
y.create.l HWIO_MSS_XPU_REV_ADDR A:0x400007c
y.create.l HWIO_MSS_XPU_RG0_RACR0_ADDR A:0x4000200
y.create.l HWIO_MSS_XPU_RG1_RACR0_ADDR A:0x4000280
y.create.l HWIO_MSS_XPU_RG2_RACR0_ADDR A:0x4000300
y.create.l HWIO_MSS_XPU_RG3_RACR0_ADDR A:0x4000380
y.create.l HWIO_MSS_XPU_RG4_RACR0_ADDR A:0x4000400
y.create.l HWIO_MSS_XPU_RG0_SCR_ADDR A:0x4000250
y.create.l HWIO_MSS_XPU_RG1_SCR_ADDR A:0x40002d0
y.create.l HWIO_MSS_XPU_RG2_SCR_ADDR A:0x4000350
y.create.l HWIO_MSS_XPU_RG3_SCR_ADDR A:0x40003d0
y.create.l HWIO_MSS_XPU_RG4_SCR_ADDR A:0x4000450
y.create.l HWIO_MSS_XPU_RG0_MCR_ADDR A:0x4000254
y.create.l HWIO_MSS_XPU_RG1_MCR_ADDR A:0x40002d4
y.create.l HWIO_MSS_XPU_RG2_MCR_ADDR A:0x4000354
y.create.l HWIO_MSS_XPU_RG3_MCR_ADDR A:0x40003d4
y.create.l HWIO_MSS_XPU_RG4_MCR_ADDR A:0x4000454
y.create.l HWIO_MSS_RMB_REG_BASE_START_ADDR A:0x4020000
y.create.l HWIO_MSS_RMB_REG_BASE_LAST_ADDR A:0x402003c
y.create.l HWIO_MSS_RMB_REG_BASE_END_ADDR A:0x4030000
y.create.l HWIO_MSS_RELAY_MSG_BUFFER_00_ADDR A:0x4020000
y.create.l HWIO_MSS_RELAY_MSG_BUFFER_01_ADDR A:0x4020004
y.create.l HWIO_MSS_RELAY_MSG_BUFFER_02_ADDR A:0x4020008
y.create.l HWIO_MSS_RELAY_MSG_BUFFER_03_ADDR A:0x402000c
y.create.l HWIO_MSS_RELAY_MSG_BUFFER_04_ADDR A:0x4020010
y.create.l HWIO_MSS_RELAY_MSG_BUFFER_05_ADDR A:0x4020014
y.create.l HWIO_MSS_RELAY_MSG_BUFFER_06_ADDR A:0x4020018
y.create.l HWIO_MSS_RELAY_MSG_BUFFER_07_ADDR A:0x402001c
y.create.l HWIO_MSS_RELAY_MSG_BUFFER_08_ADDR A:0x4020020
y.create.l HWIO_MSS_RELAY_MSG_BUFFER_09_ADDR A:0x4020024
y.create.l HWIO_MSS_RELAY_MSG_BUFFER_10_ADDR A:0x4020028
y.create.l HWIO_MSS_RELAY_MSG_BUFFER_11_ADDR A:0x402002c
y.create.l HWIO_MSS_RELAY_MSG_BUFFER_12_ADDR A:0x4020030
y.create.l HWIO_MSS_RELAY_MSG_BUFFER_13_ADDR A:0x4020034
y.create.l HWIO_MSS_RELAY_MSG_BUFFER_14_ADDR A:0x4020038
y.create.l HWIO_MSS_RELAY_MSG_BUFFER_15_ADDR A:0x402003c
y.create.l HWIO_MSS_BAM_NDP_AUTO_SCALE_V2_0_REG_BASE_START_ADDR A:0x4044000
y.create.l HWIO_MSS_BAM_NDP_AUTO_SCALE_V2_0_REG_BASE_LAST_ADDR A:0x405c934
y.create.l HWIO_MSS_BAM_NDP_AUTO_SCALE_V2_0_REG_BASE_END_ADDR A:0x405d000
y.create.l HWIO_MSS_BAM_CTRL_ADDR A:0x4044000
y.create.l HWIO_MSS_BAM_TIMER_ADDR A:0x4044040
y.create.l HWIO_MSS_BAM_TIMER_CTRL_ADDR A:0x4044044
y.create.l HWIO_MSS_BAM_DESC_CNT_TRSHLD_ADDR A:0x4044008
y.create.l HWIO_MSS_BAM_IRQ_STTS_ADDR A:0x4044014
y.create.l HWIO_MSS_BAM_IRQ_CLR_ADDR A:0x4044018
y.create.l HWIO_MSS_BAM_IRQ_EN_ADDR A:0x404401c
y.create.l HWIO_MSS_BAM_CNFG_BITS_ADDR A:0x404407c
y.create.l HWIO_MSS_BAM_CNFG_BITS_2_ADDR A:0x4044084
y.create.l HWIO_MSS_BAM_REVISION_ADDR A:0x4045000
y.create.l HWIO_MSS_BAM_SW_VERSION_ADDR A:0x4045004
y.create.l HWIO_MSS_BAM_NUM_PIPES_ADDR A:0x4045008
y.create.l HWIO_MSS_BAM_TEST_BUS_SEL_ADDR A:0x4045010
y.create.l HWIO_MSS_BAM_TEST_BUS_REG_ADDR A:0x4045014
y.create.l HWIO_MSS_BAM_AHB_MASTER_ERR_CTRLS_ADDR A:0x4045024
y.create.l HWIO_MSS_BAM_AHB_MASTER_ERR_ADDR_ADDR A:0x4045028
y.create.l HWIO_MSS_BAM_AHB_MASTER_ERR_DATA_ADDR A:0x404502c
y.create.l HWIO_MSS_BAM_AHB_MASTER_ERR_ADDR_LSB_ADDR A:0x4045100
y.create.l HWIO_MSS_BAM_AHB_MASTER_ERR_ADDR_MSB_ADDR A:0x4045104
y.create.l HWIO_MSS_BAM_TRUST_REG_ADDR A:0x4046000
y.create.l HWIO_MSS_BAM_P_TRUST_REG0_ADDR A:0x4046020
y.create.l HWIO_MSS_BAM_P_TRUST_REG1_ADDR A:0x4046024
y.create.l HWIO_MSS_BAM_P_TRUST_REG2_ADDR A:0x4046028
y.create.l HWIO_MSS_BAM_P_TRUST_REG3_ADDR A:0x404602c
y.create.l HWIO_MSS_BAM_P_TRUST_REG4_ADDR A:0x4046030
y.create.l HWIO_MSS_BAM_P_TRUST_REG5_ADDR A:0x4046034
y.create.l HWIO_MSS_BAM_IRQ_SRCS_EE0_ADDR A:0x4047000
y.create.l HWIO_MSS_BAM_IRQ_SRCS_EE1_ADDR A:0x4048000
y.create.l HWIO_MSS_BAM_IRQ_SRCS_EE2_ADDR A:0x4049000
y.create.l HWIO_MSS_BAM_IRQ_SRCS_EE3_ADDR A:0x404a000
y.create.l HWIO_MSS_BAM_IRQ_SRCS_MSK_EE0_ADDR A:0x4047004
y.create.l HWIO_MSS_BAM_IRQ_SRCS_MSK_EE1_ADDR A:0x4048004
y.create.l HWIO_MSS_BAM_IRQ_SRCS_MSK_EE2_ADDR A:0x4049004
y.create.l HWIO_MSS_BAM_IRQ_SRCS_MSK_EE3_ADDR A:0x404a004
y.create.l HWIO_MSS_BAM_IRQ_SRCS_UNMASKED_EE0_ADDR A:0x4047008
y.create.l HWIO_MSS_BAM_IRQ_SRCS_UNMASKED_EE1_ADDR A:0x4048008
y.create.l HWIO_MSS_BAM_IRQ_SRCS_UNMASKED_EE2_ADDR A:0x4049008
y.create.l HWIO_MSS_BAM_IRQ_SRCS_UNMASKED_EE3_ADDR A:0x404a008
y.create.l HWIO_MSS_BAM_PIPE_ATTR_EE0_ADDR A:0x404700c
y.create.l HWIO_MSS_BAM_PIPE_ATTR_EE1_ADDR A:0x404800c
y.create.l HWIO_MSS_BAM_PIPE_ATTR_EE2_ADDR A:0x404900c
y.create.l HWIO_MSS_BAM_PIPE_ATTR_EE3_ADDR A:0x404a00c
y.create.l HWIO_MSS_BAM_IRQ_SRCS_ADDR A:0x4047010
y.create.l HWIO_MSS_BAM_IRQ_SRCS_MSK_ADDR A:0x4047014
y.create.l HWIO_MSS_BAM_IRQ_SRCS_UNMASKED_ADDR A:0x4047018
y.create.l HWIO_MSS_BAM_P_CTRL0_ADDR A:0x4057000
y.create.l HWIO_MSS_BAM_P_CTRL1_ADDR A:0x4058000
y.create.l HWIO_MSS_BAM_P_CTRL2_ADDR A:0x4059000
y.create.l HWIO_MSS_BAM_P_CTRL3_ADDR A:0x405a000
y.create.l HWIO_MSS_BAM_P_CTRL4_ADDR A:0x405b000
y.create.l HWIO_MSS_BAM_P_CTRL5_ADDR A:0x405c000
y.create.l HWIO_MSS_BAM_P_RST0_ADDR A:0x4057004
y.create.l HWIO_MSS_BAM_P_RST1_ADDR A:0x4058004
y.create.l HWIO_MSS_BAM_P_RST2_ADDR A:0x4059004
y.create.l HWIO_MSS_BAM_P_RST3_ADDR A:0x405a004
y.create.l HWIO_MSS_BAM_P_RST4_ADDR A:0x405b004
y.create.l HWIO_MSS_BAM_P_RST5_ADDR A:0x405c004
y.create.l HWIO_MSS_BAM_P_HALT0_ADDR A:0x4057008
y.create.l HWIO_MSS_BAM_P_HALT1_ADDR A:0x4058008
y.create.l HWIO_MSS_BAM_P_HALT2_ADDR A:0x4059008
y.create.l HWIO_MSS_BAM_P_HALT3_ADDR A:0x405a008
y.create.l HWIO_MSS_BAM_P_HALT4_ADDR A:0x405b008
y.create.l HWIO_MSS_BAM_P_HALT5_ADDR A:0x405c008
y.create.l HWIO_MSS_BAM_P_IRQ_STTS0_ADDR A:0x4057010
y.create.l HWIO_MSS_BAM_P_IRQ_STTS1_ADDR A:0x4058010
y.create.l HWIO_MSS_BAM_P_IRQ_STTS2_ADDR A:0x4059010
y.create.l HWIO_MSS_BAM_P_IRQ_STTS3_ADDR A:0x405a010
y.create.l HWIO_MSS_BAM_P_IRQ_STTS4_ADDR A:0x405b010
y.create.l HWIO_MSS_BAM_P_IRQ_STTS5_ADDR A:0x405c010
y.create.l HWIO_MSS_BAM_P_IRQ_CLR0_ADDR A:0x4057014
y.create.l HWIO_MSS_BAM_P_IRQ_CLR1_ADDR A:0x4058014
y.create.l HWIO_MSS_BAM_P_IRQ_CLR2_ADDR A:0x4059014
y.create.l HWIO_MSS_BAM_P_IRQ_CLR3_ADDR A:0x405a014
y.create.l HWIO_MSS_BAM_P_IRQ_CLR4_ADDR A:0x405b014
y.create.l HWIO_MSS_BAM_P_IRQ_CLR5_ADDR A:0x405c014
y.create.l HWIO_MSS_BAM_P_IRQ_EN0_ADDR A:0x4057018
y.create.l HWIO_MSS_BAM_P_IRQ_EN1_ADDR A:0x4058018
y.create.l HWIO_MSS_BAM_P_IRQ_EN2_ADDR A:0x4059018
y.create.l HWIO_MSS_BAM_P_IRQ_EN3_ADDR A:0x405a018
y.create.l HWIO_MSS_BAM_P_IRQ_EN4_ADDR A:0x405b018
y.create.l HWIO_MSS_BAM_P_IRQ_EN5_ADDR A:0x405c018
y.create.l HWIO_MSS_BAM_P_TIMER0_ADDR A:0x405701c
y.create.l HWIO_MSS_BAM_P_TIMER1_ADDR A:0x405801c
y.create.l HWIO_MSS_BAM_P_TIMER2_ADDR A:0x405901c
y.create.l HWIO_MSS_BAM_P_TIMER3_ADDR A:0x405a01c
y.create.l HWIO_MSS_BAM_P_TIMER4_ADDR A:0x405b01c
y.create.l HWIO_MSS_BAM_P_TIMER5_ADDR A:0x405c01c
y.create.l HWIO_MSS_BAM_P_TIMER_CTRL0_ADDR A:0x4057020
y.create.l HWIO_MSS_BAM_P_TIMER_CTRL1_ADDR A:0x4058020
y.create.l HWIO_MSS_BAM_P_TIMER_CTRL2_ADDR A:0x4059020
y.create.l HWIO_MSS_BAM_P_TIMER_CTRL3_ADDR A:0x405a020
y.create.l HWIO_MSS_BAM_P_TIMER_CTRL4_ADDR A:0x405b020
y.create.l HWIO_MSS_BAM_P_TIMER_CTRL5_ADDR A:0x405c020
y.create.l HWIO_MSS_BAM_P_PRDCR_SDBND0_ADDR A:0x4057024
y.create.l HWIO_MSS_BAM_P_PRDCR_SDBND1_ADDR A:0x4058024
y.create.l HWIO_MSS_BAM_P_PRDCR_SDBND2_ADDR A:0x4059024
y.create.l HWIO_MSS_BAM_P_PRDCR_SDBND3_ADDR A:0x405a024
y.create.l HWIO_MSS_BAM_P_PRDCR_SDBND4_ADDR A:0x405b024
y.create.l HWIO_MSS_BAM_P_PRDCR_SDBND5_ADDR A:0x405c024
y.create.l HWIO_MSS_BAM_P_CNSMR_SDBND0_ADDR A:0x4057028
y.create.l HWIO_MSS_BAM_P_CNSMR_SDBND1_ADDR A:0x4058028
y.create.l HWIO_MSS_BAM_P_CNSMR_SDBND2_ADDR A:0x4059028
y.create.l HWIO_MSS_BAM_P_CNSMR_SDBND3_ADDR A:0x405a028
y.create.l HWIO_MSS_BAM_P_CNSMR_SDBND4_ADDR A:0x405b028
y.create.l HWIO_MSS_BAM_P_CNSMR_SDBND5_ADDR A:0x405c028
y.create.l HWIO_MSS_BAM_P_SW_OFSTS0_ADDR A:0x4057800
y.create.l HWIO_MSS_BAM_P_SW_OFSTS1_ADDR A:0x4058800
y.create.l HWIO_MSS_BAM_P_SW_OFSTS2_ADDR A:0x4059800
y.create.l HWIO_MSS_BAM_P_SW_OFSTS3_ADDR A:0x405a800
y.create.l HWIO_MSS_BAM_P_SW_OFSTS4_ADDR A:0x405b800
y.create.l HWIO_MSS_BAM_P_SW_OFSTS5_ADDR A:0x405c800
y.create.l HWIO_MSS_BAM_P_AU_PSM_CNTXT_1_0_ADDR A:0x4057804
y.create.l HWIO_MSS_BAM_P_AU_PSM_CNTXT_1_1_ADDR A:0x4058804
y.create.l HWIO_MSS_BAM_P_AU_PSM_CNTXT_1_2_ADDR A:0x4059804
y.create.l HWIO_MSS_BAM_P_AU_PSM_CNTXT_1_3_ADDR A:0x405a804
y.create.l HWIO_MSS_BAM_P_AU_PSM_CNTXT_1_4_ADDR A:0x405b804
y.create.l HWIO_MSS_BAM_P_AU_PSM_CNTXT_1_5_ADDR A:0x405c804
y.create.l HWIO_MSS_BAM_P_PSM_CNTXT_2_0_ADDR A:0x4057808
y.create.l HWIO_MSS_BAM_P_PSM_CNTXT_2_1_ADDR A:0x4058808
y.create.l HWIO_MSS_BAM_P_PSM_CNTXT_2_2_ADDR A:0x4059808
y.create.l HWIO_MSS_BAM_P_PSM_CNTXT_2_3_ADDR A:0x405a808
y.create.l HWIO_MSS_BAM_P_PSM_CNTXT_2_4_ADDR A:0x405b808
y.create.l HWIO_MSS_BAM_P_PSM_CNTXT_2_5_ADDR A:0x405c808
y.create.l HWIO_MSS_BAM_P_PSM_CNTXT_3_0_ADDR A:0x405780c
y.create.l HWIO_MSS_BAM_P_PSM_CNTXT_3_1_ADDR A:0x405880c
y.create.l HWIO_MSS_BAM_P_PSM_CNTXT_3_2_ADDR A:0x405980c
y.create.l HWIO_MSS_BAM_P_PSM_CNTXT_3_3_ADDR A:0x405a80c
y.create.l HWIO_MSS_BAM_P_PSM_CNTXT_3_4_ADDR A:0x405b80c
y.create.l HWIO_MSS_BAM_P_PSM_CNTXT_3_5_ADDR A:0x405c80c
y.create.l HWIO_MSS_BAM_P_PSM_CNTXT_4_0_ADDR A:0x4057810
y.create.l HWIO_MSS_BAM_P_PSM_CNTXT_4_1_ADDR A:0x4058810
y.create.l HWIO_MSS_BAM_P_PSM_CNTXT_4_2_ADDR A:0x4059810
y.create.l HWIO_MSS_BAM_P_PSM_CNTXT_4_3_ADDR A:0x405a810
y.create.l HWIO_MSS_BAM_P_PSM_CNTXT_4_4_ADDR A:0x405b810
y.create.l HWIO_MSS_BAM_P_PSM_CNTXT_4_5_ADDR A:0x405c810
y.create.l HWIO_MSS_BAM_P_PSM_CNTXT_5_0_ADDR A:0x4057814
y.create.l HWIO_MSS_BAM_P_PSM_CNTXT_5_1_ADDR A:0x4058814
y.create.l HWIO_MSS_BAM_P_PSM_CNTXT_5_2_ADDR A:0x4059814
y.create.l HWIO_MSS_BAM_P_PSM_CNTXT_5_3_ADDR A:0x405a814
y.create.l HWIO_MSS_BAM_P_PSM_CNTXT_5_4_ADDR A:0x405b814
y.create.l HWIO_MSS_BAM_P_PSM_CNTXT_5_5_ADDR A:0x405c814
y.create.l HWIO_MSS_BAM_P_EVNT_REG0_ADDR A:0x4057818
y.create.l HWIO_MSS_BAM_P_EVNT_REG1_ADDR A:0x4058818
y.create.l HWIO_MSS_BAM_P_EVNT_REG2_ADDR A:0x4059818
y.create.l HWIO_MSS_BAM_P_EVNT_REG3_ADDR A:0x405a818
y.create.l HWIO_MSS_BAM_P_EVNT_REG4_ADDR A:0x405b818
y.create.l HWIO_MSS_BAM_P_EVNT_REG5_ADDR A:0x405c818
y.create.l HWIO_MSS_BAM_P_DESC_FIFO_ADDR0_ADDR A:0x405781c
y.create.l HWIO_MSS_BAM_P_DESC_FIFO_ADDR1_ADDR A:0x405881c
y.create.l HWIO_MSS_BAM_P_DESC_FIFO_ADDR2_ADDR A:0x405981c
y.create.l HWIO_MSS_BAM_P_DESC_FIFO_ADDR3_ADDR A:0x405a81c
y.create.l HWIO_MSS_BAM_P_DESC_FIFO_ADDR4_ADDR A:0x405b81c
y.create.l HWIO_MSS_BAM_P_DESC_FIFO_ADDR5_ADDR A:0x405c81c
y.create.l HWIO_MSS_BAM_P_FIFO_SIZES0_ADDR A:0x4057820
y.create.l HWIO_MSS_BAM_P_FIFO_SIZES1_ADDR A:0x4058820
y.create.l HWIO_MSS_BAM_P_FIFO_SIZES2_ADDR A:0x4059820
y.create.l HWIO_MSS_BAM_P_FIFO_SIZES3_ADDR A:0x405a820
y.create.l HWIO_MSS_BAM_P_FIFO_SIZES4_ADDR A:0x405b820
y.create.l HWIO_MSS_BAM_P_FIFO_SIZES5_ADDR A:0x405c820
y.create.l HWIO_MSS_BAM_P_DATA_FIFO_ADDR0_ADDR A:0x4057824
y.create.l HWIO_MSS_BAM_P_DATA_FIFO_ADDR1_ADDR A:0x4058824
y.create.l HWIO_MSS_BAM_P_DATA_FIFO_ADDR2_ADDR A:0x4059824
y.create.l HWIO_MSS_BAM_P_DATA_FIFO_ADDR3_ADDR A:0x405a824
y.create.l HWIO_MSS_BAM_P_DATA_FIFO_ADDR4_ADDR A:0x405b824
y.create.l HWIO_MSS_BAM_P_DATA_FIFO_ADDR5_ADDR A:0x405c824
y.create.l HWIO_MSS_BAM_P_EVNT_GEN_TRSHLD0_ADDR A:0x4057828
y.create.l HWIO_MSS_BAM_P_EVNT_GEN_TRSHLD1_ADDR A:0x4058828
y.create.l HWIO_MSS_BAM_P_EVNT_GEN_TRSHLD2_ADDR A:0x4059828
y.create.l HWIO_MSS_BAM_P_EVNT_GEN_TRSHLD3_ADDR A:0x405a828
y.create.l HWIO_MSS_BAM_P_EVNT_GEN_TRSHLD4_ADDR A:0x405b828
y.create.l HWIO_MSS_BAM_P_EVNT_GEN_TRSHLD5_ADDR A:0x405c828
y.create.l HWIO_MSS_BAM_P_EVNT_DEST_ADDR0_ADDR A:0x405782c
y.create.l HWIO_MSS_BAM_P_EVNT_DEST_ADDR1_ADDR A:0x405882c
y.create.l HWIO_MSS_BAM_P_EVNT_DEST_ADDR2_ADDR A:0x405982c
y.create.l HWIO_MSS_BAM_P_EVNT_DEST_ADDR3_ADDR A:0x405a82c
y.create.l HWIO_MSS_BAM_P_EVNT_DEST_ADDR4_ADDR A:0x405b82c
y.create.l HWIO_MSS_BAM_P_EVNT_DEST_ADDR5_ADDR A:0x405c82c
y.create.l HWIO_MSS_BAM_P_DF_CNTXT_0_ADDR A:0x4057830
y.create.l HWIO_MSS_BAM_P_DF_CNTXT_1_ADDR A:0x4058830
y.create.l HWIO_MSS_BAM_P_DF_CNTXT_2_ADDR A:0x4059830
y.create.l HWIO_MSS_BAM_P_DF_CNTXT_3_ADDR A:0x405a830
y.create.l HWIO_MSS_BAM_P_DF_CNTXT_4_ADDR A:0x405b830
y.create.l HWIO_MSS_BAM_P_DF_CNTXT_5_ADDR A:0x405c830
y.create.l HWIO_MSS_BAM_P_RETR_CNTXT_0_ADDR A:0x4057834
y.create.l HWIO_MSS_BAM_P_RETR_CNTXT_1_ADDR A:0x4058834
y.create.l HWIO_MSS_BAM_P_RETR_CNTXT_2_ADDR A:0x4059834
y.create.l HWIO_MSS_BAM_P_RETR_CNTXT_3_ADDR A:0x405a834
y.create.l HWIO_MSS_BAM_P_RETR_CNTXT_4_ADDR A:0x405b834
y.create.l HWIO_MSS_BAM_P_RETR_CNTXT_5_ADDR A:0x405c834
y.create.l HWIO_MSS_BAM_P_SI_CNTXT_0_ADDR A:0x4057838
y.create.l HWIO_MSS_BAM_P_SI_CNTXT_1_ADDR A:0x4058838
y.create.l HWIO_MSS_BAM_P_SI_CNTXT_2_ADDR A:0x4059838
y.create.l HWIO_MSS_BAM_P_SI_CNTXT_3_ADDR A:0x405a838
y.create.l HWIO_MSS_BAM_P_SI_CNTXT_4_ADDR A:0x405b838
y.create.l HWIO_MSS_BAM_P_SI_CNTXT_5_ADDR A:0x405c838
y.create.l HWIO_MSS_BAM_P_PSM_CNTXT_3_LSB0_ADDR A:0x4057900
y.create.l HWIO_MSS_BAM_P_PSM_CNTXT_3_LSB1_ADDR A:0x4058900
y.create.l HWIO_MSS_BAM_P_PSM_CNTXT_3_LSB2_ADDR A:0x4059900
y.create.l HWIO_MSS_BAM_P_PSM_CNTXT_3_LSB3_ADDR A:0x405a900
y.create.l HWIO_MSS_BAM_P_PSM_CNTXT_3_LSB4_ADDR A:0x405b900
y.create.l HWIO_MSS_BAM_P_PSM_CNTXT_3_LSB5_ADDR A:0x405c900
y.create.l HWIO_MSS_BAM_P_PSM_CNTXT_3_MSB0_ADDR A:0x4057904
y.create.l HWIO_MSS_BAM_P_PSM_CNTXT_3_MSB1_ADDR A:0x4058904
y.create.l HWIO_MSS_BAM_P_PSM_CNTXT_3_MSB2_ADDR A:0x4059904
y.create.l HWIO_MSS_BAM_P_PSM_CNTXT_3_MSB3_ADDR A:0x405a904
y.create.l HWIO_MSS_BAM_P_PSM_CNTXT_3_MSB4_ADDR A:0x405b904
y.create.l HWIO_MSS_BAM_P_PSM_CNTXT_3_MSB5_ADDR A:0x405c904
y.create.l HWIO_MSS_BAM_P_DESC_FIFO_ADDR_LSB0_ADDR A:0x4057910
y.create.l HWIO_MSS_BAM_P_DESC_FIFO_ADDR_LSB1_ADDR A:0x4058910
y.create.l HWIO_MSS_BAM_P_DESC_FIFO_ADDR_LSB2_ADDR A:0x4059910
y.create.l HWIO_MSS_BAM_P_DESC_FIFO_ADDR_LSB3_ADDR A:0x405a910
y.create.l HWIO_MSS_BAM_P_DESC_FIFO_ADDR_LSB4_ADDR A:0x405b910
y.create.l HWIO_MSS_BAM_P_DESC_FIFO_ADDR_LSB5_ADDR A:0x405c910
y.create.l HWIO_MSS_BAM_P_DESC_FIFO_ADDR_MSB0_ADDR A:0x4057914
y.create.l HWIO_MSS_BAM_P_DESC_FIFO_ADDR_MSB1_ADDR A:0x4058914
y.create.l HWIO_MSS_BAM_P_DESC_FIFO_ADDR_MSB2_ADDR A:0x4059914
y.create.l HWIO_MSS_BAM_P_DESC_FIFO_ADDR_MSB3_ADDR A:0x405a914
y.create.l HWIO_MSS_BAM_P_DESC_FIFO_ADDR_MSB4_ADDR A:0x405b914
y.create.l HWIO_MSS_BAM_P_DESC_FIFO_ADDR_MSB5_ADDR A:0x405c914
y.create.l HWIO_MSS_BAM_P_DATA_FIFO_ADDR_LSB0_ADDR A:0x4057920
y.create.l HWIO_MSS_BAM_P_DATA_FIFO_ADDR_LSB1_ADDR A:0x4058920
y.create.l HWIO_MSS_BAM_P_DATA_FIFO_ADDR_LSB2_ADDR A:0x4059920
y.create.l HWIO_MSS_BAM_P_DATA_FIFO_ADDR_LSB3_ADDR A:0x405a920
y.create.l HWIO_MSS_BAM_P_DATA_FIFO_ADDR_LSB4_ADDR A:0x405b920
y.create.l HWIO_MSS_BAM_P_DATA_FIFO_ADDR_LSB5_ADDR A:0x405c920
y.create.l HWIO_MSS_BAM_P_DATA_FIFO_ADDR_MSB0_ADDR A:0x4057924
y.create.l HWIO_MSS_BAM_P_DATA_FIFO_ADDR_MSB1_ADDR A:0x4058924
y.create.l HWIO_MSS_BAM_P_DATA_FIFO_ADDR_MSB2_ADDR A:0x4059924
y.create.l HWIO_MSS_BAM_P_DATA_FIFO_ADDR_MSB3_ADDR A:0x405a924
y.create.l HWIO_MSS_BAM_P_DATA_FIFO_ADDR_MSB4_ADDR A:0x405b924
y.create.l HWIO_MSS_BAM_P_DATA_FIFO_ADDR_MSB5_ADDR A:0x405c924
y.create.l HWIO_MSS_BAM_P_EVNT_DEST_ADDR_LSB0_ADDR A:0x4057930
y.create.l HWIO_MSS_BAM_P_EVNT_DEST_ADDR_LSB1_ADDR A:0x4058930
y.create.l HWIO_MSS_BAM_P_EVNT_DEST_ADDR_LSB2_ADDR A:0x4059930
y.create.l HWIO_MSS_BAM_P_EVNT_DEST_ADDR_LSB3_ADDR A:0x405a930
y.create.l HWIO_MSS_BAM_P_EVNT_DEST_ADDR_LSB4_ADDR A:0x405b930
y.create.l HWIO_MSS_BAM_P_EVNT_DEST_ADDR_LSB5_ADDR A:0x405c930
y.create.l HWIO_MSS_BAM_P_EVNT_DEST_ADDR_MSB0_ADDR A:0x4057934
y.create.l HWIO_MSS_BAM_P_EVNT_DEST_ADDR_MSB1_ADDR A:0x4058934
y.create.l HWIO_MSS_BAM_P_EVNT_DEST_ADDR_MSB2_ADDR A:0x4059934
y.create.l HWIO_MSS_BAM_P_EVNT_DEST_ADDR_MSB3_ADDR A:0x405a934
y.create.l HWIO_MSS_BAM_P_EVNT_DEST_ADDR_MSB4_ADDR A:0x405b934
y.create.l HWIO_MSS_BAM_P_EVNT_DEST_ADDR_MSB5_ADDR A:0x405c934
y.create.l HWIO_MSS_QDSP6V67SS_PUB_REG_BASE_START_ADDR A:0x4080000
y.create.l HWIO_MSS_QDSP6V67SS_PUB_REG_BASE_LAST_ADDR A:0x4082030
y.create.l HWIO_MSS_QDSP6V67SS_PUB_REG_BASE_END_ADDR A:0x4084040
y.create.l HWIO_MSS_QDSP6SS_VERSION_ADDR A:0x4080000
y.create.l HWIO_MSS_QDSP6SS_RST_EVB_ADDR A:0x4080010
y.create.l HWIO_MSS_QDSP6SS_CLADE2_ARES_CFG_ADDR A:0x4080014
y.create.l HWIO_MSS_QDSP6SS_DBG_CFG_ADDR A:0x4080018
y.create.l HWIO_MSS_QDSP6SS_RET_CFG_ADDR A:0x408001c
y.create.l HWIO_MSS_QDSP6SS_CORE_CBCR_ADDR A:0x4080020
y.create.l HWIO_MSS_QDSP6SS_CORE_CMD_RCGR_ADDR A:0x4080028
y.create.l HWIO_MSS_QDSP6SS_CORE_CFG_RCGR_ADDR A:0x408002c
y.create.l HWIO_MSS_QDSP6SS_SPDM_MON_CBCR_ADDR A:0x4080048
y.create.l HWIO_MSS_QDSP6SS_XO_CBCR_ADDR A:0x4080038
y.create.l HWIO_MSS_QDSP6SS_SLEEP_CBCR_ADDR A:0x408003c
y.create.l HWIO_MSS_QDSP6SS_NMI_ADDR A:0x4080040
y.create.l HWIO_MSS_QDSP6SS_NMI_STATUS_ADDR A:0x4080044
y.create.l HWIO_MSS_QDSP6SS_INTF_HALTREQ_ADDR A:0x4080088
y.create.l HWIO_MSS_QDSP6SS_INTF_HALTACK_ADDR A:0x408008c
y.create.l HWIO_MSS_QDSP6SS_INTFCLAMP_SET_ADDR A:0x4080090
y.create.l HWIO_MSS_QDSP6SS_INTFCLAMP_CLEAR_ADDR A:0x4080094
y.create.l HWIO_MSS_QDSP6SS_INTFCLAMP_STATUS_ADDR A:0x4080098
y.create.l HWIO_MSS_QDSP6SS_INTF_FIFO_RESET_ADDR A:0x408009c
y.create.l HWIO_MSS_QDSP6SS_STATERET_CTL_ADDR A:0x40800a0
y.create.l HWIO_MSS_QDSP6SS_CGC_OVERRIDE_ADDR A:0x40800b0
y.create.l HWIO_MSS_QDSP6SS_CORE_BHS_CTL_ADDR A:0x40800c0
y.create.l HWIO_MSS_QDSP6SS_CPR_OVERRIDE_ADDR A:0x40800d0
y.create.l HWIO_MSS_QDSP6SS_STRAP_TCM_ADDR A:0x4080100
y.create.l HWIO_MSS_QDSP6SS_STRAP_AHBUPPER_ADDR A:0x4080104
y.create.l HWIO_MSS_QDSP6SS_STRAP_AHBLOWER_ADDR A:0x4080108
y.create.l HWIO_MSS_QDSP6SS_DCC_CTRL_ADDR A:0x4080118
y.create.l HWIO_MSS_QDSP6SS_STRAP_AXIM2UPPER_ADDR A:0x408011c
y.create.l HWIO_MSS_QDSP6SS_STRAP_AXIM2LOWER_ADDR A:0x4080120
y.create.l HWIO_MSS_QDSP6SS_QMC_SVS_CTL_ADDR A:0x4080130
y.create.l HWIO_MSS_QDSP6SS_CORE_MEM_STAGGER_CTL_ADDR A:0x4080140
y.create.l HWIO_MSS_QDSP6SS_PLL_MODE_ADDR A:0x4080200
y.create.l HWIO_MSS_QDSP6SS_PLL_L_VAL_ADDR A:0x4080204
y.create.l HWIO_MSS_QDSP6SS_PLL_ALPHA_VAL_ADDR A:0x4080208
y.create.l HWIO_MSS_QDSP6SS_PLL_ALPHA_VAL_U_ADDR A:0x408020c
y.create.l HWIO_MSS_QDSP6SS_PLL_USER_CTL_ADDR A:0x4080210
y.create.l HWIO_MSS_QDSP6SS_PLL_USER_CTL_U_ADDR A:0x4080214
y.create.l HWIO_MSS_QDSP6SS_PLL_CONFIG_CTL_ADDR A:0x4080218
y.create.l HWIO_MSS_QDSP6SS_PLL_TEST_CTL_ADDR A:0x408021c
y.create.l HWIO_MSS_QDSP6SS_PLL_TEST_CTL_U_ADDR A:0x4080220
y.create.l HWIO_MSS_QDSP6SS_PLL_STATUS_ADDR A:0x4080224
y.create.l HWIO_MSS_QDSP6SS_PLL_FREQ_CTL_ADDR A:0x4080228
y.create.l HWIO_MSS_QDSP6SS_PLL_RCG_UPDATE_STATUS_ADDR A:0x4080260
y.create.l HWIO_MSS_QDSP6SS_PLL_RCG_UPDATE_CFG_ADDR A:0x4080264
y.create.l HWIO_MSS_QDSP6SS_PLL_RCG_UPDATE_DLYCTL_ADDR A:0x4080268
y.create.l HWIO_MSS_QDSP6SS_PLL_RCG_UPDATE_CMD_ADDR A:0x408026c
y.create.l HWIO_MSS_QDSP6SS_DBG_NMI_CFG_ADDR A:0x4080300
y.create.l HWIO_MSS_QDSP6SS_DBG_NMI_PWR_STATUS_ADDR A:0x4080304
y.create.l HWIO_MSS_QDSP6SS_BOOT_CORE_START_ADDR A:0x4080400
y.create.l HWIO_MSS_QDSP6SS_BOOT_CMD_ADDR A:0x4080404
y.create.l HWIO_MSS_QDSP6SS_BOOT_STATUS_ADDR A:0x4080408
y.create.l HWIO_MSS_QDSP6SS_CORE_BHS_CFG_ADDR A:0x4080410
y.create.l HWIO_MSS_QDSP6SS_CORE_BHS_CMD_ADDR A:0x4080414
y.create.l HWIO_MSS_QDSP6SS_CORE_BHS_STATUS_ADDR A:0x4080418
y.create.l HWIO_MSS_QDSP6SS_VPE_VU_CBCR_ADDR A:0x4080420
y.create.l HWIO_MSS_QDSP6SS_MEM_CFG_ADDR A:0x4080430
y.create.l HWIO_MSS_QDSP6SS_MEM_CMD_ADDR A:0x4080434
y.create.l HWIO_MSS_QDSP6SS_MEM_STATUS_ADDR A:0x4080438
y.create.l HWIO_MSS_QDSP6SS_RESET_CFG_ADDR A:0x4080440
y.create.l HWIO_MSS_QDSP6SS_RESET_CMD_ADDR A:0x4080444
y.create.l HWIO_MSS_QDSP6SS_RESET_STATUS_ADDR A:0x4080448
y.create.l HWIO_MSS_QDSP6SS_CLAMP_CFG_ADDR A:0x4080450
y.create.l HWIO_MSS_QDSP6SS_CLAMP_CMD_ADDR A:0x4080454
y.create.l HWIO_MSS_QDSP6SS_CLAMP_STATUS_ADDR A:0x4080458
y.create.l HWIO_MSS_QDSP6SS_CLK_CFG_ADDR A:0x4080460
y.create.l HWIO_MSS_QDSP6SS_CLK_CMD_ADDR A:0x4080464
y.create.l HWIO_MSS_QDSP6SS_CLK_STATUS_ADDR A:0x4080468
y.create.l HWIO_MSS_QDSP6SS_MEM_STAGGER_RESET_CFG_ADDR A:0x4080470
y.create.l HWIO_MSS_QDSP6SS_MEM_STAGGER_RESET_CMD_ADDR A:0x4080474
y.create.l HWIO_MSS_QDSP6SS_MEM_STAGGER_RESET_STATUS_ADDR A:0x4080478
y.create.l HWIO_MSS_QDSP6SS_MEM_STAGGER_RESTORE_CMD_ADDR A:0x4080484
y.create.l HWIO_MSS_QDSP6SS_MEM_STAGGER_RESTORE_STATUS_ADDR A:0x4080488
y.create.l HWIO_MSS_QDSP6SS_CPMEM_CFG_ADDR A:0x4080520
y.create.l HWIO_MSS_QDSP6SS_CPMEM_CMD_ADDR A:0x4080524
y.create.l HWIO_MSS_QDSP6SS_CPMEM_STATUS_ADDR A:0x4080528
y.create.l HWIO_MSS_QDSP6SS_L2ITCM_CFG_ADDR A:0x4080550
y.create.l HWIO_MSS_QDSP6SS_L2ITCM_CMD_ADDR A:0x4080554
y.create.l HWIO_MSS_QDSP6SS_L2ITCM_STATUS_ADDR A:0x4080558
y.create.l HWIO_MSS_QDSP6SS_VU_QOS_ADDR A:0x4080560
y.create.l HWIO_MSS_QDSP6SS_TEST_BUS_CTL_ADDR A:0x4082000
y.create.l HWIO_MSS_QDSP6SS_TEST_BUS_VALUE_ADDR A:0x4082004
y.create.l HWIO_MSS_QDSP6SS_TEST_BUS_WDATA_ADDR A:0x4082008
y.create.l HWIO_MSS_QDSP6SS_PWRDBG_CTL_ADDR A:0x408200c
y.create.l HWIO_MSS_QDSP6SS_TEST_CLK_CTL_ADDR A:0x4082010
y.create.l HWIO_MSS_QDSP6SS_BHS_TEST_ADDR A:0x4082014
y.create.l HWIO_MSS_QDSP6SS_ZMEAS_CONFIG_ADDR A:0x4082018
y.create.l HWIO_MSS_QDSP6SS_CORE_STATUS_ADDR A:0x4082028
y.create.l HWIO_MSS_QDSP6SS_MEM_DEBUG_ADDR A:0x4082030
y.create.l HWIO_MSS_QDSP6V67SS_CSR_REG_BASE_START_ADDR A:0x4100000
y.create.l HWIO_MSS_QDSP6V67SS_CSR_REG_BASE_LAST_ADDR A:0x410c24c
y.create.l HWIO_MSS_QDSP6V67SS_CSR_REG_BASE_END_ADDR A:0x410d000
y.create.l HWIO_MSS_QDSP6SS_INSTANCE_ID_ADDR A:0x4100000
y.create.l HWIO_MSS_QDSP6SS_CP_EFUSE_STATUS_ADDR A:0x4100100
y.create.l HWIO_MSS_QDSP6SS_WDOG_RESET_ADDR A:0x4104000
y.create.l HWIO_MSS_QDSP6SS_WDOG_CTL_ADDR A:0x4104004
y.create.l HWIO_MSS_QDSP6SS_WDOG_STATUS_ADDR A:0x4104008
y.create.l HWIO_MSS_QDSP6SS_WDOG_BARK_TIME_ADDR A:0x410400c
y.create.l HWIO_MSS_QDSP6SS_WDOG_BITE_TIME_ADDR A:0x4104010
y.create.l HWIO_MSS_QDSP6SS_WDOG_NMI_TIME_ADDR A:0x4104014
y.create.l HWIO_MSS_QDSP6SS_WDOG_TEST_LOAD_ADDR A:0x4104018
y.create.l HWIO_MSS_QDSP6SS_WDOG_TEST_ADDR A:0x410401c
y.create.l HWIO_MSS_QDSP6SS_GLBCNT_TRIG_CFG_ADDR A:0x4104100
y.create.l HWIO_MSS_QDSP6SS_TS_0_EN_ADDR A:0x4105000
y.create.l HWIO_MSS_QDSP6SS_TS_1_EN_ADDR A:0x4105010
y.create.l HWIO_MSS_QDSP6SS_TS_2_EN_ADDR A:0x4105020
y.create.l HWIO_MSS_QDSP6SS_TS_3_EN_ADDR A:0x4105030
y.create.l HWIO_MSS_QDSP6SS_TS_0_STATUS_ADDR A:0x4105004
y.create.l HWIO_MSS_QDSP6SS_TS_1_STATUS_ADDR A:0x4105014
y.create.l HWIO_MSS_QDSP6SS_TS_2_STATUS_ADDR A:0x4105024
y.create.l HWIO_MSS_QDSP6SS_TS_3_STATUS_ADDR A:0x4105034
y.create.l HWIO_MSS_QDSP6SS_TS_0_TIMESTAMP_L_ADDR A:0x4105008
y.create.l HWIO_MSS_QDSP6SS_TS_1_TIMESTAMP_L_ADDR A:0x4105018
y.create.l HWIO_MSS_QDSP6SS_TS_2_TIMESTAMP_L_ADDR A:0x4105028
y.create.l HWIO_MSS_QDSP6SS_TS_3_TIMESTAMP_L_ADDR A:0x4105038
y.create.l HWIO_MSS_QDSP6SS_TS_0_TIMESTAMP_H_ADDR A:0x410500c
y.create.l HWIO_MSS_QDSP6SS_TS_1_TIMESTAMP_H_ADDR A:0x410501c
y.create.l HWIO_MSS_QDSP6SS_TS_2_TIMESTAMP_H_ADDR A:0x410502c
y.create.l HWIO_MSS_QDSP6SS_TS_3_TIMESTAMP_H_ADDR A:0x410503c
y.create.l HWIO_MSS_QDSP6SS_TS_HWE_SEL_ADDR A:0x4105100
y.create.l HWIO_MSS_QDSP6SS_IPC_ADDR A:0x4108000
y.create.l HWIO_MSS_QDSP6SS_IPC1_ADDR A:0x4108004
y.create.l HWIO_MSS_QDSP6SS_BLOCK_INTR_ADDR A:0x410c008
y.create.l HWIO_MSS_QDSP6SS_SLPC_CFG_ADDR A:0x410c01c
y.create.l HWIO_MSS_QDSP6SS_RSCCTL_BR_ADDR A:0x410c020
y.create.l HWIO_MSS_QDSP6SS_WAKEUP_CTL_ADDR A:0x410c024
y.create.l HWIO_MSS_QDSP6SS_L2VIC_WAKEUP_EN_ADDR A:0x410c028
y.create.l HWIO_MSS_QDSP6SS_WAKEUP_STATUS_ADDR A:0x410c02c
y.create.l HWIO_MSS_QDSP6SS_RSC_EVENT_EXTPLL_OVR_ADDR A:0x410c050
y.create.l HWIO_MSS_QDSP6SS_RSC_EVENT_ISOINTF_OVR_ADDR A:0x410c054
y.create.l HWIO_MSS_QDSP6SS_RSC_EVENT_PRSC_OVR_ADDR A:0x410c058
y.create.l HWIO_MSS_QDSP6SS_RSC_EVENT_PLL_OVR_ADDR A:0x410c05c
y.create.l HWIO_MSS_QDSP6SS_RSC_EVENT_MEM_OVR_ADDR A:0x410c060
y.create.l HWIO_MSS_QDSP6SS_RSCCTL_EN_ARES_ADDR A:0x410c100
y.create.l HWIO_MSS_QDSP6SS_RSCCTL_EN_CLAMP_ADDR A:0x410c104
y.create.l HWIO_MSS_QDSP6SS_RSCCTL_EN_CLK_ADDR A:0x410c108
y.create.l HWIO_MSS_QDSP6SS_RSCCTL_EN_MEM_RET_ADDR A:0x410c10c
y.create.l HWIO_MSS_QDSP6SS_RSCCTL_EN_MEM_CTL_ADDR A:0x410c110
y.create.l HWIO_MSS_QDSP6SS_RSCCTL_EN_BHS_ADDR A:0x410c114
y.create.l HWIO_MSS_QDSP6SS_RSCCTL_EN_LDO_ADDR A:0x410c118
y.create.l HWIO_MSS_QDSP6SS_RSCCTL_EN_EXT_ADDR A:0x410c11c
y.create.l HWIO_MSS_QDSP6SS_RSCCTL_EN_PLL_ADDR A:0x410c120
y.create.l HWIO_MSS_QDSP6SS_RSCCTL_EN_STATERET_ADDR A:0x410c124
y.create.l HWIO_MSS_QDSP6SS_RSCCTL_EN_ISOINTF_CTL_ADDR A:0x410c128
y.create.l HWIO_MSS_QDSP6SS_RSCCTL_EN_ISOINTF_CLAMP_ADDR A:0x410c12c
y.create.l HWIO_MSS_QDSP6SS_RSCCTL_EN_ISOINTF_CLK_ADDR A:0x410c130
y.create.l HWIO_MSS_QDSP6SS_RSCCTL_EN_L2MEM_RET_ADDR A:0x410c134
y.create.l HWIO_MSS_QDSP6SS_RSCCTL_EN_PRSC_ADDR A:0x410c138
y.create.l HWIO_MSS_QDSP6SS_RSCCTL_EN_L1SMEM_RET_ADDR A:0x410c140
y.create.l HWIO_MSS_QDSP6SS_RSCCTL_EN_MEM_STAGGER_ADDR A:0x410c144
y.create.l HWIO_MSS_QDSP6SS_RSCCTL_EN_VTCMEM_RET_ADDR A:0x410c148
y.create.l HWIO_MSS_QDSP6SS_RSCCTL_EN_L2ITCM_RET_ADDR A:0x410c14c
y.create.l HWIO_MSS_QDSP6SS_RSCCTL_EN_ARES_SET_ADDR A:0x410c180
y.create.l HWIO_MSS_QDSP6SS_RSCCTL_EN_CLAMP_SET_ADDR A:0x410c184
y.create.l HWIO_MSS_QDSP6SS_RSCCTL_EN_CLK_SET_ADDR A:0x410c188
y.create.l HWIO_MSS_QDSP6SS_RSCCTL_EN_MEM_RET_SET_ADDR A:0x410c18c
y.create.l HWIO_MSS_QDSP6SS_RSCCTL_EN_MEM_CTL_SET_ADDR A:0x410c190
y.create.l HWIO_MSS_QDSP6SS_RSCCTL_EN_BHS_SET_ADDR A:0x410c194
y.create.l HWIO_MSS_QDSP6SS_RSCCTL_EN_LDO_SET_ADDR A:0x410c198
y.create.l HWIO_MSS_QDSP6SS_RSCCTL_EN_EXT_SET_ADDR A:0x410c19c
y.create.l HWIO_MSS_QDSP6SS_RSCCTL_EN_PLL_SET_ADDR A:0x410c1a0
y.create.l HWIO_MSS_QDSP6SS_RSCCTL_EN_STATERET_SET_ADDR A:0x410c1a4
y.create.l HWIO_MSS_QDSP6SS_RSCCTL_EN_ISOINTF_CTL_SET_ADDR A:0x410c1a8
y.create.l HWIO_MSS_QDSP6SS_RSCCTL_EN_ISOINTF_CLAMP_SET_ADDR A:0x410c1ac
y.create.l HWIO_MSS_QDSP6SS_RSCCTL_EN_ISOINTF_CLK_SET_ADDR A:0x410c1b0
y.create.l HWIO_MSS_QDSP6SS_RSCCTL_EN_L2MEM_RET_SET_ADDR A:0x410c1b4
y.create.l HWIO_MSS_QDSP6SS_RSCCTL_EN_PRSC_SET_ADDR A:0x410c1b8
y.create.l HWIO_MSS_QDSP6SS_RSCCTL_EN_L1SMEM_RET_SET_ADDR A:0x410c1c0
y.create.l HWIO_MSS_QDSP6SS_RSCCTL_EN_MEM_STAGGER_SET_ADDR A:0x410c1c4
y.create.l HWIO_MSS_QDSP6SS_RSCCTL_EN_VTCMEM_RET_SET_ADDR A:0x410c1c8
y.create.l HWIO_MSS_QDSP6SS_RSCCTL_EN_L2ITCM_RET_SET_ADDR A:0x410c1cc
y.create.l HWIO_MSS_QDSP6SS_RSCCTL_EN_ARES_CLEAR_ADDR A:0x410c200
y.create.l HWIO_MSS_QDSP6SS_RSCCTL_EN_CLAMP_CLEAR_ADDR A:0x410c204
y.create.l HWIO_MSS_QDSP6SS_RSCCTL_EN_CLK_CLEAR_ADDR A:0x410c208
y.create.l HWIO_MSS_QDSP6SS_RSCCTL_EN_MEM_RET_CLEAR_ADDR A:0x410c20c
y.create.l HWIO_MSS_QDSP6SS_RSCCTL_EN_MEM_CTL_CLEAR_ADDR A:0x410c210
y.create.l HWIO_MSS_QDSP6SS_RSCCTL_EN_BHS_CLEAR_ADDR A:0x410c214
y.create.l HWIO_MSS_QDSP6SS_RSCCTL_EN_LDO_CLEAR_ADDR A:0x410c218
y.create.l HWIO_MSS_QDSP6SS_RSCCTL_EN_EXT_CLEAR_ADDR A:0x410c21c
y.create.l HWIO_MSS_QDSP6SS_RSCCTL_EN_PLL_CLEAR_ADDR A:0x410c220
y.create.l HWIO_MSS_QDSP6SS_RSCCTL_EN_STATERET_CLEAR_ADDR A:0x410c224
y.create.l HWIO_MSS_QDSP6SS_RSCCTL_EN_ISOINTF_CTL_CLEAR_ADDR A:0x410c228
y.create.l HWIO_MSS_QDSP6SS_RSCCTL_EN_ISOINTF_CLAMP_CLEAR_ADDR A:0x410c22c
y.create.l HWIO_MSS_QDSP6SS_RSCCTL_EN_ISOINTF_CLK_CLEAR_ADDR A:0x410c230
y.create.l HWIO_MSS_QDSP6SS_RSCCTL_EN_L2MEM_RET_CLEAR_ADDR A:0x410c234
y.create.l HWIO_MSS_QDSP6SS_RSCCTL_EN_PRSC_CLEAR_ADDR A:0x410c238
y.create.l HWIO_MSS_QDSP6SS_RSCCTL_EN_L1SMEM_RET_CLEAR_ADDR A:0x410c240
y.create.l HWIO_MSS_QDSP6SS_RSCCTL_EN_MEM_STAGGER_CLEAR_ADDR A:0x410c244
y.create.l HWIO_MSS_QDSP6SS_RSCCTL_EN_VTCMEM_RET_CLEAR_ADDR A:0x410c248
y.create.l HWIO_MSS_QDSP6SS_RSCCTL_EN_L2ITCM_RET_CLEAR_ADDR A:0x410c24c
y.create.l HWIO_MSS_QDSP6V67SS_L2VIC_REG_BASE_START_ADDR A:0x4110000
y.create.l HWIO_MSS_QDSP6V67SS_L2VIC_REG_BASE_LAST_ADDR A:0x41107fc
y.create.l HWIO_MSS_QDSP6V67SS_L2VIC_REG_BASE_END_ADDR A:0x4111000
y.create.l HWIO_MSS_QDSP6SS_L2VIC_VID_GRP_0_ADDR A:0x4110000
y.create.l HWIO_MSS_QDSP6SS_L2VIC_VID_GRP_1_ADDR A:0x4110004
y.create.l HWIO_MSS_QDSP6SS_L2VIC_VID_GRP_2_ADDR A:0x4110008
y.create.l HWIO_MSS_QDSP6SS_L2VIC_VID_GRP_3_ADDR A:0x411000c
y.create.l HWIO_MSS_QDSP6SS_L2VIC_INT_ENABLE0_ADDR A:0x4110100
y.create.l HWIO_MSS_QDSP6SS_L2VIC_INT_ENABLE1_ADDR A:0x4110104
y.create.l HWIO_MSS_QDSP6SS_L2VIC_INT_ENABLE2_ADDR A:0x4110108
y.create.l HWIO_MSS_QDSP6SS_L2VIC_INT_ENABLE3_ADDR A:0x411010c
y.create.l HWIO_MSS_QDSP6SS_L2VIC_INT_ENABLE4_ADDR A:0x4110110
y.create.l HWIO_MSS_QDSP6SS_L2VIC_INT_ENABLE5_ADDR A:0x4110114
y.create.l HWIO_MSS_QDSP6SS_L2VIC_INT_ENABLE6_ADDR A:0x4110118
y.create.l HWIO_MSS_QDSP6SS_L2VIC_INT_ENABLE7_ADDR A:0x411011c
y.create.l HWIO_MSS_QDSP6SS_L2VIC_INT_ENABLE8_ADDR A:0x4110120
y.create.l HWIO_MSS_QDSP6SS_L2VIC_INT_ENABLE9_ADDR A:0x4110124
y.create.l HWIO_MSS_QDSP6SS_L2VIC_INT_ENABLE_CLEAR0_ADDR A:0x4110180
y.create.l HWIO_MSS_QDSP6SS_L2VIC_INT_ENABLE_CLEAR1_ADDR A:0x4110184
y.create.l HWIO_MSS_QDSP6SS_L2VIC_INT_ENABLE_CLEAR2_ADDR A:0x4110188
y.create.l HWIO_MSS_QDSP6SS_L2VIC_INT_ENABLE_CLEAR3_ADDR A:0x411018c
y.create.l HWIO_MSS_QDSP6SS_L2VIC_INT_ENABLE_CLEAR4_ADDR A:0x4110190
y.create.l HWIO_MSS_QDSP6SS_L2VIC_INT_ENABLE_CLEAR5_ADDR A:0x4110194
y.create.l HWIO_MSS_QDSP6SS_L2VIC_INT_ENABLE_CLEAR6_ADDR A:0x4110198
y.create.l HWIO_MSS_QDSP6SS_L2VIC_INT_ENABLE_CLEAR7_ADDR A:0x411019c
y.create.l HWIO_MSS_QDSP6SS_L2VIC_INT_ENABLE_CLEAR8_ADDR A:0x41101a0
y.create.l HWIO_MSS_QDSP6SS_L2VIC_INT_ENABLE_CLEAR9_ADDR A:0x41101a4
y.create.l HWIO_MSS_QDSP6SS_L2VIC_INT_ENABLE_SET0_ADDR A:0x4110200
y.create.l HWIO_MSS_QDSP6SS_L2VIC_INT_ENABLE_SET1_ADDR A:0x4110204
y.create.l HWIO_MSS_QDSP6SS_L2VIC_INT_ENABLE_SET2_ADDR A:0x4110208
y.create.l HWIO_MSS_QDSP6SS_L2VIC_INT_ENABLE_SET3_ADDR A:0x411020c
y.create.l HWIO_MSS_QDSP6SS_L2VIC_INT_ENABLE_SET4_ADDR A:0x4110210
y.create.l HWIO_MSS_QDSP6SS_L2VIC_INT_ENABLE_SET5_ADDR A:0x4110214
y.create.l HWIO_MSS_QDSP6SS_L2VIC_INT_ENABLE_SET6_ADDR A:0x4110218
y.create.l HWIO_MSS_QDSP6SS_L2VIC_INT_ENABLE_SET7_ADDR A:0x411021c
y.create.l HWIO_MSS_QDSP6SS_L2VIC_INT_ENABLE_SET8_ADDR A:0x4110220
y.create.l HWIO_MSS_QDSP6SS_L2VIC_INT_ENABLE_SET9_ADDR A:0x4110224
y.create.l HWIO_MSS_QDSP6SS_L2VIC_INT_TYPE0_ADDR A:0x4110280
y.create.l HWIO_MSS_QDSP6SS_L2VIC_INT_TYPE1_ADDR A:0x4110284
y.create.l HWIO_MSS_QDSP6SS_L2VIC_INT_TYPE2_ADDR A:0x4110288
y.create.l HWIO_MSS_QDSP6SS_L2VIC_INT_TYPE3_ADDR A:0x411028c
y.create.l HWIO_MSS_QDSP6SS_L2VIC_INT_TYPE4_ADDR A:0x4110290
y.create.l HWIO_MSS_QDSP6SS_L2VIC_INT_TYPE5_ADDR A:0x4110294
y.create.l HWIO_MSS_QDSP6SS_L2VIC_INT_TYPE6_ADDR A:0x4110298
y.create.l HWIO_MSS_QDSP6SS_L2VIC_INT_TYPE7_ADDR A:0x411029c
y.create.l HWIO_MSS_QDSP6SS_L2VIC_INT_TYPE8_ADDR A:0x41102a0
y.create.l HWIO_MSS_QDSP6SS_L2VIC_INT_TYPE9_ADDR A:0x41102a4
y.create.l HWIO_MSS_QDSP6SS_L2VIC_INT_STATUS0_ADDR A:0x4110380
y.create.l HWIO_MSS_QDSP6SS_L2VIC_INT_STATUS1_ADDR A:0x4110384
y.create.l HWIO_MSS_QDSP6SS_L2VIC_INT_STATUS2_ADDR A:0x4110388
y.create.l HWIO_MSS_QDSP6SS_L2VIC_INT_STATUS3_ADDR A:0x411038c
y.create.l HWIO_MSS_QDSP6SS_L2VIC_INT_STATUS4_ADDR A:0x4110390
y.create.l HWIO_MSS_QDSP6SS_L2VIC_INT_STATUS5_ADDR A:0x4110394
y.create.l HWIO_MSS_QDSP6SS_L2VIC_INT_STATUS6_ADDR A:0x4110398
y.create.l HWIO_MSS_QDSP6SS_L2VIC_INT_STATUS7_ADDR A:0x411039c
y.create.l HWIO_MSS_QDSP6SS_L2VIC_INT_STATUS8_ADDR A:0x41103a0
y.create.l HWIO_MSS_QDSP6SS_L2VIC_INT_STATUS9_ADDR A:0x41103a4
y.create.l HWIO_MSS_QDSP6SS_L2VIC_INT_CLEAR0_ADDR A:0x4110400
y.create.l HWIO_MSS_QDSP6SS_L2VIC_INT_CLEAR1_ADDR A:0x4110404
y.create.l HWIO_MSS_QDSP6SS_L2VIC_INT_CLEAR2_ADDR A:0x4110408
y.create.l HWIO_MSS_QDSP6SS_L2VIC_INT_CLEAR3_ADDR A:0x411040c
y.create.l HWIO_MSS_QDSP6SS_L2VIC_INT_CLEAR4_ADDR A:0x4110410
y.create.l HWIO_MSS_QDSP6SS_L2VIC_INT_CLEAR5_ADDR A:0x4110414
y.create.l HWIO_MSS_QDSP6SS_L2VIC_INT_CLEAR6_ADDR A:0x4110418
y.create.l HWIO_MSS_QDSP6SS_L2VIC_INT_CLEAR7_ADDR A:0x411041c
y.create.l HWIO_MSS_QDSP6SS_L2VIC_INT_CLEAR8_ADDR A:0x4110420
y.create.l HWIO_MSS_QDSP6SS_L2VIC_INT_CLEAR9_ADDR A:0x4110424
y.create.l HWIO_MSS_QDSP6SS_L2VIC_SOFT_INT0_ADDR A:0x4110480
y.create.l HWIO_MSS_QDSP6SS_L2VIC_SOFT_INT1_ADDR A:0x4110484
y.create.l HWIO_MSS_QDSP6SS_L2VIC_SOFT_INT2_ADDR A:0x4110488
y.create.l HWIO_MSS_QDSP6SS_L2VIC_SOFT_INT3_ADDR A:0x411048c
y.create.l HWIO_MSS_QDSP6SS_L2VIC_SOFT_INT4_ADDR A:0x4110490
y.create.l HWIO_MSS_QDSP6SS_L2VIC_SOFT_INT5_ADDR A:0x4110494
y.create.l HWIO_MSS_QDSP6SS_L2VIC_SOFT_INT6_ADDR A:0x4110498
y.create.l HWIO_MSS_QDSP6SS_L2VIC_SOFT_INT7_ADDR A:0x411049c
y.create.l HWIO_MSS_QDSP6SS_L2VIC_SOFT_INT8_ADDR A:0x41104a0
y.create.l HWIO_MSS_QDSP6SS_L2VIC_SOFT_INT9_ADDR A:0x41104a4
y.create.l HWIO_MSS_QDSP6SS_L2VIC_INT_PENDING0_ADDR A:0x4110500
y.create.l HWIO_MSS_QDSP6SS_L2VIC_INT_PENDING1_ADDR A:0x4110504
y.create.l HWIO_MSS_QDSP6SS_L2VIC_INT_PENDING2_ADDR A:0x4110508
y.create.l HWIO_MSS_QDSP6SS_L2VIC_INT_PENDING3_ADDR A:0x411050c
y.create.l HWIO_MSS_QDSP6SS_L2VIC_INT_PENDING4_ADDR A:0x4110510
y.create.l HWIO_MSS_QDSP6SS_L2VIC_INT_PENDING5_ADDR A:0x4110514
y.create.l HWIO_MSS_QDSP6SS_L2VIC_INT_PENDING6_ADDR A:0x4110518
y.create.l HWIO_MSS_QDSP6SS_L2VIC_INT_PENDING7_ADDR A:0x411051c
y.create.l HWIO_MSS_QDSP6SS_L2VIC_INT_PENDING8_ADDR A:0x4110520
y.create.l HWIO_MSS_QDSP6SS_L2VIC_INT_PENDING9_ADDR A:0x4110524
y.create.l HWIO_MSS_QDSP6SS_L2VIC_INT_GRP0_0_ADDR A:0x4110600
y.create.l HWIO_MSS_QDSP6SS_L2VIC_INT_GRP1_0_ADDR A:0x4110604
y.create.l HWIO_MSS_QDSP6SS_L2VIC_INT_GRP2_0_ADDR A:0x4110608
y.create.l HWIO_MSS_QDSP6SS_L2VIC_INT_GRP3_0_ADDR A:0x411060c
y.create.l HWIO_MSS_QDSP6SS_L2VIC_INT_GRP4_0_ADDR A:0x4110610
y.create.l HWIO_MSS_QDSP6SS_L2VIC_INT_GRP5_0_ADDR A:0x4110614
y.create.l HWIO_MSS_QDSP6SS_L2VIC_INT_GRP6_0_ADDR A:0x4110618
y.create.l HWIO_MSS_QDSP6SS_L2VIC_INT_GRP7_0_ADDR A:0x411061c
y.create.l HWIO_MSS_QDSP6SS_L2VIC_INT_GRP8_0_ADDR A:0x4110620
y.create.l HWIO_MSS_QDSP6SS_L2VIC_INT_GRP9_0_ADDR A:0x4110624
y.create.l HWIO_MSS_QDSP6SS_L2VIC_INT_GRP0_1_ADDR A:0x4110680
y.create.l HWIO_MSS_QDSP6SS_L2VIC_INT_GRP1_1_ADDR A:0x4110684
y.create.l HWIO_MSS_QDSP6SS_L2VIC_INT_GRP2_1_ADDR A:0x4110688
y.create.l HWIO_MSS_QDSP6SS_L2VIC_INT_GRP3_1_ADDR A:0x411068c
y.create.l HWIO_MSS_QDSP6SS_L2VIC_INT_GRP4_1_ADDR A:0x4110690
y.create.l HWIO_MSS_QDSP6SS_L2VIC_INT_GRP5_1_ADDR A:0x4110694
y.create.l HWIO_MSS_QDSP6SS_L2VIC_INT_GRP6_1_ADDR A:0x4110698
y.create.l HWIO_MSS_QDSP6SS_L2VIC_INT_GRP7_1_ADDR A:0x411069c
y.create.l HWIO_MSS_QDSP6SS_L2VIC_INT_GRP8_1_ADDR A:0x41106a0
y.create.l HWIO_MSS_QDSP6SS_L2VIC_INT_GRP9_1_ADDR A:0x41106a4
y.create.l HWIO_MSS_QDSP6SS_L2VIC_INT_GRP0_2_ADDR A:0x4110700
y.create.l HWIO_MSS_QDSP6SS_L2VIC_INT_GRP1_2_ADDR A:0x4110704
y.create.l HWIO_MSS_QDSP6SS_L2VIC_INT_GRP2_2_ADDR A:0x4110708
y.create.l HWIO_MSS_QDSP6SS_L2VIC_INT_GRP3_2_ADDR A:0x411070c
y.create.l HWIO_MSS_QDSP6SS_L2VIC_INT_GRP4_2_ADDR A:0x4110710
y.create.l HWIO_MSS_QDSP6SS_L2VIC_INT_GRP5_2_ADDR A:0x4110714
y.create.l HWIO_MSS_QDSP6SS_L2VIC_INT_GRP6_2_ADDR A:0x4110718
y.create.l HWIO_MSS_QDSP6SS_L2VIC_INT_GRP7_2_ADDR A:0x411071c
y.create.l HWIO_MSS_QDSP6SS_L2VIC_INT_GRP8_2_ADDR A:0x4110720
y.create.l HWIO_MSS_QDSP6SS_L2VIC_INT_GRP9_2_ADDR A:0x4110724
y.create.l HWIO_MSS_QDSP6SS_L2VIC_INT_GRP0_3_ADDR A:0x4110780
y.create.l HWIO_MSS_QDSP6SS_L2VIC_INT_GRP1_3_ADDR A:0x4110784
y.create.l HWIO_MSS_QDSP6SS_L2VIC_INT_GRP2_3_ADDR A:0x4110788
y.create.l HWIO_MSS_QDSP6SS_L2VIC_INT_GRP3_3_ADDR A:0x411078c
y.create.l HWIO_MSS_QDSP6SS_L2VIC_INT_GRP4_3_ADDR A:0x4110790
y.create.l HWIO_MSS_QDSP6SS_L2VIC_INT_GRP5_3_ADDR A:0x4110794
y.create.l HWIO_MSS_QDSP6SS_L2VIC_INT_GRP6_3_ADDR A:0x4110798
y.create.l HWIO_MSS_QDSP6SS_L2VIC_INT_GRP7_3_ADDR A:0x411079c
y.create.l HWIO_MSS_QDSP6SS_L2VIC_INT_GRP8_3_ADDR A:0x41107a0
y.create.l HWIO_MSS_QDSP6SS_L2VIC_INT_GRP9_3_ADDR A:0x41107a4
y.create.l HWIO_MSS_QDSP6SS_QDSP6SS_QTMR_AC_REG_BASE_START_ADDR A:0x4120000
y.create.l HWIO_MSS_QDSP6SS_QDSP6SS_QTMR_AC_REG_BASE_LAST_ADDR A:0x4120fd0
y.create.l HWIO_MSS_QDSP6SS_QDSP6SS_QTMR_AC_REG_BASE_END_ADDR A:0x4121000
y.create.l HWIO_MSS_QDSP6SS_QTMR_AC_CNTFRQ_ADDR A:0x4120000
y.create.l HWIO_MSS_QDSP6SS_QTMR_AC_CNTSR_ADDR A:0x4120004
y.create.l HWIO_MSS_QDSP6SS_QTMR_AC_CNTTID_ADDR A:0x4120008
y.create.l HWIO_MSS_QDSP6SS_QTMR_AC_CNTACR_0_ADDR A:0x4120040
y.create.l HWIO_MSS_QDSP6SS_QTMR_AC_CNTACR_1_ADDR A:0x4120044
y.create.l HWIO_MSS_QDSP6SS_QTMR_AC_CNTACR_2_ADDR A:0x4120048
y.create.l HWIO_MSS_QDSP6SS_QTMR_AC_CNTVOFF_LO_0_ADDR A:0x4120080
y.create.l HWIO_MSS_QDSP6SS_QTMR_AC_CNTVOFF_LO_1_ADDR A:0x4120088
y.create.l HWIO_MSS_QDSP6SS_QTMR_AC_CNTVOFF_LO_2_ADDR A:0x4120090
y.create.l HWIO_MSS_QDSP6SS_QTMR_AC_CNTVOFF_HI_0_ADDR A:0x4120084
y.create.l HWIO_MSS_QDSP6SS_QTMR_AC_CNTVOFF_HI_1_ADDR A:0x412008c
y.create.l HWIO_MSS_QDSP6SS_QTMR_AC_CNTVOFF_HI_2_ADDR A:0x4120094
y.create.l HWIO_MSS_QDSP6SS_QTMR_AC_CFG_ADDR A:0x4120fc0
y.create.l HWIO_MSS_QDSP6SS_QTMR_AC_VERSION_ADDR A:0x4120fd0
y.create.l HWIO_MSS_QDSP6SS_QTMR_F0_0_REG_BASE_START_ADDR A:0x4121000
y.create.l HWIO_MSS_QDSP6SS_QTMR_F0_0_REG_BASE_LAST_ADDR A:0x4121fd0
y.create.l HWIO_MSS_QDSP6SS_QTMR_F0_0_REG_BASE_END_ADDR A:0x4122000
y.create.l HWIO_MSS_QDSP6SS_QTMR_V1_CNTPCT_LO_0_ADDR A:0x4121000
y.create.l HWIO_MSS_QDSP6SS_QTMR_V1_CNTPCT_HI_0_ADDR A:0x4121004
y.create.l HWIO_MSS_QDSP6SS_QTMR_V1_CNTVCT_LO_0_ADDR A:0x4121008
y.create.l HWIO_MSS_QDSP6SS_QTMR_V1_CNTVCT_HI_0_ADDR A:0x412100c
y.create.l HWIO_MSS_QDSP6SS_QTMR_V1_CNTFRQ_0_ADDR A:0x4121010
y.create.l HWIO_MSS_QDSP6SS_QTMR_V1_CNTPL0ACR_0_ADDR A:0x4121014
y.create.l HWIO_MSS_QDSP6SS_QTMR_V1_CNTVOFF_LO_0_ADDR A:0x4121018
y.create.l HWIO_MSS_QDSP6SS_QTMR_V1_CNTVOFF_HI_0_ADDR A:0x412101c
y.create.l HWIO_MSS_QDSP6SS_QTMR_V1_CNTP_CVAL_LO_0_ADDR A:0x4121020
y.create.l HWIO_MSS_QDSP6SS_QTMR_V1_CNTP_CVAL_HI_0_ADDR A:0x4121024
y.create.l HWIO_MSS_QDSP6SS_QTMR_V1_CNTP_TVAL_0_ADDR A:0x4121028
y.create.l HWIO_MSS_QDSP6SS_QTMR_V1_CNTP_CTL_0_ADDR A:0x412102c
y.create.l HWIO_MSS_QDSP6SS_QTMR_V1_CNTV_CVAL_LO_0_ADDR A:0x4121030
y.create.l HWIO_MSS_QDSP6SS_QTMR_V1_CNTV_CVAL_HI_0_ADDR A:0x4121034
y.create.l HWIO_MSS_QDSP6SS_QTMR_V1_CNTV_TVAL_0_ADDR A:0x4121038
y.create.l HWIO_MSS_QDSP6SS_QTMR_V1_CNTV_CTL_0_ADDR A:0x412103c
y.create.l HWIO_MSS_QDSP6SS_QTMR_V1_VERSION_0_ADDR A:0x4121fd0
y.create.l HWIO_MSS_QDSP6SS_QTMR_F1_1_REG_BASE_START_ADDR A:0x4122000
y.create.l HWIO_MSS_QDSP6SS_QTMR_F1_1_REG_BASE_LAST_ADDR A:0x4122fd0
y.create.l HWIO_MSS_QDSP6SS_QTMR_F1_1_REG_BASE_END_ADDR A:0x4123000
y.create.l HWIO_MSS_QDSP6SS_QTMR_V1_CNTPCT_LO_1_ADDR A:0x4122000
y.create.l HWIO_MSS_QDSP6SS_QTMR_V1_CNTPCT_HI_1_ADDR A:0x4122004
y.create.l HWIO_MSS_QDSP6SS_QTMR_V1_CNTVCT_LO_1_ADDR A:0x4122008
y.create.l HWIO_MSS_QDSP6SS_QTMR_V1_CNTVCT_HI_1_ADDR A:0x412200c
y.create.l HWIO_MSS_QDSP6SS_QTMR_V1_CNTFRQ_1_ADDR A:0x4122010
y.create.l HWIO_MSS_QDSP6SS_QTMR_V1_CNTPL0ACR_1_ADDR A:0x4122014
y.create.l HWIO_MSS_QDSP6SS_QTMR_V1_CNTVOFF_LO_1_ADDR A:0x4122018
y.create.l HWIO_MSS_QDSP6SS_QTMR_V1_CNTVOFF_HI_1_ADDR A:0x412201c
y.create.l HWIO_MSS_QDSP6SS_QTMR_V1_CNTP_CVAL_LO_1_ADDR A:0x4122020
y.create.l HWIO_MSS_QDSP6SS_QTMR_V1_CNTP_CVAL_HI_1_ADDR A:0x4122024
y.create.l HWIO_MSS_QDSP6SS_QTMR_V1_CNTP_TVAL_1_ADDR A:0x4122028
y.create.l HWIO_MSS_QDSP6SS_QTMR_V1_CNTP_CTL_1_ADDR A:0x412202c
y.create.l HWIO_MSS_QDSP6SS_QTMR_V1_CNTV_CVAL_LO_1_ADDR A:0x4122030
y.create.l HWIO_MSS_QDSP6SS_QTMR_V1_CNTV_CVAL_HI_1_ADDR A:0x4122034
y.create.l HWIO_MSS_QDSP6SS_QTMR_V1_CNTV_TVAL_1_ADDR A:0x4122038
y.create.l HWIO_MSS_QDSP6SS_QTMR_V1_CNTV_CTL_1_ADDR A:0x412203c
y.create.l HWIO_MSS_QDSP6SS_QTMR_V1_VERSION_1_ADDR A:0x4122fd0
y.create.l HWIO_MSS_QDSP6SS_QTMR_F2_2_REG_BASE_START_ADDR A:0x4123000
y.create.l HWIO_MSS_QDSP6SS_QTMR_F2_2_REG_BASE_LAST_ADDR A:0x4123fd0
y.create.l HWIO_MSS_QDSP6SS_QTMR_F2_2_REG_BASE_END_ADDR A:0x4124000
y.create.l HWIO_MSS_QDSP6SS_QTMR_V1_CNTPCT_LO_2_ADDR A:0x4123000
y.create.l HWIO_MSS_QDSP6SS_QTMR_V1_CNTPCT_HI_2_ADDR A:0x4123004
y.create.l HWIO_MSS_QDSP6SS_QTMR_V1_CNTVCT_LO_2_ADDR A:0x4123008
y.create.l HWIO_MSS_QDSP6SS_QTMR_V1_CNTVCT_HI_2_ADDR A:0x412300c
y.create.l HWIO_MSS_QDSP6SS_QTMR_V1_CNTFRQ_2_ADDR A:0x4123010
y.create.l HWIO_MSS_QDSP6SS_QTMR_V1_CNTPL0ACR_2_ADDR A:0x4123014
y.create.l HWIO_MSS_QDSP6SS_QTMR_V1_CNTVOFF_LO_2_ADDR A:0x4123018
y.create.l HWIO_MSS_QDSP6SS_QTMR_V1_CNTVOFF_HI_2_ADDR A:0x412301c
y.create.l HWIO_MSS_QDSP6SS_QTMR_V1_CNTP_CVAL_LO_2_ADDR A:0x4123020
y.create.l HWIO_MSS_QDSP6SS_QTMR_V1_CNTP_CVAL_HI_2_ADDR A:0x4123024
y.create.l HWIO_MSS_QDSP6SS_QTMR_V1_CNTP_TVAL_2_ADDR A:0x4123028
y.create.l HWIO_MSS_QDSP6SS_QTMR_V1_CNTP_CTL_2_ADDR A:0x412302c
y.create.l HWIO_MSS_QDSP6SS_QTMR_V1_CNTV_CVAL_LO_2_ADDR A:0x4123030
y.create.l HWIO_MSS_QDSP6SS_QTMR_V1_CNTV_CVAL_HI_2_ADDR A:0x4123034
y.create.l HWIO_MSS_QDSP6SS_QTMR_V1_CNTV_TVAL_2_ADDR A:0x4123038
y.create.l HWIO_MSS_QDSP6SS_QTMR_V1_CNTV_CTL_2_ADDR A:0x412303c
y.create.l HWIO_MSS_QDSP6SS_QTMR_V1_VERSION_2_ADDR A:0x4123fd0
y.create.l HWIO_MSS_QDSP6SS_RSCC_RSCC_RSC_REG_BASE_START_ADDR A:0x4130000
y.create.l HWIO_MSS_QDSP6SS_RSCC_RSCC_RSC_REG_BASE_LAST_ADDR A:0x41306bc
y.create.l HWIO_MSS_QDSP6SS_RSCC_RSCC_RSC_REG_BASE_END_ADDR A:0x4140000
y.create.l HWIO_MSS_QDSP6SS_RSCC_RSC_ID_DRV0_ADDR A:0x4130000
y.create.l HWIO_MSS_QDSP6SS_RSCC_RSC_PARAM_SOLVER_CONFIG_DRV0_ADDR A:0x4130004
y.create.l HWIO_MSS_QDSP6SS_RSCC_RSC_PARAM_RSC_CONFIG_DRV0_ADDR A:0x4130008
y.create.l HWIO_MSS_QDSP6SS_RSCC_RSC_PARAM_RSC_PARENTCHILD_CONFIG_DRV0_ADDR A:0x413000c
y.create.l HWIO_MSS_QDSP6SS_RSCC_RSC_STATUS0_DRV0_ADDR A:0x4130010
y.create.l HWIO_MSS_QDSP6SS_RSCC_RSC_STATUS1_DRV0_ADDR A:0x4130014
y.create.l HWIO_MSS_QDSP6SS_RSCC_RSC_STATUS2_DRV0_ADDR A:0x4130018
y.create.l HWIO_MSS_QDSP6SS_RSCC_HW_EVENT_OWNER_DRV0_ADDR A:0x413004c
y.create.l HWIO_MSS_QDSP6SS_RSCC_HW_EVENT_MUX0_SELECT_DRV0_ADDR A:0x4130050
y.create.l HWIO_MSS_QDSP6SS_RSCC_HW_EVENT_MUX1_SELECT_DRV0_ADDR A:0x4130054
y.create.l HWIO_MSS_QDSP6SS_RSCC_HW_EVENT_MUX2_SELECT_DRV0_ADDR A:0x4130058
y.create.l HWIO_MSS_QDSP6SS_RSCC_HW_EVENT_MUX3_SELECT_DRV0_ADDR A:0x413005c
y.create.l HWIO_MSS_QDSP6SS_RSCC_RSC_ERROR_IRQ_STATUS_DRV0_ADDR A:0x41300d0
y.create.l HWIO_MSS_QDSP6SS_RSCC_RSC_ERROR_IRQ_CLEAR_DRV0_ADDR A:0x41300d4
y.create.l HWIO_MSS_QDSP6SS_RSCC_RSC_ERROR_IRQ_ENABLE_DRV0_ADDR A:0x41300d8
y.create.l HWIO_MSS_QDSP6SS_RSCC_RSC_ERROR_RESP_CTRL_DRV0_ADDR A:0x4130100
y.create.l HWIO_MSS_QDSP6SS_RSCC_RSC_TIMESTAMP_UNIT_OWNER_DRV0_ADDR A:0x4130200
y.create.l HWIO_MSS_QDSP6SS_RSCC_RSC_TIMESTAMP_UNIT0_EN_DRV0_ADDR A:0x4130204
y.create.l HWIO_MSS_QDSP6SS_RSCC_RSC_TIMESTAMP_UNIT1_EN_DRV0_ADDR A:0x4130224
y.create.l HWIO_MSS_QDSP6SS_RSCC_RSC_TIMESTAMP_UNIT2_EN_DRV0_ADDR A:0x4130244
y.create.l HWIO_MSS_QDSP6SS_RSCC_RSC_TIMESTAMP_UNIT3_EN_DRV0_ADDR A:0x4130264
y.create.l HWIO_MSS_QDSP6SS_RSCC_RSC_TIMESTAMP_UNIT0_TIMESTAMP_L_DRV0_ADDR A:0x4130208
y.create.l HWIO_MSS_QDSP6SS_RSCC_RSC_TIMESTAMP_UNIT1_TIMESTAMP_L_DRV0_ADDR A:0x4130228
y.create.l HWIO_MSS_QDSP6SS_RSCC_RSC_TIMESTAMP_UNIT2_TIMESTAMP_L_DRV0_ADDR A:0x4130248
y.create.l HWIO_MSS_QDSP6SS_RSCC_RSC_TIMESTAMP_UNIT3_TIMESTAMP_L_DRV0_ADDR A:0x4130268
y.create.l HWIO_MSS_QDSP6SS_RSCC_RSC_TIMESTAMP_UNIT0_TIMESTAMP_H_DRV0_ADDR A:0x413020c
y.create.l HWIO_MSS_QDSP6SS_RSCC_RSC_TIMESTAMP_UNIT1_TIMESTAMP_H_DRV0_ADDR A:0x413022c
y.create.l HWIO_MSS_QDSP6SS_RSCC_RSC_TIMESTAMP_UNIT2_TIMESTAMP_H_DRV0_ADDR A:0x413024c
y.create.l HWIO_MSS_QDSP6SS_RSCC_RSC_TIMESTAMP_UNIT3_TIMESTAMP_H_DRV0_ADDR A:0x413026c
y.create.l HWIO_MSS_QDSP6SS_RSCC_RSC_TIMESTAMP_UNIT0_OUTPUT_DRV0_ADDR A:0x4130210
y.create.l HWIO_MSS_QDSP6SS_RSCC_RSC_TIMESTAMP_UNIT1_OUTPUT_DRV0_ADDR A:0x4130230
y.create.l HWIO_MSS_QDSP6SS_RSCC_RSC_TIMESTAMP_UNIT2_OUTPUT_DRV0_ADDR A:0x4130250
y.create.l HWIO_MSS_QDSP6SS_RSCC_RSC_TIMESTAMP_UNIT3_OUTPUT_DRV0_ADDR A:0x4130270
y.create.l HWIO_MSS_QDSP6SS_RSCC_RSC_SEQ_OVERRIDE_START_ADDR_DRV0_ADDR A:0x4130400
y.create.l HWIO_MSS_QDSP6SS_RSCC_RSC_SEQ_BUSY_DRV0_ADDR A:0x4130404
y.create.l HWIO_MSS_QDSP6SS_RSCC_RSC_SEQ_PROGRAM_COUNTER_DRV0_ADDR A:0x4130408
y.create.l HWIO_MSS_QDSP6SS_RSCC_RSC_SEQ_CFG_BR_ADDR_0_DRV0_ADDR A:0x4130410
y.create.l HWIO_MSS_QDSP6SS_RSCC_RSC_SEQ_CFG_BR_ADDR_1_DRV0_ADDR A:0x4130414
y.create.l HWIO_MSS_QDSP6SS_RSCC_RSC_SEQ_CFG_BR_ADDR_2_DRV0_ADDR A:0x4130418
y.create.l HWIO_MSS_QDSP6SS_RSCC_RSC_SEQ_CFG_BR_ADDR_3_DRV0_ADDR A:0x413041c
y.create.l HWIO_MSS_QDSP6SS_RSCC_RSC_SEQ_CFG_DELAY_VAL_0_DRV0_ADDR A:0x4130450
y.create.l HWIO_MSS_QDSP6SS_RSCC_RSC_SEQ_CFG_DELAY_VAL_1_DRV0_ADDR A:0x4130454
y.create.l HWIO_MSS_QDSP6SS_RSCC_RSC_SEQ_CFG_DELAY_VAL_2_DRV0_ADDR A:0x4130458
y.create.l HWIO_MSS_QDSP6SS_RSCC_RSC_SEQ_CFG_DELAY_VAL_3_DRV0_ADDR A:0x413045c
y.create.l HWIO_MSS_QDSP6SS_RSCC_RSC_SEQ_OVERRIDE_TRIGGER_DRV0_ADDR A:0x4130460
y.create.l HWIO_MSS_QDSP6SS_RSCC_RSC_SEQ_OVERRIDE_TRIGGER_START_ADDRESS_DRV0_ADDR A:0x4130464
y.create.l HWIO_MSS_QDSP6SS_RSCC_RSC_SEQ_DBG_BREAKPOINT_ADDR_DRV0_ADDR A:0x4130490
y.create.l HWIO_MSS_QDSP6SS_RSCC_RSC_SEQ_DBG_STEP_DRV0_ADDR A:0x4130494
y.create.l HWIO_MSS_QDSP6SS_RSCC_RSC_SEQ_DBG_CONTINUE_DRV0_ADDR A:0x4130498
y.create.l HWIO_MSS_QDSP6SS_RSCC_RSC_SEQ_DBG_STAT_DRV0_ADDR A:0x413049c
y.create.l HWIO_MSS_QDSP6SS_RSCC_RSC_SEQ_OVERRIDE_PWR_CNTRL_MASK_DRV0_ADDR A:0x41304a0
y.create.l HWIO_MSS_QDSP6SS_RSCC_RSC_SEQ_OVERRIDE_PWR_CNTRL_VAL_DRV0_ADDR A:0x41304a4
y.create.l HWIO_MSS_QDSP6SS_RSCC_RSC_SEQ_OVERRIDE_WAIT_EVENT_MASK_DRV0_ADDR A:0x41304a8
y.create.l HWIO_MSS_QDSP6SS_RSCC_RSC_SEQ_OVERRIDE_WAIT_EVENT_VAL_DRV0_ADDR A:0x41304ac
y.create.l HWIO_MSS_QDSP6SS_RSCC_SEQ_MEM_0_DRV0_ADDR A:0x4130600
y.create.l HWIO_MSS_QDSP6SS_RSCC_SEQ_MEM_1_DRV0_ADDR A:0x4130604
y.create.l HWIO_MSS_QDSP6SS_RSCC_SEQ_MEM_2_DRV0_ADDR A:0x4130608
y.create.l HWIO_MSS_QDSP6SS_RSCC_SEQ_MEM_3_DRV0_ADDR A:0x413060c
y.create.l HWIO_MSS_QDSP6SS_RSCC_SEQ_MEM_4_DRV0_ADDR A:0x4130610
y.create.l HWIO_MSS_QDSP6SS_RSCC_SEQ_MEM_5_DRV0_ADDR A:0x4130614
y.create.l HWIO_MSS_QDSP6SS_RSCC_SEQ_MEM_6_DRV0_ADDR A:0x4130618
y.create.l HWIO_MSS_QDSP6SS_RSCC_SEQ_MEM_7_DRV0_ADDR A:0x413061c
y.create.l HWIO_MSS_QDSP6SS_RSCC_SEQ_MEM_8_DRV0_ADDR A:0x4130620
y.create.l HWIO_MSS_QDSP6SS_RSCC_SEQ_MEM_9_DRV0_ADDR A:0x4130624
y.create.l HWIO_MSS_PERPH_REG_BASE_START_ADDR A:0x4180000
y.create.l HWIO_MSS_PERPH_REG_BASE_LAST_ADDR A:0x418f000
y.create.l HWIO_MSS_PERPH_REG_BASE_END_ADDR A:0x418f020
y.create.l HWIO_MSS_ENABLE_ADDR A:0x4180000
y.create.l HWIO_MSS_CLAMP_MEM_ADDR A:0x4180004
y.create.l HWIO_MSS_CLAMP_IO_ADDR A:0x4180008
y.create.l HWIO_MSS_BUS_AHB2AHB_CFG_ADDR A:0x418000c
y.create.l HWIO_MSS_BUS_MAXI2AXI_CFG_ADDR A:0x4180010
y.create.l HWIO_MSS_CUSTOM_MEM_ARRSTBYN_ADDR A:0x4180014
y.create.l HWIO_MSS_ANALOG_IP_TEST_CTL_ADDR A:0x4180018
y.create.l HWIO_MSS_ATB_ID_ADDR A:0x418001c
y.create.l HWIO_MSS_DBG_BUS_CTL_ADDR A:0x4180020
y.create.l HWIO_MSS_AHB_ACCESS_ERR_IRQ_EN_ADDR A:0x4180024
y.create.l HWIO_MSS_AHB_ACCESS_ERR_IRQ_STATUS_ADDR A:0x4180028
y.create.l HWIO_MSS_AHB_ACCESS_ERR_IRQ_CLR_ADDR A:0x418002c
y.create.l HWIO_MSS_BUS_CTL_CFG_ADDR A:0x4180030
y.create.l HWIO_MSS_MSA_ADDR A:0x4180058
y.create.l HWIO_MSS_HW_VERSION_ADDR A:0x418005c
y.create.l HWIO_MSS_MODEM_MEM_SLP_CNTL_ADDR A:0x4180060
y.create.l HWIO_MSS_CLOCK_SPDM_MON_ADDR A:0x4180064
y.create.l HWIO_MSS_DEBUG_CLOCK_CTL_ADDR A:0x4180078
y.create.l HWIO_MSS_BBRX_EXT_CLOCK_MUX_SEL_ADDR A:0x418007c
y.create.l HWIO_MSS_BBRX_CTL_ADDR A:0x4180094
y.create.l HWIO_MSS_DEBUG_CTL_ADDR A:0x4180098
y.create.l HWIO_MSS_POWER_ADDR A:0x418009c
y.create.l HWIO_MSS_MSA_NC_HM_ADDR A:0x41800a0
y.create.l HWIO_MSS_CXM_ADDR A:0x41800a4
y.create.l HWIO_MSS_RELAY_MSG_SHADOW_00_ADDR A:0x4180400
y.create.l HWIO_MSS_RELAY_MSG_SHADOW_01_ADDR A:0x4180404
y.create.l HWIO_MSS_RELAY_MSG_SHADOW_02_ADDR A:0x4180408
y.create.l HWIO_MSS_RELAY_MSG_SHADOW_03_ADDR A:0x418040c
y.create.l HWIO_MSS_RELAY_MSG_SHADOW_04_ADDR A:0x4180410
y.create.l HWIO_MSS_RELAY_MSG_SHADOW_05_ADDR A:0x4180414
y.create.l HWIO_MSS_RELAY_MSG_SHADOW_06_ADDR A:0x4180418
y.create.l HWIO_MSS_RELAY_MSG_SHADOW_07_ADDR A:0x418041c
y.create.l HWIO_MSS_RELAY_MSG_SHADOW_08_ADDR A:0x4180420
y.create.l HWIO_MSS_RELAY_MSG_SHADOW_09_ADDR A:0x4180424
y.create.l HWIO_MSS_RELAY_MSG_SHADOW_10_ADDR A:0x4180428
y.create.l HWIO_MSS_RELAY_MSG_SHADOW_11_ADDR A:0x418042c
y.create.l HWIO_MSS_RELAY_MSG_SHADOW_12_ADDR A:0x4180430
y.create.l HWIO_MSS_RELAY_MSG_SHADOW_13_ADDR A:0x4180434
y.create.l HWIO_MSS_RELAY_MSG_SHADOW_14_ADDR A:0x4180438
y.create.l HWIO_MSS_RELAY_MSG_SHADOW_15_ADDR A:0x418043c
y.create.l HWIO_MSS_MPLL1_MODE_ADDR A:0x4181020
y.create.l HWIO_MSS_MPLL1_L_VAL_ADDR A:0x4181024
y.create.l HWIO_MSS_MPLL1_M_VAL_ADDR A:0x4181028
y.create.l HWIO_MSS_MPLL1_N_VAL_ADDR A:0x418102c
y.create.l HWIO_MSS_MPLL1_USER_CTL_ADDR A:0x4181030
y.create.l HWIO_MSS_MPLL1_CONFIG_CTL_ADDR A:0x4181034
y.create.l HWIO_MSS_MPLL1_TEST_CTL_ADDR A:0x4181038
y.create.l HWIO_MSS_MPLL1_STATUS_ADDR A:0x418103c
y.create.l HWIO_MSS_UIM0_BCR_ADDR A:0x4181060
y.create.l HWIO_MSS_Q6SS_BCR_ADDR A:0x4181068
y.create.l HWIO_MSS_NAV_CE_BRIDGE_BCR_ADDR A:0x418106c
y.create.l HWIO_MSS_NAV_BCR_ADDR A:0x4181074
y.create.l HWIO_MSS_UIM0_CBCR_ADDR A:0x4181078
y.create.l HWIO_MSS_XO_UIM0_CBCR_ADDR A:0x4181080
y.create.l HWIO_MSS_XO_MODEM_CBCR_ADDR A:0x4181088
y.create.l HWIO_MSS_BUS_UIM0_CBCR_ADDR A:0x4181090
y.create.l HWIO_MSS_BUS_CSR_CBCR_ADDR A:0x4181098
y.create.l HWIO_MSS_BUS_BRIDGE_CBCR_ADDR A:0x418109c
y.create.l HWIO_MSS_BUS_MODEM_CBCR_ADDR A:0x41810a0
y.create.l HWIO_MSS_BUS_Q6_CBCR_ADDR A:0x41810a4
y.create.l HWIO_MSS_BUS_NAV_CE_BRIDGE_CBCR_ADDR A:0x41810a8
y.create.l HWIO_MSS_BUS_CRYPTO_CBCR_ADDR A:0x41810ac
y.create.l HWIO_MSS_BUS_NAV_CBCR_ADDR A:0x41810b0
y.create.l HWIO_MSS_BUS_NC_HM_BRIDGE_CX_CBCR_ADDR A:0x41810b4
y.create.l HWIO_MSS_BUS_ATB_CBCR_ADDR A:0x41810b8
y.create.l HWIO_MSS_BUS_MODEM_BRIDGE_CX_CBCR_ADDR A:0x41810c0
y.create.l HWIO_MSS_BUS_SLAVE_TIMEOUT_CBCR_ADDR A:0x41810c4
y.create.l HWIO_MSS_BUS_COMBODAC_COMP_CBCR_ADDR A:0x41810cc
y.create.l HWIO_MSS_MODEM_CFG_AHB_CBCR_ADDR A:0x41810d4
y.create.l HWIO_MSS_MODEM_SNOC_AXI_CBCR_ADDR A:0x41810d8
y.create.l HWIO_MSS_NAV_SNOC_AXI_CBCR_ADDR A:0x41810dc
y.create.l HWIO_MSS_MPLL2_MAIN_BUS_CBCR_ADDR A:0x41810e0
y.create.l HWIO_MSS_RFC_CMD_RCGR_ADDR A:0x41810e4
y.create.l HWIO_MSS_RFC_CFG_RCGR_ADDR A:0x41810e8
y.create.l HWIO_MSS_MPLL1_EARLY_BUS_CBCR_ADDR A:0x41810ec
y.create.l HWIO_MSS_MODEM_AXI_CMD_RCGR_ADDR A:0x41810f0
y.create.l HWIO_MSS_MODEM_AXI_CFG_RCGR_ADDR A:0x41810f4
y.create.l HWIO_MSS_RFFE_CFG_RCGR_ADDR A:0x41810f8
y.create.l HWIO_MSS_BUS_CMD_RCGR_ADDR A:0x4181108
y.create.l HWIO_MSS_BUS_CFG_RCGR_ADDR A:0x418110c
y.create.l HWIO_MSS_Q6_CMD_RCGR_ADDR A:0x4181110
y.create.l HWIO_MSS_Q6_CFG_RCGR_ADDR A:0x4181114
y.create.l HWIO_MSS_UIM_CMD_RCGR_ADDR A:0x4181118
y.create.l HWIO_MSS_UIM_CFG_RCGR_ADDR A:0x418111c
y.create.l HWIO_MSS_BIMC_THROTTLE_ADDR A:0x4181130
y.create.l HWIO_MSS_RESERVE_02_ADDR A:0x4181134
y.create.l HWIO_MSS_UIM0_MND_CMD_RCGR_ADDR A:0x4181150
y.create.l HWIO_MSS_UIM0_MND_CFG_RCGR_ADDR A:0x4181154
y.create.l HWIO_MSS_UIM0_MND_M_ADDR A:0x4181158
y.create.l HWIO_MSS_UIM0_MND_N_ADDR A:0x418115c
y.create.l HWIO_MSS_UIM0_MND_D_ADDR A:0x4181160
y.create.l HWIO_MSS_BUS_MGPI_CBCR_ADDR A:0x418119c
y.create.l HWIO_MSS_MGPI_BCR_ADDR A:0x41811a0
y.create.l HWIO_MSS_TDEC_CMD_RCGR_ADDR A:0x41811bc
y.create.l HWIO_MSS_TDEC_CFG_RCGR_ADDR A:0x41811c0
y.create.l HWIO_MSS_ADC_BCR_ADDR A:0x41811c4
y.create.l HWIO_MSS_ADC_CBCR_ADDR A:0x41811c8
y.create.l HWIO_MSS_L1S_NAV_MEM_CMD_RCGR_ADDR A:0x41811cc
y.create.l HWIO_MSS_L1S_NAV_MEM_CFG_RCGR_ADDR A:0x41811d0
y.create.l HWIO_MSS_SILVER_BCR_ADDR A:0x41811d4
y.create.l HWIO_MSS_SILVER_CBCR_ADDR A:0x41811d8
y.create.l HWIO_MSS_NAV_DBE_BCR_ADDR A:0x41811dc
y.create.l HWIO_MSS_NAV_DBE_CBCR_ADDR A:0x41811e0
y.create.l HWIO_MSS_SHARED_MEM_BCR_ADDR A:0x41811e4
y.create.l HWIO_MSS_SHARED_MEM_CBCR_ADDR A:0x41811e8
y.create.l HWIO_MODEM_NAV_MODE_SEL_ADDR A:0x41811ec
y.create.l HWIO_MSS_SILVER_CLK_HW_CTRL_ADDR A:0x41811f0
y.create.l HWIO_MSS_DAC_CLK_CFG_ADDR A:0x41811f4
y.create.l HWIO_MSS_CLK_XO_GATE_CFG_ADDR A:0x41811f8
y.create.l HWIO_MSS_FAST_CHARGE_PULSE_CTRL_ADDR A:0x41811fc
y.create.l HWIO_MSS_DACC_FAST_CHARGE_PULSE_GEN_ADDR A:0x4181200
y.create.l HWIO_MSS_TXAGC_FAST_CHARGE_PULSE_GEN_ADDR A:0x4181204
y.create.l HWIO_MSS_MODEM_AXI_BCR_ADDR A:0x4181208
y.create.l HWIO_MSS_MODEM_AXI_CBCR_ADDR A:0x418120c
y.create.l HWIO_MSS_NAV_AXI_CBCR_ADDR A:0x4181210
y.create.l HWIO_MSS_BIT_COXM_MND_CMD_RCGR_ADDR A:0x4181214
y.create.l HWIO_MSS_BIT_COXM_MND_CFG_RCGR_ADDR A:0x4181218
y.create.l HWIO_MSS_BIT_COXM_MND_M_ADDR A:0x418121c
y.create.l HWIO_MSS_BIT_COXM_MND_N_ADDR A:0x4181220
y.create.l HWIO_MSS_BIT_COXM_MND_D_ADDR A:0x4181224
y.create.l HWIO_MSS_ALT_RESET_Q6SS_ADDR A:0x4181228
y.create.l HWIO_MSS_BIT_COXM_CBCR_ADDR A:0x418122c
y.create.l HWIO_MSS_BUS_COXM_CBCR_ADDR A:0x4181230
y.create.l HWIO_MSS_COXM_BCR_ADDR A:0x4181234
y.create.l HWIO_MSS_RFFE_BCR_ADDR A:0x4181240
y.create.l HWIO_MSS_TWO_XO_RFFE_CBCR_ADDR A:0x4181244
y.create.l HWIO_MSS_ONE_XO_RFFE_CBCR_ADDR A:0x4181248
y.create.l HWIO_MSS_HALF_XO_RFFE_CBCR_ADDR A:0x418124c
y.create.l HWIO_MSS_ADC_CMD_RCGR_ADDR A:0x4181250
y.create.l HWIO_MSS_ADC_CFG_RCGR_ADDR A:0x4181254
y.create.l HWIO_MSS_TCSR_ACC_SEL_ADDR A:0x418f000
y.create.l HWIO_MSS_UIM0_UART_DM_REG_BASE_START_ADDR A:0x4190000
y.create.l HWIO_MSS_UIM0_UART_DM_REG_BASE_LAST_ADDR A:0x41901a0
y.create.l HWIO_MSS_UIM0_UART_DM_REG_BASE_END_ADDR A:0x41901c0
y.create.l HWIO_MSS_UIM0_UART_DM_MR1_ADDR A:0x4190000
y.create.l HWIO_MSS_UIM0_UART_DM_MR2_ADDR A:0x4190004
y.create.l HWIO_MSS_UIM0_UART_DM_CSR_SR_DEPRECATED_ADDR A:0x4190008
y.create.l HWIO_MSS_UIM0_UART_DM_CR_MISR_DEPRECATED_ADDR A:0x4190010
y.create.l HWIO_MSS_UIM0_UART_DM_IMR_ISR_DEPRECATED_ADDR A:0x4190014
y.create.l HWIO_MSS_UIM0_UART_DM_IPR_ADDR A:0x4190018
y.create.l HWIO_MSS_UIM0_UART_DM_TFWR_ADDR A:0x419001c
y.create.l HWIO_MSS_UIM0_UART_DM_RFWR_ADDR A:0x4190020
y.create.l HWIO_MSS_UIM0_UART_DM_HCR_ADDR A:0x4190024
y.create.l HWIO_MSS_UIM0_UART_DM_DMRX_ADDR A:0x4190034
y.create.l HWIO_MSS_UIM0_UART_DM_IRDA_RX_TOTAL_SNAP_DEPRECATED_ADDR A:0x4190038
y.create.l HWIO_MSS_UIM0_UART_DM_DMEN_ADDR A:0x419003c
y.create.l HWIO_MSS_UIM0_UART_DM_NO_CHARS_FOR_TX_ADDR A:0x4190040
y.create.l HWIO_MSS_UIM0_UART_DM_BADR_ADDR A:0x4190044
y.create.l HWIO_MSS_UIM0_UART_DM_TESTSL_ADDR A:0x4190048
y.create.l HWIO_MSS_UIM0_UART_DM_TXFS_ADDR A:0x419004c
y.create.l HWIO_MSS_UIM0_UART_DM_RXFS_ADDR A:0x4190050
y.create.l HWIO_MSS_UIM0_UART_DM_MISR_MODE_ADDR A:0x4190060
y.create.l HWIO_MSS_UIM0_UART_DM_MISR_RESET_ADDR A:0x4190064
y.create.l HWIO_MSS_UIM0_UART_DM_MISR_EXPORT_ADDR A:0x4190068
y.create.l HWIO_MSS_UIM0_UART_DM_MISR_VAL_ADDR A:0x419006c
y.create.l HWIO_MSS_UIM0_UART_DM_TF_RF_DEPRECATED_ADDR A:0x4190070
y.create.l HWIO_MSS_UIM0_UART_DM_TF_RF_2_DEPRECATED_ADDR A:0x4190074
y.create.l HWIO_MSS_UIM0_UART_DM_TF_RF_3_DEPRECATED_ADDR A:0x4190078
y.create.l HWIO_MSS_UIM0_UART_DM_TF_RF_4_DEPRECATED_ADDR A:0x419007c
y.create.l HWIO_MSS_UIM0_UART_DM_SIM_CFG_ADDR A:0x4190080
y.create.l HWIO_MSS_UIM0_UART_DM_TEST_WR_ADDR_ADDR A:0x4190084
y.create.l HWIO_MSS_UIM0_UART_DM_TEST_WR_DATA_ADDR A:0x4190088
y.create.l HWIO_MSS_UIM0_UART_DM_TEST_RD_ADDR_ADDR A:0x419008c
y.create.l HWIO_MSS_UIM0_UART_DM_TEST_RD_DATA_ADDR A:0x4190090
y.create.l HWIO_MSS_UIM0_UART_DM_CSR_ADDR A:0x41900a0
y.create.l HWIO_MSS_UIM0_UART_DM_SR_ADDR A:0x41900a4
y.create.l HWIO_MSS_UIM0_UART_DM_CR_ADDR A:0x41900a8
y.create.l HWIO_MSS_UIM0_UART_DM_MISR_ADDR A:0x41900ac
y.create.l HWIO_MSS_UIM0_UART_DM_IMR_ADDR A:0x41900b0
y.create.l HWIO_MSS_UIM0_UART_DM_ISR_ADDR A:0x41900b4
y.create.l HWIO_MSS_UIM0_UART_DM_IRDA_ADDR A:0x41900b8
y.create.l HWIO_MSS_UIM0_UART_DM_RX_TOTAL_SNAP_ADDR A:0x41900bc
y.create.l HWIO_MSS_UIM0_UART_DM_WWT_TIMEOUT_ADDR A:0x41900c0
y.create.l HWIO_MSS_UIM0_UART_DM_CLK_CTRL_ADDR A:0x41900c4
y.create.l HWIO_MSS_UIM0_UART_DM_BCR_ADDR A:0x41900c8
y.create.l HWIO_MSS_UIM0_UART_DM_RX_TRANS_CTRL_ADDR A:0x41900cc
y.create.l HWIO_MSS_UIM0_UART_DM_DMRX_DBG_ADDR A:0x41900d0
y.create.l HWIO_MSS_UIM0_UART_DM_FSM_STATUS_ADDR A:0x41900d4
y.create.l HWIO_MSS_UIM0_UART_DM_HW_VERSION_ADDR A:0x41900d8
y.create.l HWIO_MSS_UIM0_UART_DM_GENERICS_ADDR A:0x41900dc
y.create.l HWIO_MSS_UIM0_UART_DM_ISR_CLR_ADDR A:0x41900e0
y.create.l HWIO_MSS_UIM0_UART_DM_TF_ADDR A:0x4190100
y.create.l HWIO_MSS_UIM0_UART_DM_TF_2_ADDR A:0x4190104
y.create.l HWIO_MSS_UIM0_UART_DM_TF_3_ADDR A:0x4190108
y.create.l HWIO_MSS_UIM0_UART_DM_TF_4_ADDR A:0x419010c
y.create.l HWIO_MSS_UIM0_UART_DM_TF_5_ADDR A:0x4190110
y.create.l HWIO_MSS_UIM0_UART_DM_TF_6_ADDR A:0x4190114
y.create.l HWIO_MSS_UIM0_UART_DM_TF_7_ADDR A:0x4190118
y.create.l HWIO_MSS_UIM0_UART_DM_TF_8_ADDR A:0x419011c
y.create.l HWIO_MSS_UIM0_UART_DM_TF_9_ADDR A:0x4190120
y.create.l HWIO_MSS_UIM0_UART_DM_TF_10_ADDR A:0x4190124
y.create.l HWIO_MSS_UIM0_UART_DM_TF_11_ADDR A:0x4190128
y.create.l HWIO_MSS_UIM0_UART_DM_TF_12_ADDR A:0x419012c
y.create.l HWIO_MSS_UIM0_UART_DM_TF_13_ADDR A:0x4190130
y.create.l HWIO_MSS_UIM0_UART_DM_TF_14_ADDR A:0x4190134
y.create.l HWIO_MSS_UIM0_UART_DM_TF_15_ADDR A:0x4190138
y.create.l HWIO_MSS_UIM0_UART_DM_TF_16_ADDR A:0x419013c
y.create.l HWIO_MSS_UIM0_UART_DM_RF_ADDR A:0x4190140
y.create.l HWIO_MSS_UIM0_UART_DM_RF_2_ADDR A:0x4190144
y.create.l HWIO_MSS_UIM0_UART_DM_RF_3_ADDR A:0x4190148
y.create.l HWIO_MSS_UIM0_UART_DM_RF_4_ADDR A:0x419014c
y.create.l HWIO_MSS_UIM0_UART_DM_RF_5_ADDR A:0x4190150
y.create.l HWIO_MSS_UIM0_UART_DM_RF_6_ADDR A:0x4190154
y.create.l HWIO_MSS_UIM0_UART_DM_RF_7_ADDR A:0x4190158
y.create.l HWIO_MSS_UIM0_UART_DM_RF_8_ADDR A:0x419015c
y.create.l HWIO_MSS_UIM0_UART_DM_RF_9_ADDR A:0x4190160
y.create.l HWIO_MSS_UIM0_UART_DM_RF_10_ADDR A:0x4190164
y.create.l HWIO_MSS_UIM0_UART_DM_RF_11_ADDR A:0x4190168
y.create.l HWIO_MSS_UIM0_UART_DM_RF_12_ADDR A:0x419016c
y.create.l HWIO_MSS_UIM0_UART_DM_RF_13_ADDR A:0x4190170
y.create.l HWIO_MSS_UIM0_UART_DM_RF_14_ADDR A:0x4190174
y.create.l HWIO_MSS_UIM0_UART_DM_RF_15_ADDR A:0x4190178
y.create.l HWIO_MSS_UIM0_UART_DM_RF_16_ADDR A:0x419017c
y.create.l HWIO_MSS_UIM0_UART_DM_UIM_CFG_ADDR A:0x4190180
y.create.l HWIO_MSS_UIM0_UART_DM_UIM_CMD_ADDR A:0x4190184
y.create.l HWIO_MSS_UIM0_UART_DM_UIM_IO_STATUS_ADDR A:0x4190188
y.create.l HWIO_MSS_UIM0_UART_DM_UIM_IRQ_ISR_ADDR A:0x419018c
y.create.l HWIO_MSS_UIM0_UART_DM_UIM_IRQ_MISR_ADDR A:0x4190190
y.create.l HWIO_MSS_UIM0_UART_DM_UIM_IRQ_CLR_ADDR A:0x4190194
y.create.l HWIO_MSS_UIM0_UART_DM_UIM_IRQ_IMR_ADDR A:0x4190198
y.create.l HWIO_MSS_UIM0_UART_DM_UIM_IRQ_IMR_SET_ADDR A:0x419019c
y.create.l HWIO_MSS_UIM0_UART_DM_UIM_IRQ_IMR_CLR_ADDR A:0x41901a0
y.create.l HWIO_MSS_CXM_UART_DM_REG_BASE_START_ADDR A:0x41a0000
y.create.l HWIO_MSS_CXM_UART_DM_REG_BASE_LAST_ADDR A:0x41a01e4
y.create.l HWIO_MSS_CXM_UART_DM_REG_BASE_END_ADDR A:0x41a0200
y.create.l HWIO_MSS_CXM_UART_DM_MR1_ADDR A:0x41a0000
y.create.l HWIO_MSS_CXM_UART_DM_MR2_ADDR A:0x41a0004
y.create.l HWIO_MSS_CXM_UART_DM_CSR_SR_DEPRECATED_ADDR A:0x41a0008
y.create.l HWIO_MSS_CXM_UART_DM_CR_MISR_DEPRECATED_ADDR A:0x41a0010
y.create.l HWIO_MSS_CXM_UART_DM_IMR_ISR_DEPRECATED_ADDR A:0x41a0014
y.create.l HWIO_MSS_CXM_UART_DM_IPR_ADDR A:0x41a0018
y.create.l HWIO_MSS_CXM_UART_DM_TFWR_ADDR A:0x41a001c
y.create.l HWIO_MSS_CXM_UART_DM_RFWR_ADDR A:0x41a0020
y.create.l HWIO_MSS_CXM_UART_DM_HCR_ADDR A:0x41a0024
y.create.l HWIO_MSS_CXM_UART_DM_DMRX_ADDR A:0x41a0034
y.create.l HWIO_MSS_CXM_UART_DM_IRDA_RX_TOTAL_SNAP_DEPRECATED_ADDR A:0x41a0038
y.create.l HWIO_MSS_CXM_UART_DM_DMEN_ADDR A:0x41a003c
y.create.l HWIO_MSS_CXM_UART_DM_NO_CHARS_FOR_TX_ADDR A:0x41a0040
y.create.l HWIO_MSS_CXM_UART_DM_BADR_ADDR A:0x41a0044
y.create.l HWIO_MSS_CXM_UART_DM_TESTSL_ADDR A:0x41a0048
y.create.l HWIO_MSS_CXM_UART_DM_TXFS_ADDR A:0x41a004c
y.create.l HWIO_MSS_CXM_UART_DM_RXFS_ADDR A:0x41a0050
y.create.l HWIO_MSS_CXM_UART_DM_MISR_MODE_ADDR A:0x41a0060
y.create.l HWIO_MSS_CXM_UART_DM_MISR_RESET_ADDR A:0x41a0064
y.create.l HWIO_MSS_CXM_UART_DM_MISR_EXPORT_ADDR A:0x41a0068
y.create.l HWIO_MSS_CXM_UART_DM_MISR_VAL_ADDR A:0x41a006c
y.create.l HWIO_MSS_CXM_UART_DM_TF_RF_DEPRECATED_ADDR A:0x41a0070
y.create.l HWIO_MSS_CXM_UART_DM_TF_RF_2_DEPRECATED_ADDR A:0x41a0074
y.create.l HWIO_MSS_CXM_UART_DM_TF_RF_3_DEPRECATED_ADDR A:0x41a0078
y.create.l HWIO_MSS_CXM_UART_DM_TF_RF_4_DEPRECATED_ADDR A:0x41a007c
y.create.l HWIO_MSS_CXM_UART_DM_SIM_CFG_ADDR A:0x41a0080
y.create.l HWIO_MSS_CXM_UART_DM_TEST_WR_ADDR_ADDR A:0x41a0084
y.create.l HWIO_MSS_CXM_UART_DM_TEST_WR_DATA_ADDR A:0x41a0088
y.create.l HWIO_MSS_CXM_UART_DM_TEST_RD_ADDR_ADDR A:0x41a008c
y.create.l HWIO_MSS_CXM_UART_DM_TEST_RD_DATA_ADDR A:0x41a0090
y.create.l HWIO_MSS_CXM_UART_DM_CSR_ADDR A:0x41a00a0
y.create.l HWIO_MSS_CXM_UART_DM_SR_ADDR A:0x41a00a4
y.create.l HWIO_MSS_CXM_UART_DM_CR_ADDR A:0x41a00a8
y.create.l HWIO_MSS_CXM_UART_DM_MISR_ADDR A:0x41a00ac
y.create.l HWIO_MSS_CXM_UART_DM_IMR_ADDR A:0x41a00b0
y.create.l HWIO_MSS_CXM_UART_DM_ISR_ADDR A:0x41a00b4
y.create.l HWIO_MSS_CXM_UART_DM_IRDA_ADDR A:0x41a00b8
y.create.l HWIO_MSS_CXM_UART_DM_RX_TOTAL_SNAP_ADDR A:0x41a00bc
y.create.l HWIO_MSS_CXM_UART_DM_WWT_TIMEOUT_ADDR A:0x41a00c0
y.create.l HWIO_MSS_CXM_UART_DM_CLK_CTRL_ADDR A:0x41a00c4
y.create.l HWIO_MSS_CXM_UART_DM_BCR_ADDR A:0x41a00c8
y.create.l HWIO_MSS_CXM_UART_DM_RX_TRANS_CTRL_ADDR A:0x41a00cc
y.create.l HWIO_MSS_CXM_UART_DM_DMRX_DBG_ADDR A:0x41a00d0
y.create.l HWIO_MSS_CXM_UART_DM_FSM_STATUS_ADDR A:0x41a00d4
y.create.l HWIO_MSS_CXM_UART_DM_HW_VERSION_ADDR A:0x41a00d8
y.create.l HWIO_MSS_CXM_UART_DM_GENERICS_ADDR A:0x41a00dc
y.create.l HWIO_MSS_CXM_UART_DM_TF_ADDR A:0x41a0100
y.create.l HWIO_MSS_CXM_UART_DM_TF_2_ADDR A:0x41a0104
y.create.l HWIO_MSS_CXM_UART_DM_TF_3_ADDR A:0x41a0108
y.create.l HWIO_MSS_CXM_UART_DM_TF_4_ADDR A:0x41a010c
y.create.l HWIO_MSS_CXM_UART_DM_TF_5_ADDR A:0x41a0110
y.create.l HWIO_MSS_CXM_UART_DM_TF_6_ADDR A:0x41a0114
y.create.l HWIO_MSS_CXM_UART_DM_TF_7_ADDR A:0x41a0118
y.create.l HWIO_MSS_CXM_UART_DM_TF_8_ADDR A:0x41a011c
y.create.l HWIO_MSS_CXM_UART_DM_TF_9_ADDR A:0x41a0120
y.create.l HWIO_MSS_CXM_UART_DM_TF_10_ADDR A:0x41a0124
y.create.l HWIO_MSS_CXM_UART_DM_TF_11_ADDR A:0x41a0128
y.create.l HWIO_MSS_CXM_UART_DM_TF_12_ADDR A:0x41a012c
y.create.l HWIO_MSS_CXM_UART_DM_TF_13_ADDR A:0x41a0130
y.create.l HWIO_MSS_CXM_UART_DM_TF_14_ADDR A:0x41a0134
y.create.l HWIO_MSS_CXM_UART_DM_TF_15_ADDR A:0x41a0138
y.create.l HWIO_MSS_CXM_UART_DM_TF_16_ADDR A:0x41a013c
y.create.l HWIO_MSS_CXM_UART_DM_RF_ADDR A:0x41a0140
y.create.l HWIO_MSS_CXM_UART_DM_RF_2_ADDR A:0x41a0144
y.create.l HWIO_MSS_CXM_UART_DM_RF_3_ADDR A:0x41a0148
y.create.l HWIO_MSS_CXM_UART_DM_RF_4_ADDR A:0x41a014c
y.create.l HWIO_MSS_CXM_UART_DM_RF_5_ADDR A:0x41a0150
y.create.l HWIO_MSS_CXM_UART_DM_RF_6_ADDR A:0x41a0154
y.create.l HWIO_MSS_CXM_UART_DM_RF_7_ADDR A:0x41a0158
y.create.l HWIO_MSS_CXM_UART_DM_RF_8_ADDR A:0x41a015c
y.create.l HWIO_MSS_CXM_UART_DM_RF_9_ADDR A:0x41a0160
y.create.l HWIO_MSS_CXM_UART_DM_RF_10_ADDR A:0x41a0164
y.create.l HWIO_MSS_CXM_UART_DM_RF_11_ADDR A:0x41a0168
y.create.l HWIO_MSS_CXM_UART_DM_RF_12_ADDR A:0x41a016c
y.create.l HWIO_MSS_CXM_UART_DM_RF_13_ADDR A:0x41a0170
y.create.l HWIO_MSS_CXM_UART_DM_RF_14_ADDR A:0x41a0174
y.create.l HWIO_MSS_CXM_UART_DM_RF_15_ADDR A:0x41a0178
y.create.l HWIO_MSS_CXM_UART_DM_RF_16_ADDR A:0x41a017c
y.create.l HWIO_MSS_CXM_UART_DM_UIM_CFG_ADDR A:0x41a0180
y.create.l HWIO_MSS_CXM_UART_DM_UIM_CMD_ADDR A:0x41a0184
y.create.l HWIO_MSS_CXM_UART_DM_UIM_IO_STATUS_ADDR A:0x41a0188
y.create.l HWIO_MSS_CXM_UART_DM_UIM_IRQ_ISR_ADDR A:0x41a018c
y.create.l HWIO_MSS_CXM_UART_DM_UIM_IRQ_MISR_ADDR A:0x41a0190
y.create.l HWIO_MSS_CXM_UART_DM_UIM_IRQ_CLR_ADDR A:0x41a0194
y.create.l HWIO_MSS_CXM_UART_DM_UIM_IRQ_IMR_ADDR A:0x41a0198
y.create.l HWIO_MSS_CXM_UART_DM_UIM_IRQ_IMR_SET_ADDR A:0x41a019c
y.create.l HWIO_MSS_CXM_UART_DM_UIM_IRQ_IMR_CLR_ADDR A:0x41a01a0
y.create.l HWIO_MSS_CXM_CONFIG_ADDR A:0x41a01a4
y.create.l HWIO_MSS_CXM_TX_CONFIG_ADDR A:0x41a01a8
y.create.l HWIO_MSS_CXM_RX_STAT_ADDR A:0x41a01ac
y.create.l HWIO_MSS_CXM_DBG_STAT_ADDR A:0x41a01b0
y.create.l HWIO_MSS_CXM_DIR_UART_TR_ADDR A:0x41a01b4
y.create.l HWIO_MSS_CXM_TYP0_RESP_TOUT_DUR_ADDR A:0x41a01b8
y.create.l HWIO_MSS_CXM_TYP0_RESP_STAT_ADDR A:0x41a01bc
y.create.l HWIO_MSS_CXM_WCN_PRIORITY_REG_STAT_ADDR A:0x41a01c0
y.create.l HWIO_MSS_CXM_RX_WCI2_MSG_TYPE0_CONTENT_ADDR A:0x41a01c4
y.create.l HWIO_MSS_CXM_RX_WCI2_MSG_TYPE1_CONTENT_ADDR A:0x41a01c8
y.create.l HWIO_MSS_CXM_RX_WCI2_MSG_TYPE2_CONTENT_ADDR A:0x41a01cc
y.create.l HWIO_MSS_CXM_RX_WCI2_MSG_TYPE3_CONTENT_ADDR A:0x41a01d0
y.create.l HWIO_MSS_CXM_RX_WCI2_MSG_TYPE4_CONTENT_ADDR A:0x41a01d4
y.create.l HWIO_MSS_CXM_RX_WCI2_MSG_TYPE5_CONTENT_ADDR A:0x41a01d8
y.create.l HWIO_MSS_CXM_RX_WCI2_MSG_TYPE6_CONTENT_ADDR A:0x41a01dc
y.create.l HWIO_MSS_CXM_RX_WCI2_MSG_TYPE7_CONTENT_ADDR A:0x41a01e0
y.create.l HWIO_MSS_CXM_SPARE_BITS_ADDR A:0x41a01e4
y.create.l HWIO_MSS_CM_MANTICORE_ADC_REG_BASE_START_ADDR A:0x41a1000
y.create.l HWIO_MSS_CM_MANTICORE_ADC_REG_BASE_LAST_ADDR A:0x41a1064
y.create.l HWIO_MSS_CM_MANTICORE_ADC_REG_BASE_END_ADDR A:0x41a1100
y.create.l HWIO_MSS_ATOP_REG1_ADDR A:0x41a1000
y.create.l HWIO_MSS_ATOP_REG2_ADDR A:0x41a1004
y.create.l HWIO_MSS_ATOP_REG3_ADDR A:0x41a1008
y.create.l HWIO_MSS_ATOP_REG4_ADDR A:0x41a100c
y.create.l HWIO_MSS_DOUBLER_ADDR A:0x41a1010
y.create.l HWIO_MSS_ADC_ENABLE_ADDR A:0x41a1014
y.create.l HWIO_MSS_SLEEP_MODE_ADDR A:0x41a1018
y.create.l HWIO_MSS_OFFSET_PRESET_Q_ADDR A:0x41a101c
y.create.l HWIO_MSS_OFFSET_PRESET_I_ADDR A:0x41a1020
y.create.l HWIO_MSS_DIGITAL_CLAMP_ADDR A:0x41a1024
y.create.l HWIO_MSS_EN_OUTCLK_ADDR A:0x41a1028
y.create.l HWIO_MSS_EN_PROTECT_B_ADDR A:0x41a102c
y.create.l HWIO_MSS_TRIGGER_ACTUAL_ADDR A:0x41a1030
y.create.l HWIO_MSS_DTOP_REG1_ADDR A:0x41a1034
y.create.l HWIO_MSS_DTOP_REG2_ADDR A:0x41a1038
y.create.l HWIO_MSS_DTOP_REG3_ADDR A:0x41a103c
y.create.l HWIO_MSS_DTOP_REG4_ADDR A:0x41a1040
y.create.l HWIO_MSS_DTOP_REG5_ADDR A:0x41a1044
y.create.l HWIO_MSS_DTOP_REG6_ADDR A:0x41a1048
y.create.l HWIO_MSS_DTOP_REG7_ADDR A:0x41a104c
y.create.l HWIO_MSS_DTOP_REG8_ADDR A:0x41a1050
y.create.l HWIO_MSS_DTOP_REG9_ADDR A:0x41a1054
y.create.l HWIO_MSS_DTOP_REG10_ADDR A:0x41a1058
y.create.l HWIO_MSS_DTOP_REG11_ADDR A:0x41a105c
y.create.l HWIO_MSS_DTOP_REG12_ADDR A:0x41a1060
y.create.l HWIO_MSS_DTOP_REG13_ADDR A:0x41a1064
y.create.l HWIO_MSS_CONF_BUS_TIMEOUT_REG_BASE_START_ADDR A:0x41b0000
y.create.l HWIO_MSS_CONF_BUS_TIMEOUT_REG_BASE_LAST_ADDR A:0x41b0034
y.create.l HWIO_MSS_CONF_BUS_TIMEOUT_REG_BASE_END_ADDR A:0x41b1000
y.create.l HWIO_MSS_CONF_ABT_HW_VERSION_ADDR A:0x41b0000
y.create.l HWIO_MSS_CONF_ABT_INST_ID_ADDR A:0x41b0004
y.create.l HWIO_MSS_CONF_ABT_NUM_SLAVES_ADDR A:0x41b0008
y.create.l HWIO_MSS_CONF_ABT_TIMER_LOADVAL_ADDR A:0x41b000c
y.create.l HWIO_MSS_CONF_ABT_TIMER_MODE_ADDR A:0x41b0010
y.create.l HWIO_MSS_CONF_ABT_INTR_STATUS_ADDR A:0x41b0014
y.create.l HWIO_MSS_CONF_ABT_INTR_CLEAR_ADDR A:0x41b0018
y.create.l HWIO_MSS_CONF_ABT_INTR_ENABLE_ADDR A:0x41b001c
y.create.l HWIO_MSS_CONF_ABT_SYND_VALID_ADDR A:0x41b0020
y.create.l HWIO_MSS_CONF_ABT_SYND_CLEAR_ADDR A:0x41b0024
y.create.l HWIO_MSS_CONF_ABT_SYND_ID_ADDR A:0x41b0028
y.create.l HWIO_MSS_CONF_ABT_SYND_ADDR0_ADDR A:0x41b002c
y.create.l HWIO_MSS_CONF_ABT_SYND_ADDR1_ADDR A:0x41b0030
y.create.l HWIO_MSS_CONF_ABT_SYND_HREADY_ADDR A:0x41b0034
y.create.l HWIO_MODEM_DTR_DAC_CALIB_0_REG_BASE_START_ADDR A:0x41b2000
y.create.l HWIO_MODEM_DTR_DAC_CALIB_0_REG_BASE_LAST_ADDR A:0x41b204c
y.create.l HWIO_MODEM_DTR_DAC_CALIB_0_REG_BASE_END_ADDR A:0x41b2400
y.create.l HWIO_DAC_CALIB_CFG_0_ADDR A:0x41b2000
y.create.l HWIO_DAC_IREF_UPDATE_0_ADDR A:0x41b2004
y.create.l HWIO_DAC_RT_FUSE_CODE_0_ADDR A:0x41b2008
y.create.l HWIO_TXDAC_CONFIG0_0_ADDR A:0x41b200c
y.create.l HWIO_TXDAC_CONFIG1_0_ADDR A:0x41b2010
y.create.l HWIO_TXDAC_CONFIG2_0_ADDR A:0x41b2014
y.create.l HWIO_TXDAC_CONFIG3_0_ADDR A:0x41b2018
y.create.l HWIO_DAC_CALIB_STATUS_0_ADDR A:0x41b201c
y.create.l HWIO_DAC_ATEST_MUX_SEL_0_ADDR A:0x41b2020
y.create.l HWIO_TXDAC_DEBUG_MODE_0_ADDR A:0x41b2024
y.create.l HWIO_TXDAC_STATUS0_0_ADDR A:0x41b2028
y.create.l HWIO_TXDAC_STATUS1_0_ADDR A:0x41b202c
y.create.l HWIO_DAC_CALIB_CMDS_0_ADDR A:0x41b2030
y.create.l HWIO_DAC_MANUAL_MEM_DEBUG_0_ADDR A:0x41b2034
y.create.l HWIO_DAC_SIGGEN_CFG_0_ADDR A:0x41b2038
y.create.l HWIO_DAC_GPIO_CFG_0_ADDR A:0x41b203c
y.create.l HWIO_DAC_MANUAL_MEM_RD_0_ADDR A:0x41b2040
y.create.l HWIO_TXDAC_ING_CFG_0_ADDR A:0x41b2044
y.create.l HWIO_TXDAC_OUTG_DATA_0_ADDR A:0x41b2048
y.create.l HWIO_TXDAC_PGM_DATA_CFG_0_ADDR A:0x41b204c
y.create.l HWIO_DAC_REGARRAY_0_REG_BASE_START_ADDR A:0x41b2400
y.create.l HWIO_DAC_REGARRAY_0_REG_BASE_LAST_ADDR A:0x41b2520
y.create.l HWIO_DAC_REGARRAY_0_REG_BASE_END_ADDR A:0x41b2800
y.create.l HWIO_DAC_REGARRAY_START_0_ADDR A:0x41b2400
y.create.l HWIO_DAC_REGARRAY_END_0_ADDR A:0x41b2520
y.create.l HWIO_MSS_MGPI_REG_BASE_START_ADDR A:0x41b3000
y.create.l HWIO_MSS_MGPI_REG_BASE_LAST_ADDR A:0x41b3108
y.create.l HWIO_MSS_MGPI_REG_BASE_END_ADDR A:0x41b3128
y.create.l HWIO_MSS_MGPI_PMIC_CONFIG0_ADDR A:0x41b3000
y.create.l HWIO_MSS_MGPI_PMIC_CONFIG1_ADDR A:0x41b3008
y.create.l HWIO_MSS_MGPI_PMIC_CONFIG2_ADDR A:0x41b3010
y.create.l HWIO_MSS_MGPI_PMIC_CONFIG3_ADDR A:0x41b3018
y.create.l HWIO_MSS_MGPI_PMIC_CONFIG4_ADDR A:0x41b3020
y.create.l HWIO_MSS_MGPI_PMIC_CONFIG5_ADDR A:0x41b3028
y.create.l HWIO_MSS_MGPI_PMIC_CONFIG6_ADDR A:0x41b3030
y.create.l HWIO_MSS_MGPI_PMIC_CONFIG7_ADDR A:0x41b3038
y.create.l HWIO_MSS_MGPI_PMIC_CONFIG8_ADDR A:0x41b3040
y.create.l HWIO_MSS_MGPI_PMIC_CONFIG9_ADDR A:0x41b3048
y.create.l HWIO_MSS_MGPI_CONF_STATUS0_ADDR A:0x41b3004
y.create.l HWIO_MSS_MGPI_CONF_STATUS1_ADDR A:0x41b300c
y.create.l HWIO_MSS_MGPI_CONF_STATUS2_ADDR A:0x41b3014
y.create.l HWIO_MSS_MGPI_CONF_STATUS3_ADDR A:0x41b301c
y.create.l HWIO_MSS_MGPI_CONF_STATUS4_ADDR A:0x41b3024
y.create.l HWIO_MSS_MGPI_CONF_STATUS5_ADDR A:0x41b302c
y.create.l HWIO_MSS_MGPI_CONF_STATUS6_ADDR A:0x41b3034
y.create.l HWIO_MSS_MGPI_CONF_STATUS7_ADDR A:0x41b303c
y.create.l HWIO_MSS_MGPI_CONF_STATUS8_ADDR A:0x41b3044
y.create.l HWIO_MSS_MGPI_CONF_STATUS9_ADDR A:0x41b304c
y.create.l HWIO_MSS_MGPI_MASTER_CSR_ADDR A:0x41b3100
y.create.l HWIO_MSS_MGPI_HW_VERSION_ADDR A:0x41b3104
y.create.l HWIO_MSS_CRYPTO_REG_BASE_START_ADDR A:0x41fa000
y.create.l HWIO_MSS_CRYPTO_REG_BASE_LAST_ADDR A:0x41ff014
y.create.l HWIO_MSS_CRYPTO_REG_BASE_END_ADDR A:0x4200000
y.create.l HWIO_MSS_CRYPTO_VERSION_ADDR A:0x41fa000
y.create.l HWIO_MSS_CRYPTO_LIB_VERSION_ADDR A:0x41fa004
y.create.l HWIO_MSS_CRYPTO_DATA_IN0_ADDR A:0x41fa010
y.create.l HWIO_MSS_CRYPTO_DATA_IN1_ADDR A:0x41fa014
y.create.l HWIO_MSS_CRYPTO_DATA_IN2_ADDR A:0x41fa018
y.create.l HWIO_MSS_CRYPTO_DATA_IN3_ADDR A:0x41fa01c
y.create.l HWIO_MSS_CRYPTO_DATA_OUT0_ADDR A:0x41fa020
y.create.l HWIO_MSS_CRYPTO_DATA_OUT1_ADDR A:0x41fa024
y.create.l HWIO_MSS_CRYPTO_DATA_OUT2_ADDR A:0x41fa028
y.create.l HWIO_MSS_CRYPTO_DATA_OUT3_ADDR A:0x41fa02c
y.create.l HWIO_MSS_CRYPTO_STATUS_ADDR A:0x41fa100
y.create.l HWIO_MSS_CRYPTO_STATUS2_ADDR A:0x41fa104
y.create.l HWIO_MSS_CRYPTO_STATUS3_ADDR A:0x41fa11c
y.create.l HWIO_MSS_CRYPTO_STATUS4_ADDR A:0x41fa124
y.create.l HWIO_MSS_CRYPTO_PIPE_GLOBAL_TIMER_EN_MIRROR_ADDR A:0x41fa130
y.create.l HWIO_MSS_CRYPTO_PIPE_GLOBAL_TIMER_LO_MIRROR_ADDR A:0x41fa134
y.create.l HWIO_MSS_CRYPTO_PIPE_GLOBAL_TIMER_HI_MIRROR_ADDR A:0x41fa138
y.create.l HWIO_MSS_CRYPTO_BIST_STATUS_ADDR A:0x41fa114
y.create.l HWIO_MSS_CRYPTO_BIST_FINISH_ADDR A:0x41fa118
y.create.l HWIO_MSS_CRYPTO_ENGINES_AVAIL_ADDR A:0x41fa108
y.create.l HWIO_MSS_CRYPTO_FIFO_SIZES_ADDR A:0x41fa10c
y.create.l HWIO_MSS_CRYPTO_SEG_SIZE_ADDR A:0x41fa110
y.create.l HWIO_MSS_CRYPTO_GOPROC_ADDR A:0x41fa120
y.create.l HWIO_MSS_CRYPTO_GOPROC_QC_KEY_ADDR A:0x41fb000
y.create.l HWIO_MSS_CRYPTO_GOPROC_OEM_KEY_ADDR A:0x41fc000
y.create.l HWIO_MSS_CRYPTO_ENCR_SEG_CFG_ADDR A:0x41fa200
y.create.l HWIO_MSS_CRYPTO_ENCR_SEG_SIZE_ADDR A:0x41fa204
y.create.l HWIO_MSS_CRYPTO_ENCR_SEG_START_ADDR A:0x41fa208
y.create.l HWIO_MSS_CRYPTO_ENCR_KEY0_ADDR A:0x41fd000
y.create.l HWIO_MSS_CRYPTO_ENCR_KEY1_ADDR A:0x41fd004
y.create.l HWIO_MSS_CRYPTO_ENCR_KEY2_ADDR A:0x41fd008
y.create.l HWIO_MSS_CRYPTO_ENCR_KEY3_ADDR A:0x41fd00c
y.create.l HWIO_MSS_CRYPTO_ENCR_KEY4_ADDR A:0x41fd010
y.create.l HWIO_MSS_CRYPTO_ENCR_KEY5_ADDR A:0x41fd014
y.create.l HWIO_MSS_CRYPTO_ENCR_KEY6_ADDR A:0x41fd018
y.create.l HWIO_MSS_CRYPTO_ENCR_KEY7_ADDR A:0x41fd01c
y.create.l HWIO_MSS_CRYPTO_ENCR_XTS_KEY0_ADDR A:0x41fd020
y.create.l HWIO_MSS_CRYPTO_ENCR_XTS_KEY1_ADDR A:0x41fd024
y.create.l HWIO_MSS_CRYPTO_ENCR_XTS_KEY2_ADDR A:0x41fd028
y.create.l HWIO_MSS_CRYPTO_ENCR_XTS_KEY3_ADDR A:0x41fd02c
y.create.l HWIO_MSS_CRYPTO_ENCR_XTS_KEY4_ADDR A:0x41fd030
y.create.l HWIO_MSS_CRYPTO_ENCR_XTS_KEY5_ADDR A:0x41fd034
y.create.l HWIO_MSS_CRYPTO_ENCR_XTS_KEY6_ADDR A:0x41fd038
y.create.l HWIO_MSS_CRYPTO_ENCR_XTS_KEY7_ADDR A:0x41fd03c
y.create.l HWIO_MSS_CRYPTO_ENCR_CNTR0_IV0_ADDR A:0x41fa20c
y.create.l HWIO_MSS_CRYPTO_ENCR_CNTR1_IV1_ADDR A:0x41fa210
y.create.l HWIO_MSS_CRYPTO_ENCR_CNTR2_IV2_ADDR A:0x41fa214
y.create.l HWIO_MSS_CRYPTO_ENCR_CNTR3_IV3_ADDR A:0x41fa218
y.create.l HWIO_MSS_CRYPTO_ENCR_CNTR_MASK_ADDR A:0x41fa21c
y.create.l HWIO_MSS_CRYPTO_ENCR_CNTR_MASK2_ADDR A:0x41fa234
y.create.l HWIO_MSS_CRYPTO_ENCR_CNTR_MASK1_ADDR A:0x41fa238
y.create.l HWIO_MSS_CRYPTO_ENCR_CNTR_MASK0_ADDR A:0x41fa23c
y.create.l HWIO_MSS_CRYPTO_ENCR_CCM_INIT_CNTR0_ADDR A:0x41fa220
y.create.l HWIO_MSS_CRYPTO_ENCR_CCM_INIT_CNTR1_ADDR A:0x41fa224
y.create.l HWIO_MSS_CRYPTO_ENCR_CCM_INIT_CNTR2_ADDR A:0x41fa228
y.create.l HWIO_MSS_CRYPTO_ENCR_CCM_INIT_CNTR3_ADDR A:0x41fa22c
y.create.l HWIO_MSS_CRYPTO_ENCR_XTS_DU_SIZE_ADDR A:0x41fa230
y.create.l HWIO_MSS_CRYPTO_AUTH_SEG_CFG_ADDR A:0x41fa300
y.create.l HWIO_MSS_CRYPTO_AUTH_SEG_SIZE_ADDR A:0x41fa304
y.create.l HWIO_MSS_CRYPTO_AUTH_SEG_START_ADDR A:0x41fa308
y.create.l HWIO_MSS_CRYPTO_AUTH_KEY0_ADDR A:0x41fd040
y.create.l HWIO_MSS_CRYPTO_AUTH_KEY1_ADDR A:0x41fd044
y.create.l HWIO_MSS_CRYPTO_AUTH_KEY2_ADDR A:0x41fd048
y.create.l HWIO_MSS_CRYPTO_AUTH_KEY3_ADDR A:0x41fd04c
y.create.l HWIO_MSS_CRYPTO_AUTH_KEY4_ADDR A:0x41fd050
y.create.l HWIO_MSS_CRYPTO_AUTH_KEY5_ADDR A:0x41fd054
y.create.l HWIO_MSS_CRYPTO_AUTH_KEY6_ADDR A:0x41fd058
y.create.l HWIO_MSS_CRYPTO_AUTH_KEY7_ADDR A:0x41fd05c
y.create.l HWIO_MSS_CRYPTO_AUTH_KEY8_ADDR A:0x41fd060
y.create.l HWIO_MSS_CRYPTO_AUTH_KEY9_ADDR A:0x41fd064
y.create.l HWIO_MSS_CRYPTO_AUTH_IV0_ADDR A:0x41fa310
y.create.l HWIO_MSS_CRYPTO_AUTH_IV1_ADDR A:0x41fa314
y.create.l HWIO_MSS_CRYPTO_AUTH_IV2_ADDR A:0x41fa318
y.create.l HWIO_MSS_CRYPTO_AUTH_IV3_ADDR A:0x41fa31c
y.create.l HWIO_MSS_CRYPTO_AUTH_IV4_ADDR A:0x41fa320
y.create.l HWIO_MSS_CRYPTO_AUTH_IV5_ADDR A:0x41fa324
y.create.l HWIO_MSS_CRYPTO_AUTH_IV6_ADDR A:0x41fa328
y.create.l HWIO_MSS_CRYPTO_AUTH_IV7_ADDR A:0x41fa32c
y.create.l HWIO_MSS_CRYPTO_AUTH_IV8_ADDR A:0x41fa330
y.create.l HWIO_MSS_CRYPTO_AUTH_IV9_ADDR A:0x41fa334
y.create.l HWIO_MSS_CRYPTO_AUTH_INFO_NONCE0_ADDR A:0x41fa350
y.create.l HWIO_MSS_CRYPTO_AUTH_INFO_NONCE1_ADDR A:0x41fa354
y.create.l HWIO_MSS_CRYPTO_AUTH_INFO_NONCE2_ADDR A:0x41fa358
y.create.l HWIO_MSS_CRYPTO_AUTH_INFO_NONCE3_ADDR A:0x41fa35c
y.create.l HWIO_MSS_CRYPTO_AUTH_BYTECNT0_ADDR A:0x41fa390
y.create.l HWIO_MSS_CRYPTO_AUTH_BYTECNT1_ADDR A:0x41fa394
y.create.l HWIO_MSS_CRYPTO_AUTH_BYTECNT2_ADDR A:0x41fa398
y.create.l HWIO_MSS_CRYPTO_AUTH_BYTECNT3_ADDR A:0x41fa39c
y.create.l HWIO_MSS_CRYPTO_AUTH_EXP_MAC0_ADDR A:0x41fa3a0
y.create.l HWIO_MSS_CRYPTO_AUTH_EXP_MAC1_ADDR A:0x41fa3a4
y.create.l HWIO_MSS_CRYPTO_AUTH_EXP_MAC2_ADDR A:0x41fa3a8
y.create.l HWIO_MSS_CRYPTO_AUTH_EXP_MAC3_ADDR A:0x41fa3ac
y.create.l HWIO_MSS_CRYPTO_AUTH_EXP_MAC4_ADDR A:0x41fa3b0
y.create.l HWIO_MSS_CRYPTO_AUTH_EXP_MAC5_ADDR A:0x41fa3b4
y.create.l HWIO_MSS_CRYPTO_AUTH_EXP_MAC6_ADDR A:0x41fa3b8
y.create.l HWIO_MSS_CRYPTO_AUTH_EXP_MAC7_ADDR A:0x41fa3bc
y.create.l HWIO_MSS_CRYPTO_AUTH_EXP_MAC8_ADDR A:0x41fa3c0
y.create.l HWIO_MSS_CRYPTO_AUTH_EXP_MAC9_ADDR A:0x41fa3c4
y.create.l HWIO_MSS_CRYPTO_CONFIG_ADDR A:0x41fa400
y.create.l HWIO_MSS_CRYPTO_PWR_CTRL_ADDR A:0x41fa408
y.create.l HWIO_MSS_CRYPTO_DATA_PATT_PROC_CFG_ADDR A:0x41fa500
y.create.l HWIO_MSS_CRYPTO_DATA_PARTIAL_BLOCK_PROC_CFG_ADDR A:0x41fa504
y.create.l HWIO_MSS_CRYPTO_DEBUG_ENABLE_ADDR A:0x41ff000
y.create.l HWIO_MSS_CRYPTO_DEBUG_ADDR A:0x41ff004
y.create.l HWIO_MSS_CRYPTO_PIPE_GLOBAL_TIMER_EN_ADDR A:0x41ff008
y.create.l HWIO_MSS_CRYPTO_PIPE_GLOBAL_TIMER_LO_ADDR A:0x41ff00c
y.create.l HWIO_MSS_CRYPTO_PIPE_GLOBAL_TIMER_HI_ADDR A:0x41ff010
y.create.l HWIO_MSS_CRYPTO_PIPE_KEY_PAUSE_SW_SRC_ADDR A:0x41ff014
y.create.l HWIO_MSS_CRYPTO_BAM_REG_BASE_START_ADDR A:0x41c4000
y.create.l HWIO_MSS_CRYPTO_BAM_REG_BASE_LAST_ADDR A:0x41d8934
y.create.l HWIO_MSS_CRYPTO_BAM_REG_BASE_END_ADDR A:0x41e8000
y.create.l HWIO_MSS_CRYPTO_BAM_CTRL_ADDR A:0x41c4000
y.create.l HWIO_MSS_CRYPTO_BAM_TIMER_ADDR A:0x41c4040
y.create.l HWIO_MSS_CRYPTO_BAM_TIMER_CTRL_ADDR A:0x41c4044
y.create.l HWIO_MSS_CRYPTO_BAM_DESC_CNT_TRSHLD_ADDR A:0x41c4008
y.create.l HWIO_MSS_CRYPTO_BAM_IRQ_STTS_ADDR A:0x41c4014
y.create.l HWIO_MSS_CRYPTO_BAM_IRQ_CLR_ADDR A:0x41c4018
y.create.l HWIO_MSS_CRYPTO_BAM_IRQ_EN_ADDR A:0x41c401c
y.create.l HWIO_MSS_CRYPTO_BAM_CNFG_BITS_ADDR A:0x41c407c
y.create.l HWIO_MSS_CRYPTO_BAM_CNFG_BITS_2_ADDR A:0x41c4084
y.create.l HWIO_MSS_CRYPTO_BAM_REVISION_ADDR A:0x41c5000
y.create.l HWIO_MSS_CRYPTO_BAM_SW_VERSION_ADDR A:0x41c5004
y.create.l HWIO_MSS_CRYPTO_BAM_NUM_PIPES_ADDR A:0x41c5008
y.create.l HWIO_MSS_CRYPTO_BAM_TEST_BUS_SEL_ADDR A:0x41c5010
y.create.l HWIO_MSS_CRYPTO_BAM_TEST_BUS_REG_ADDR A:0x41c5014
y.create.l HWIO_MSS_CRYPTO_BAM_AHB_MASTER_ERR_CTRLS_ADDR A:0x41c5024
y.create.l HWIO_MSS_CRYPTO_BAM_AHB_MASTER_ERR_ADDR_ADDR A:0x41c5028
y.create.l HWIO_MSS_CRYPTO_BAM_AHB_MASTER_ERR_DATA_ADDR A:0x41c502c
y.create.l HWIO_MSS_CRYPTO_BAM_AHB_MASTER_ERR_ADDR_LSB_ADDR A:0x41c5100
y.create.l HWIO_MSS_CRYPTO_BAM_AHB_MASTER_ERR_ADDR_MSB_ADDR A:0x41c5104
y.create.l HWIO_MSS_CRYPTO_BAM_TRUST_REG_ADDR A:0x41c6000
y.create.l HWIO_MSS_CRYPTO_BAM_P_TRUST_REG0_ADDR A:0x41c6020
y.create.l HWIO_MSS_CRYPTO_BAM_P_TRUST_REG1_ADDR A:0x41c6024
y.create.l HWIO_MSS_CRYPTO_BAM_IRQ_SRCS_EE0_ADDR A:0x41c7000
y.create.l HWIO_MSS_CRYPTO_BAM_IRQ_SRCS_EE1_ADDR A:0x41c8000
y.create.l HWIO_MSS_CRYPTO_BAM_IRQ_SRCS_EE2_ADDR A:0x41c9000
y.create.l HWIO_MSS_CRYPTO_BAM_IRQ_SRCS_EE3_ADDR A:0x41ca000
y.create.l HWIO_MSS_CRYPTO_BAM_IRQ_SRCS_MSK_EE0_ADDR A:0x41c7004
y.create.l HWIO_MSS_CRYPTO_BAM_IRQ_SRCS_MSK_EE1_ADDR A:0x41c8004
y.create.l HWIO_MSS_CRYPTO_BAM_IRQ_SRCS_MSK_EE2_ADDR A:0x41c9004
y.create.l HWIO_MSS_CRYPTO_BAM_IRQ_SRCS_MSK_EE3_ADDR A:0x41ca004
y.create.l HWIO_MSS_CRYPTO_BAM_IRQ_SRCS_UNMASKED_EE0_ADDR A:0x41c7008
y.create.l HWIO_MSS_CRYPTO_BAM_IRQ_SRCS_UNMASKED_EE1_ADDR A:0x41c8008
y.create.l HWIO_MSS_CRYPTO_BAM_IRQ_SRCS_UNMASKED_EE2_ADDR A:0x41c9008
y.create.l HWIO_MSS_CRYPTO_BAM_IRQ_SRCS_UNMASKED_EE3_ADDR A:0x41ca008
y.create.l HWIO_MSS_CRYPTO_BAM_PIPE_ATTR_EE0_ADDR A:0x41c700c
y.create.l HWIO_MSS_CRYPTO_BAM_PIPE_ATTR_EE1_ADDR A:0x41c800c
y.create.l HWIO_MSS_CRYPTO_BAM_PIPE_ATTR_EE2_ADDR A:0x41c900c
y.create.l HWIO_MSS_CRYPTO_BAM_PIPE_ATTR_EE3_ADDR A:0x41ca00c
y.create.l HWIO_MSS_CRYPTO_BAM_IRQ_SRCS_ADDR A:0x41c7010
y.create.l HWIO_MSS_CRYPTO_BAM_IRQ_SRCS_MSK_ADDR A:0x41c7014
y.create.l HWIO_MSS_CRYPTO_BAM_IRQ_SRCS_UNMASKED_ADDR A:0x41c7018
y.create.l HWIO_MSS_CRYPTO_BAM_P_CTRL0_ADDR A:0x41d7000
y.create.l HWIO_MSS_CRYPTO_BAM_P_CTRL1_ADDR A:0x41d8000
y.create.l HWIO_MSS_CRYPTO_BAM_P_RST0_ADDR A:0x41d7004
y.create.l HWIO_MSS_CRYPTO_BAM_P_RST1_ADDR A:0x41d8004
y.create.l HWIO_MSS_CRYPTO_BAM_P_HALT0_ADDR A:0x41d7008
y.create.l HWIO_MSS_CRYPTO_BAM_P_HALT1_ADDR A:0x41d8008
y.create.l HWIO_MSS_CRYPTO_BAM_P_IRQ_STTS0_ADDR A:0x41d7010
y.create.l HWIO_MSS_CRYPTO_BAM_P_IRQ_STTS1_ADDR A:0x41d8010
y.create.l HWIO_MSS_CRYPTO_BAM_P_IRQ_CLR0_ADDR A:0x41d7014
y.create.l HWIO_MSS_CRYPTO_BAM_P_IRQ_CLR1_ADDR A:0x41d8014
y.create.l HWIO_MSS_CRYPTO_BAM_P_IRQ_EN0_ADDR A:0x41d7018
y.create.l HWIO_MSS_CRYPTO_BAM_P_IRQ_EN1_ADDR A:0x41d8018
y.create.l HWIO_MSS_CRYPTO_BAM_P_TIMER0_ADDR A:0x41d701c
y.create.l HWIO_MSS_CRYPTO_BAM_P_TIMER1_ADDR A:0x41d801c
y.create.l HWIO_MSS_CRYPTO_BAM_P_TIMER_CTRL0_ADDR A:0x41d7020
y.create.l HWIO_MSS_CRYPTO_BAM_P_TIMER_CTRL1_ADDR A:0x41d8020
y.create.l HWIO_MSS_CRYPTO_BAM_P_PRDCR_SDBND0_ADDR A:0x41d7024
y.create.l HWIO_MSS_CRYPTO_BAM_P_PRDCR_SDBND1_ADDR A:0x41d8024
y.create.l HWIO_MSS_CRYPTO_BAM_P_CNSMR_SDBND0_ADDR A:0x41d7028
y.create.l HWIO_MSS_CRYPTO_BAM_P_CNSMR_SDBND1_ADDR A:0x41d8028
y.create.l HWIO_MSS_CRYPTO_BAM_P_SW_OFSTS0_ADDR A:0x41d7800
y.create.l HWIO_MSS_CRYPTO_BAM_P_SW_OFSTS1_ADDR A:0x41d8800
y.create.l HWIO_MSS_CRYPTO_BAM_P_AU_PSM_CNTXT_1_0_ADDR A:0x41d7804
y.create.l HWIO_MSS_CRYPTO_BAM_P_AU_PSM_CNTXT_1_1_ADDR A:0x41d8804
y.create.l HWIO_MSS_CRYPTO_BAM_P_PSM_CNTXT_2_0_ADDR A:0x41d7808
y.create.l HWIO_MSS_CRYPTO_BAM_P_PSM_CNTXT_2_1_ADDR A:0x41d8808
y.create.l HWIO_MSS_CRYPTO_BAM_P_PSM_CNTXT_3_0_ADDR A:0x41d780c
y.create.l HWIO_MSS_CRYPTO_BAM_P_PSM_CNTXT_3_1_ADDR A:0x41d880c
y.create.l HWIO_MSS_CRYPTO_BAM_P_PSM_CNTXT_4_0_ADDR A:0x41d7810
y.create.l HWIO_MSS_CRYPTO_BAM_P_PSM_CNTXT_4_1_ADDR A:0x41d8810
y.create.l HWIO_MSS_CRYPTO_BAM_P_PSM_CNTXT_5_0_ADDR A:0x41d7814
y.create.l HWIO_MSS_CRYPTO_BAM_P_PSM_CNTXT_5_1_ADDR A:0x41d8814
y.create.l HWIO_MSS_CRYPTO_BAM_P_EVNT_REG0_ADDR A:0x41d7818
y.create.l HWIO_MSS_CRYPTO_BAM_P_EVNT_REG1_ADDR A:0x41d8818
y.create.l HWIO_MSS_CRYPTO_BAM_P_DESC_FIFO_ADDR0_ADDR A:0x41d781c
y.create.l HWIO_MSS_CRYPTO_BAM_P_DESC_FIFO_ADDR1_ADDR A:0x41d881c
y.create.l HWIO_MSS_CRYPTO_BAM_P_FIFO_SIZES0_ADDR A:0x41d7820
y.create.l HWIO_MSS_CRYPTO_BAM_P_FIFO_SIZES1_ADDR A:0x41d8820
y.create.l HWIO_MSS_CRYPTO_BAM_P_DATA_FIFO_ADDR0_ADDR A:0x41d7824
y.create.l HWIO_MSS_CRYPTO_BAM_P_DATA_FIFO_ADDR1_ADDR A:0x41d8824
y.create.l HWIO_MSS_CRYPTO_BAM_P_EVNT_GEN_TRSHLD0_ADDR A:0x41d7828
y.create.l HWIO_MSS_CRYPTO_BAM_P_EVNT_GEN_TRSHLD1_ADDR A:0x41d8828
y.create.l HWIO_MSS_CRYPTO_BAM_P_EVNT_DEST_ADDR0_ADDR A:0x41d782c
y.create.l HWIO_MSS_CRYPTO_BAM_P_EVNT_DEST_ADDR1_ADDR A:0x41d882c
y.create.l HWIO_MSS_CRYPTO_BAM_P_DF_CNTXT_0_ADDR A:0x41d7830
y.create.l HWIO_MSS_CRYPTO_BAM_P_DF_CNTXT_1_ADDR A:0x41d8830
y.create.l HWIO_MSS_CRYPTO_BAM_P_RETR_CNTXT_0_ADDR A:0x41d7834
y.create.l HWIO_MSS_CRYPTO_BAM_P_RETR_CNTXT_1_ADDR A:0x41d8834
y.create.l HWIO_MSS_CRYPTO_BAM_P_SI_CNTXT_0_ADDR A:0x41d7838
y.create.l HWIO_MSS_CRYPTO_BAM_P_SI_CNTXT_1_ADDR A:0x41d8838
y.create.l HWIO_MSS_CRYPTO_BAM_P_PSM_CNTXT_3_LSB0_ADDR A:0x41d7900
y.create.l HWIO_MSS_CRYPTO_BAM_P_PSM_CNTXT_3_LSB1_ADDR A:0x41d8900
y.create.l HWIO_MSS_CRYPTO_BAM_P_PSM_CNTXT_3_MSB0_ADDR A:0x41d7904
y.create.l HWIO_MSS_CRYPTO_BAM_P_PSM_CNTXT_3_MSB1_ADDR A:0x41d8904
y.create.l HWIO_MSS_CRYPTO_BAM_P_DESC_FIFO_ADDR_LSB0_ADDR A:0x41d7910
y.create.l HWIO_MSS_CRYPTO_BAM_P_DESC_FIFO_ADDR_LSB1_ADDR A:0x41d8910
y.create.l HWIO_MSS_CRYPTO_BAM_P_DESC_FIFO_ADDR_MSB0_ADDR A:0x41d7914
y.create.l HWIO_MSS_CRYPTO_BAM_P_DESC_FIFO_ADDR_MSB1_ADDR A:0x41d8914
y.create.l HWIO_MSS_CRYPTO_BAM_P_DATA_FIFO_ADDR_LSB0_ADDR A:0x41d7920
y.create.l HWIO_MSS_CRYPTO_BAM_P_DATA_FIFO_ADDR_LSB1_ADDR A:0x41d8920
y.create.l HWIO_MSS_CRYPTO_BAM_P_DATA_FIFO_ADDR_MSB0_ADDR A:0x41d7924
y.create.l HWIO_MSS_CRYPTO_BAM_P_DATA_FIFO_ADDR_MSB1_ADDR A:0x41d8924
y.create.l HWIO_MSS_CRYPTO_BAM_P_EVNT_DEST_ADDR_LSB0_ADDR A:0x41d7930
y.create.l HWIO_MSS_CRYPTO_BAM_P_EVNT_DEST_ADDR_LSB1_ADDR A:0x41d8930
y.create.l HWIO_MSS_CRYPTO_BAM_P_EVNT_DEST_ADDR_MSB0_ADDR A:0x41d7934
y.create.l HWIO_MSS_CRYPTO_BAM_P_EVNT_DEST_ADDR_MSB1_ADDR A:0x41d8934
y.create.l HWIO_MSS_NAV_WTR_BASE_REG_BASE_START_ADDR A:0x4200000
y.create.l HWIO_MSS_NAV_WTR_BASE_REG_BASE_LAST_ADDR A:0x42006f4
y.create.l HWIO_MSS_NAV_WTR_BASE_REG_BASE_END_ADDR A:0x4201900
y.create.l HWIO_MSS_WTR_RC_CONTROL_ADDR A:0x4200000
y.create.l HWIO_MSS_WTR_RC_CONFIG_ADDR A:0x4200004
y.create.l HWIO_MSS_WTR_RC_RSRATE_ADDR A:0x4200008
y.create.l HWIO_MSS_WTR_RC_GLO_RSRATE_ADDR A:0x420000c
y.create.l HWIO_MSS_WTR_RC_STMR_GNSSRTC_CMP_VAL_ADDR A:0x420001c
y.create.l HWIO_MSS_WTR_RC_TIME_LATCHING_ADDR A:0x4200020
y.create.l HWIO_MSS_WTR_RC_STMR_TRIG_CNT_VAL_ADDR A:0x4200024
y.create.l HWIO_MSS_WTR_RC_PPSO_ASSERT_ADDR A:0x4200028
y.create.l HWIO_MSS_WTR_RC_PPSO_DEASSERT_ADDR A:0x420002c
y.create.l HWIO_MSS_WTR_RC_PPSO_ASSERT1_ADDR A:0x4200030
y.create.l HWIO_MSS_WTR_RC_PPSO_DEASSERT1_ADDR A:0x4200034
y.create.l HWIO_MSS_WTR_RC_GNSS_RTC_STATUS_ADDR A:0x4200038
y.create.l HWIO_MSS_WTR_RC_GLO_GNSS_RTC_STATUS_ADDR A:0x420003c
y.create.l HWIO_MSS_WTR_RC_IRQ_STATUS_ADDR A:0x4200040
y.create.l HWIO_MSS_WTR_HW_EVENT_IRQ_STATUS_ADDR A:0x4200044
y.create.l HWIO_MSS_WTR_HW_EVENT_IRQ_STATUS1_ADDR A:0x4200048
y.create.l HWIO_MSS_WTR_RC_PPSI_RTC_ADDR A:0x420004c
y.create.l HWIO_MSS_WTR_RC_PPSI_RTC1_ADDR A:0x4200050
y.create.l HWIO_MSS_WTR_RC_NAV_TEST_BUS_ADDR A:0x4200054
y.create.l HWIO_MSS_AD_MODE_ADDR A:0x4200080
y.create.l HWIO_MSS_AD_RX1_CONFIG_ADDR A:0x4200084
y.create.l HWIO_MSS_AD_RX2_CONFIG_ADDR A:0x4200088
y.create.l HWIO_MSS_AD_SPEC_ANALYZER_CMD_ADDR A:0x420008c
y.create.l HWIO_MSS_AD_SL_INDEX_ADDR A:0x4200090
y.create.l HWIO_MSS_AD_RX1_MEAN_MON_ADDR A:0x4200094
y.create.l HWIO_MSS_AD_RX2_MEAN_MON_ADDR A:0x4200098
y.create.l HWIO_MSS_AD_RX1_BLANK_MONITOR_ADDR A:0x420009c
y.create.l HWIO_MSS_AD_RX2_BLANK_MONITOR_ADDR A:0x42000a0
y.create.l HWIO_MSS_AD_SPEC_ANALYZER_STATUS_ADDR A:0x42000a4
y.create.l HWIO_MSS_AD_RX1_AMPL_MON_ADDR A:0x42000a8
y.create.l HWIO_MSS_AD_RX2_AMPL_MON_ADDR A:0x42000ac
y.create.l HWIO_MSS_WTR_STMR_STATUS0_RD_ADDR A:0x42000c0
y.create.l HWIO_MSS_WTR_STMR_STATUS1_RD_ADDR A:0x42000c4
y.create.l HWIO_MSS_WTR_STMR_STATUS2_RD_ADDR A:0x42000c8
y.create.l HWIO_MSS_WTR_STMR_STATUS3_RD_ADDR A:0x42000cc
y.create.l HWIO_MSS_WTR_STMR_STATUS4_RD_ADDR A:0x42000d0
y.create.l HWIO_MSS_WTR_STMR_STATUS5_RD_ADDR A:0x42000d4
y.create.l HWIO_MSS_WTR_STMR_STATUS6_RD_ADDR A:0x42000d8
y.create.l HWIO_MSS_WTR_STMR_STATUS7_RD_ADDR A:0x42000dc
y.create.l HWIO_MSS_WTR_STMR_STATUS8_RD_ADDR A:0x42000e0
y.create.l HWIO_MSS_WTR_STMR_STATUS9_RD_ADDR A:0x42000e4
y.create.l HWIO_MSS_WTR_STMR_STATUS10_RD_ADDR A:0x42000e8
y.create.l HWIO_MSS_WTR_STMR_STATUS11_RD_ADDR A:0x42000ec
y.create.l HWIO_MSS_TSG_CONFIG_ADDR A:0x4200100
y.create.l HWIO_MSS_TSG_RX_OFFSET_ADDR A:0x4200104
y.create.l HWIO_MSS_TSG_RS_RATE_ADDR A:0x4200108
y.create.l HWIO_MSS_TSG_INIT_COUNT_ADDR A:0x420010c
y.create.l HWIO_MSS_TSG_FREQ_ADDR A:0x4200110
y.create.l HWIO_MSS_TSG_DATA_SEED_ADDR A:0x4200114
y.create.l HWIO_MSS_TSG_PILOT_SEED_ADDR A:0x4200118
y.create.l HWIO_MSS_TSG_FIRST_CODE_ADDR A:0x420011c
y.create.l HWIO_MSS_TSG_L1CP_ADDR A:0x4200120
y.create.l HWIO_MSS_TSG_L1CD_ADDR A:0x4200124
y.create.l HWIO_MSS_TSG_COUNT_STATUS_ADDR A:0x4200128
y.create.l HWIO_MSS_BP1_CONFIG_ADDR A:0x4200200
y.create.l HWIO_MSS_BP1_IF_FREQ_ADDR A:0x4200204
y.create.l HWIO_MSS_BP1_1ST_NOTCH1_ADDR A:0x4200208
y.create.l HWIO_MSS_BP1_1ST_NOTCH2_ADDR A:0x420020c
y.create.l HWIO_MSS_BP1_1ST_NOTCH3_ADDR A:0x4200210
y.create.l HWIO_MSS_BP1_PRE_NOTCH_ADDR A:0x4200214
y.create.l HWIO_MSS_BP1_NOTCH1_ADDR A:0x4200218
y.create.l HWIO_MSS_BP1_NOTCH2_ADDR A:0x420021c
y.create.l HWIO_MSS_BP1_NOTCH3_ADDR A:0x4200220
y.create.l HWIO_MSS_BP1_NOTCH4_ADDR A:0x4200224
y.create.l HWIO_MSS_BP1_NOTCH5_ADDR A:0x4200228
y.create.l HWIO_MSS_BP1_NOTCH6_ADDR A:0x420022c
y.create.l HWIO_MSS_BP1_EQ_COEF_REAL_ADDR A:0x4200230
y.create.l HWIO_MSS_BP1_EQ_COEF_IMAG_ADDR A:0x4200234
y.create.l HWIO_MSS_BP1_THRESH_ADDR A:0x4200238
y.create.l HWIO_MSS_BP1_AMPL_EST_MODE_ADDR A:0x420023c
y.create.l HWIO_MSS_BP1_OUT_BLANK_CFG_ADDR A:0x4200240
y.create.l HWIO_MSS_BP1_SM_TEST_CFG_ADDR A:0x4200244
y.create.l HWIO_MSS_BP1_SCH2_AMPL_MON_ADDR A:0x4200248
y.create.l HWIO_MSS_BP1_SCH3_AMPL_MON_ADDR A:0x420024c
y.create.l HWIO_MSS_BP1_SCH_CX20_AMPL_MON_ADDR A:0x4200250
y.create.l HWIO_MSS_BP1_PRE_AMPL_MON_ADDR A:0x4200254
y.create.l HWIO_MSS_BP1_BLANK_MONITOR_ADDR A:0x4200258
y.create.l HWIO_MSS_BP1_JAMMER_CTL1_ADDR A:0x420025c
y.create.l HWIO_MSS_BP1_JAMMER_CTL2_ADDR A:0x4200260
y.create.l HWIO_MSS_BP1_JAMMER_CTL3_ADDR A:0x4200264
y.create.l HWIO_MSS_BP1_JAMMER_CTL4_ADDR A:0x4200268
y.create.l HWIO_MSS_BP1_JAMMER_LOG1_MON_ADDR A:0x420026c
y.create.l HWIO_MSS_BP1_JAMMER_LOG2_MON_ADDR A:0x4200270
y.create.l HWIO_MSS_BP1_JAMMER_LOG3_MON_ADDR A:0x4200274
y.create.l HWIO_MSS_BP1_JAMMER_LOG4_MON_ADDR A:0x4200278
y.create.l HWIO_MSS_BP1_PRE_NF_LOAD_ADDR A:0x420027c
y.create.l HWIO_MSS_BP1_NF1_LOAD_ADDR A:0x4200280
y.create.l HWIO_MSS_BP1_NF2_LOAD_ADDR A:0x4200284
y.create.l HWIO_MSS_BP1_NF3_LOAD_ADDR A:0x4200288
y.create.l HWIO_MSS_BP1_NF4_LOAD_ADDR A:0x420028c
y.create.l HWIO_MSS_BP1_NF5_LOAD_ADDR A:0x4200290
y.create.l HWIO_MSS_BP1_NF6_LOAD_ADDR A:0x4200294
y.create.l HWIO_MSS_BP3_CONFIG_ADDR A:0x4200400
y.create.l HWIO_MSS_BP3_SUBCH_SRC_SEL_ADDR A:0x4200404
y.create.l HWIO_MSS_BP3_IF_FREQ_ADDR A:0x4200408
y.create.l HWIO_MSS_BP3_L2_IF_FREQ_ADDR A:0x420040c
y.create.l HWIO_MSS_BP3_PRE_NOTCH_ADDR A:0x4200410
y.create.l HWIO_MSS_BP3_NOTCH1_ADDR A:0x4200414
y.create.l HWIO_MSS_BP3_NOTCH2_ADDR A:0x4200418
y.create.l HWIO_MSS_BP3_NOTCH3_ADDR A:0x420041c
y.create.l HWIO_MSS_BP3_NOTCH4_ADDR A:0x4200420
y.create.l HWIO_MSS_BP3_NOTCH5_ADDR A:0x4200424
y.create.l HWIO_MSS_BP3_NOTCH6_ADDR A:0x4200428
y.create.l HWIO_MSS_BP3_NOTCH7_ADDR A:0x420042c
y.create.l HWIO_MSS_BP3_NOTCH8_ADDR A:0x4200430
y.create.l HWIO_MSS_BP3_NOTCH9_ADDR A:0x4200434
y.create.l HWIO_MSS_BP3_NOTCH10_ADDR A:0x4200438
y.create.l HWIO_MSS_BP3_NOTCH11_ADDR A:0x420043c
y.create.l HWIO_MSS_BP3_NOTCH12_ADDR A:0x4200440
y.create.l HWIO_MSS_BP3_EQ_COEF_REAL_ADDR A:0x4200444
y.create.l HWIO_MSS_BP3_EQ_COEF_IMAG_ADDR A:0x4200448
y.create.l HWIO_MSS_BP3_L2_EQ_COEF_REAL_ADDR A:0x420044c
y.create.l HWIO_MSS_BP3_L2_EQ_COEF_IMAG_ADDR A:0x4200450
y.create.l HWIO_MSS_BP3_SCH_MODE_ADDR A:0x4200454
y.create.l HWIO_MSS_BP3_SCH1_FREQ_ADDR A:0x4200458
y.create.l HWIO_MSS_BP3_SCH2_FREQ_ADDR A:0x420045c
y.create.l HWIO_MSS_BP3_SCH3_FREQ_ADDR A:0x4200460
y.create.l HWIO_MSS_BP3_SCH4_FREQ_ADDR A:0x4200464
y.create.l HWIO_MSS_BP3_SCH5_FREQ_ADDR A:0x4200468
y.create.l HWIO_MSS_BP3_SCH6_FREQ_ADDR A:0x420046c
y.create.l HWIO_MSS_BP3_SCH7_FREQ_ADDR A:0x4200470
y.create.l HWIO_MSS_BP3_SCH8_FREQ_ADDR A:0x4200474
y.create.l HWIO_MSS_BP3_SCH9_FREQ_ADDR A:0x4200478
y.create.l HWIO_MSS_BP3_SCH10_FREQ_ADDR A:0x420047c
y.create.l HWIO_MSS_BP3_SCH11_FREQ_ADDR A:0x4200480
y.create.l HWIO_MSS_BP3_SCH12_FREQ_ADDR A:0x4200484
y.create.l HWIO_MSS_BP3_THRESH_A_ADDR A:0x4200488
y.create.l HWIO_MSS_BP3_THRESH_B_ADDR A:0x420048c
y.create.l HWIO_MSS_BP3_THRESH_C_ADDR A:0x4200490
y.create.l HWIO_MSS_BP3_THRESH_D_ADDR A:0x4200494
y.create.l HWIO_MSS_BP3_THRESH_E_ADDR A:0x4200498
y.create.l HWIO_MSS_BP3_THRESH_F_ADDR A:0x420049c
y.create.l HWIO_MSS_BP3_THRESH_G_ADDR A:0x42004a0
y.create.l HWIO_MSS_BP3_AMP_EST_CONFIG_ADDR A:0x42004a4
y.create.l HWIO_MSS_BP3_OUT_BLANK_CFG_ADDR A:0x42004a8
y.create.l HWIO_MSS_BP3_SM_TEST_CFG_ADDR A:0x42004ac
y.create.l HWIO_MSS_BP3_SCH1_AMPL_MON_ADDR A:0x42004b0
y.create.l HWIO_MSS_BP3_SCH2_AMPL_MON_ADDR A:0x42004b4
y.create.l HWIO_MSS_BP3_SCH3_AMPL_MON_ADDR A:0x42004b8
y.create.l HWIO_MSS_BP3_SCH4_AMPL_MON_ADDR A:0x42004bc
y.create.l HWIO_MSS_BP3_SCH5_AMPL_MON_ADDR A:0x42004c0
y.create.l HWIO_MSS_BP3_SCH6_AMPL_MON_ADDR A:0x42004c4
y.create.l HWIO_MSS_BP3_SCH7_AMPL_MON_ADDR A:0x42004c8
y.create.l HWIO_MSS_BP3_SCH8_AMPL_MON_ADDR A:0x42004cc
y.create.l HWIO_MSS_BP3_SCH9_AMPL_MON_ADDR A:0x42004d0
y.create.l HWIO_MSS_BP3_SCH10_AMPL_MON_ADDR A:0x42004d4
y.create.l HWIO_MSS_BP3_SCH11_AMPL_MON_ADDR A:0x42004d8
y.create.l HWIO_MSS_BP3_SCH12_AMPL_MON_ADDR A:0x42004dc
y.create.l HWIO_MSS_BP3_SCH_CX20_AMPL_MON_ADDR A:0x42004e0
y.create.l HWIO_MSS_BP3_SCH_CX20_L2_AMPL_MON_ADDR A:0x42004e4
y.create.l HWIO_MSS_BP3_PRE_AMPL_MON_ADDR A:0x42004e8
y.create.l HWIO_MSS_BP3_L2_PRE_AMPL_MON_ADDR A:0x42004ec
y.create.l HWIO_MSS_BP3_BLANK_MONITOR_ADDR A:0x42004f0
y.create.l HWIO_MSS_BP3_JAMMER_CTL1_ADDR A:0x42004f4
y.create.l HWIO_MSS_BP3_JAMMER_CTL2_ADDR A:0x42004f8
y.create.l HWIO_MSS_BP3_JAMMER_CTL3_ADDR A:0x42004fc
y.create.l HWIO_MSS_BP3_JAMMER_CTL4_ADDR A:0x4200500
y.create.l HWIO_MSS_BP3_JAMMER_LOG1_MON_ADDR A:0x4200504
y.create.l HWIO_MSS_BP3_JAMMER_LOG2_MON_ADDR A:0x4200508
y.create.l HWIO_MSS_BP3_JAMMER_LOG3_MON_ADDR A:0x420050c
y.create.l HWIO_MSS_BP3_JAMMER_LOG4_MON_ADDR A:0x4200510
y.create.l HWIO_MSS_BP3_PRE_NF_LOAD_ADDR A:0x4200514
y.create.l HWIO_MSS_BP3_NF1_LOAD_ADDR A:0x4200518
y.create.l HWIO_MSS_BP3_NF2_LOAD_ADDR A:0x420051c
y.create.l HWIO_MSS_BP3_NF3_LOAD_ADDR A:0x4200520
y.create.l HWIO_MSS_BP3_NF4_LOAD_ADDR A:0x4200524
y.create.l HWIO_MSS_BP3_NF5_LOAD_ADDR A:0x4200528
y.create.l HWIO_MSS_BP3_NF6_LOAD_ADDR A:0x420052c
y.create.l HWIO_MSS_BP3_NF7_LOAD_ADDR A:0x4200530
y.create.l HWIO_MSS_BP3_NF8_LOAD_ADDR A:0x4200534
y.create.l HWIO_MSS_BP3_NF9_LOAD_ADDR A:0x4200538
y.create.l HWIO_MSS_BP3_NF10_LOAD_ADDR A:0x420053c
y.create.l HWIO_MSS_BP3_NF11_LOAD_ADDR A:0x4200540
y.create.l HWIO_MSS_BP3_NF12_LOAD_ADDR A:0x4200544
y.create.l HWIO_MSS_WTR_SMI_MODE_ADDR A:0x4200600
y.create.l HWIO_MSS_WTR_SMI_SCH_MODE_ADDR A:0x4200604
y.create.l HWIO_MSS_WTR_SMI_BASEADDR1_BANK0_ADDR A:0x4200608
y.create.l HWIO_MSS_WTR_SMI_BASEADDR2_BANK0_ADDR A:0x420060c
y.create.l HWIO_MSS_WTR_SMI_BASEADDR3A_BANK0_ADDR A:0x4200610
y.create.l HWIO_MSS_WTR_SMI_BASEADDR3B_BANK0_ADDR A:0x4200614
y.create.l HWIO_MSS_WTR_SMI_BASEADDR3C_BANK0_ADDR A:0x4200618
y.create.l HWIO_MSS_WTR_SMI_BASEADDR3D_ADDR A:0x420061c
y.create.l HWIO_MSS_WTR_SMI_BASEADDR4_ADDR A:0x4200620
y.create.l HWIO_MSS_WTR_SMI_BASEADDR1_BANK1_ADDR A:0x4200624
y.create.l HWIO_MSS_WTR_SMI_BASEADDR2_BANK1_ADDR A:0x4200628
y.create.l HWIO_MSS_WTR_SMI_BASEADDR3A_BANK1_ADDR A:0x420062c
y.create.l HWIO_MSS_WTR_SMI_BASEADDR3B_BANK1_ADDR A:0x4200630
y.create.l HWIO_MSS_WTR_SMI_BASEADDR3C_BANK1_ADDR A:0x4200634
y.create.l HWIO_MSS_WTR_SMI_BASEADDR2P_ADDR A:0x4200638
y.create.l HWIO_MSS_PR_READ_CTL_ADDR A:0x4200680
y.create.l HWIO_MSS_PR_GNSS_RTC_READ_CTL_ADDR A:0x4200684
y.create.l HWIO_MSS_PR_SW_TRIGGER_ADDR A:0x4200688
y.create.l HWIO_MSS_PR_EVENT_READ_CTL_ADDR A:0x420068c
y.create.l HWIO_MSS_PR_READ_LIST_0_ADDR A:0x4200690
y.create.l HWIO_MSS_PR_READ_LIST_1_ADDR A:0x4200694
y.create.l HWIO_MSS_PR_READ_LIST_2_ADDR A:0x4200698
y.create.l HWIO_MSS_PR_READ_LIST_3_ADDR A:0x420069c
y.create.l HWIO_MSS_STMR_BLANK_ENA_ADDR A:0x42006c0
y.create.l HWIO_MSS_STMR_BLANK0_ON_ADDR A:0x42006c4
y.create.l HWIO_MSS_STMR_BLANK1_ON_ADDR A:0x42006c8
y.create.l HWIO_MSS_STMR_BLANK2_ON_ADDR A:0x42006cc
y.create.l HWIO_MSS_STMR_BLANK3_ON_ADDR A:0x42006d0
y.create.l HWIO_MSS_STMR_BLANK4_ON_ADDR A:0x42006d4
y.create.l HWIO_MSS_STMR_BLANK5_ON_ADDR A:0x42006d8
y.create.l HWIO_MSS_STMR_BLANK0_OFF_ADDR A:0x42006dc
y.create.l HWIO_MSS_STMR_BLANK1_OFF_ADDR A:0x42006e0
y.create.l HWIO_MSS_STMR_BLANK2_OFF_ADDR A:0x42006e4
y.create.l HWIO_MSS_STMR_BLANK3_OFF_ADDR A:0x42006e8
y.create.l HWIO_MSS_STMR_BLANK4_OFF_ADDR A:0x42006ec
y.create.l HWIO_MSS_STMR_BLANK5_OFF_ADDR A:0x42006f0
y.create.l HWIO_MSS_STMR_BLANK_STATUS_ADDR A:0x42006f4
y.create.l HWIO_MSS_NAV_TOP_BASE_REG_BASE_START_ADDR A:0x4201900
y.create.l HWIO_MSS_NAV_TOP_BASE_REG_BASE_LAST_ADDR A:0x4201af8
y.create.l HWIO_MSS_NAV_TOP_BASE_REG_BASE_END_ADDR A:0x4202000
y.create.l HWIO_MSS_NAV_CLK_STMR_XO_CLK_BCR_ADDR A:0x4201a10
y.create.l HWIO_MSS_NAV_CLK_CORE_CLK_BCR_ADDR A:0x4201a14
y.create.l HWIO_MSS_NAV_CLK_DMA_CLK_BCR_ADDR A:0x4201a18
y.create.l HWIO_MSS_NAV_CLK_CP_CLK_BCR_ADDR A:0x4201a1c
y.create.l HWIO_MSS_NAV_CLK_DP_CLK_BCR_ADDR A:0x4201a20
y.create.l HWIO_MSS_NAV_CLK_XO_GDSC_CLK_BCR_ADDR A:0x4201a28
y.create.l HWIO_MSS_WTR_NAV_CLK_BP1_CLK_BCR_ADDR A:0x4201a30
y.create.l HWIO_MSS_WTR_NAV_CLK_BP3_CLK_BCR_ADDR A:0x4201a38
y.create.l HWIO_MSS_WTR_NAV_CLK_ADC_CLK_BCR_ADDR A:0x4201a40
y.create.l HWIO_MSS_WTR_NAV_CLK_NAV_CLK_BCR_ADDR A:0x4201a44
y.create.l HWIO_MSS_WTR_NAV_CLK_ADC_RET_CLK_BCR_ADDR A:0x4201a48
y.create.l HWIO_MSS_NAV_CLK_STMR_XO_CLK_CBCR_ADDR A:0x4201a4c
y.create.l HWIO_MSS_NAV_CLK_CORE_CLK_CBCR_ADDR A:0x4201a50
y.create.l HWIO_MSS_NAV_CLK_DMA_CLK_CBCR_ADDR A:0x4201a54
y.create.l HWIO_MSS_NAV_CLK_CP_CLK_CBCR_ADDR A:0x4201a58
y.create.l HWIO_MSS_NAV_CLK_DP_CLK_CBCR_ADDR A:0x4201a5c
y.create.l HWIO_MSS_WTR_NAV_CLK_BP1_CLK_CBCR_ADDR A:0x4201a68
y.create.l HWIO_MSS_WTR_NAV_CLK_BP3_CLK_CBCR_ADDR A:0x4201a70
y.create.l HWIO_MSS_WTR_NAV_CLK_ADC_CLK_CBCR_ADDR A:0x4201a78
y.create.l HWIO_MSS_WTR_NAV_CLK_CORE_CLK_CBCR_ADDR A:0x4201a7c
y.create.l HWIO_MSS_WTR_NAV_CLK_ADC_RET_CLK_CBCR_ADDR A:0x4201a80
y.create.l HWIO_MSS_ADC_FIFO_RESET_ADDR A:0x4201a84
y.create.l HWIO_MSS_NAV_CLK_TEST_DBG_CONFIG_ADDR A:0x4201a8c
y.create.l HWIO_MSS_NAV_CLK_GDS_ADDR A:0x4201a90
y.create.l HWIO_MSS_NAV_CLK_MISC_ADDR A:0x4201a94
y.create.l HWIO_MSS_NAV_CLK_IPCAT_ADDR A:0x4201a98
y.create.l HWIO_MSS_NAV_CLK_AXI_BRIDGE_STATUS_ADDR A:0x4201a9c
y.create.l HWIO_MSS_NAV_CLK_STATUS_ADDR A:0x4201aa0
y.create.l HWIO_MSS_NAV_CLK_MASTER_QSB_SIDEBAND_ADDR A:0x4201aac
y.create.l HWIO_MSS_NAV_CLK_QDSS_TESTBUS_ADDR A:0x4201af8
y.create.l HWIO_MSS_NAV_BB_BASE_REG_BASE_START_ADDR A:0x4202000
y.create.l HWIO_MSS_NAV_BB_BASE_REG_BASE_LAST_ADDR A:0x42c33fc
y.create.l HWIO_MSS_NAV_BB_BASE_REG_BASE_END_ADDR A:0x42c8000
y.create.l HWIO_MSS_CP_START_ADDR A:0x4203300
y.create.l HWIO_MSS_CP_CONFIG1_ADDR A:0x4203304
y.create.l HWIO_MSS_CP_CONFIG2_ADDR A:0x4203308
y.create.l HWIO_MSS_CP_SAMPLE_INDEX_ADDR A:0x420330c
y.create.l HWIO_MSS_CP_PHASE_ADDR A:0x4203310
y.create.l HWIO_MSS_CP_FREQ_ADDR A:0x4203314
y.create.l HWIO_MSS_CP_DATA_SEED_ADDR A:0x4203318
y.create.l HWIO_MSS_CP_PILOT_SEED_ADDR A:0x420331c
y.create.l HWIO_MSS_CP_CODE_INDEX_ADDR A:0x4203320
y.create.l HWIO_MSS_CP_BUF2_BASE_ADDR_ADDR A:0x420333c
y.create.l HWIO_MSS_CP_STATUS_ADDR A:0x4203340
y.create.l HWIO_MSS_CCP_IND_WORDS_NEEDED_ADDR A:0x4202300
y.create.l HWIO_MSS_CCP_DIR_WORDS_NEEDED_ADDR A:0x4202304
y.create.l HWIO_MSS_CCP_IND_MOVE_SIZE_RMM_ADDR A:0x4202308
y.create.l HWIO_MSS_CCP_DIR_MOVE_SIZE_RMM_ADDR A:0x420230c
y.create.l HWIO_MSS_CCP_IND_MOVE_REQ_ADDR A:0x4202310
y.create.l HWIO_MSS_CCP_DIR_MOVE_REQ_ADDR A:0x4202314
y.create.l HWIO_MSS_CCP_CP_CLKEN_ADDR A:0x4202318
y.create.l HWIO_MSS_CCP_IND_INIT_ADDR A:0x420231c
y.create.l HWIO_MSS_CCP_DIR_INIT_ADDR A:0x4202320
y.create.l HWIO_MSS_CCP_TARGET_RTC_ADDR A:0x4202324
y.create.l HWIO_MSS_CCP_BREAKPOINT_ADDR A:0x4202328
y.create.l HWIO_MSS_CCP_BREAK_STATE_ADDR A:0x420232c
y.create.l HWIO_MSS_CCP_PROG_STATUS_ADDR A:0x4202330
y.create.l HWIO_MSS_CCP_G10_STATUS_ADDR A:0x4202334
y.create.l HWIO_MSS_CCP_G32_STATUS_ADDR A:0x4202338
y.create.l HWIO_MSS_CCP_G54_STATUS_ADDR A:0x420233c
y.create.l HWIO_MSS_CCP_G76_STATUS_ADDR A:0x4202340
y.create.l HWIO_MSS_CCP_G98_STATUS_ADDR A:0x4202344
y.create.l HWIO_MSS_CCP_GBA_STATUS_ADDR A:0x4202348
y.create.l HWIO_MSS_CCP_GDC_STATUS_ADDR A:0x420234c
y.create.l HWIO_MSS_CCP_P10_STATUS_ADDR A:0x4202350
y.create.l HWIO_MSS_CCP_P2_STATUS_ADDR A:0x4202354
y.create.l HWIO_MSS_CCP_GNSS_RTC_STATUS_ADDR A:0x4202358
y.create.l HWIO_MSS_CCP_RMM_IND_1_STATUS_ADDR A:0x420235c
y.create.l HWIO_MSS_CCP_RMM_IND_2_STATUS_ADDR A:0x4202360
y.create.l HWIO_MSS_CCP_RMM_DIR_1_STATUS_ADDR A:0x4202364
y.create.l HWIO_MSS_CCP_RMM_DIR_2_STATUS_ADDR A:0x4202368
y.create.l HWIO_MSS_CCP_IND_TEST_MOVE_ADDR A:0x420236c
y.create.l HWIO_MSS_CCP_DIR_TEST_MOVE_ADDR A:0x4202370
y.create.l HWIO_MSS_CCP_SM_CH_BANK_ADDR A:0x4202374
y.create.l HWIO_MSS_CCP_SM_BUF_LEN_STATUS_ADDR A:0x4202378
y.create.l HWIO_MSS_CCP_SM_CUR_BUF_LEN_STATUS_ADDR A:0x420237c
y.create.l HWIO_MSS_CCP_SM_CUR_BANK_STATUS_ADDR A:0x4202380
y.create.l HWIO_MSS_CCP_SM_TEST_MUX_ADDR A:0x4202384
y.create.l HWIO_MSS_CCP_STMR_RTC_STATUS_ADDR A:0x4202388
y.create.l HWIO_MSS_CCP_IRQ_GEN_ADDR A:0x420238c
y.create.l HWIO_MSS_CCP_GPIO_TO_DCP_ADDR A:0x4202390
y.create.l HWIO_MSS_CCP_GPIO_FROM_DCP_STATUS_ADDR A:0x4202394
y.create.l HWIO_MSS_CCP_RMM_CONFLICT_STATUS_ADDR A:0x4202398
y.create.l HWIO_MSS_CCP_SHARED_BUF_MODE_ADDR A:0x420239c
y.create.l HWIO_MSS_CCP_RMM_POINTER_INIT_ADDR A:0x42023a0
y.create.l HWIO_MSS_CCP_TRACE_SEL_ADDR A:0x42023a4
y.create.l HWIO_MSS_CCP_ADDR_BREAKPOINT_ADDR A:0x42023a8
y.create.l HWIO_MSS_CCP_DATA_BREAKPOINT_MASK_ADDR A:0x42023ac
y.create.l HWIO_MSS_CCP_DATA_BREAKPOINT_ADDR A:0x42023b0
y.create.l HWIO_MSS_CCP_PC_BREAKPOINT_ADDR A:0x42023b4
y.create.l HWIO_MSS_CCP_GREG_BREAKPOINT_MASK_ADDR A:0x42023b8
y.create.l HWIO_MSS_CCP_GREG_BREAKPOINT_ADDR A:0x42023bc
y.create.l HWIO_MSS_CCP_MISC_CNTRL_ADDR A:0x42023c0
y.create.l HWIO_MSS_RC_CONTROL_ADDR A:0x4202400
y.create.l HWIO_MSS_RC_B1_POLYNOMIAL_MASK_ADDR A:0x4202404
y.create.l HWIO_MSS_RC_RTC_PRELOAD_ADDR A:0x4202408
y.create.l HWIO_MSS_RC_RTC_PHASE_ADDR A:0x420240c
y.create.l HWIO_MSS_RC_TC_TXFR_CTL_ADDR A:0x4202410
y.create.l HWIO_MSS_RC_TC_TXFR_CFG0_ADDR A:0x4202414
y.create.l HWIO_MSS_RC_TC_TXFR_CFG1_ADDR A:0x4202418
y.create.l HWIO_MSS_RC_TC_TXFR_STATUS_ADDR A:0x420241c
y.create.l HWIO_MSS_RC_GNSS_RTC_STATUS_ADDR A:0x4202420
y.create.l HWIO_MSS_RC_NAV_TEST_BUS_ADDR A:0x4202424
y.create.l HWIO_MSS_RC_RTC_CONTROL_ADDR A:0x4202428
y.create.l HWIO_MSS_RC_PPSO_ASSERT_ADDR A:0x420242c
y.create.l HWIO_MSS_RC_PPSO_DEASSERT_ADDR A:0x4202430
y.create.l HWIO_MSS_RC_GPS_ON_ADDR A:0x4202434
y.create.l HWIO_MSS_RC_PPSI_RTC_ADDR A:0x4202438
y.create.l HWIO_MSS_RC_IRQ_STATUS_ADDR A:0x420243c
y.create.l HWIO_MSS_STMR_STATUS0_ADDR A:0x4202440
y.create.l HWIO_MSS_STMR_STATUS1_ADDR A:0x4202444
y.create.l HWIO_MSS_STMR_STATUS2_ADDR A:0x4202448
y.create.l HWIO_MSS_STMR_STATUS3_ADDR A:0x420244c
y.create.l HWIO_MSS_RC_TT_STATUS_ADDR A:0x4202450
y.create.l HWIO_MSS_RC_STMR_TRIG_CNT_VAL_ADDR A:0x4202454
y.create.l HWIO_MSS_RC_BLANKING_IRQ_EN_ADDR A:0x4202458
y.create.l HWIO_MSS_NQ_DEBUG_STATUS_ADDR A:0x420245c
y.create.l HWIO_MSS_RC_BLANKING_IRQ_STATUS_ADDR A:0x4202460
y.create.l HWIO_MSS_RC_BLANKING_SIGNAL_STATUS_ADDR A:0x4202464
y.create.l HWIO_MSS_RC_IRQ_STATUS1_ADDR A:0x4202468
y.create.l HWIO_MSS_RC_BLANKING_IRQ_STATUS1_ADDR A:0x420246c
y.create.l HWIO_MSS_SMI_MODE_ADDR A:0x4202500
y.create.l HWIO_MSS_SMI_SCH_MODE_ADDR A:0x4202504
y.create.l HWIO_MSS_SMI_BASEADDR1_BANK0_ADDR A:0x4202508
y.create.l HWIO_MSS_SMI_BASEADDR2_BANK0_ADDR A:0x420250c
y.create.l HWIO_MSS_SMI_BASEADDR3A_BANK0_ADDR A:0x4202510
y.create.l HWIO_MSS_SMI_BASEADDR3B_BANK0_ADDR A:0x4202514
y.create.l HWIO_MSS_SMI_BASEADDR3C_BANK0_ADDR A:0x4202518
y.create.l HWIO_MSS_SMI_BASEADDR4_ADDR A:0x4202520
y.create.l HWIO_MSS_SMI_BASEADDR1_BANK1_ADDR A:0x4202524
y.create.l HWIO_MSS_SMI_BASEADDR2_BANK1_ADDR A:0x4202528
y.create.l HWIO_MSS_SMI_BASEADDR3A_BANK1_ADDR A:0x420252c
y.create.l HWIO_MSS_SMI_BASEADDR3B_BANK1_ADDR A:0x4202530
y.create.l HWIO_MSS_SMI_BASEADDR3C_BANK1_ADDR A:0x4202534
y.create.l HWIO_MSS_SMI_BASEADDR2P_ADDR A:0x4202538
y.create.l HWIO_MSS_SMI_BLANK_CFG_ADDR A:0x420253c
y.create.l HWIO_MSS_SMI_BLANK_STATUS_ADDR A:0x4202540
y.create.l HWIO_MSS_SMI_BLANK_MONITOR_BP1_ADDR A:0x4202544
y.create.l HWIO_MSS_SMI_BLANK_MONITOR_BP2_ADDR A:0x4202548
y.create.l HWIO_MSS_SMI_BLANK_MONITOR_BP2P_ADDR A:0x420254c
y.create.l HWIO_MSS_SMI_BLANK_MONITOR_BP3_4_ADDR A:0x4202550
y.create.l HWIO_MSS_SMI_BIST_DETECTOR_0_ADDR A:0x4202554
y.create.l HWIO_MSS_SMI_BIST_DETECTOR_1_ADDR A:0x4202558
y.create.l HWIO_MSS_SMI_BIST_DETECTOR_2_ADDR A:0x420255c
y.create.l HWIO_MSS_SMI_BIST_DETECTOR_3_ADDR A:0x4202560
y.create.l HWIO_MSS_SMI_BIST_DETECTOR_4_ADDR A:0x4202564
y.create.l HWIO_MSS_SMI_BIST_DETECTOR_5_ADDR A:0x4202568
y.create.l HWIO_MSS_SMI_RSTRZN_CFG_ADDR A:0x420256c
y.create.l HWIO_MSS_SMI_RSTRZN_ADDR_ADDR A:0x4202570
y.create.l HWIO_MSS_SMI_RSTRZN_STATUS_ADDR A:0x4202574
y.create.l HWIO_MSS_DMAIP_CH0_LLP_ADDR A:0x4202610
y.create.l HWIO_MSS_DMAIP_CH0_CTL0_ADDR A:0x4202618
y.create.l HWIO_MSS_DMAIP_CH0_CTL1_ADDR A:0x420261c
y.create.l HWIO_MSS_DMAIP_CH0_CFG0_ADDR A:0x4202640
y.create.l HWIO_MSS_DMAIP_CH0_CFG1_ADDR A:0x4202644
y.create.l HWIO_MSS_DMAIP_CH1_LLP_ADDR A:0x4202668
y.create.l HWIO_MSS_DMAIP_CH1_CTL0_ADDR A:0x4202670
y.create.l HWIO_MSS_DMAIP_CH1_CTL1_ADDR A:0x4202674
y.create.l HWIO_MSS_DMAIP_CH1_CFG0_ADDR A:0x4202698
y.create.l HWIO_MSS_DMAIP_CH1_CFG1_ADDR A:0x420269c
y.create.l HWIO_MSS_DMAIP_CH2_LLP_ADDR A:0x42026c0
y.create.l HWIO_MSS_DMAIP_CH2_CTL0_ADDR A:0x42026c8
y.create.l HWIO_MSS_DMAIP_CH2_CTL1_ADDR A:0x42026cc
y.create.l HWIO_MSS_DMAIP_CH2_CFG0_ADDR A:0x42026f0
y.create.l HWIO_MSS_DMAIP_CH2_CFG1_ADDR A:0x42026f4
y.create.l HWIO_MSS_DMAIP_CH3_LLP_ADDR A:0x4202718
y.create.l HWIO_MSS_DMAIP_CH3_CTL0_ADDR A:0x4202720
y.create.l HWIO_MSS_DMAIP_CH3_CTL1_ADDR A:0x4202724
y.create.l HWIO_MSS_DMAIP_CH3_CFG0_ADDR A:0x4202748
y.create.l HWIO_MSS_DMAIP_CH3_CFG1_ADDR A:0x420274c
y.create.l HWIO_MSS_DMAIP_INT_MASKTFR_ADDR A:0x4202910
y.create.l HWIO_MSS_DMAIP_INT_MASKBLK_ADDR A:0x4202918
y.create.l HWIO_MSS_DMAIP_INT_MASKSRCTFR_ADDR A:0x4202920
y.create.l HWIO_MSS_DMAIP_INT_MASKDSTTFR_ADDR A:0x4202928
y.create.l HWIO_MSS_DMAIP_INT_MASKERR_ADDR A:0x4202930
y.create.l HWIO_MSS_DMAIP_CFGREG_ADDR A:0x4202998
y.create.l HWIO_MSS_DMAIP_CHEN_ADDR A:0x42029a0
y.create.l HWIO_MSS_DMACTRL_GLB_STATUS_ADDR A:0x4202a00
y.create.l HWIO_MSS_DMACTRL_GLB_CFG_ADDR A:0x4202a04
y.create.l HWIO_MSS_DMACTRL_EXT_MEM_BASE_ADDR_ADDR A:0x4202a10
y.create.l HWIO_MSS_DMACTRL_INT_MEM_BASE_ADDR_ADDR A:0x4202a14
y.create.l HWIO_MSS_DMACTRL_CACHE_BUF_PTR_ADDR A:0x4202a18
y.create.l HWIO_MSS_DMACTRL_LAST_ADDR_M0_ADDR A:0x4202a1c
y.create.l HWIO_MSS_DMACTRL_LAST_CTRL_M0_ADDR A:0x4202a20
y.create.l HWIO_MSS_DMACTRL_LAST_ADDR_M1_ADDR A:0x4202a24
y.create.l HWIO_MSS_DMACTRL_LAST_CTRL_M1_ADDR A:0x4202a28
y.create.l HWIO_MSS_DMACTRL_LAST_ADDR_M2_ADDR A:0x4202a2c
y.create.l HWIO_MSS_DMACTRL_LAST_CTRL_M2_ADDR A:0x4202a30
y.create.l HWIO_MSS_BUS_STATS_CTRL_ADDR A:0x4202a34
y.create.l HWIO_MSS_BUS_STATS_STATUS_ADDR A:0x4202a38
y.create.l HWIO_MSS_BUS_STATS_PRELOAD_ADDR A:0x4202a3c
y.create.l HWIO_MSS_DMACTRL_LAST_ADDR_M3_ADDR A:0x4202a40
y.create.l HWIO_MSS_DMACTRL_LAST_CTRL_M3_ADDR A:0x4202a44
y.create.l HWIO_MSS_DMACTRL_BUP_STATUS1_ADDR A:0x4202a48
y.create.l HWIO_MSS_DMACTRL_BUP_STATUS2_ADDR A:0x4202a4c
y.create.l HWIO_MSS_DMACTRL_BUP_STATUS3_ADDR A:0x4202a50
y.create.l HWIO_MSS_DMACTRL_BUP_STATUS4_ADDR A:0x4202a54
y.create.l HWIO_MSS_DMACTRL_BUP_STATUS5_ADDR A:0x4202a58
y.create.l HWIO_MSS_DMACTRL_BUP_STATUS6_ADDR A:0x4202a5c
y.create.l HWIO_MSS_DMACTRL_BUP_DBG_CTRL_ADDR A:0x4202a60
y.create.l HWIO_MSS_DMACTRL_NAVMEM_START_ADDR_ADDR A:0x4202a64
y.create.l HWIO_MSS_DMACTRL_NAVMEM_END_ADDR_ADDR A:0x4202a68
y.create.l HWIO_MSS_DMACTRL_NAVREG_START_ADDR_ADDR A:0x4202a6c
y.create.l HWIO_MSS_DMACTRL_NAVREG_END_ADDR_ADDR A:0x4202a70
y.create.l HWIO_MSS_DMACTRL_NAVCGM_START_ADDR_ADDR A:0x4202a74
y.create.l HWIO_MSS_DMACTRL_NAVCGM_END_ADDR_ADDR A:0x4202a78
y.create.l HWIO_MSS_DMACTRL_CH0_CMD1_START_ADDR_ADDR A:0x4202a80
y.create.l HWIO_MSS_DMACTRL_CH1_CMD1_START_ADDR_ADDR A:0x4202b00
y.create.l HWIO_MSS_DMACTRL_CH2_CMD1_START_ADDR_ADDR A:0x4202b80
y.create.l HWIO_MSS_DMACTRL_CH3_CMD1_START_ADDR_ADDR A:0x4202c00
y.create.l HWIO_MSS_DMACTRL_CH0_CMD2_START_ADDR_ADDR A:0x4202a84
y.create.l HWIO_MSS_DMACTRL_CH1_CMD2_START_ADDR_ADDR A:0x4202b04
y.create.l HWIO_MSS_DMACTRL_CH2_CMD2_START_ADDR_ADDR A:0x4202b84
y.create.l HWIO_MSS_DMACTRL_CH3_CMD2_START_ADDR_ADDR A:0x4202c04
y.create.l HWIO_MSS_DMACTRL_CH0_CMD3_START_ADDR_ADDR A:0x4202a88
y.create.l HWIO_MSS_DMACTRL_CH1_CMD3_START_ADDR_ADDR A:0x4202b08
y.create.l HWIO_MSS_DMACTRL_CH2_CMD3_START_ADDR_ADDR A:0x4202b88
y.create.l HWIO_MSS_DMACTRL_CH3_CMD3_START_ADDR_ADDR A:0x4202c08
y.create.l HWIO_MSS_DMACTRL_CH0_CACHE_ADDR_ADDR A:0x4202a90
y.create.l HWIO_MSS_DMACTRL_CH1_CACHE_ADDR_ADDR A:0x4202b10
y.create.l HWIO_MSS_DMACTRL_CH2_CACHE_ADDR_ADDR A:0x4202b90
y.create.l HWIO_MSS_DMACTRL_CH3_CACHE_ADDR_ADDR A:0x4202c10
y.create.l HWIO_MSS_DMACTRL_CH0_BUF_ADDR_ADDR A:0x4202a94
y.create.l HWIO_MSS_DMACTRL_CH1_BUF_ADDR_ADDR A:0x4202b14
y.create.l HWIO_MSS_DMACTRL_CH2_BUF_ADDR_ADDR A:0x4202b94
y.create.l HWIO_MSS_DMACTRL_CH3_BUF_ADDR_ADDR A:0x4202c14
y.create.l HWIO_MSS_DMACTRL_CH0_CTL0_INIT_DATA_ADDR A:0x4202a98
y.create.l HWIO_MSS_DMACTRL_CH1_CTL0_INIT_DATA_ADDR A:0x4202b18
y.create.l HWIO_MSS_DMACTRL_CH2_CTL0_INIT_DATA_ADDR A:0x4202b98
y.create.l HWIO_MSS_DMACTRL_CH3_CTL0_INIT_DATA_ADDR A:0x4202c18
y.create.l HWIO_MSS_DMACTRL_CH0_CTL1_INIT_DATA_ADDR A:0x4202a9c
y.create.l HWIO_MSS_DMACTRL_CH1_CTL1_INIT_DATA_ADDR A:0x4202b1c
y.create.l HWIO_MSS_DMACTRL_CH2_CTL1_INIT_DATA_ADDR A:0x4202b9c
y.create.l HWIO_MSS_DMACTRL_CH3_CTL1_INIT_DATA_ADDR A:0x4202c1c
y.create.l HWIO_MSS_DMACTRL_CH0_CMD_READY_ADDR A:0x4202aa0
y.create.l HWIO_MSS_DMACTRL_CH1_CMD_READY_ADDR A:0x4202b20
y.create.l HWIO_MSS_DMACTRL_CH2_CMD_READY_ADDR A:0x4202ba0
y.create.l HWIO_MSS_DMACTRL_CH3_CMD_READY_ADDR A:0x4202c20
y.create.l HWIO_MSS_DMACTRL_CH0_CTL_ADDR A:0x4202aa4
y.create.l HWIO_MSS_DMACTRL_CH1_CTL_ADDR A:0x4202b24
y.create.l HWIO_MSS_DMACTRL_CH2_CTL_ADDR A:0x4202ba4
y.create.l HWIO_MSS_DMACTRL_CH3_CTL_ADDR A:0x4202c24
y.create.l HWIO_MSS_DMACTRL_CH0_CFG_ADDR A:0x4202aa8
y.create.l HWIO_MSS_DMACTRL_CH1_CFG_ADDR A:0x4202b28
y.create.l HWIO_MSS_DMACTRL_CH2_CFG_ADDR A:0x4202ba8
y.create.l HWIO_MSS_DMACTRL_CH3_CFG_ADDR A:0x4202c28
y.create.l HWIO_MSS_DMACTRL_CH0_STATUS1_ADDR A:0x4202ab0
y.create.l HWIO_MSS_DMACTRL_CH1_STATUS1_ADDR A:0x4202b30
y.create.l HWIO_MSS_DMACTRL_CH2_STATUS1_ADDR A:0x4202bb0
y.create.l HWIO_MSS_DMACTRL_CH3_STATUS1_ADDR A:0x4202c30
y.create.l HWIO_MSS_DMACTRL_CH0_STATUS2_ADDR A:0x4202ab4
y.create.l HWIO_MSS_DMACTRL_CH1_STATUS2_ADDR A:0x4202b34
y.create.l HWIO_MSS_DMACTRL_CH2_STATUS2_ADDR A:0x4202bb4
y.create.l HWIO_MSS_DMACTRL_CH3_STATUS2_ADDR A:0x4202c34
y.create.l HWIO_MSS_DMACTRL_CH0_CACHE_DATA_ADDR A:0x4202ab8
y.create.l HWIO_MSS_DMACTRL_CH1_CACHE_DATA_ADDR A:0x4202b38
y.create.l HWIO_MSS_DMACTRL_CH2_CACHE_DATA_ADDR A:0x4202bb8
y.create.l HWIO_MSS_DMACTRL_CH3_CACHE_DATA_ADDR A:0x4202c38
y.create.l HWIO_MSS_DMACTRL_CH0_BUF_DATA_ADDR A:0x4202abc
y.create.l HWIO_MSS_DMACTRL_CH1_BUF_DATA_ADDR A:0x4202b3c
y.create.l HWIO_MSS_DMACTRL_CH2_BUF_DATA_ADDR A:0x4202bbc
y.create.l HWIO_MSS_DMACTRL_CH3_BUF_DATA_ADDR A:0x4202c3c
y.create.l HWIO_MSS_DMACTRL_CH0_LAST_SRC_ADDR_ADDR A:0x4202ac0
y.create.l HWIO_MSS_DMACTRL_CH1_LAST_SRC_ADDR_ADDR A:0x4202b40
y.create.l HWIO_MSS_DMACTRL_CH2_LAST_SRC_ADDR_ADDR A:0x4202bc0
y.create.l HWIO_MSS_DMACTRL_CH3_LAST_SRC_ADDR_ADDR A:0x4202c40
y.create.l HWIO_MSS_DMACTRL_CH0_LAST_DST_ADDR_ADDR A:0x4202ac4
y.create.l HWIO_MSS_DMACTRL_CH1_LAST_DST_ADDR_ADDR A:0x4202b44
y.create.l HWIO_MSS_DMACTRL_CH2_LAST_DST_ADDR_ADDR A:0x4202bc4
y.create.l HWIO_MSS_DMACTRL_CH3_LAST_DST_ADDR_ADDR A:0x4202c44
y.create.l HWIO_MSS_DMACTRL_CH0_LAST_CC_W0_ADDR A:0x4202ac8
y.create.l HWIO_MSS_DMACTRL_CH1_LAST_CC_W0_ADDR A:0x4202b48
y.create.l HWIO_MSS_DMACTRL_CH2_LAST_CC_W0_ADDR A:0x4202bc8
y.create.l HWIO_MSS_DMACTRL_CH3_LAST_CC_W0_ADDR A:0x4202c48
y.create.l HWIO_MSS_DMACTRL_CH0_LAST_CC_W1_ADDR A:0x4202acc
y.create.l HWIO_MSS_DMACTRL_CH1_LAST_CC_W1_ADDR A:0x4202b4c
y.create.l HWIO_MSS_DMACTRL_CH2_LAST_CC_W1_ADDR A:0x4202bcc
y.create.l HWIO_MSS_DMACTRL_CH3_LAST_CC_W1_ADDR A:0x4202c4c
y.create.l HWIO_MSS_DMACTRL_CH0_LAST_CC_W2_ADDR A:0x4202ad0
y.create.l HWIO_MSS_DMACTRL_CH1_LAST_CC_W2_ADDR A:0x4202b50
y.create.l HWIO_MSS_DMACTRL_CH2_LAST_CC_W2_ADDR A:0x4202bd0
y.create.l HWIO_MSS_DMACTRL_CH3_LAST_CC_W2_ADDR A:0x4202c50
y.create.l HWIO_MSS_DMACTRL_CH0_STATS_MIN_ADDR A:0x4202ad4
y.create.l HWIO_MSS_DMACTRL_CH1_STATS_MIN_ADDR A:0x4202b54
y.create.l HWIO_MSS_DMACTRL_CH2_STATS_MIN_ADDR A:0x4202bd4
y.create.l HWIO_MSS_DMACTRL_CH3_STATS_MIN_ADDR A:0x4202c54
y.create.l HWIO_MSS_DMACTRL_CH0_STATS_MAX_ADDR A:0x4202ad8
y.create.l HWIO_MSS_DMACTRL_CH1_STATS_MAX_ADDR A:0x4202b58
y.create.l HWIO_MSS_DMACTRL_CH2_STATS_MAX_ADDR A:0x4202bd8
y.create.l HWIO_MSS_DMACTRL_CH3_STATS_MAX_ADDR A:0x4202c58
y.create.l HWIO_MSS_DMACTRL_CH0_STATS_AVG_ADDR A:0x4202adc
y.create.l HWIO_MSS_DMACTRL_CH1_STATS_AVG_ADDR A:0x4202b5c
y.create.l HWIO_MSS_DMACTRL_CH2_STATS_AVG_ADDR A:0x4202bdc
y.create.l HWIO_MSS_DMACTRL_CH3_STATS_AVG_ADDR A:0x4202c5c
y.create.l HWIO_MSS_DMACTRL_CH0_STATS_CUR_ADDR A:0x4202ae0
y.create.l HWIO_MSS_DMACTRL_CH1_STATS_CUR_ADDR A:0x4202b60
y.create.l HWIO_MSS_DMACTRL_CH2_STATS_CUR_ADDR A:0x4202be0
y.create.l HWIO_MSS_DMACTRL_CH3_STATS_CUR_ADDR A:0x4202c60
y.create.l HWIO_MSS_DMACTRL_CH0_STATUS3_ADDR A:0x4202ae4
y.create.l HWIO_MSS_DMACTRL_CH1_STATUS3_ADDR A:0x4202b64
y.create.l HWIO_MSS_DMACTRL_CH2_STATUS3_ADDR A:0x4202be4
y.create.l HWIO_MSS_DMACTRL_CH3_STATUS3_ADDR A:0x4202c64
y.create.l HWIO_MSS_DMACTRL_NAVEGM_START_ADDR_ADDR A:0x4202ae8
y.create.l HWIO_MSS_DMACTRL_NAVEGM_END_ADDR_ADDR A:0x4202aec
y.create.l HWIO_MSS_DMACTRL_NAVCPRM_START_ADDR_ADDR A:0x4202af8
y.create.l HWIO_MSS_DMACTRL_NAVCPRM_END_ADDR_ADDR A:0x4202afc
y.create.l HWIO_MSS_DMACTRL_CH0_STATS_MAX_CMD0_ADDR_ADDR A:0x4202c80
y.create.l HWIO_MSS_DMACTRL_CH0_STATS_MAX_CMD1_ADDR_ADDR A:0x4202c84
y.create.l HWIO_MSS_DMACTRL_CH0_STATS_MAX_CMD2_ADDR_ADDR A:0x4202c88
y.create.l HWIO_MSS_DMACTRL_CH0_STATS_MAX_CMD_FLAG_ADDR_ADDR A:0x4202c8c
y.create.l HWIO_MSS_DMACTRL_CH0_STATS_MAX_CMD_CNTR_ADDR_ADDR A:0x4202c90
y.create.l HWIO_MSS_DMACTRL_CH1_STATS_MAX_CMD0_ADDR_ADDR A:0x4202c94
y.create.l HWIO_MSS_DMACTRL_CH1_STATS_MAX_CMD1_ADDR_ADDR A:0x4202c98
y.create.l HWIO_MSS_DMACTRL_CH1_STATS_MAX_CMD2_ADDR_ADDR A:0x4202c9c
y.create.l HWIO_MSS_DMACTRL_CH1_STATS_MAX_CMD_FLAG_ADDR_ADDR A:0x4202ca0
y.create.l HWIO_MSS_DMACTRL_CH1_STATS_MAX_CMD_CNTR_ADDR_ADDR A:0x4202ca4
y.create.l HWIO_MSS_DMACTRL_CH2_STATS_MAX_CMD0_ADDR_ADDR A:0x4202ca8
y.create.l HWIO_MSS_DMACTRL_CH2_STATS_MAX_CMD1_ADDR_ADDR A:0x4202cac
y.create.l HWIO_MSS_DMACTRL_CH2_STATS_MAX_CMD2_ADDR_ADDR A:0x4202cb0
y.create.l HWIO_MSS_DMACTRL_CH2_STATS_MAX_CMD_FLAG_ADDR_ADDR A:0x4202cb4
y.create.l HWIO_MSS_DMACTRL_CH2_STATS_MAX_CMD_CNTR_ADDR_ADDR A:0x4202cb8
y.create.l HWIO_MSS_DMACTRL_CH3_STATS_MAX_CMD0_ADDR_ADDR A:0x4202cbc
y.create.l HWIO_MSS_DMACTRL_CH3_STATS_MAX_CMD1_ADDR_ADDR A:0x4202cc0
y.create.l HWIO_MSS_DMACTRL_CH3_STATS_MAX_CMD2_ADDR_ADDR A:0x4202cc4
y.create.l HWIO_MSS_DMACTRL_CH3_STATS_MAX_CMD_FLAG_ADDR_ADDR A:0x4202cc8
y.create.l HWIO_MSS_DMACTRL_CH3_STATS_MAX_CMD_CNTR_ADDR_ADDR A:0x4202ccc
y.create.l HWIO_MSS_DMACTRL_CH0_STATS_CUR_CMD_FLG0_ADDR_ADDR A:0x4202ce0
y.create.l HWIO_MSS_DMACTRL_CH0_STATS_CUR_CMD_FLG1_ADDR_ADDR A:0x4202ce8
y.create.l HWIO_MSS_DMACTRL_CH0_STATS_CUR_CMD_FLG2_ADDR_ADDR A:0x4202cf0
y.create.l HWIO_MSS_DMACTRL_CH0_STATS_CUR_CMD_FLG3_ADDR_ADDR A:0x4202cf8
y.create.l HWIO_MSS_DMACTRL_CH1_STATS_CUR_CMD_FLG0_ADDR_ADDR A:0x4202d20
y.create.l HWIO_MSS_DMACTRL_CH1_STATS_CUR_CMD_FLG1_ADDR_ADDR A:0x4202d28
y.create.l HWIO_MSS_DMACTRL_CH1_STATS_CUR_CMD_FLG2_ADDR_ADDR A:0x4202d30
y.create.l HWIO_MSS_DMACTRL_CH1_STATS_CUR_CMD_FLG3_ADDR_ADDR A:0x4202d38
y.create.l HWIO_MSS_DMACTRL_CH2_STATS_CUR_CMD_FLG0_ADDR_ADDR A:0x4202d60
y.create.l HWIO_MSS_DMACTRL_CH2_STATS_CUR_CMD_FLG1_ADDR_ADDR A:0x4202d68
y.create.l HWIO_MSS_DMACTRL_CH2_STATS_CUR_CMD_FLG2_ADDR_ADDR A:0x4202d70
y.create.l HWIO_MSS_DMACTRL_CH2_STATS_CUR_CMD_FLG3_ADDR_ADDR A:0x4202d78
y.create.l HWIO_MSS_DMACTRL_CH3_STATS_CUR_CMD_FLG0_ADDR_ADDR A:0x4202da0
y.create.l HWIO_MSS_DMACTRL_CH3_STATS_CUR_CMD_FLG1_ADDR_ADDR A:0x4202da8
y.create.l HWIO_MSS_DMACTRL_CH3_STATS_CUR_CMD_FLG2_ADDR_ADDR A:0x4202db0
y.create.l HWIO_MSS_DMACTRL_CH3_STATS_CUR_CMD_FLG3_ADDR_ADDR A:0x4202db8
y.create.l HWIO_MSS_DMACTRL_CH0_STATS_CUR_CMD_CNTR0_ADDR_ADDR A:0x4202ce4
y.create.l HWIO_MSS_DMACTRL_CH0_STATS_CUR_CMD_CNTR1_ADDR_ADDR A:0x4202cec
y.create.l HWIO_MSS_DMACTRL_CH0_STATS_CUR_CMD_CNTR2_ADDR_ADDR A:0x4202cf4
y.create.l HWIO_MSS_DMACTRL_CH0_STATS_CUR_CMD_CNTR3_ADDR_ADDR A:0x4202cfc
y.create.l HWIO_MSS_DMACTRL_CH1_STATS_CUR_CMD_CNTR0_ADDR_ADDR A:0x4202d24
y.create.l HWIO_MSS_DMACTRL_CH1_STATS_CUR_CMD_CNTR1_ADDR_ADDR A:0x4202d2c
y.create.l HWIO_MSS_DMACTRL_CH1_STATS_CUR_CMD_CNTR2_ADDR_ADDR A:0x4202d34
y.create.l HWIO_MSS_DMACTRL_CH1_STATS_CUR_CMD_CNTR3_ADDR_ADDR A:0x4202d3c
y.create.l HWIO_MSS_DMACTRL_CH2_STATS_CUR_CMD_CNTR0_ADDR_ADDR A:0x4202d64
y.create.l HWIO_MSS_DMACTRL_CH2_STATS_CUR_CMD_CNTR1_ADDR_ADDR A:0x4202d6c
y.create.l HWIO_MSS_DMACTRL_CH2_STATS_CUR_CMD_CNTR2_ADDR_ADDR A:0x4202d74
y.create.l HWIO_MSS_DMACTRL_CH2_STATS_CUR_CMD_CNTR3_ADDR_ADDR A:0x4202d7c
y.create.l HWIO_MSS_DMACTRL_CH3_STATS_CUR_CMD_CNTR0_ADDR_ADDR A:0x4202da4
y.create.l HWIO_MSS_DMACTRL_CH3_STATS_CUR_CMD_CNTR1_ADDR_ADDR A:0x4202dac
y.create.l HWIO_MSS_DMACTRL_CH3_STATS_CUR_CMD_CNTR2_ADDR_ADDR A:0x4202db4
y.create.l HWIO_MSS_DMACTRL_CH3_STATS_CUR_CMD_CNTR3_ADDR_ADDR A:0x4202dbc
y.create.l HWIO_MSS_XFR_SIZE_OPTION_0_ADDR A:0x4202e00
y.create.l HWIO_MSS_XFR_SIZE_OPTION_1_ADDR A:0x4202e04
y.create.l HWIO_MSS_XFR_SIZE_OPTION_2_ADDR A:0x4202e08
y.create.l HWIO_MSS_XFR_SIZE_OPTION_3_ADDR A:0x4202e0c
y.create.l HWIO_MSS_XFR_SIZE_OPTION_4_ADDR A:0x4202e10
y.create.l HWIO_MSS_XFR_SIZE_OPTION_5_ADDR A:0x4202e14
y.create.l HWIO_MSS_XFR_SIZE_OPTION_6_ADDR A:0x4202e18
y.create.l HWIO_MSS_XFR_SIZE_OPTION_7_ADDR A:0x4202e1c
y.create.l HWIO_MSS_XFR_SIZE_OPTION_8_ADDR A:0x4202e20
y.create.l HWIO_MSS_XFR_SIZE_OPTION_9_ADDR A:0x4202e24
y.create.l HWIO_MSS_SM_ADDR_BEGIN_ADDR A:0x4240000
y.create.l HWIO_MSS_SM_ADDR_END_ADDR A:0x424b3fc
y.create.l HWIO_MSS_CDM_ADDR_BEGIN_ADDR A:0x4210000
y.create.l HWIO_MSS_CDM_ADDR_END_ADDR A:0x4213ffc
y.create.l HWIO_MSS_CPRM_ADDR_BEGIN_ADDR A:0x42c0000
y.create.l HWIO_MSS_CPRM_ADDR_END_ADDR A:0x42c33fc
y.create.l HWIO_MSS_CCM_ADDR_BEGIN_ADDR A:0x4214000
y.create.l HWIO_MSS_CCM_ADDR_END_ADDR A:0x42159fc
y.create.l HWIO_MSS_CVM_ADDR_BEGIN_ADDR A:0x4218000
y.create.l HWIO_MSS_CVM_ADDR_END_ADDR A:0x42199fc
y.create.l HWIO_MSS_CPM_ADDR_BEGIN_ADDR A:0x421c000
y.create.l HWIO_MSS_CPM_ADDR_END_ADDR A:0x421d9fc
y.create.l HWIO_MSS_CCM_START1_CMD_ADDR A:0x4214000
y.create.l HWIO_MSS_CCM_START2_CMD_ADDR A:0x4214004
y.create.l HWIO_MSS_CCM_WORD1_CMD_ADDR A:0x4214008
y.create.l HWIO_MSS_CCM_WORD2_CMD_ADDR A:0x421400c
y.create.l HWIO_MSS_CCM_WORD3_CMD_ADDR A:0x4214010
y.create.l HWIO_MSS_CCM_WORD4_CMD_ADDR A:0x4214014
y.create.l HWIO_MSS_CCM_WORD5_CMD_ADDR A:0x4214018
y.create.l HWIO_MSS_CCM_WORD6_CMD_ADDR A:0x421401c
y.create.l HWIO_MSS_CCM_WORD7_CMD_ADDR A:0x4214020
y.create.l HWIO_MSS_CCM_END_CMD_ADDR A:0x4214024
y.create.l HWIO_MSS_CCM_LOAD_CMD_ADDR A:0x42147e0
y.create.l HWIO_MSS_CCM_DATA_CODE_BASE_CMD_ADDR A:0x42147e4
y.create.l HWIO_MSS_CCM_PILOT_CODE_BASE_CMD_ADDR A:0x42147e8
y.create.l HWIO_MSS_CCM_SEQ_NUMBER_STATUS_ADDR A:0x42147ec
y.create.l HWIO_MSS_CCM_DONE_RTC_STATUS_ADDR A:0x42147f0
y.create.l HWIO_MSS_DP_GLOBAL_CTL_ADDR A:0x4202000
y.create.l HWIO_MSS_DP_TC_CTL_ADDR A:0x4202004
y.create.l HWIO_MSS_DP_TC_STATUS_ADDR A:0x4202008
y.create.l HWIO_MSS_DP_BIN0_BLOCK_EXP_BIAS_ADDR A:0x420200c
y.create.l HWIO_MSS_DP_BIN1_BLOCK_EXP_BIAS_ADDR A:0x4202010
y.create.l HWIO_MSS_DP_BIN2_BLOCK_EXP_BIAS_ADDR A:0x4202014
y.create.l HWIO_MSS_DP_BIN3_BLOCK_EXP_BIAS_ADDR A:0x4202018
y.create.l HWIO_MSS_DP_BIN4_BLOCK_EXP_BIAS_ADDR A:0x420201c
y.create.l HWIO_MSS_DP_BIN5_BLOCK_EXP_BIAS_ADDR A:0x4202020
y.create.l HWIO_MSS_DP_BIN6_BLOCK_EXP_BIAS_ADDR A:0x4202024
y.create.l HWIO_MSS_DP_BIN7_BLOCK_EXP_BIAS_ADDR A:0x4202028
y.create.l HWIO_MSS_DP_BIN8_BLOCK_EXP_BIAS_ADDR A:0x420202c
y.create.l HWIO_MSS_DP_BIN9_BLOCK_EXP_BIAS_ADDR A:0x4202030
y.create.l HWIO_MSS_DP_MEM_START_ADDR_ADDR A:0x420205c
y.create.l HWIO_MSS_DP_CTL1_ADDR A:0x4202060
y.create.l HWIO_MSS_DP_CTL2_ADDR A:0x4202064
y.create.l HWIO_MSS_DP_CTL3_ADDR A:0x4202068
y.create.l HWIO_MSS_DP_CTL4_ADDR A:0x420206c
y.create.l HWIO_MSS_DP_TMPM_START_ADDR_ADDR A:0x4202070
y.create.l HWIO_MSS_DP_START_COMMAND_ADDR A:0x4202074
y.create.l HWIO_MSS_DP_GRID_MAX_STATUS_ADDR A:0x4202078
y.create.l HWIO_MSS_DP_BIN0_MAX_MIN_STATUS_ADDR A:0x420207c
y.create.l HWIO_MSS_DP_BIN1_MAX_MIN_STATUS_ADDR A:0x4202080
y.create.l HWIO_MSS_DP_BIN2_MAX_MIN_STATUS_ADDR A:0x4202084
y.create.l HWIO_MSS_DP_BIN3_MAX_MIN_STATUS_ADDR A:0x4202088
y.create.l HWIO_MSS_DP_BIN4_MAX_MIN_STATUS_ADDR A:0x420208c
y.create.l HWIO_MSS_DP_BIN5_MAX_MIN_STATUS_ADDR A:0x4202090
y.create.l HWIO_MSS_DP_BIN6_MAX_MIN_STATUS_ADDR A:0x4202094
y.create.l HWIO_MSS_DP_BIN7_MAX_MIN_STATUS_ADDR A:0x4202098
y.create.l HWIO_MSS_DP_BIN8_MAX_MIN_STATUS_ADDR A:0x420209c
y.create.l HWIO_MSS_DP_BIN9_MAX_MIN_STATUS_ADDR A:0x42020a0
y.create.l HWIO_MSS_DP_STATUS_ADDR A:0x42020cc
y.create.l HWIO_MSS_DP_DCP_BREAKPOINT_ADDR A:0x42020d0
y.create.l HWIO_MSS_DP_DCP_BREAK_STATE_ADDR A:0x42020d4
y.create.l HWIO_MSS_DP_DCP_PROG_STATUS_ADDR A:0x42020d8
y.create.l HWIO_MSS_DP_DCP_G10_STATUS_ADDR A:0x42020dc
y.create.l HWIO_MSS_DP_DCP_G32_STATUS_ADDR A:0x42020e0
y.create.l HWIO_MSS_DP_DCP_G54_STATUS_ADDR A:0x42020e4
y.create.l HWIO_MSS_DP_DCP_G76_STATUS_ADDR A:0x42020e8
y.create.l HWIO_MSS_DP_DCP_G98_STATUS_ADDR A:0x42020ec
y.create.l HWIO_MSS_DP_DCP_GBA_STATUS_ADDR A:0x42020f0
y.create.l HWIO_MSS_DP_DCP_GDC_STATUS_ADDR A:0x42020f4
y.create.l HWIO_MSS_DP_DCP_P10_STATUS_ADDR A:0x42020f8
y.create.l HWIO_MSS_DP_DCP_P2_STATUS_ADDR A:0x42020fc
y.create.l HWIO_MSS_DP_NUMERATOR_ADDR A:0x4202100
y.create.l HWIO_MSS_DP_DENOMINATOR_ADDR A:0x4202104
y.create.l HWIO_MSS_DP_OUT_DIV_STATUS_ADDR A:0x4202108
y.create.l HWIO_MSS_DP_PD_CTL1_ADDR A:0x420210c
y.create.l HWIO_MSS_DP_PD_CTL2_ADDR A:0x4202110
y.create.l HWIO_MSS_DP_INPUT_NOISE_ADDR A:0x4202114
y.create.l HWIO_MSS_DP_SORT_NOISE_0_STATUS_ADDR A:0x4202118
y.create.l HWIO_MSS_DP_SORT_NOISE_1_STATUS_ADDR A:0x420211c
y.create.l HWIO_MSS_DP_SORT_NOISE_2_STATUS_ADDR A:0x4202120
y.create.l HWIO_MSS_DP_SORT_NOISE_3_STATUS_ADDR A:0x4202124
y.create.l HWIO_MSS_DP_SORT_NOISE_4_STATUS_ADDR A:0x4202128
y.create.l HWIO_MSS_DP_SORT_NOISE_5_STATUS_ADDR A:0x420212c
y.create.l HWIO_MSS_DP_SORT_NOISE_6_STATUS_ADDR A:0x4202130
y.create.l HWIO_MSS_DP_SORT_NOISE_7_STATUS_ADDR A:0x4202134
y.create.l HWIO_MSS_DP_SORT_NOISE_8_STATUS_ADDR A:0x4202138
y.create.l HWIO_MSS_DP_SORT_NOISE_9_STATUS_ADDR A:0x420213c
y.create.l HWIO_MSS_DP_SORT_MAX_10_STATUS_ADDR A:0x4202168
y.create.l HWIO_MSS_DP_SORT_MAX_32_STATUS_ADDR A:0x420216c
y.create.l HWIO_MSS_DP_SORT_MAX_54_STATUS_ADDR A:0x4202170
y.create.l HWIO_MSS_DP_SORT_MAX_76_STATUS_ADDR A:0x4202174
y.create.l HWIO_MSS_DP_SORT_MAX_98_STATUS_ADDR A:0x4202178
y.create.l HWIO_MSS_DP_SORT_MAX_BA_STATUS_ADDR A:0x420217c
y.create.l HWIO_MSS_DP_SORT_MAX_DC_STATUS_ADDR A:0x4202180
y.create.l HWIO_MSS_DP_SORT_MAX_FE_STATUS_ADDR A:0x4202184
y.create.l HWIO_MSS_DP_SUM_MAX_MAG_STATUS_ADDR A:0x4202188
y.create.l HWIO_MSS_DP_SORT_MIN_10_STATUS_ADDR A:0x420218c
y.create.l HWIO_MSS_DP_SORT_MIN_32_STATUS_ADDR A:0x4202190
y.create.l HWIO_MSS_DP_SORT_MIN_54_STATUS_ADDR A:0x4202194
y.create.l HWIO_MSS_DP_SORT_MIN_76_STATUS_ADDR A:0x4202198
y.create.l HWIO_MSS_DP_SORT_MIN_98_STATUS_ADDR A:0x420219c
y.create.l HWIO_MSS_DP_SORT_MIN_BA_STATUS_ADDR A:0x42021a0
y.create.l HWIO_MSS_DP_SORT_MIN_DC_STATUS_ADDR A:0x42021a4
y.create.l HWIO_MSS_DP_SORT_MIN_FE_STATUS_ADDR A:0x42021a8
y.create.l HWIO_MSS_DP_SUM_MIN_MAG_STATUS_ADDR A:0x42021ac
y.create.l HWIO_MSS_DP_FREQ_BIN_NOISE_SUM_STATUS_ADDR A:0x42021b0
y.create.l HWIO_MSS_DP_FREQ_BIN_NOISE_CNT_STATUS_ADDR A:0x42021b4
y.create.l HWIO_MSS_DP_SUM_ENERGY_STATUS_ADDR A:0x42021b8
y.create.l HWIO_MSS_DP_SUM_ENERGY_NOISE_STATUS_ADDR A:0x42021bc
y.create.l HWIO_MSS_DP_MAG_PEAK_CANDIDATE_10_STATUS_ADDR A:0x42021c0
y.create.l HWIO_MSS_DP_MAG_PEAK_CANDIDATE_32_STATUS_ADDR A:0x42021c4
y.create.l HWIO_MSS_DP_MAG_PEAK_CANDIDATE_54_STATUS_ADDR A:0x42021c8
y.create.l HWIO_MSS_DP_IDX_PEAK_CANDIDATE_30_STATUS_ADDR A:0x42021cc
y.create.l HWIO_MSS_DP_IDX_PEAK_CANDIDATE_54_STATUS_ADDR A:0x42021d0
y.create.l HWIO_MSS_DP_GNSS_RTC_STATUS_ADDR A:0x42021d4
y.create.l HWIO_MSS_DP_STMR_RTC_STATUS_ADDR A:0x42021d8
y.create.l HWIO_MSS_DP_DCP_IRQ_GEN_ADDR A:0x42021dc
y.create.l HWIO_MSS_DP_DCP_GPIO_TO_CCP_ADDR A:0x42021e0
y.create.l HWIO_MSS_DP_DCP_GPIO_FROM_CCP_STATUS_ADDR A:0x42021e4
y.create.l HWIO_MSS_DP_DCP_ADDR_BREAKPOINT_ADDR A:0x42021e8
y.create.l HWIO_MSS_DP_DCP_DATA_BREAKPOINT_MASK_ADDR A:0x42021ec
y.create.l HWIO_MSS_DP_DCP_DATA_BREAKPOINT_ADDR A:0x42021f0
y.create.l HWIO_MSS_DP_DCP_PC_BREAKPOINT_ADDR A:0x42021f4
y.create.l HWIO_MSS_DP_DCP_GREG_BREAKPOINT_MASK_ADDR A:0x42021f8
y.create.l HWIO_MSS_DP_DCP_GREG_BREAKPOINT_ADDR A:0x42021fc
y.create.l HWIO_MSS_DP_DCP_MISC_CNTRL_ADDR A:0x4202200
y.create.l HWIO_MSS_DP_DCP_TRACE_SEL_ADDR A:0x4202204
y.create.l HWIO_MSS_DP_CGMA_ADDR_BEGIN_ADDR A:0x4284000
y.create.l HWIO_MSS_DP_CGMA_ADDR_END_ADDR A:0x42859fc
y.create.l HWIO_MSS_DP_CGMB_ADDR_BEGIN_ADDR A:0x4288000
y.create.l HWIO_MSS_DP_CGMB_ADDR_END_ADDR A:0x42899fc
y.create.l HWIO_MSS_DP_EGMA_ADDR_BEGIN_ADDR A:0x428c000
y.create.l HWIO_MSS_DP_EGMA_ADDR_END_ADDR A:0x428e9fc
y.create.l HWIO_MSS_DP_EGMB_ADDR_BEGIN_ADDR A:0x4290000
y.create.l HWIO_MSS_DP_EGMB_ADDR_END_ADDR A:0x42929fc
y.create.l HWIO_MSS_DP_TMPM_ADDR_BEGIN_ADDR A:0x4294000
y.create.l HWIO_MSS_DP_TMPM_ADDR_END_ADDR A:0x42967fc
y.create.l HWIO_MSS_DP_DCM_ADDR_BEGIN_ADDR A:0x4298000
y.create.l HWIO_MSS_DP_DCM_ADDR_END_ADDR A:0x42999fc
y.create.l HWIO_MSS_DP_DVM_ADDR_BEGIN_ADDR A:0x429c000
y.create.l HWIO_MSS_DP_DVM_ADDR_END_ADDR A:0x429e9fc
y.create.l HWIO_MSS_DP_DPM_ADDR_BEGIN_ADDR A:0x42a0000
y.create.l HWIO_MSS_DP_DPM_ADDR_END_ADDR A:0x42a49fc
y.create.l HWIO_MSS_DP_PDM1_ADDR_BEGIN_ADDR A:0x42a6000
y.create.l HWIO_MSS_DP_PDM1_ADDR_END_ADDR A:0x42a61fc
y.create.l HWIO_MSS_DP_PDM2_ADDR_BEGIN_ADDR A:0x42a6200
y.create.l HWIO_MSS_DP_PDM2_ADDR_END_ADDR A:0x42a63fc
y.create.l HWIO_MSS_DCM_START_CMD_ADDR A:0x4298000
y.create.l HWIO_MSS_DCM_WORD1_CMD_ADDR A:0x4298004
y.create.l HWIO_MSS_DCM_WORD2_CMD_ADDR A:0x4298008
y.create.l HWIO_MSS_DCM_WORD3_CMD_ADDR A:0x429800c
y.create.l HWIO_MSS_DCM_WORD4_CMD_ADDR A:0x4298010
y.create.l HWIO_MSS_DCM_WORD5_CMD_ADDR A:0x4298014
y.create.l HWIO_MSS_DCM_WORD6_CMD_ADDR A:0x4298018
y.create.l HWIO_TX_REG_BASE_START_ADDR A:0x4380000
y.create.l HWIO_TX_REG_BASE_LAST_ADDR A:0x43800e4
y.create.l HWIO_TX_REG_BASE_END_ADDR A:0x4381000
y.create.l HWIO_TX_ENABLE_ADDR A:0x4380000
y.create.l HWIO_TX_MEM_ACCESS_CFG_ADDR A:0x4380004
y.create.l HWIO_TX_MEM_PAGE_ADDR A:0x4380008
y.create.l HWIO_TX_AXI_WR_INTF_EVENT_ADDR A:0x438000c
y.create.l HWIO_TX_STMR_TRIG_FRAC_CNT_0_ADDR A:0x4380010
y.create.l HWIO_TX_FRAME_STB_FRAC_CNT_0_ADDR A:0x4380018
y.create.l HWIO_TX_MISR_CTRL_ADDR A:0x4380020
y.create.l HWIO_TX_MISR_RD_DATA_ADDR A:0x4380024
y.create.l HWIO_TX_MISR_CAP_EN_ADDR A:0x4380028
y.create.l HWIO_HARQ_DONE_STATUS_ADDR A:0x438002c
y.create.l HWIO_TX_MODE_0_ADDR A:0x4380030
y.create.l HWIO_TX_MODE_COMMON_ADDR A:0x4380038
y.create.l HWIO_TX_ENABLE_GSM_0_ADDR A:0x438003c
y.create.l HWIO_TX_MEM_TEST_WR_ADDR_ADDR A:0x4380048
y.create.l HWIO_TX_MEM_TEST_WR_ADDR_STATUS_ADDR A:0x438004c
y.create.l HWIO_TX_MEM_TEST_RD_ADDR A:0x4380050
y.create.l HWIO_TX_MEM_TEST_RD_ADDR_ADDR A:0x4380054
y.create.l HWIO_TX_MEM_TEST_RD_ADDR_STATUS_ADDR A:0x4380058
y.create.l HWIO_TX_SW_AHB_EVENT_ADDR0_ADDR A:0x4380060
y.create.l HWIO_TX_SW_AHB_EVENT_ADDR1_ADDR A:0x4380064
y.create.l HWIO_TX_SW_AHB_EVENT_ADDR2_ADDR A:0x4380068
y.create.l HWIO_TX_SW_AHB_EVENT_ADDR3_ADDR A:0x438006c
y.create.l HWIO_TX_SW_AHB_EVENT_ADDR4_ADDR A:0x4380070
y.create.l HWIO_TX_SW_AHB_EVENT_ADDR5_ADDR A:0x4380074
y.create.l HWIO_TX_SW_AHB_EVENT_ADDR6_ADDR A:0x4380078
y.create.l HWIO_TX_SW_AHB_EVENT_ADDR7_ADDR A:0x438007c
y.create.l HWIO_TX_A2_AHB_EVENT_ADDR_ADDR A:0x4380080
y.create.l HWIO_TX_EVENT_LOG_EN_ADDR A:0x4380084
y.create.l HWIO_TX_EVENT_SEL_0_ADDR A:0x4380088
y.create.l HWIO_TX_EVENT_SEL_1_ADDR A:0x438008c
y.create.l HWIO_TX_TESTBUS_SEL_ADDR A:0x4380090
y.create.l HWIO_TX_TESTBUS_RD_DATA_ADDR A:0x4380094
y.create.l HWIO_TX_TESTBUS_RD_DATA_MASK_ADDR A:0x4380098
y.create.l HWIO_TX_ERROR_IRQ_EN_ADDR A:0x438009c
y.create.l HWIO_TX_ERROR_IRQ_CLEAR_ADDR A:0x43800a0
y.create.l HWIO_TX_ERROR_IRQ_STATUS_ADDR A:0x43800a4
y.create.l HWIO_TX_STATUS_RD_ADDR A:0x43800a8
y.create.l HWIO_TX_DEBUG_IRQ_EN_ADDR A:0x43800ac
y.create.l HWIO_TX_DEBUG_IRQ_CLEAR_ADDR A:0x43800b0
y.create.l HWIO_TX_DEBUG_IRQ_STATUS_ADDR A:0x43800b4
y.create.l HWIO_TX_MODE_OFDMA_ADDR A:0x43800bc
y.create.l HWIO_TX_AXI_RD0_INTF_CTL_ADDR A:0x43800c8
y.create.l HWIO_TX_AXI_RD0_INTF_EVENT_ADDR A:0x43800cc
y.create.l HWIO_TX_SW_RESET_ENC_MOD_ADDR A:0x43800e0
y.create.l HWIO_TX_SW_RESET_TXC_TXR_0_ADDR A:0x43800e4
y.create.l HWIO_TX_MEM_REG_BASE_START_ADDR A:0x4382000
y.create.l HWIO_TX_MEM_REG_BASE_LAST_ADDR A:0x4382000
y.create.l HWIO_TX_MEM_REG_BASE_END_ADDR A:0x4383000
y.create.l HWIO_TX_MEM_START_ADDR A:0x4382000
y.create.l HWIO_TX_BRDG_REG_BASE_START_ADDR A:0x4383000
y.create.l HWIO_TX_BRDG_REG_BASE_LAST_ADDR A:0x4383040
y.create.l HWIO_TX_BRDG_REG_BASE_END_ADDR A:0x4383050
y.create.l HWIO_TX_RDR0_CFG0_ADDR A:0x4383000
y.create.l HWIO_TX_RDR1_CFG0_ADDR A:0x4383008
y.create.l HWIO_TX_RDR0_CFG1_ADDR A:0x4383004
y.create.l HWIO_TX_RDR1_CFG1_ADDR A:0x438300c
y.create.l HWIO_TX_RDR0_XFER_CTL_ADDR A:0x4383010
y.create.l HWIO_TX_RDR1_XFER_CTL_ADDR A:0x4383014
y.create.l HWIO_TX_WRTR_CFG0_ADDR A:0x4383018
y.create.l HWIO_TX_WRTR_CFG1_ADDR A:0x438301c
y.create.l HWIO_TX_WRTR_XFER_CTL_ADDR A:0x4383020
y.create.l HWIO_TX_BRDG_CTL_ADDR A:0x4383024
y.create.l HWIO_TX_BRDG_STATUS_ADDR A:0x4383028
y.create.l HWIO_TX_BRDG_CLEAR_ADDR A:0x438302c
y.create.l HWIO_TX_BRDG_ARB_PRI_ADDR A:0x4383030
y.create.l HWIO_TX_RDR0_VBUF_ADDR_ADDR A:0x4383034
y.create.l HWIO_TX_RDR1_VBUF_ADDR_ADDR A:0x4383038
y.create.l HWIO_TX_WRTR_VBUF_ADDR_ADDR A:0x438303c
y.create.l HWIO_TX_BRDG_AXI_PRI_ADDR A:0x4383040
y.create.l HWIO_TXR_A0_REG_BASE_START_ADDR A:0x4385000
y.create.l HWIO_TXR_A0_REG_BASE_LAST_ADDR A:0x4385084
y.create.l HWIO_TXR_A0_REG_BASE_END_ADDR A:0x4386000
y.create.l HWIO_TXR_IQ_DAC_A0_ADDR A:0x4385000
y.create.l HWIO_TXR_STR_CTRL_A0_ADDR A:0x4385008
y.create.l HWIO_TXR_PDA_CTRL_A0_ADDR A:0x438500c
y.create.l HWIO_TXR_PDA_WD_UPDATE_CTRL_A0_ADDR A:0x4385010
y.create.l HWIO_TXR_PDA_CTRL_WD_OFFSET_A0_ADDR A:0x4385014
y.create.l HWIO_TXR_PDA_OFFSET_CMD_A0_ADDR A:0x4385018
y.create.l HWIO_TXR_PPDSM_CTL_A0_ADDR A:0x438501c
y.create.l HWIO_TXR_PPDSM_OVERRIDE_VAL_A0_ADDR A:0x4385020
y.create.l HWIO_TXR_PPDSM_OVERRIDE_REP_A0_ADDR A:0x4385024
y.create.l HWIO_TXR_FIFO_PTR_DIFF_A_A0_ADDR A:0x4385028
y.create.l HWIO_TXR_FIFO_PTR_DIFF_B_A0_ADDR A:0x438502c
y.create.l HWIO_TXR_FIFO_STATUS_A_A0_ADDR A:0x4385030
y.create.l HWIO_TXR_FIFO_STATUS_B_A0_ADDR A:0x4385034
y.create.l HWIO_TXR_FIFO_CMD_A0_ADDR A:0x4385038
y.create.l HWIO_TXR_FIFO_CTRL_A0_ADDR A:0x438503c
y.create.l HWIO_TXR_STREAM_IF_CTRL_A0_ADDR A:0x4385040
y.create.l HWIO_TXR_FMT_CONV_CTL_A0_ADDR A:0x4385050
y.create.l HWIO_TXR_TEST_BUS_IN_IQ_SWAP_A0_ADDR A:0x4385054
y.create.l HWIO_TXR_TEST_BUS_OUT_IQ_SWAP_A0_ADDR A:0x4385058
y.create.l HWIO_TXR_IQ_DAC_CURRENT_A0_ADDR A:0x438505c
y.create.l HWIO_TXR_STR_CTRL_CURRENT_A0_ADDR A:0x4385060
y.create.l HWIO_TXR_PDA_CTRL_CURRENT_A0_ADDR A:0x4385064
y.create.l HWIO_TXR_PDA_WD_UPDATE_CTRL_CURRENT_A0_ADDR A:0x4385068
y.create.l HWIO_TXR_PDA_CTRL_WD_OFFSET_CURRENT_A0_ADDR A:0x438506c
y.create.l HWIO_TXR_PDA_OFFSET_CMD_CURRENT_A0_ADDR A:0x4385070
y.create.l HWIO_TXR_PPDSM_CTL_CURRENT_A0_ADDR A:0x4385074
y.create.l HWIO_TXR_PPDSM_OVERRIDE_VAL_CURRENT_A0_ADDR A:0x4385078
y.create.l HWIO_TXR_PPDSM_OVERRIDE_REP_CURRENT_A0_ADDR A:0x438507c
y.create.l HWIO_TXR_STREAM_IF_CTRL_CURRENT_A0_ADDR A:0x4385080
y.create.l HWIO_TXR_FMT_CONV_CTL_CURRENT_A0_ADDR A:0x4385084
y.create.l HWIO_TXC_A0_REG_BASE_START_ADDR A:0x4384000
y.create.l HWIO_TXC_A0_REG_BASE_LAST_ADDR A:0x4384360
y.create.l HWIO_TXC_A0_REG_BASE_END_ADDR A:0x4385000
y.create.l HWIO_TXC_TECH_SEL_A0_ADDR A:0x4384000
y.create.l HWIO_TXC_DP_CFG_A0_ADDR A:0x4384004
y.create.l HWIO_TXC_DP_CFG_2_A0_ADDR A:0x4384008
y.create.l HWIO_TXC_DP_ENV_SCALE_VAL_A0_ADDR A:0x4384010
y.create.l HWIO_TXC_DP_ENV_SCALE_VAL_SET2_A0_ADDR A:0x4384014
y.create.l HWIO_TXC_DP_ENV_SCALE_VAL_IMM_A0_ADDR A:0x4384018
y.create.l HWIO_TXC_DP_RAMP_ARM_A0_ADDR A:0x4384024
y.create.l HWIO_TXC_DP_RAMP_START_TIME_A0_ADDR A:0x4384028
y.create.l HWIO_TXC_DP_RAMP_SLOT_A_CFG_A0_ADDR A:0x4384038
y.create.l HWIO_TXC_DP_RAMP_SLOT_B_CFG_A0_ADDR A:0x438403c
y.create.l HWIO_TXC_DP_RAMP_GAP_A0_ADDR A:0x4384040
y.create.l HWIO_TXC_DP_RAMP_SLOT_A_CFG_ACT_A0_ADDR A:0x4384044
y.create.l HWIO_TXC_DP_RAMP_SLOT_B_CFG_ACT_A0_ADDR A:0x4384048
y.create.l HWIO_TXC_DP_RAMP_GAP_ACT_A0_ADDR A:0x438404c
y.create.l HWIO_TXC_DP_PHASE_OVR_VAL_A0_ADDR A:0x4384080
y.create.l HWIO_TXC_PP_PHASE_OVR_VAL_A0_ADDR A:0x4384084
y.create.l HWIO_TXC_DP_ENV_OVR_VAL_A0_ADDR A:0x4384088
y.create.l HWIO_TXC_EP_ENV_OVR_VAL_A0_ADDR A:0x438408c
y.create.l HWIO_TXC_EP_ENV_OVR_VAL_SET2_A0_ADDR A:0x4384090
y.create.l HWIO_TXC_DP_ROT_PHASE_INC_A0_ADDR A:0x43840a0
y.create.l HWIO_TXC_DP_ROT_PHASE_INC_SET2_A0_ADDR A:0x43840a4
y.create.l HWIO_TXC_DP_ROT_PHASE_INIT_A0_ADDR A:0x43840a8
y.create.l HWIO_TXC_DP_ROT_PHASE_INIT_SET2_A0_ADDR A:0x43840ac
y.create.l HWIO_TXC_DP_ROT_PHASE_SHIFT_A0_ADDR A:0x43840b0
y.create.l HWIO_TXC_DP_ROT_PHASE_SHIFT_SET2_A0_ADDR A:0x43840b4
y.create.l HWIO_TXC_DP_IQ_GAIN_A0_ADDR A:0x43840b8
y.create.l HWIO_TXC_DP_IQ_GAIN_SET2_A0_ADDR A:0x43840bc
y.create.l HWIO_TXC_DP_IQMC_A0_ADDR A:0x43840d0
y.create.l HWIO_TXC_DP_IQMC_SET2_A0_ADDR A:0x43840d4
y.create.l HWIO_TXC_DP_PEQ1_A0_ADDR A:0x43840d8
y.create.l HWIO_TXC_DP_PEQ1_SET2_A0_ADDR A:0x43840dc
y.create.l HWIO_TXC_DP_PEQ2_A0_ADDR A:0x43840f0
y.create.l HWIO_TXC_DP_PEQ2_SET2_A0_ADDR A:0x43840f4
y.create.l HWIO_TXC_DP_DCOC_A0_ADDR A:0x43840f8
y.create.l HWIO_TXC_DP_DCOC_SET2_A0_ADDR A:0x43840fc
y.create.l HWIO_TXC_DM1_CFG_A0_ADDR A:0x4384100
y.create.l HWIO_TXC_DP_IQ_GAIN_IMM_A0_ADDR A:0x4384104
y.create.l HWIO_TXC_DP_IQMC_IMM_A0_ADDR A:0x4384108
y.create.l HWIO_TXC_DP_DCOC_IMM_A0_ADDR A:0x438410c
y.create.l HWIO_TXC_DP_PEQ1_Q_A0_ADDR A:0x4384110
y.create.l HWIO_TXC_DP_PEQ1_Q_SET2_A0_ADDR A:0x4384114
y.create.l HWIO_TXC_EP_GAIN_A0_ADDR A:0x4384160
y.create.l HWIO_TXC_EP_GAIN_SET2_A0_ADDR A:0x4384164
y.create.l HWIO_TXC_EP_PEQ1_A0_ADDR A:0x4384168
y.create.l HWIO_TXC_EP_PEQ1_SET2_A0_ADDR A:0x438416c
y.create.l HWIO_TXC_EP_DCOC_A0_ADDR A:0x4384170
y.create.l HWIO_TXC_EP_DCOC_SET2_A0_ADDR A:0x4384174
y.create.l HWIO_TXC_EP_DM2_FINE_TAU_A0_ADDR A:0x4384178
y.create.l HWIO_TXC_EP_DM3_FRAC_TAU_A0_ADDR A:0x438417c
y.create.l HWIO_TXC_PP_GAIN_A0_ADDR A:0x4384180
y.create.l HWIO_TXC_PP_SPILL_A0_ADDR A:0x4384190
y.create.l HWIO_TXC_EP_PEQ2_A0_ADDR A:0x4384198
y.create.l HWIO_TXC_TIMESTAMP_T1_A0_ADDR A:0x43841a0
y.create.l HWIO_TXC_TIMESTAMP_T2_A0_ADDR A:0x43841a8
y.create.l HWIO_TXC_TIMESTAMP_REUSE_A0_ADDR A:0x43841b0
y.create.l HWIO_TXC_SAMPLE_COUNT_A0_ADDR A:0x43841b4
y.create.l HWIO_TXC_SAMPLE_COUNT_CTL_A0_ADDR A:0x43841b8
y.create.l HWIO_TXC_REF_ARM_A0_ADDR A:0x43841c0
y.create.l HWIO_TXC_REF_DWN_FACTOR_A0_ADDR A:0x43841c4
y.create.l HWIO_TXC_REF_NUM_SAMPLES_A0_ADDR A:0x43841c8
y.create.l HWIO_TXC_REF_START_TIME_A0_ADDR A:0x43841cc
y.create.l HWIO_TXC_REF_STATUS_A0_ADDR A:0x43841d0
y.create.l HWIO_TXC_REF_PEAK_POWER_A0_ADDR A:0x43841d4
y.create.l HWIO_TXC_REF_RMS_POWER_M_A0_ADDR A:0x43841d8
y.create.l HWIO_TXC_REF_RMS_POWER_L_A0_ADDR A:0x43841dc
y.create.l HWIO_TXC_REF_MODE_A0_ADDR A:0x43841e0
y.create.l HWIO_TXC_REF_I_GAIN_VAL_A0_ADDR A:0x43841e4
y.create.l HWIO_TXC_REF_Q_GAIN_VAL_A0_ADDR A:0x43841e8
y.create.l HWIO_TXC_REF_POWERCALC_OR_LOG_A0_ADDR A:0x43841ec
y.create.l HWIO_TXC_TESTBUS_SELECT_A0_ADDR A:0x43841f0
y.create.l HWIO_TXC_TEST_BUS_IN_IQ_SWAP_A0_ADDR A:0x43841f4
y.create.l HWIO_TXC_TEST_BUS_OUT_IQ_SWAP_A0_ADDR A:0x43841f8
y.create.l HWIO_TXC_AMAM_PENDING_A0_ADDR A:0x4384220
y.create.l HWIO_TXC_AMPM_PENDING_A0_ADDR A:0x4384224
y.create.l HWIO_TXC_AMAM_PENDING_SET2_A0_ADDR A:0x4384230
y.create.l HWIO_TXC_AMPM_PENDING_SET2_A0_ADDR A:0x4384234
y.create.l HWIO_TXC_AMAM_ACTIVE_A0_ADDR A:0x4384240
y.create.l HWIO_TXC_AMPM_ACTIVE_A0_ADDR A:0x4384244
y.create.l HWIO_TXC_RAMP_ACTIVE_A0_ADDR A:0x438424c
y.create.l HWIO_TXC_REF_POWER_SUM_I_A0_ADDR A:0x43842e0
y.create.l HWIO_TXC_REF_POWER_SUM_Q_A0_ADDR A:0x43842e4
y.create.l HWIO_TXC_REF_POWER_SUM_IQ_M_A0_ADDR A:0x43842e8
y.create.l HWIO_TXC_REF_POWER_SUM_IQ_L_A0_ADDR A:0x43842ec
y.create.l HWIO_TXC_REF_POWER_SUM_QQ_M_A0_ADDR A:0x43842f0
y.create.l HWIO_TXC_REF_POWER_SUM_QQ_L_A0_ADDR A:0x43842f4
y.create.l HWIO_TXC_DP_CFG_LATCHED_A0_ADDR A:0x4384300
y.create.l HWIO_TXC_DP_ENV_SCALE_VAL_LATCHED_A0_ADDR A:0x4384304
y.create.l HWIO_TXC_DP_PHASE_OVR_VAL_LATCHED_A0_ADDR A:0x4384308
y.create.l HWIO_TXC_PP_PHASE_OVR_VAL_LATCHED_A0_ADDR A:0x438430c
y.create.l HWIO_TXC_DP_ENV_OVR_VAL_LATCHED_A0_ADDR A:0x4384310
y.create.l HWIO_TXC_EP_ENV_OVR_VAL_LATCHED_A0_ADDR A:0x4384314
y.create.l HWIO_TXC_DP_ROT_PHASE_INC_LATCHED_A0_ADDR A:0x4384318
y.create.l HWIO_TXC_DP_ROT_PHASE_INIT_LATCHED_A0_ADDR A:0x438431c
y.create.l HWIO_TXC_DP_ROT_PHASE_SHIFT_LATCHED_A0_ADDR A:0x4384320
y.create.l HWIO_TXC_DP_IQ_GAIN_LATCHED_A0_ADDR A:0x4384324
y.create.l HWIO_TXC_DP_IQMC_LATCHED_A0_ADDR A:0x4384328
y.create.l HWIO_TXC_DP_PEQ1_LATCHED_A0_ADDR A:0x438432c
y.create.l HWIO_TXC_DP_PEQ2_LATCHED_A0_ADDR A:0x4384330
y.create.l HWIO_TXC_DP_DCOC_LATCHED_A0_ADDR A:0x4384334
y.create.l HWIO_TXC_DM1_CFG_LATCHED_A0_ADDR A:0x4384338
y.create.l HWIO_TXC_EP_GAIN_LATCHED_A0_ADDR A:0x438433c
y.create.l HWIO_TXC_EP_PEQ1_LATCHED_A0_ADDR A:0x4384340
y.create.l HWIO_TXC_EP_DCOC_LATCHED_A0_ADDR A:0x4384344
y.create.l HWIO_TXC_EP_DM2_FINE_TAU_LATCHED_A0_ADDR A:0x4384348
y.create.l HWIO_TXC_EP_DM3_FRAC_TAU_LATCHED_A0_ADDR A:0x438434c
y.create.l HWIO_TXC_PP_GAIN_LATCHED_A0_ADDR A:0x4384350
y.create.l HWIO_TXC_PP_SPILL_LATCHED_A0_ADDR A:0x4384354
y.create.l HWIO_TXC_EP_PEQ2_LATCHED_A0_ADDR A:0x4384358
y.create.l HWIO_TXC_DP_CFG_2_LATCHED_A0_ADDR A:0x438435c
y.create.l HWIO_TXC_DP_PEQ1_Q_LATCHED_A0_ADDR A:0x4384360
y.create.l HWIO_TXC_MEM_REG_BASE_START_ADDR A:0x4388000
y.create.l HWIO_TXC_MEM_REG_BASE_LAST_ADDR A:0x43897fc
y.create.l HWIO_TXC_MEM_REG_BASE_END_ADDR A:0x4389e00
y.create.l HWIO_TXC_MEM_BANK0_ADDR0_ADDR A:0x4388000
y.create.l HWIO_TXC_MEM_BANK0_ADDR1_ADDR A:0x4388004
y.create.l HWIO_TXC_MEM_BANK0_ADDR2_ADDR A:0x4388008
y.create.l HWIO_TXC_MEM_BANK0_ADDR3_ADDR A:0x438800c
y.create.l HWIO_TXC_MEM_BANK1_ADDR0_ADDR A:0x4388400
y.create.l HWIO_TXC_MEM_BANK1_ADDR1_ADDR A:0x4388404
y.create.l HWIO_TXC_MEM_BANK1_ADDR2_ADDR A:0x4388408
y.create.l HWIO_TXC_MEM_BANK1_ADDR3_ADDR A:0x438840c
y.create.l HWIO_TXC_MEM_BANK2_ADDR0_ADDR A:0x4388800
y.create.l HWIO_TXC_MEM_BANK2_ADDR1_ADDR A:0x4388804
y.create.l HWIO_TXC_MEM_BANK2_ADDR2_ADDR A:0x4388808
y.create.l HWIO_TXC_MEM_BANK2_ADDR3_ADDR A:0x438880c
y.create.l HWIO_TXC_MEM_BANK3_ADDR0_ADDR A:0x4388c00
y.create.l HWIO_TXC_MEM_BANK3_ADDR1_ADDR A:0x4388c04
y.create.l HWIO_TXC_MEM_BANK3_ADDR2_ADDR A:0x4388c08
y.create.l HWIO_TXC_MEM_BANK3_ADDR3_ADDR A:0x4388c0c
y.create.l HWIO_TXC_MEM_BANK4_ADDR0_ADDR A:0x4389000
y.create.l HWIO_TXC_MEM_BANK4_ADDR1_ADDR A:0x4389004
y.create.l HWIO_TXC_MEM_BANK4_ADDR2_ADDR A:0x4389008
y.create.l HWIO_TXC_MEM_BANK4_ADDR3_ADDR A:0x438900c
y.create.l HWIO_TXC_MEM_BANK5_ADDR0_ADDR A:0x4389400
y.create.l HWIO_TXC_MEM_BANK5_ADDR1_ADDR A:0x4389404
y.create.l HWIO_TXC_MEM_BANK5_ADDR2_ADDR A:0x4389408
y.create.l HWIO_TXC_MEM_BANK5_ADDR3_ADDR A:0x438940c
y.create.l HWIO_O_TX_REG_BASE_START_ADDR A:0x438a000
y.create.l HWIO_O_TX_REG_BASE_LAST_ADDR A:0x438a05c
y.create.l HWIO_O_TX_REG_BASE_END_ADDR A:0x438a200
y.create.l HWIO_O_TX_TEST_MODE_ADDR A:0x438a000
y.create.l HWIO_O_TX_CLK_CTL_ADDR A:0x438a004
y.create.l HWIO_O_TX_SW_CLK_CTL_ADDR A:0x438a008
y.create.l HWIO_O_TX_CLK_STATUS_REG_ADDR A:0x438a00c
y.create.l HWIO_O_TX_ENCODER_STATUS_ADDR A:0x438a010
y.create.l HWIO_O_TX_HW_IDLE_ADDR A:0x438a014
y.create.l HWIO_O_TX_BUS_TIMEOUT_ADDR A:0x438a018
y.create.l HWIO_O_TX_WMORE_INT_STATUS_ADDR A:0x438a01c
y.create.l HWIO_O_TX_WMORE_INT_CLEAR_ADDR A:0x438a020
y.create.l HWIO_O_TX_WMORE_TX_PWRDWN_ADDR A:0x438a024
y.create.l HWIO_O_TX_L0_DEC_ACK_BITS_ADDR A:0x438a028
y.create.l HWIO_O_TX_L1_DEC_ACK_BITS_ADDR A:0x438a02c
y.create.l HWIO_O_TX_WMORE_CLIP_THR1_ADDR A:0x438a030
y.create.l HWIO_O_TX_WMORE_CLIP_THR2_ADDR A:0x438a034
y.create.l HWIO_O_TX_WMORE_TS2_ADDR A:0x438a038
y.create.l HWIO_O_TX_WMORE_TS1_ADDR A:0x438a03c
y.create.l HWIO_O_TX_WMORE_CLIP_ENABLE_ADDR A:0x438a040
y.create.l HWIO_O_TX_WMORE_NOTCH_ENABLE_ADDR A:0x438a044
y.create.l HWIO_O_TX_WMORE_NOTCH_ALPHA_I_ADDR A:0x438a048
y.create.l HWIO_O_TX_WMORE_NOTCH_ALPHA_Q_ADDR A:0x438a04c
y.create.l HWIO_O_TX_WMORE_NOTCH_BETA_ADDR A:0x438a050
y.create.l HWIO_O_TX_WMORE_NOTCH_TS1_ADDR A:0x438a054
y.create.l HWIO_O_TX_WMORE_IFFT_SIZE_ADDR A:0x438a058
y.create.l HWIO_O_TX_RM_DBUF_CTL_ADDR A:0x438a05c
y.create.l HWIO_O_TX_WMORE_TS_TRIF_REG_BASE_START_ADDR A:0x438a200
y.create.l HWIO_O_TX_WMORE_TS_TRIF_REG_BASE_LAST_ADDR A:0x438a50c
y.create.l HWIO_O_TX_WMORE_TS_TRIF_REG_BASE_END_ADDR A:0x438a600
y.create.l HWIO_O_TX_WMORE_STATUS_WORD0_ADDR A:0x438a200
y.create.l HWIO_TX_LTE_WMORE_WORD0_ADDR A:0x438a300
y.create.l HWIO_TX_LTE_WMORE_WORD1_ADDR A:0x438a304
y.create.l HWIO_TX_LTE_WMORE_WORD2_ADDR A:0x438a308
y.create.l HWIO_TX_LTE_WMORE_WORD3_ADDR A:0x438a30c
y.create.l HWIO_TX_LTE_WMORE_WORD4_ADDR A:0x438a310
y.create.l HWIO_TX_LTE_WMORE_WORD5_ADDR A:0x438a314
y.create.l HWIO_TX_LTE_WMORE_WORD6_ADDR A:0x438a318
y.create.l HWIO_TX_LTE_WMORE_WORD7_ADDR A:0x438a31c
y.create.l HWIO_TX_LTE_WMORE_WORD8_ADDR A:0x438a320
y.create.l HWIO_TX_LTE_WMORE_WORD9_ADDR A:0x438a324
y.create.l HWIO_TX_LTE_WMORE_WORD10_ADDR A:0x438a328
y.create.l HWIO_TX_LTE_WMORE_WORD11_ADDR A:0x438a32c
y.create.l HWIO_TX_LTE_WMORE_WORD12_ADDR A:0x438a330
y.create.l HWIO_TX_LTE_WMORE_WORD13_ADDR A:0x438a334
y.create.l HWIO_TX_LTE_WMORE_WORD14_ADDR A:0x438a338
y.create.l HWIO_TX_LTE_WMORE_WORD15_ADDR A:0x438a33c
y.create.l HWIO_TX_LTE_WMORE_WORD16_ADDR A:0x438a340
y.create.l HWIO_TX_LTE_WMORE_WORD17_ADDR A:0x438a344
y.create.l HWIO_TX_LTE_WMORE_WORD18_ADDR A:0x438a348
y.create.l HWIO_TX_LTE_WMORE_WORD19_ADDR A:0x438a34c
y.create.l HWIO_TX_LTE_WMORE_WORD20_ADDR A:0x438a350
y.create.l HWIO_TX_LTE_WMORE_WORD21_ADDR A:0x438a354
y.create.l HWIO_TX_LTE_WMORE_WORD22_ADDR A:0x438a358
y.create.l HWIO_TX_LTE_WMORE_WORD23_ADDR A:0x438a35c
y.create.l HWIO_TX_LTE_WMORE_UPPTS_WORD0_ADDR A:0x438a400
y.create.l HWIO_TX_LTE_WMORE_UPPTS_WORD1_ADDR A:0x438a404
y.create.l HWIO_TX_LTE_WMORE_UPPTS_WORD2_ADDR A:0x438a408
y.create.l HWIO_TX_LTE_WMORE_UPPTS_WORD3_ADDR A:0x438a40c
y.create.l HWIO_TX_LTE_WMORE_UPPTS_WORD4_ADDR A:0x438a410
y.create.l HWIO_TX_LTE_WMORE_UPPTS_WORD5_ADDR A:0x438a414
y.create.l HWIO_TX_LTE_WMORE_UPPTS_WORD6_ADDR A:0x438a418
y.create.l HWIO_TX_LTE_WMORE_UPPTS_WORD7_ADDR A:0x438a41c
y.create.l HWIO_TX_LTE_WMORE_UPPTS_WORD8_ADDR A:0x438a420
y.create.l HWIO_TX_LTE_WMORE_PRACH_WORD0_ADDR A:0x438a500
y.create.l HWIO_TX_LTE_WMORE_PRACH_WORD1_ADDR A:0x438a504
y.create.l HWIO_TX_LTE_WMORE_PRACH_WORD2_ADDR A:0x438a508
y.create.l HWIO_TX_LTE_WMORE_PRACH_WORD3_ADDR A:0x438a50c
y.create.l HWIO_O_TX_ENC_TS_TRIF_REG_BASE_START_ADDR A:0x438a600
y.create.l HWIO_O_TX_ENC_TS_TRIF_REG_BASE_LAST_ADDR A:0x438a714
y.create.l HWIO_O_TX_ENC_TS_TRIF_REG_BASE_END_ADDR A:0x438a800
y.create.l HWIO_O_TX_ENC_STATUS_WORD0_ADDR A:0x438a600
y.create.l HWIO_TX_LTE_PUSCH_ENC_WORD0_ADDR A:0x438a700
y.create.l HWIO_TX_LTE_PUSCH_ENC_WORD1_ADDR A:0x438a704
y.create.l HWIO_TX_LTE_PUSCH_ENC_WORD2_ADDR A:0x438a708
y.create.l HWIO_TX_LTE_PUSCH_ENC_WORD3_ADDR A:0x438a70c
y.create.l HWIO_TX_LTE_PUSCH_ENC_WORD4_ADDR A:0x438a710
y.create.l HWIO_TX_LTE_PUSCH_ENC_WORD5_ADDR A:0x438a714
y.create.l HWIO_O_TX_MOD_TS_TRIF_REG_BASE_START_ADDR A:0x438a800
y.create.l HWIO_O_TX_MOD_TS_TRIF_REG_BASE_LAST_ADDR A:0x438ae04
y.create.l HWIO_O_TX_MOD_TS_TRIF_REG_BASE_END_ADDR A:0x438af00
y.create.l HWIO_O_TX_MOD_STATUS_WORD0_ADDR A:0x438a800
y.create.l HWIO_TX_LTE_PUSCH_MOD_WORD0_ADDR A:0x438a900
y.create.l HWIO_TX_LTE_PUSCH_MOD_WORD1_ADDR A:0x438a904
y.create.l HWIO_TX_LTE_PUSCH_MOD_WORD2_ADDR A:0x438a908
y.create.l HWIO_TX_LTE_PUSCH_MOD_WORD3_ADDR A:0x438a90c
y.create.l HWIO_TX_LTE_PUSCH_MOD_WORD4_ADDR A:0x438a910
y.create.l HWIO_TX_LTE_PUSCH_MOD_WORD5_ADDR A:0x438a914
y.create.l HWIO_TX_LTE_PUSCH_MOD_WORD6_ADDR A:0x438a918
y.create.l HWIO_TX_LTE_PUSCH_MOD_WORD7_ADDR A:0x438a91c
y.create.l HWIO_TX_LTE_PUSCH_MOD_WORD8_ADDR A:0x438a920
y.create.l HWIO_TX_LTE_PUSCH_MOD_WORD9_ADDR A:0x438a924
y.create.l HWIO_TX_LTE_PUSCH_MOD_WORD10_ADDR A:0x438a928
y.create.l HWIO_TX_LTE_PUSCH_MOD_WORD11_ADDR A:0x438a92c
y.create.l HWIO_TX_LTE_PUSCH_MOD_WORD12_ADDR A:0x438a930
y.create.l HWIO_TX_LTE_PUSCH_MOD_WORD13_ADDR A:0x438a934
y.create.l HWIO_TX_LTE_PUSCH_MOD_WORD14_ADDR A:0x438a938
y.create.l HWIO_TX_LTE_PUSCH_MOD_WORD15_ADDR A:0x438a93c
y.create.l HWIO_TX_LTE_PUSCH_MOD_WORD16_ADDR A:0x438a940
y.create.l HWIO_TX_LTE_PUSCH_MOD_WORD17_ADDR A:0x438a944
y.create.l HWIO_TX_LTE_PUSCH_MOD_WORD18_ADDR A:0x438a948
y.create.l HWIO_TX_LTE_PUSCH_MOD_WORD19_ADDR A:0x438a94c
y.create.l HWIO_TX_LTE_PUSCH_MOD_WORD20_ADDR A:0x438a950
y.create.l HWIO_TX_LTE_PUSCH_MOD_WORD21_ADDR A:0x438a954
y.create.l HWIO_TX_LTE_PUSCH_MOD_WORD22_ADDR A:0x438a958
y.create.l HWIO_TX_LTE_PUCCH_MOD_WORD0_ADDR A:0x438aa00
y.create.l HWIO_TX_LTE_PUCCH_MOD_WORD1_ADDR A:0x438aa04
y.create.l HWIO_TX_LTE_PUCCH_MOD_WORD2_ADDR A:0x438aa08
y.create.l HWIO_TX_LTE_PUCCH_MOD_WORD3_ADDR A:0x438aa0c
y.create.l HWIO_TX_LTE_PUCCH_MOD_WORD4_ADDR A:0x438aa10
y.create.l HWIO_TX_LTE_PUCCH_MOD_WORD5_ADDR A:0x438aa14
y.create.l HWIO_TX_LTE_PUCCH_MOD_WORD6_ADDR A:0x438aa18
y.create.l HWIO_TX_LTE_PUCCH_MOD_WORD7_ADDR A:0x438aa1c
y.create.l HWIO_TX_LTE_PUCCH_MOD_WORD8_ADDR A:0x438aa20
y.create.l HWIO_TX_LTE_PUCCH_MOD_WORD9_ADDR A:0x438aa24
y.create.l HWIO_TX_LTE_PUCCH_MOD_WORD10_ADDR A:0x438aa28
y.create.l HWIO_TX_LTE_PUCCH_MOD_WORD11_ADDR A:0x438aa2c
y.create.l HWIO_TX_LTE_PUCCH_MOD_WORD12_ADDR A:0x438aa30
y.create.l HWIO_TX_LTE_PUCCH_MOD_WORD13_ADDR A:0x438aa34
y.create.l HWIO_TX_LTE_PUCCH_MOD_WORD14_ADDR A:0x438aa38
y.create.l HWIO_TX_LTE_PUCCH_MOD_WORD15_ADDR A:0x438aa3c
y.create.l HWIO_TX_LTE_PUCCH_MOD_WORD16_ADDR A:0x438aa40
y.create.l HWIO_TX_LTE_PUCCH_MOD_WORD17_ADDR A:0x438aa44
y.create.l HWIO_TX_LTE_PUCCH_MOD_WORD18_ADDR A:0x438aa48
y.create.l HWIO_TX_LTE_PRACH_MOD_WORD0_ADDR A:0x438ab00
y.create.l HWIO_TX_LTE_PRACH_MOD_WORD1_ADDR A:0x438ab04
y.create.l HWIO_TX_LTE_PRACH_MOD_WORD2_ADDR A:0x438ab08
y.create.l HWIO_TX_LTE_PRACH_MOD_WORD3_ADDR A:0x438ab0c
y.create.l HWIO_TX_LTE_PRACH_MOD_WORD4_ADDR A:0x438ab10
y.create.l HWIO_TX_LTE_PRACH_MOD_WORD5_ADDR A:0x438ab14
y.create.l HWIO_TX_LTE_UPPTS_MOD_WORD0_ADDR A:0x438ac00
y.create.l HWIO_TX_LTE_UPPTS_MOD_WORD1_ADDR A:0x438ac04
y.create.l HWIO_TX_LTE_UPPTS_MOD_WORD2_ADDR A:0x438ac08
y.create.l HWIO_TX_LTE_UPPTS_MOD_WORD3_ADDR A:0x438ac0c
y.create.l HWIO_TX_LTE_UPPTS_MOD_WORD4_ADDR A:0x438ac10
y.create.l HWIO_TX_LTE_UPPTS_MOD_WORD5_ADDR A:0x438ac14
y.create.l HWIO_TX_LTE_UPPTS_MOD_WORD6_ADDR A:0x438ac18
y.create.l HWIO_TX_LTE_UPPTS_MOD_WORD7_ADDR A:0x438ac1c
y.create.l HWIO_TX_LTE_UPPTS_MOD_WORD8_ADDR A:0x438ac20
y.create.l HWIO_TX_LTE_UPPTS_MOD_WORD9_ADDR A:0x438ac24
y.create.l HWIO_TX_LTE_UPPTS_MOD_WORD10_ADDR A:0x438ac28
y.create.l HWIO_TX_LTE_UPPTS_MOD_WORD11_ADDR A:0x438ac2c
y.create.l HWIO_TX_LTE_UPPTS_MOD_WORD12_ADDR A:0x438ac30
y.create.l HWIO_TX_LTE_UPPTS_MOD_WORD13_ADDR A:0x438ac34
y.create.l HWIO_TX_LTE_UPPTS_MOD_WORD14_ADDR A:0x438ac38
y.create.l HWIO_TX_LTE_UPPTS_MOD_WORD15_ADDR A:0x438ac3c
y.create.l HWIO_TX_LTE_UPPTS_MOD_WORD16_ADDR A:0x438ac40
y.create.l HWIO_TX_LTE_UPPTS_MOD_WORD17_ADDR A:0x438ac44
y.create.l HWIO_TX_LTE_UPPTS_MOD_WORD18_ADDR A:0x438ac48
y.create.l HWIO_TX_LTE_UPPTS_MOD_WORD19_ADDR A:0x438ac4c
y.create.l HWIO_TX_LTE_UPPTS_MOD_WORD20_ADDR A:0x438ac50
y.create.l HWIO_TX_LTE_UPPTS_MOD_WORD21_ADDR A:0x438ac54
y.create.l HWIO_TX_LTE_UPPTS_MOD_WORD22_ADDR A:0x438ac58
y.create.l HWIO_TX_LTE_UPPTS_MOD_WORD23_ADDR A:0x438ac5c
y.create.l HWIO_TX_LTE_UPPTS_MOD_WORD24_ADDR A:0x438ac60
y.create.l HWIO_TX_LTE_UPPTS_MOD_WORD25_ADDR A:0x438ac64
y.create.l HWIO_TX_LTE_UPPTS_MOD_WORD26_ADDR A:0x438ac68
y.create.l HWIO_TX_LTE_UPPTS_MOD_WORD27_ADDR A:0x438ac6c
y.create.l HWIO_TX_LTE_UPPTS_MOD_WORD28_ADDR A:0x438ac70
y.create.l HWIO_TX_LTE_UPPTS_MOD_WORD29_ADDR A:0x438ac74
y.create.l HWIO_TX_LTE_PUSCH_MOD_ACK_WORD0_ADDR A:0x438ad00
y.create.l HWIO_TX_LTE_PUCCH_MOD_ACK_WORD0_ADDR A:0x438ae00
y.create.l HWIO_TX_LTE_PUCCH_MOD_ACK_WORD1_ADDR A:0x438ae04
y.create.l HWIO_RXFE_TOP_CFG_REG_BASE_START_ADDR A:0x4360000
y.create.l HWIO_RXFE_TOP_CFG_REG_BASE_LAST_ADDR A:0x436009c
y.create.l HWIO_RXFE_TOP_CFG_REG_BASE_END_ADDR A:0x4361000
y.create.l HWIO_RXFE_ENABLE_ADDR A:0x4360000
y.create.l HWIO_RXFE_ADC0_LOGIC_CFG_ADDR A:0x4360004
y.create.l HWIO_RXFE_WB0_ADCMUX_CFG_ADDR A:0x4360018
y.create.l HWIO_RXFE_NB0_WBMUX_CFG_ADDR A:0x436002c
y.create.l HWIO_RXFE_NB1_WBMUX_CFG_ADDR A:0x4360030
y.create.l HWIO_RXFE_TOP_STATUS_ADDR A:0x436004c
y.create.l HWIO_RXFE_RFIF_UPDATE_CMD_ADDR A:0x4360050
y.create.l HWIO_RXFE_TOP_SPARE_REG_ADDR A:0x4360084
y.create.l HWIO_RXFE_DBG_ENABLES_ADDR A:0x4360090
y.create.l HWIO_RXFE_DBG_PROBE_CTL_ADDR A:0x4360094
y.create.l HWIO_RXFE_DBG_CMD_ADDR A:0x4360098
y.create.l HWIO_RXFE_PBS_CFG_ADDR A:0x436009c
y.create.l HWIO_RXFE_WB_WB0_REG_BASE_START_ADDR A:0x4364000
y.create.l HWIO_RXFE_WB_WB0_REG_BASE_LAST_ADDR A:0x43640e8
y.create.l HWIO_RXFE_WB_WB0_REG_BASE_END_ADDR A:0x4365000
y.create.l HWIO_RXFE_WB_TOP_CTL_WB0_ADDR A:0x4364000
y.create.l HWIO_RXFE_WB_TOP_CMD_WB0_ADDR A:0x4364004
y.create.l HWIO_RXFE_WB_TOP_STATUS_WB0_ADDR A:0x4364008
y.create.l HWIO_RXFE_WB_STOPGATE_ACTION_SAMPLE_WB0_ADDR A:0x436400c
y.create.l HWIO_RXFE_WB_TIMINGCTL_STATUS_WB0_ADDR A:0x4364010
y.create.l HWIO_RXFE_WB_WBPWR_CFG_WB0_ADDR A:0x4364018
y.create.l HWIO_RXFE_WB_WBPWR_CMD_WB0_ADDR A:0x436401c
y.create.l HWIO_RXFE_WB_WBPWR_START_ACTION_SAMPLE_WB0_ADDR A:0x4364020
y.create.l HWIO_RXFE_WB_WBPWR_START_MASK_WB0_ADDR A:0x4364024
y.create.l HWIO_RXFE_WB_WBPWR_STOP_ACTION_SAMPLE_WB0_ADDR A:0x4364028
y.create.l HWIO_RXFE_WB_WBPWR_FINAL_ACC_WB0_ADDR A:0x436402c
y.create.l HWIO_RXFE_WB_WBPWR_CURR_ACC_WB0_ADDR A:0x4364030
y.create.l HWIO_RXFE_WB_WBPWR_MAX_ACC_WB0_ADDR A:0x4364034
y.create.l HWIO_RXFE_WB_WBDC_CFG_WB0_ADDR A:0x4364038
y.create.l HWIO_RXFE_WB_WBDC_CMD_WB0_ADDR A:0x436403c
y.create.l HWIO_RXFE_WB_WBDC_START_ACTION_SAMPLE_WB0_ADDR A:0x4364040
y.create.l HWIO_RXFE_WB_WBDC_STOP_ACTION_SAMPLE_WB0_ADDR A:0x4364044
y.create.l HWIO_RXFE_WB_WBDC_UPDATE_ACTION_SAMPLE_WB0_ADDR A:0x4364048
y.create.l HWIO_RXFE_WB_WBDC_UPDATE_DELAY_WB0_ADDR A:0x436404c
y.create.l HWIO_RXFE_WB_WBDC_OVRD_I_WB0_ADDR A:0x4364050
y.create.l HWIO_RXFE_WB_WBDC_OVRD_Q_WB0_ADDR A:0x4364054
y.create.l HWIO_RXFE_WB_WBDC_EST1_CURR_I_WB0_ADDR A:0x4364058
y.create.l HWIO_RXFE_WB_WBDC_EST1_CURR_Q_WB0_ADDR A:0x436405c
y.create.l HWIO_RXFE_WB_WBDC_EST1_PREV_I_WB0_ADDR A:0x4364060
y.create.l HWIO_RXFE_WB_WBDC_EST1_PREV_Q_WB0_ADDR A:0x4364064
y.create.l HWIO_RXFE_WB_WBDC_EST1_LOAD_I_WB0_ADDR A:0x4364068
y.create.l HWIO_RXFE_WB_WBDC_EST1_LOAD_Q_WB0_ADDR A:0x436406c
y.create.l HWIO_RXFE_WB_WBDC_EST2_CURR_I_WB0_ADDR A:0x4364070
y.create.l HWIO_RXFE_WB_WBDC_EST2_CURR_Q_WB0_ADDR A:0x4364074
y.create.l HWIO_RXFE_WB_WBDC_EST2_PREV_I_WB0_ADDR A:0x4364078
y.create.l HWIO_RXFE_WB_WBDC_EST2_PREV_Q_WB0_ADDR A:0x436407c
y.create.l HWIO_RXFE_WB_WBDC_EST2_LOAD_I_WB0_ADDR A:0x4364080
y.create.l HWIO_RXFE_WB_WBDC_EST2_LOAD_Q_WB0_ADDR A:0x4364084
y.create.l HWIO_RXFE_WB_VSRC_CFG_WB0_ADDR A:0x4364088
y.create.l HWIO_RXFE_WB_VSRC_T2BYT1M1_WB0_ADDR A:0x436408c
y.create.l HWIO_RXFE_WB_VSRC_CMD_WB0_ADDR A:0x4364090
y.create.l HWIO_RXFE_WB_VSRC_STATUS_WB0_ADDR A:0x4364094
y.create.l HWIO_RXFE_WB_VSRC_UPDT_ACTION_SAMPLE_WB0_ADDR A:0x4364098
y.create.l HWIO_RXFE_WB_VSRC_CURR_T1BYT2_WB0_ADDR A:0x436409c
y.create.l HWIO_RXFE_WB_VSRC_CURR_T2BYT1M1_WB0_ADDR A:0x43640a0
y.create.l HWIO_RXFE_WB_VSRC_SCTR_LOAD_VALUE_WB0_ADDR A:0x43640a4
y.create.l HWIO_RXFE_WB_VSRC_SCTR_WA_WB0_ADDR A:0x43640a8
y.create.l HWIO_RXFE_WB_VSRC_SCTR_SNAPSHOT_WB0_ADDR A:0x43640ac
y.create.l HWIO_RXFE_WB_VSRC_ACC_SNAPSHOT_WB0_ADDR A:0x43640b0
y.create.l HWIO_RXFE_WB_DEC_FILT_CFG_WB0_ADDR A:0x43640b4
y.create.l HWIO_RXFE_WB_IQMC_CFG0_WB0_ADDR A:0x43640b8
y.create.l HWIO_RXFE_WB_IQMC_CFG1_WB0_ADDR A:0x43640bc
y.create.l HWIO_RXFE_WB_IQMC_CURR_VALS_WB0_ADDR A:0x43640c0
y.create.l HWIO_RXFE_WB_IQMC_UPDT_CMD_WB0_ADDR A:0x43640c4
y.create.l HWIO_RXFE_WB_IQMC_UPDT_ACTION_SAMPLE_WB0_ADDR A:0x43640c8
y.create.l HWIO_RXFE_WB_NOTCH_FILT0_CFG0_WB0_ADDR A:0x43640cc
y.create.l HWIO_RXFE_WB_NOTCH_FILT0_CFG1_WB0_ADDR A:0x43640d0
y.create.l HWIO_RXFE_WB_NOTCH_FILT012_CFG_WB0_ADDR A:0x43640e4
y.create.l HWIO_RXFE_WB_SPARE_REG_WB0_ADDR A:0x43640e8
y.create.l HWIO_RXFE_NB_NB0_REG_BASE_START_ADDR A:0x4370000
y.create.l HWIO_RXFE_NB_NB0_REG_BASE_LAST_ADDR A:0x43700dc
y.create.l HWIO_RXFE_NB_NB0_REG_BASE_END_ADDR A:0x4371000
y.create.l HWIO_RXFE_NB_TOP_CTL_NB0_ADDR A:0x4370000
y.create.l HWIO_RXFE_NB_GATE_CMD_NB0_ADDR A:0x4370004
y.create.l HWIO_RXFE_NB_GATE_STATUS_NB0_ADDR A:0x4370008
y.create.l HWIO_RXFE_NB_GATE_ACTION_SAMPLE_NB0_ADDR A:0x437000c
y.create.l HWIO_RXFE_NB_TIMINGCTL_STATUS_NB0_ADDR A:0x4370010
y.create.l HWIO_RXFE_NB_CSR_CFG_NB0_ADDR A:0x4370014
y.create.l HWIO_RXFE_NB_CSR_CMD_NB0_ADDR A:0x4370018
y.create.l HWIO_RXFE_NB_CSR_PHASEUPDT_ACTION_SAMPLE_NB0_ADDR A:0x437001c
y.create.l HWIO_RXFE_NB_CSR_FREQUPDT_ACTION_SAMPLE_NB0_ADDR A:0x4370020
y.create.l HWIO_RXFE_NB_CSR_PHASE_OFFSET_NB0_ADDR A:0x4370024
y.create.l HWIO_RXFE_NB_CSR_FREQ_OFFSET_NB0_ADDR A:0x4370028
y.create.l HWIO_RXFE_NB_CSR_CURR_PHASE_OFFSET_NB0_ADDR A:0x437002c
y.create.l HWIO_RXFE_NB_CSR_CURR_FREQ_OFFSET_NB0_ADDR A:0x4370030
y.create.l HWIO_RXFE_NB_FILTERS_CFG_NB0_ADDR A:0x4370034
y.create.l HWIO_RXFE_NB_ICI_COEF0_NB0_ADDR A:0x437003c
y.create.l HWIO_RXFE_NB_ICI_COEF1_NB0_ADDR A:0x4370040
y.create.l HWIO_RXFE_NB_ICI_COEF2_NB0_ADDR A:0x4370044
y.create.l HWIO_RXFE_NB_ICI_COEF3_NB0_ADDR A:0x4370048
y.create.l HWIO_RXFE_NB_ICI_COEF4_NB0_ADDR A:0x437004c
y.create.l HWIO_RXFE_NB_ICI_COEF5_NB0_ADDR A:0x4370050
y.create.l HWIO_RXFE_NB_ICI_COEF6_NB0_ADDR A:0x4370054
y.create.l HWIO_RXFE_NB_ICI_COEF7_NB0_ADDR A:0x4370058
y.create.l HWIO_RXFE_NB_ICI_COEF8_NB0_ADDR A:0x437005c
y.create.l HWIO_RXFE_NB_ICI_COEF9_NB0_ADDR A:0x4370060
y.create.l HWIO_RXFE_NB_NBDC_COMPVAL_I_NB0_ADDR A:0x437006c
y.create.l HWIO_RXFE_NB_NBDC_COMPVAL_Q_NB0_ADDR A:0x4370070
y.create.l HWIO_RXFE_NB_NBPWR_CFG_NB0_ADDR A:0x4370074
y.create.l HWIO_RXFE_NB_NBPWR_CMD_NB0_ADDR A:0x4370078
y.create.l HWIO_RXFE_NB_NBPWR_START_ACTION_SAMPLE_NB0_ADDR A:0x437007c
y.create.l HWIO_RXFE_NB_NBPWR_START_MASK_NB0_ADDR A:0x4370080
y.create.l HWIO_RXFE_NB_NBPWR_STOP_ACTION_SAMPLE_NB0_ADDR A:0x4370084
y.create.l HWIO_RXFE_NB_NBPWR_FINAL_ACC_NB0_ADDR A:0x4370088
y.create.l HWIO_RXFE_NB_NBPWR_CURR_ACC_NB0_ADDR A:0x437008c
y.create.l HWIO_RXFE_NB_NBPWR_MAX_ACC_NB0_ADDR A:0x4370090
y.create.l HWIO_RXFE_NB_FINAL_BITWIDTHS_CFG_NB0_ADDR A:0x43700ac
y.create.l HWIO_RXFE_NB_FINAL_SWAP_NB0_ADDR A:0x43700dc
y.create.l HWIO_RXFE_NB_WTR_CFG_NB0_ADDR A:0x43700b0
y.create.l HWIO_RXFE_NB_WTR_FUNC_CFG_NB0_ADDR A:0x43700b4
y.create.l HWIO_RXFE_NB_WTR_DBG_CFG0_NB0_ADDR A:0x43700b8
y.create.l HWIO_RXFE_NB_WTR_DBG_CFG1_NB0_ADDR A:0x43700bc
y.create.l HWIO_RXFE_NB_WTR_CMD_NB0_ADDR A:0x43700c0
y.create.l HWIO_RXFE_NB_WTR_START_ACTION_SAMPLE_NB0_ADDR A:0x43700c4
y.create.l HWIO_RXFE_NB_WTR_STOP_ACTION_SAMPLE_NB0_ADDR A:0x43700c8
y.create.l HWIO_RXFE_NB_WTR_STATUS_NB0_ADDR A:0x43700d0
y.create.l HWIO_RXFE_NB_WTR_ADDR_SNAPSHOT_NB0_ADDR A:0x43700d4
y.create.l HWIO_RXFE_NB_SPARE_REG_NB0_ADDR A:0x43700d8
y.create.l HWIO_RXFE_NB_NB1_REG_BASE_START_ADDR A:0x4371000
y.create.l HWIO_RXFE_NB_NB1_REG_BASE_LAST_ADDR A:0x43710dc
y.create.l HWIO_RXFE_NB_NB1_REG_BASE_END_ADDR A:0x4372000
y.create.l HWIO_RXFE_NB_TOP_CTL_NB1_ADDR A:0x4371000
y.create.l HWIO_RXFE_NB_GATE_CMD_NB1_ADDR A:0x4371004
y.create.l HWIO_RXFE_NB_GATE_STATUS_NB1_ADDR A:0x4371008
y.create.l HWIO_RXFE_NB_GATE_ACTION_SAMPLE_NB1_ADDR A:0x437100c
y.create.l HWIO_RXFE_NB_TIMINGCTL_STATUS_NB1_ADDR A:0x4371010
y.create.l HWIO_RXFE_NB_CSR_CFG_NB1_ADDR A:0x4371014
y.create.l HWIO_RXFE_NB_CSR_CMD_NB1_ADDR A:0x4371018
y.create.l HWIO_RXFE_NB_CSR_PHASEUPDT_ACTION_SAMPLE_NB1_ADDR A:0x437101c
y.create.l HWIO_RXFE_NB_CSR_FREQUPDT_ACTION_SAMPLE_NB1_ADDR A:0x4371020
y.create.l HWIO_RXFE_NB_CSR_PHASE_OFFSET_NB1_ADDR A:0x4371024
y.create.l HWIO_RXFE_NB_CSR_FREQ_OFFSET_NB1_ADDR A:0x4371028
y.create.l HWIO_RXFE_NB_CSR_CURR_PHASE_OFFSET_NB1_ADDR A:0x437102c
y.create.l HWIO_RXFE_NB_CSR_CURR_FREQ_OFFSET_NB1_ADDR A:0x4371030
y.create.l HWIO_RXFE_NB_FILTERS_CFG_NB1_ADDR A:0x4371034
y.create.l HWIO_RXFE_NB_ICI_COEF0_NB1_ADDR A:0x437103c
y.create.l HWIO_RXFE_NB_ICI_COEF1_NB1_ADDR A:0x4371040
y.create.l HWIO_RXFE_NB_ICI_COEF2_NB1_ADDR A:0x4371044
y.create.l HWIO_RXFE_NB_ICI_COEF3_NB1_ADDR A:0x4371048
y.create.l HWIO_RXFE_NB_ICI_COEF4_NB1_ADDR A:0x437104c
y.create.l HWIO_RXFE_NB_ICI_COEF5_NB1_ADDR A:0x4371050
y.create.l HWIO_RXFE_NB_ICI_COEF6_NB1_ADDR A:0x4371054
y.create.l HWIO_RXFE_NB_ICI_COEF7_NB1_ADDR A:0x4371058
y.create.l HWIO_RXFE_NB_ICI_COEF8_NB1_ADDR A:0x437105c
y.create.l HWIO_RXFE_NB_ICI_COEF9_NB1_ADDR A:0x4371060
y.create.l HWIO_RXFE_NB_NBDC_COMPVAL_I_NB1_ADDR A:0x437106c
y.create.l HWIO_RXFE_NB_NBDC_COMPVAL_Q_NB1_ADDR A:0x4371070
y.create.l HWIO_RXFE_NB_NBPWR_CFG_NB1_ADDR A:0x4371074
y.create.l HWIO_RXFE_NB_NBPWR_CMD_NB1_ADDR A:0x4371078
y.create.l HWIO_RXFE_NB_NBPWR_START_ACTION_SAMPLE_NB1_ADDR A:0x437107c
y.create.l HWIO_RXFE_NB_NBPWR_START_MASK_NB1_ADDR A:0x4371080
y.create.l HWIO_RXFE_NB_NBPWR_STOP_ACTION_SAMPLE_NB1_ADDR A:0x4371084
y.create.l HWIO_RXFE_NB_NBPWR_FINAL_ACC_NB1_ADDR A:0x4371088
y.create.l HWIO_RXFE_NB_NBPWR_CURR_ACC_NB1_ADDR A:0x437108c
y.create.l HWIO_RXFE_NB_NBPWR_MAX_ACC_NB1_ADDR A:0x4371090
y.create.l HWIO_RXFE_NB_FINAL_BITWIDTHS_CFG_NB1_ADDR A:0x43710ac
y.create.l HWIO_RXFE_NB_FINAL_SWAP_NB1_ADDR A:0x43710dc
y.create.l HWIO_RXFE_NB_WTR_CFG_NB1_ADDR A:0x43710b0
y.create.l HWIO_RXFE_NB_WTR_FUNC_CFG_NB1_ADDR A:0x43710b4
y.create.l HWIO_RXFE_NB_WTR_DBG_CFG0_NB1_ADDR A:0x43710b8
y.create.l HWIO_RXFE_NB_WTR_DBG_CFG1_NB1_ADDR A:0x43710bc
y.create.l HWIO_RXFE_NB_WTR_CMD_NB1_ADDR A:0x43710c0
y.create.l HWIO_RXFE_NB_WTR_START_ACTION_SAMPLE_NB1_ADDR A:0x43710c4
y.create.l HWIO_RXFE_NB_WTR_STOP_ACTION_SAMPLE_NB1_ADDR A:0x43710c8
y.create.l HWIO_RXFE_NB_WTR_STATUS_NB1_ADDR A:0x43710d0
y.create.l HWIO_RXFE_NB_WTR_ADDR_SNAPSHOT_NB1_ADDR A:0x43710d4
y.create.l HWIO_RXFE_NB_SPARE_REG_NB1_ADDR A:0x43710d8
y.create.l HWIO_RXFE_BRDG_REG_BASE_START_ADDR A:0x437f000
y.create.l HWIO_RXFE_BRDG_REG_BASE_LAST_ADDR A:0x437f060
y.create.l HWIO_RXFE_BRDG_REG_BASE_END_ADDR A:0x437f100
y.create.l HWIO_RXFE_WRTR0_CFG0_ADDR A:0x437f000
y.create.l HWIO_RXFE_WRTR1_CFG0_ADDR A:0x437f008
y.create.l HWIO_RXFE_WRTR0_CFG1_ADDR A:0x437f004
y.create.l HWIO_RXFE_WRTR1_CFG1_ADDR A:0x437f00c
y.create.l HWIO_RXFE_WRTR_XFER_CTL_ADDR A:0x437f040
y.create.l HWIO_RXFE_BRDG_CTL_ADDR A:0x437f044
y.create.l HWIO_RXFE_BRDG_STATUS_ADDR A:0x437f048
y.create.l HWIO_RXFE_BRDG_CLEAR_ADDR A:0x437f04c
y.create.l HWIO_RXFE_BRDG_ARB_PRI_ADDR A:0x437f050
y.create.l HWIO_RXFE_BRDG_AXI_PRI_ADDR A:0x437f054
y.create.l HWIO_RXFE_BRDG_AXI_IDLE_CNT0_ADDR A:0x437f058
y.create.l HWIO_RXFE_BRDG_AXI_IDLE_CNT1_ADDR A:0x437f060
y.create.l HWIO_DEMBACK_COMMON_REG_BASE_START_ADDR A:0x4340000
y.create.l HWIO_DEMBACK_COMMON_REG_BASE_LAST_ADDR A:0x4340008
y.create.l HWIO_DEMBACK_COMMON_REG_BASE_END_ADDR A:0x4340100
y.create.l HWIO_DEMBACK_EN_ADDR A:0x4340000
y.create.l HWIO_DEMBACK_MODE_SEL_ADDR A:0x4340004
y.create.l HWIO_DEMBACK_AHB_ERR_ADDR A:0x4340008
y.create.l HWIO_DEMBACK_BRDG_REG_BASE_START_ADDR A:0x4340100
y.create.l HWIO_DEMBACK_BRDG_REG_BASE_LAST_ADDR A:0x43401ac
y.create.l HWIO_DEMBACK_BRDG_REG_BASE_END_ADDR A:0x4340200
y.create.l HWIO_DEMBACK_RDR0_XFER_CTL_ADDR A:0x4340100
y.create.l HWIO_DEMBACK_RDR0_CTX0_CFG0_ADDR A:0x4340108
y.create.l HWIO_DEMBACK_RDR0_CTX0_CFG1_ADDR A:0x434010c
y.create.l HWIO_DEMBACK_RDR0_CTX1_CFG0_ADDR A:0x4340110
y.create.l HWIO_DEMBACK_RDR0_CTX1_CFG1_ADDR A:0x4340114
y.create.l HWIO_DEMBACK_RDR0_CTX2_CFG0_ADDR A:0x4340118
y.create.l HWIO_DEMBACK_RDR0_CTX2_CFG1_ADDR A:0x434011c
y.create.l HWIO_DEMBACK_RDR0_CTX3_CFG0_ADDR A:0x4340120
y.create.l HWIO_DEMBACK_RDR0_CTX3_CFG1_ADDR A:0x4340124
y.create.l HWIO_DEMBACK_RDR1_XFER_CTL_ADDR A:0x4340148
y.create.l HWIO_DEMBACK_RDR1_CFG0_ADDR A:0x434014c
y.create.l HWIO_DEMBACK_RDR1_CFG1_ADDR A:0x4340150
y.create.l HWIO_DEMBACK_RDR2_XFER_CTL_ADDR A:0x4340154
y.create.l HWIO_DEMBACK_RDR2_CFG0_ADDR A:0x4340158
y.create.l HWIO_DEMBACK_RDR2_CFG1_ADDR A:0x434015c
y.create.l HWIO_DEMBACK_BRDG_CTL_ADDR A:0x4340190
y.create.l HWIO_DEMBACK_BRDG_STATUS_ADDR A:0x4340194
y.create.l HWIO_DEMBACK_BRDG_CLEAR_ADDR A:0x4340198
y.create.l HWIO_DEMBACK_BRDG_AXI_PRI_ADDR A:0x43401a0
y.create.l HWIO_DEMBACK_DBG_CTL_ADDR A:0x43401ac
y.create.l HWIO_LTE_DEMBACK_REG_BASE_START_ADDR A:0x4341000
y.create.l HWIO_LTE_DEMBACK_REG_BASE_LAST_ADDR A:0x434102c
y.create.l HWIO_LTE_DEMBACK_REG_BASE_END_ADDR A:0x4341050
y.create.l HWIO_LTE_DBE_SCRAMBLE_SEED_FF_X1_SEED_ADDR A:0x4341008
y.create.l HWIO_LTE_DBE_TESTBUS_ENABLE_ADDR A:0x434100c
y.create.l HWIO_LTE_DBE_TESTBUS_STATUS_ADDR A:0x4341010
y.create.l HWIO_LTE_DBE_PDSCH_CMD_COUNT_ADDR A:0x434101c
y.create.l HWIO_LTE_DBE_PDSCH_DONE_COUNT_ADDR A:0x4341028
y.create.l HWIO_LTE_CFG_ADDR A:0x434102c
y.create.l HWIO_CCHP_TOP_RIF_MMAP_REG_BASE_START_ADDR A:0x4342000
y.create.l HWIO_CCHP_TOP_RIF_MMAP_REG_BASE_LAST_ADDR A:0x4342028
y.create.l HWIO_CCHP_TOP_RIF_MMAP_REG_BASE_END_ADDR A:0x434202c
y.create.l HWIO_CCHP_COMMON_ADDR A:0x4342000
y.create.l HWIO_CCHP_CMD_ADDR A:0x4342004
y.create.l HWIO_CCHP_LLR_CAND_ADDR A:0x4342008
y.create.l HWIO_CCHP_VBUF_CFG_0_WORD0_ADDR A:0x434200c
y.create.l HWIO_CCHP_VBUF_CFG_0_WORD1_ADDR A:0x4342010
y.create.l HWIO_CCHP_VBUF_CFG_1_WORD0_ADDR A:0x4342014
y.create.l HWIO_CCHP_VBUF_CFG_1_WORD1_ADDR A:0x4342018
y.create.l HWIO_CCHP_VBUF_CFG_2_WORD0_ADDR A:0x434201c
y.create.l HWIO_CCHP_VBUF_CFG_2_WORD1_ADDR A:0x4342020
y.create.l HWIO_CCHP_TASK_DONE_STATUS_ADDR A:0x4342024
y.create.l HWIO_CCHP_TASK_CFG_STATUS_ADDR A:0x4342028
y.create.l HWIO_DB_BUF_REG_BASE_START_ADDR A:0x4344000
y.create.l HWIO_DB_BUF_REG_BASE_LAST_ADDR A:0x4344108
y.create.l HWIO_DB_BUF_REG_BASE_END_ADDR A:0x4348000
y.create.l HWIO_DEMBACK_BUFF_MODE_ADDR A:0x4344004
y.create.l HWIO_DEMBACK_AHB_MEM_PAGE_ADDR A:0x4344008
y.create.l HWIO_DEMBACK_BUFF_MEM_CMD_ADDR A:0x4344010
y.create.l HWIO_DEMBACK_BUFF_MEM_WR_ADDR A:0x4344014
y.create.l HWIO_DEMBACK_BUFF_MEM_RD_ADDR A:0x4344018
y.create.l HWIO_DEMBACK_DBBUF_RDR0_CFG0_ADDR A:0x4344020
y.create.l HWIO_DEMBACK_DBBUF_RDR1_CFG0_ADDR A:0x434402c
y.create.l HWIO_DEMBACK_DBBUF_RDR2_CFG0_ADDR A:0x4344038
y.create.l HWIO_DEMBACK_DBBUF_RDR3_CFG0_ADDR A:0x4344044
y.create.l HWIO_DEMBACK_DBBUF_RDR0_CFG1_ADDR A:0x4344024
y.create.l HWIO_DEMBACK_DBBUF_RDR1_CFG1_ADDR A:0x4344030
y.create.l HWIO_DEMBACK_DBBUF_RDR2_CFG1_ADDR A:0x434403c
y.create.l HWIO_DEMBACK_DBBUF_RDR3_CFG1_ADDR A:0x4344048
y.create.l HWIO_DEMBACK_DBBUF_RDR0_XFER_CTL_ADDR A:0x4344028
y.create.l HWIO_DEMBACK_DBBUF_RDR1_XFER_CTL_ADDR A:0x4344034
y.create.l HWIO_DEMBACK_DBBUF_RDR2_XFER_CTL_ADDR A:0x4344040
y.create.l HWIO_DEMBACK_DBBUF_RDR3_XFER_CTL_ADDR A:0x434404c
y.create.l HWIO_DEMBACK_DBBUF_WRTR0_CFG0_ADDR A:0x4344080
y.create.l HWIO_DEMBACK_DBBUF_WRTR1_CFG0_ADDR A:0x434408c
y.create.l HWIO_DEMBACK_DBBUF_WRTR2_CFG0_ADDR A:0x4344098
y.create.l HWIO_DEMBACK_DBBUF_WRTR3_CFG0_ADDR A:0x43440a4
y.create.l HWIO_DEMBACK_DBBUF_WRTR0_CFG1_ADDR A:0x4344084
y.create.l HWIO_DEMBACK_DBBUF_WRTR1_CFG1_ADDR A:0x4344090
y.create.l HWIO_DEMBACK_DBBUF_WRTR2_CFG1_ADDR A:0x434409c
y.create.l HWIO_DEMBACK_DBBUF_WRTR3_CFG1_ADDR A:0x43440a8
y.create.l HWIO_DEMBACK_DBBUF_WRTR0_XFER_CTL_ADDR A:0x4344088
y.create.l HWIO_DEMBACK_DBBUF_WRTR1_XFER_CTL_ADDR A:0x4344094
y.create.l HWIO_DEMBACK_DBBUF_WRTR2_XFER_CTL_ADDR A:0x43440a0
y.create.l HWIO_DEMBACK_DBBUF_WRTR3_XFER_CTL_ADDR A:0x43440ac
y.create.l HWIO_DEMBACK_DBBUF_BRDG_CTL_ADDR A:0x4344100
y.create.l HWIO_DEMBACK_DBBUF_BRDG_STATUS_ADDR A:0x4344104
y.create.l HWIO_DEMBACK_DBBUF_BRDG_CLEAR_ADDR A:0x4344108
y.create.l HWIO_LTE_DEMBACK_SCH_TRIF_REG_BASE_START_ADDR A:0x4349000
y.create.l HWIO_LTE_DEMBACK_SCH_TRIF_REG_BASE_LAST_ADDR A:0x4349200
y.create.l HWIO_LTE_DEMBACK_SCH_TRIF_REG_BASE_END_ADDR A:0x4349300
y.create.l HWIO_LTE_DEMBACK_SCH_STATUS_WORD0_ADDR A:0x4349000
y.create.l HWIO_LTE_DEMBACK_SCH_SHARED_WORD0_ADDR A:0x4349100
y.create.l HWIO_LTE_DEMBACK_SCH_SHARED_WORD1_ADDR A:0x4349104
y.create.l HWIO_LTE_DEMBACK_SCH_SHARED_WORD2_ADDR A:0x4349108
y.create.l HWIO_LTE_DEMBACK_SCH_SHARED_WORD3_ADDR A:0x434910c
y.create.l HWIO_LTE_DEMBACK_SCH_SHARED_WORD4_ADDR A:0x4349110
y.create.l HWIO_LTE_DEMBACK_SCH_SHARED_WORD5_ADDR A:0x4349114
y.create.l HWIO_LTE_DEMBACK_SCH_SHARED_WORD6_ADDR A:0x4349118
y.create.l HWIO_PDSCH_HARQ_CFG_WORD0_ADDR A:0x4349200
y.create.l HWIO_DECOB_REG_BASE_START_ADDR A:0x4350500
y.create.l HWIO_DECOB_REG_BASE_LAST_ADDR A:0x43505bc
y.create.l HWIO_DECOB_REG_BASE_END_ADDR A:0x43505c1
y.create.l HWIO_DECOB_MEM_BASE_MIN_ADDR A:0x4350500
y.create.l HWIO_DECOB_MEM_BASE_MIN_INT_ADDR A:0x4350580
y.create.l HWIO_DECOB_MEM_BASE_MAX_ADDR A:0x43505bc
y.create.l HWIO_DB_BUF_PAGE_REG_BASE_START_ADDR A:0x435c000
y.create.l HWIO_DB_BUF_PAGE_REG_BASE_LAST_ADDR A:0x435fffc
y.create.l HWIO_DB_BUF_PAGE_REG_BASE_END_ADDR A:0x4360000
y.create.l HWIO_HARQ_PAGE_START_ADDR A:0x435c000
y.create.l HWIO_HARQ_PAGE_END_ADDR A:0x435fffc
y.create.l HWIO_TDEC_REG_BASE_START_ADDR A:0x433c000
y.create.l HWIO_TDEC_REG_BASE_LAST_ADDR A:0x433c0a4
y.create.l HWIO_TDEC_REG_BASE_END_ADDR A:0x433c0a8
y.create.l HWIO_TDEC_CLK_CTL_ADDR A:0x433c000
y.create.l HWIO_TDEC_SW_CLK_EN_ADDR A:0x433c004
y.create.l HWIO_TDEC_CLK_STATUS_REG_ADDR A:0x433c008
y.create.l HWIO_TDEC_MODE_CTL_ADDR A:0x433c00c
y.create.l HWIO_TD_COMMON_CFG0_ADDR A:0x433c020
y.create.l HWIO_TD_COMMON_CFG1_ADDR A:0x433c024
y.create.l HWIO_TD_COMMON_CFG2_ADDR A:0x433c028
y.create.l HWIO_TDEC_HW_IDLE_ADDR A:0x433c044
y.create.l HWIO_TDEC_TESTBUS_ENABLE_ADDR A:0x433c060
y.create.l HWIO_TDEC_TESTBUS_STATUS_ADDR A:0x433c064
y.create.l HWIO_DECIB_PAGE_ID_ADDR A:0x433c068
y.create.l HWIO_TDEC_AHB_ERROR_ADDR_RD_ADDR A:0x433c070
y.create.l HWIO_TEST_CRC_000_RD_ADDR A:0x433c074
y.create.l HWIO_TEST_CRC_001_RD_ADDR A:0x433c078
y.create.l HWIO_TEST_CRC_010_RD_ADDR A:0x433c07c
y.create.l HWIO_TEST_CRC_011_RD_ADDR A:0x433c080
y.create.l HWIO_TEST_CRC_100_RD_ADDR A:0x433c084
y.create.l HWIO_TEST_CRC_101_RD_ADDR A:0x433c088
y.create.l HWIO_TEST_CRC_110_RD_ADDR A:0x433c08c
y.create.l HWIO_TEST_CRC_111_RD_ADDR A:0x433c090
y.create.l HWIO_A2_TEST_SW_CFG_DATA0_ADDR A:0x433c094
y.create.l HWIO_A2_TEST_SW_CFG_DATA1_ADDR A:0x433c098
y.create.l HWIO_A2_TEST_SW_CFG_DATA2_ADDR A:0x433c09c
y.create.l HWIO_A2_TEST_SW_CFG_DATA3_ADDR A:0x433c0a0
y.create.l HWIO_A2_TEST_SW_CFG_DATA4_ADDR A:0x433c0a4
y.create.l HWIO_TD_CFG_TRIF_REG_BASE_START_ADDR A:0x433d000
y.create.l HWIO_TD_CFG_TRIF_REG_BASE_LAST_ADDR A:0x433d314
y.create.l HWIO_TD_CFG_TRIF_REG_BASE_END_ADDR A:0x433d400
y.create.l HWIO_TD_CFG_STATUS_WORD0_ADDR A:0x433d000
y.create.l HWIO_LTE_CFG_WORD0_ADDR A:0x433d100
y.create.l HWIO_LTE_CFG_WORD1_ADDR A:0x433d104
y.create.l HWIO_LTE_CFG_WORD2_ADDR A:0x433d108
y.create.l HWIO_LTE_TRBLK_CFG_WORD0_0_ADDR A:0x433d200
y.create.l HWIO_LTE_TRBLK_CFG_WORD1_0_ADDR A:0x433d204
y.create.l HWIO_LTE_TRBLK_CFG_WORD2_0_ADDR A:0x433d208
y.create.l HWIO_LTE_TRBLK_CFG_WORD3_0_ADDR A:0x433d20c
y.create.l HWIO_LTE_TRBLK_CFG_WORD4_0_ADDR A:0x433d210
y.create.l HWIO_LTE_TRBLK_CFG_WORD5_0_ADDR A:0x433d214
y.create.l HWIO_LTE_TRBLK_CFG_WORD0_1_ADDR A:0x433d300
y.create.l HWIO_LTE_TRBLK_CFG_WORD1_1_ADDR A:0x433d304
y.create.l HWIO_LTE_TRBLK_CFG_WORD2_1_ADDR A:0x433d308
y.create.l HWIO_LTE_TRBLK_CFG_WORD3_1_ADDR A:0x433d30c
y.create.l HWIO_LTE_TRBLK_CFG_WORD4_1_ADDR A:0x433d310
y.create.l HWIO_LTE_TRBLK_CFG_WORD5_1_ADDR A:0x433d314
y.create.l HWIO_TD_TRIF_REG_BASE_START_ADDR A:0x433e000
y.create.l HWIO_TD_TRIF_REG_BASE_LAST_ADDR A:0x433e208
y.create.l HWIO_TD_TRIF_REG_BASE_END_ADDR A:0x433e300
y.create.l HWIO_TD_STATUS_WORD0_ADDR A:0x433e000
y.create.l HWIO_LTE_PDSCH_WORD0_0_ADDR A:0x433e100
y.create.l HWIO_LTE_PDSCH_WORD1_0_ADDR A:0x433e104
y.create.l HWIO_LTE_PDSCH_WORD2_0_ADDR A:0x433e108
y.create.l HWIO_LTE_PDSCH_WORD0_1_ADDR A:0x433e200
y.create.l HWIO_LTE_PDSCH_WORD1_1_ADDR A:0x433e204
y.create.l HWIO_LTE_PDSCH_WORD2_1_ADDR A:0x433e208
y.create.l HWIO_TDECIB_MEM_REG_BASE_START_ADDR A:0x433f000
y.create.l HWIO_TDECIB_MEM_REG_BASE_LAST_ADDR A:0x433fffc
y.create.l HWIO_TDECIB_MEM_REG_BASE_END_ADDR A:0x4340000
y.create.l HWIO_TDECIB_MEM_START_ADDR A:0x433f000
y.create.l HWIO_TDECIB_MEM_END_ADDR A:0x433fffc
y.create.l HWIO_PDMEM_REG_BASE_START_ADDR A:0x4300000
y.create.l HWIO_PDMEM_REG_BASE_LAST_ADDR A:0x430bffc
y.create.l HWIO_PDMEM_REG_BASE_END_ADDR A:0x430c000
y.create.l HWIO_PDMEM_MIN_ADDR A:0x4300000
y.create.l HWIO_PDMEM_MAX_ADDR A:0x430bffc
y.create.l HWIO_CONTROL_REG_BASE_START_ADDR A:0x431fc00
y.create.l HWIO_CONTROL_REG_BASE_LAST_ADDR A:0x431fda4
y.create.l HWIO_CONTROL_REG_BASE_END_ADDR A:0x4320000
y.create.l HWIO_CCS_MSTS_ADDR A:0x431fc00
y.create.l HWIO_CCS_MCTL_ADDR A:0x431fc04
y.create.l HWIO_CCS_IPC_ADDR A:0x431fc08
y.create.l HWIO_CCS_PIC0MSK_ADDR A:0x431fc0c
y.create.l HWIO_CCS_PIC0STS_ADDR A:0x431fc10
y.create.l HWIO_CCS_PIC2MSK_ADDR A:0x431fc14
y.create.l HWIO_CCS_PIC2STS_ADDR A:0x431fc18
y.create.l HWIO_CCS_PIC3MSK_ADDR A:0x431fc1c
y.create.l HWIO_CCS_PIC3STS_ADDR A:0x431fc20
y.create.l HWIO_CCS_PIC4MSK_ADDR A:0x431fc24
y.create.l HWIO_CCS_PIC4STS_ADDR A:0x431fc28
y.create.l HWIO_CCS_PIC5MSK_ADDR A:0x431fc2c
y.create.l HWIO_CCS_PIC5STS_ADDR A:0x431fc30
y.create.l HWIO_CCS_PIC6MSK_ADDR A:0x431fc34
y.create.l HWIO_CCS_PIC6STS_ADDR A:0x431fc38
y.create.l HWIO_CCS_PIT_ADDR A:0x431fc3c
y.create.l HWIO_CCS_UTIME_ADDR A:0x431fc40
y.create.l HWIO_CCS_MON0_ADDR A:0x431fc44
y.create.l HWIO_CCS_MON1_ADDR A:0x431fc48
y.create.l HWIO_CCS_MON2_ADDR A:0x431fc4c
y.create.l HWIO_CCS_MON3_ADDR A:0x431fc50
y.create.l HWIO_CCS_MON4_ADDR A:0x431fc54
y.create.l HWIO_CCS_MON5_ADDR A:0x431fc58
y.create.l HWIO_CCS_MON6_ADDR A:0x431fc5c
y.create.l HWIO_CCS_MON7_ADDR A:0x431fc60
y.create.l HWIO_CCS_MON8_ADDR A:0x431fc64
y.create.l HWIO_CCS_MON9_ADDR A:0x431fc68
y.create.l HWIO_CCS_TMR0_ADDR A:0x431fc74
y.create.l HWIO_CCS_TMR1_ADDR A:0x431fc78
y.create.l HWIO_CCS_TMR2_ADDR A:0x431fc7c
y.create.l HWIO_CCS_TMR3_ADDR A:0x431fc80
y.create.l HWIO_CCS_DMAC_ADDR A:0x431fc84
y.create.l HWIO_CCS_DMAC0SRC_ADDR A:0x431fc88
y.create.l HWIO_CCS_DMAC1SRC_ADDR A:0x431fc98
y.create.l HWIO_CCS_DMAC2SRC_ADDR A:0x431fca8
y.create.l HWIO_CCS_DMAC3SRC_ADDR A:0x431fcb8
y.create.l HWIO_CCS_DMAC4SRC_ADDR A:0x431fcc8
y.create.l HWIO_CCS_DMAC5SRC_ADDR A:0x431fcd8
y.create.l HWIO_CCS_DMAC6SRC_ADDR A:0x431fce8
y.create.l HWIO_CCS_DMAC7SRC_ADDR A:0x431fcf8
y.create.l HWIO_CCS_DMAC0DST_ADDR A:0x431fc8c
y.create.l HWIO_CCS_DMAC1DST_ADDR A:0x431fc9c
y.create.l HWIO_CCS_DMAC2DST_ADDR A:0x431fcac
y.create.l HWIO_CCS_DMAC3DST_ADDR A:0x431fcbc
y.create.l HWIO_CCS_DMAC4DST_ADDR A:0x431fccc
y.create.l HWIO_CCS_DMAC5DST_ADDR A:0x431fcdc
y.create.l HWIO_CCS_DMAC6DST_ADDR A:0x431fcec
y.create.l HWIO_CCS_DMAC7DST_ADDR A:0x431fcfc
y.create.l HWIO_CCS_DMAC0LNK_ADDR A:0x431fc90
y.create.l HWIO_CCS_DMAC1LNK_ADDR A:0x431fca0
y.create.l HWIO_CCS_DMAC2LNK_ADDR A:0x431fcb0
y.create.l HWIO_CCS_DMAC3LNK_ADDR A:0x431fcc0
y.create.l HWIO_CCS_DMAC4LNK_ADDR A:0x431fcd0
y.create.l HWIO_CCS_DMAC5LNK_ADDR A:0x431fce0
y.create.l HWIO_CCS_DMAC6LNK_ADDR A:0x431fcf0
y.create.l HWIO_CCS_DMAC7LNK_ADDR A:0x431fd00
y.create.l HWIO_CCS_DMAC0CTL_ADDR A:0x431fc94
y.create.l HWIO_CCS_DMAC1CTL_ADDR A:0x431fca4
y.create.l HWIO_CCS_DMAC2CTL_ADDR A:0x431fcb4
y.create.l HWIO_CCS_DMAC3CTL_ADDR A:0x431fcc4
y.create.l HWIO_CCS_DMAC4CTL_ADDR A:0x431fcd4
y.create.l HWIO_CCS_DMAC5CTL_ADDR A:0x431fce4
y.create.l HWIO_CCS_DMAC6CTL_ADDR A:0x431fcf4
y.create.l HWIO_CCS_DMAC7CTL_ADDR A:0x431fd04
y.create.l HWIO_CCS_RFI_ADDR A:0x431fd08
y.create.l HWIO_CCS_GRFC_SET_ADDR A:0x431fd0c
y.create.l HWIO_CCS_GRFC_CLR_ADDR A:0x431fd10
y.create.l HWIO_CCS_RFFE0_ADDR A:0x431fd14
y.create.l HWIO_CCS_RFFE1_ADDR A:0x431fd30
y.create.l HWIO_CCS_RFFE2_ADDR A:0x431fd4c
y.create.l HWIO_CCS_RFFE0DAT0_ADDR A:0x431fd18
y.create.l HWIO_CCS_RFFE1DAT0_ADDR A:0x431fd34
y.create.l HWIO_CCS_RFFE2DAT0_ADDR A:0x431fd50
y.create.l HWIO_CCS_RFFE0DAT1_ADDR A:0x431fd1c
y.create.l HWIO_CCS_RFFE1DAT1_ADDR A:0x431fd38
y.create.l HWIO_CCS_RFFE2DAT1_ADDR A:0x431fd54
y.create.l HWIO_CCS_RFFE0DAT2_ADDR A:0x431fd20
y.create.l HWIO_CCS_RFFE1DAT2_ADDR A:0x431fd3c
y.create.l HWIO_CCS_RFFE2DAT2_ADDR A:0x431fd58
y.create.l HWIO_CCS_RFFE0DAT3_ADDR A:0x431fd24
y.create.l HWIO_CCS_RFFE1DAT3_ADDR A:0x431fd40
y.create.l HWIO_CCS_RFFE2DAT3_ADDR A:0x431fd5c
y.create.l HWIO_CCS_RFFE0_STS_ADDR A:0x431fd28
y.create.l HWIO_CCS_RFFE1_STS_ADDR A:0x431fd44
y.create.l HWIO_CCS_RFFE2_STS_ADDR A:0x431fd60
y.create.l HWIO_CCS_RFFE0CFG_ADDR A:0x431fd2c
y.create.l HWIO_CCS_RFFE1CFG_ADDR A:0x431fd48
y.create.l HWIO_CCS_RFFE2CFG_ADDR A:0x431fd64
y.create.l HWIO_CCS_RFFE0_DYN_CLK_SEL_ADDR A:0x431fd68
y.create.l HWIO_CCS_LOG_BUF_ADDR A:0x431fd6c
y.create.l HWIO_CCS_LOG_CFG_ADDR A:0x431fd70
y.create.l HWIO_CCS_LOG_PORT_ADDR A:0x431fd74
y.create.l HWIO_CCS_LOG_TASK_SRC_ADDR A:0x431fd78
y.create.l HWIO_CCS_LOG_TASK_DST_ADDR A:0x431fd7c
y.create.l HWIO_CCS_LOG_TASK_LNK_ADDR A:0x431fd80
y.create.l HWIO_CCS_LOG_TASK_CTL_ADDR A:0x431fd84
y.create.l HWIO_CCS_GRFC_RFFE_LOG_HDR_ADDR A:0x431fd88
y.create.l HWIO_CCS_GRFC_RFFE_LOG_CMD_ADDR A:0x431fd8c
y.create.l HWIO_CCS_RFFE_LOG_DAT0_ADDR A:0x431fd90
y.create.l HWIO_CCS_RFFE_LOG_DAT1_ADDR A:0x431fd94
y.create.l HWIO_CCS_RFFE_LOG_DAT2_ADDR A:0x431fd98
y.create.l HWIO_CCS_RFFE_LOG_DAT3_ADDR A:0x431fd9c
y.create.l HWIO_CCS_BP0_ADDR A:0x431fda0
y.create.l HWIO_CCS_BP1_ADDR A:0x431fda4
y.create.l HWIO_MTC_CLK_REG_BASE_START_ADDR A:0x4320000
y.create.l HWIO_MTC_CLK_REG_BASE_LAST_ADDR A:0x432003c
y.create.l HWIO_MTC_CLK_REG_BASE_END_ADDR A:0x4320400
y.create.l HWIO_MTC_ENABLE_ADDR A:0x4320000
y.create.l HWIO_MODEM_ID_ADDR A:0x4320004
y.create.l HWIO_MODEM_FEATURE_EN_ADDR A:0x4320008
y.create.l HWIO_MODEM_OPTION_EN_ADDR A:0x432000c
y.create.l HWIO_MODEM_CLK_DBG_CFG_ADDR A:0x4320010
y.create.l HWIO_MODEM_CLK_SPARE_ADDR A:0x4320014
y.create.l HWIO_MODEM_BRIC_MAXI2AXI_TESTBUS_ADDR A:0x4320038
y.create.l HWIO_MODEM_BRIC_MAXI2AXI_TESTBUS_SEL_ADDR A:0x432003c
y.create.l HWIO_MCDMA_REG_BASE_START_ADDR A:0x4320400
y.create.l HWIO_MCDMA_REG_BASE_LAST_ADDR A:0x432049c
y.create.l HWIO_MCDMA_REG_BASE_END_ADDR A:0x4320800
y.create.l HWIO_MCDMA_RESET_ADDR A:0x4320400
y.create.l HWIO_MCDMA_ENABLE_ADDR A:0x432049c
y.create.l HWIO_MCDMA_LOG_CH_BUSY_ADDR A:0x4320404
y.create.l HWIO_MCDMA_LOG_HW_CH0_SYNC_ADDR A:0x4320408
y.create.l HWIO_MCDMA_LOG_HW_CH1_SYNC_ADDR A:0x432040c
y.create.l HWIO_MCDMA_LOG_HW_CH2_SYNC_ADDR A:0x4320410
y.create.l HWIO_MCDMA_LOG_HW_CH3_SYNC_ADDR A:0x4320414
y.create.l HWIO_MCDMA_LOG_HW_CH4_SYNC_ADDR A:0x4320418
y.create.l HWIO_MCDMA_LOG_HW_CH0_CTL_ADDR A:0x4320420
y.create.l HWIO_MCDMA_LOG_HW_CH1_CTL_ADDR A:0x4320424
y.create.l HWIO_MCDMA_LOG_HW_CH2_CTL_ADDR A:0x4320428
y.create.l HWIO_MCDMA_LOG_HW_CH3_CTL_ADDR A:0x432042c
y.create.l HWIO_MCDMA_LOG_HW_CH4_CTL_ADDR A:0x4320430
y.create.l HWIO_MCDMA_LOG_SW_CH0_RESET_ADDR A:0x4320438
y.create.l HWIO_MCDMA_LOG_SW_CH1_RESET_ADDR A:0x432043c
y.create.l HWIO_MCDMA_LOG_SW_CH2_RESET_ADDR A:0x4320440
y.create.l HWIO_MCDMA_LOG_SW_CH3_RESET_ADDR A:0x4320444
y.create.l HWIO_MCDMA_LOG_SW_CH0_CTL_ADDR A:0x432044c
y.create.l HWIO_MCDMA_LOG_SW_CH1_CTL_ADDR A:0x4320450
y.create.l HWIO_MCDMA_LOG_SW_CH2_CTL_ADDR A:0x4320454
y.create.l HWIO_MCDMA_LOG_SW_CH3_CTL_ADDR A:0x4320458
y.create.l HWIO_MCDMA_PHY_CH_CTL_ADDR A:0x4320460
y.create.l HWIO_MCDMA_LOG_HW_CH0_DBG_ADDR A:0x4320464
y.create.l HWIO_MCDMA_LOG_HW_CH1_DBG_ADDR A:0x4320468
y.create.l HWIO_MCDMA_LOG_HW_CH2_DBG_ADDR A:0x432046c
y.create.l HWIO_MCDMA_LOG_HW_CH3_DBG_ADDR A:0x4320470
y.create.l HWIO_MCDMA_LOG_HW_CH4_DBG_ADDR A:0x4320474
y.create.l HWIO_MCDMA_LOG_SW_CH0_DBG_ADDR A:0x4320478
y.create.l HWIO_MCDMA_LOG_SW_CH1_DBG_ADDR A:0x432047c
y.create.l HWIO_MCDMA_LOG_SW_CH2_DBG_ADDR A:0x4320480
y.create.l HWIO_MCDMA_LOG_SW_CH3_DBG_ADDR A:0x4320484
y.create.l HWIO_MCDMA_PHY_CH_DBG_ADDR A:0x4320488
y.create.l HWIO_MCDMA_VBUF_CFG_DBG_ADDR A:0x432048c
y.create.l HWIO_MCDMA_VBUF_CFG_SEL_ADDR A:0x4320490
y.create.l HWIO_MCDMA_VBUF_CFG_RD0_ADDR A:0x4320494
y.create.l HWIO_MCDMA_VBUF_CFG_RD1_ADDR A:0x4320498
y.create.l HWIO_A2_REG_BASE_START_ADDR A:0x4320800
y.create.l HWIO_A2_REG_BASE_LAST_ADDR A:0x4320be4
y.create.l HWIO_A2_REG_BASE_END_ADDR A:0x4320c00
y.create.l HWIO_A2_SW_RESET_THRD_ADDR A:0x4320800
y.create.l HWIO_A2_SW_RESET_ACC_ADDR A:0x4320804
y.create.l HWIO_A2_TASK0_EN_ADDR A:0x4320808
y.create.l HWIO_A2_TASK1_EN_ADDR A:0x432080c
y.create.l HWIO_A2_TASK2_EN_ADDR A:0x4320810
y.create.l HWIO_A2_TASK3_EN_ADDR A:0x4320814
y.create.l HWIO_A2_TASK0_WR_PTR_ADDR A:0x4320820
y.create.l HWIO_A2_TASK1_WR_PTR_ADDR A:0x4320824
y.create.l HWIO_A2_TASK2_WR_PTR_ADDR A:0x4320828
y.create.l HWIO_A2_TASK3_WR_PTR_ADDR A:0x432082c
y.create.l HWIO_A2_TASK0_RD_PTR_ADDR A:0x4320840
y.create.l HWIO_A2_TASK1_RD_PTR_ADDR A:0x4320844
y.create.l HWIO_A2_TASK2_RD_PTR_ADDR A:0x4320848
y.create.l HWIO_A2_TASK3_RD_PTR_ADDR A:0x432084c
y.create.l HWIO_A2_TASK0_RD_PTR_INIT_ADDR A:0x4320860
y.create.l HWIO_A2_TASK1_RD_PTR_INIT_ADDR A:0x4320864
y.create.l HWIO_A2_TASK2_RD_PTR_INIT_ADDR A:0x4320868
y.create.l HWIO_A2_TASK3_RD_PTR_INIT_ADDR A:0x432086c
y.create.l HWIO_A2_TASK0_RD_PTR_INIT_EN_ADDR A:0x4320880
y.create.l HWIO_A2_TASK1_RD_PTR_INIT_EN_ADDR A:0x4320884
y.create.l HWIO_A2_TASK2_RD_PTR_INIT_EN_ADDR A:0x4320888
y.create.l HWIO_A2_TASK3_RD_PTR_INIT_EN_ADDR A:0x432088c
y.create.l HWIO_A2_QUEUE_UPPER_ADDR_ADDR A:0x43208b0
y.create.l HWIO_A2_STATUS0_WR_EN_ADDR A:0x43208c8
y.create.l HWIO_A2_STATUS1_WR_EN_ADDR A:0x43208cc
y.create.l HWIO_A2_STATUS2_WR_EN_ADDR A:0x43208d0
y.create.l HWIO_A2_STATUS3_WR_EN_ADDR A:0x43208d4
y.create.l HWIO_A2_STATUS4_WR_EN_ADDR A:0x43208d8
y.create.l HWIO_A2_STATUS0_WR_START_ADDR A:0x43208dc
y.create.l HWIO_A2_STATUS1_WR_START_ADDR A:0x43208e0
y.create.l HWIO_A2_STATUS2_WR_START_ADDR A:0x43208e4
y.create.l HWIO_A2_STATUS3_WR_START_ADDR A:0x43208e8
y.create.l HWIO_A2_STATUS4_WR_START_ADDR A:0x43208ec
y.create.l HWIO_A2_STATUS0_WR_END_ADDR A:0x43208f0
y.create.l HWIO_A2_STATUS1_WR_END_ADDR A:0x43208f4
y.create.l HWIO_A2_STATUS2_WR_END_ADDR A:0x43208f8
y.create.l HWIO_A2_STATUS3_WR_END_ADDR A:0x43208fc
y.create.l HWIO_A2_STATUS4_WR_END_ADDR A:0x4320900
y.create.l HWIO_A2_STATUS0_WR_PTR_INIT_ADDR A:0x4320904
y.create.l HWIO_A2_STATUS1_WR_PTR_INIT_ADDR A:0x4320908
y.create.l HWIO_A2_STATUS2_WR_PTR_INIT_ADDR A:0x432090c
y.create.l HWIO_A2_STATUS3_WR_PTR_INIT_ADDR A:0x4320910
y.create.l HWIO_A2_STATUS4_WR_PTR_INIT_ADDR A:0x4320914
y.create.l HWIO_A2_STATUS0_WR_PTR_INIT_EN_ADDR A:0x4320918
y.create.l HWIO_A2_STATUS1_WR_PTR_INIT_EN_ADDR A:0x432091c
y.create.l HWIO_A2_STATUS2_WR_PTR_INIT_EN_ADDR A:0x4320920
y.create.l HWIO_A2_STATUS3_WR_PTR_INIT_EN_ADDR A:0x4320924
y.create.l HWIO_A2_STATUS4_WR_PTR_INIT_EN_ADDR A:0x4320928
y.create.l HWIO_A2_STATUS0_WR_PTR_CURRENT_ADDR A:0x432092c
y.create.l HWIO_A2_STATUS1_WR_PTR_CURRENT_ADDR A:0x4320930
y.create.l HWIO_A2_STATUS2_WR_PTR_CURRENT_ADDR A:0x4320934
y.create.l HWIO_A2_STATUS3_WR_PTR_CURRENT_ADDR A:0x4320938
y.create.l HWIO_A2_STATUS4_WR_PTR_CURRENT_ADDR A:0x432093c
y.create.l HWIO_A2_STATUS0_WR_PTR_ADDR A:0x4320940
y.create.l HWIO_A2_STATUS1_WR_PTR_ADDR A:0x4320944
y.create.l HWIO_A2_STATUS2_WR_PTR_ADDR A:0x4320948
y.create.l HWIO_A2_STATUS3_WR_PTR_ADDR A:0x432094c
y.create.l HWIO_A2_STATUS4_WR_PTR_ADDR A:0x4320950
y.create.l HWIO_A2_STATUS0_RD_PTR_ADDR A:0x4320954
y.create.l HWIO_A2_STATUS1_RD_PTR_ADDR A:0x4320958
y.create.l HWIO_A2_STATUS2_RD_PTR_ADDR A:0x432095c
y.create.l HWIO_A2_STATUS3_RD_PTR_ADDR A:0x4320960
y.create.l HWIO_A2_STATUS4_RD_PTR_ADDR A:0x4320964
y.create.l HWIO_A2_FRAG0_THRESHOLD_ADDR A:0x43209c0
y.create.l HWIO_A2_FRAG1_THRESHOLD_ADDR A:0x43209c4
y.create.l HWIO_A2_FRAG0_REFILL_EN_ADDR A:0x43209c8
y.create.l HWIO_A2_FRAG1_REFILL_EN_ADDR A:0x43209cc
y.create.l HWIO_A2_FRAG0_LEN_ADDR A:0x43209d0
y.create.l HWIO_A2_FRAG1_LEN_ADDR A:0x43209d4
y.create.l HWIO_A2_FRAG0_ADDR_ADDR A:0x43209d8
y.create.l HWIO_A2_FRAG1_ADDR_ADDR A:0x43209dc
y.create.l HWIO_A2_FRAG0_PTR_ADDR A:0x43209e0
y.create.l HWIO_A2_FRAG1_PTR_ADDR A:0x43209e4
y.create.l HWIO_A2_FRAG_CACHE_LINE_ADDR A:0x43209e8
y.create.l HWIO_A2_FRAG_CACHE_LINE_MASK_ADDR A:0x43209ec
y.create.l HWIO_A2_FRAG0_TRANSFER_LEN_ADDR A:0x43209f0
y.create.l HWIO_A2_FRAG1_TRANSFER_LEN_ADDR A:0x43209f4
y.create.l HWIO_A2_FRAG0_HDR_LEN_ADDR A:0x43209f8
y.create.l HWIO_A2_FRAG1_HDR_LEN_ADDR A:0x43209fc
y.create.l HWIO_A2_FRAG0_QUEUE_START_ADDR_ADDR A:0x4320a08
y.create.l HWIO_A2_FRAG1_QUEUE_START_ADDR_ADDR A:0x4320a0c
y.create.l HWIO_A2_FRAG0_QUEUE_WR_PTR_ADDR A:0x4320aa0
y.create.l HWIO_A2_FRAG1_QUEUE_WR_PTR_ADDR A:0x4320aa4
y.create.l HWIO_A2_FRAG0_QUEUE_RD_PTR_ADDR A:0x4320aa8
y.create.l HWIO_A2_FRAG1_QUEUE_RD_PTR_ADDR A:0x4320aac
y.create.l HWIO_A2_FRAG0_RD_PTR_INIT_EN_ADDR A:0x4320acc
y.create.l HWIO_A2_FRAG1_RD_PTR_INIT_EN_ADDR A:0x4320ad0
y.create.l HWIO_A2_TIMER0_CFG_ADDR A:0x4320a10
y.create.l HWIO_A2_TIMER1_CFG_ADDR A:0x4320a14
y.create.l HWIO_A2_TIMER2_CFG_ADDR A:0x4320a18
y.create.l HWIO_A2_TIMER3_CFG_ADDR A:0x4320a1c
y.create.l HWIO_A2_TIMER0_CMD_ADDR A:0x4320a20
y.create.l HWIO_A2_TIMER1_CMD_ADDR A:0x4320a24
y.create.l HWIO_A2_TIMER2_CMD_ADDR A:0x4320a28
y.create.l HWIO_A2_TIMER3_CMD_ADDR A:0x4320a2c
y.create.l HWIO_A2_TIMER0_PERIOD_ADDR A:0x4320a40
y.create.l HWIO_A2_TIMER1_PERIOD_ADDR A:0x4320a44
y.create.l HWIO_A2_TIMER2_PERIOD_ADDR A:0x4320a48
y.create.l HWIO_A2_TIMER3_PERIOD_ADDR A:0x4320a4c
y.create.l HWIO_A2_TIMER0_STATUS_ADDR A:0x4320a50
y.create.l HWIO_A2_TIMER1_STATUS_ADDR A:0x4320a54
y.create.l HWIO_A2_TIMER2_STATUS_ADDR A:0x4320a58
y.create.l HWIO_A2_TIMER3_STATUS_ADDR A:0x4320a5c
y.create.l HWIO_A2_PER_DL_CFG_ADDR A:0x4320a70
y.create.l HWIO_A2_PER0_UL_CFG_ADDR A:0x4320a74
y.create.l HWIO_A2_PER1_UL_CFG_ADDR A:0x4320a78
y.create.l HWIO_A2_PER2_UL_CFG_ADDR A:0x4320a7c
y.create.l HWIO_A2_CKSUM_CFG_ADDR A:0x4320adc
y.create.l HWIO_A2_DL_PHY_DEC_TRBLK_THRESHOLD_ADDR A:0x4320a90
y.create.l HWIO_A2_DL_PHY_CFG_ADDR A:0x4320a94
y.create.l HWIO_A2_HW_THRD_EN_ADDR A:0x4320a98
y.create.l HWIO_A2_UL_PHY_CFG_ADDR A:0x4320a9c
y.create.l HWIO_A2_LTE_DLPHY_CMD_ADDR_ADDR A:0x4320ab0
y.create.l HWIO_A2_IP_FILT_FRAG_ADDR_ADDR A:0x4320ab4
y.create.l HWIO_A2_MCDMA_DMA_IN_ADDR_ADDR A:0x4320ab8
y.create.l HWIO_A2_MCDMA_DMA_OUT_ADDR_ADDR A:0x4320abc
y.create.l HWIO_A2_MCDMA_TASK_ADDR_ADDR A:0x4320ac0
y.create.l HWIO_A2_MCDMA_BAM_NDP_ADDR_ADDR A:0x4320ac4
y.create.l HWIO_A2_DECOB_PREFETCH_ADDR_ADDR A:0x4320ac8
y.create.l HWIO_A2_MCDMA_OST_BRST_ADDR A:0x4320ad4
y.create.l HWIO_A2_MCDMA_MAX_BRST_SIZE_ADDR A:0x4320ad8
y.create.l HWIO_A2_HW_CLK_CTL_ADDR A:0x4320ae0
y.create.l HWIO_A2_CLK_EN_CTL_ADDR A:0x4320ae4
y.create.l HWIO_A2_CLK_STATUS_ADDR A:0x4320ae8
y.create.l HWIO_A2_UL_PER_1ST_PKT_INT_EN_ADDR A:0x4320aec
y.create.l HWIO_A2_DBG_LINK_RD_ADDR A:0x4320af0
y.create.l HWIO_A2_DBG_LINK1_RD_ADDR A:0x4320af4
y.create.l HWIO_A2_DBG_FRAG0_LEN_ADDR A:0x4320af8
y.create.l HWIO_A2_DBG_FRAG1_LEN_ADDR A:0x4320afc
y.create.l HWIO_A2_DBG_FRAG2_LEN_ADDR A:0x4320b00
y.create.l HWIO_A2_DBG_FRAG3_LEN_ADDR A:0x4320b04
y.create.l HWIO_A2_DBG_FRAG4_LEN_ADDR A:0x4320b08
y.create.l HWIO_A2_DBG_FRAG0_ADDR_CUR_ADDR A:0x4320b0c
y.create.l HWIO_A2_DBG_FRAG1_ADDR_CUR_ADDR A:0x4320b10
y.create.l HWIO_A2_DBG_FRAG2_ADDR_CUR_ADDR A:0x4320b14
y.create.l HWIO_A2_DBG_FRAG3_ADDR_CUR_ADDR A:0x4320b18
y.create.l HWIO_A2_DBG_FRAG4_ADDR_CUR_ADDR A:0x4320b1c
y.create.l HWIO_A2_DBG_FRAG0_ADDR_NXT_ADDR A:0x4320b20
y.create.l HWIO_A2_DBG_FRAG1_ADDR_NXT_ADDR A:0x4320b24
y.create.l HWIO_A2_DBG_FRAG2_ADDR_NXT_ADDR A:0x4320b28
y.create.l HWIO_A2_DBG_FRAG3_ADDR_NXT_ADDR A:0x4320b2c
y.create.l HWIO_A2_DBG_FRAG4_ADDR_NXT_ADDR A:0x4320b30
y.create.l HWIO_A2_DBG_FRAG0_PTR_ADDR A:0x4320b34
y.create.l HWIO_A2_DBG_FRAG1_PTR_ADDR A:0x4320b38
y.create.l HWIO_A2_DBG_FRAG2_PTR_ADDR A:0x4320b3c
y.create.l HWIO_A2_DBG_FRAG3_PTR_ADDR A:0x4320b40
y.create.l HWIO_A2_DBG_FRAG4_PTR_ADDR A:0x4320b44
y.create.l HWIO_A2_DBG_TRBLK_LENGTH_ADDR A:0x4320b60
y.create.l HWIO_A2_DBG_TRBLK_START_ADDR_ADDR A:0x4320b64
y.create.l HWIO_A2_DBG_TRBLK_SW_INFO0_ADDR A:0x4320b68
y.create.l HWIO_A2_DBG_TRBLK_SW_INFO1_ADDR A:0x4320b6c
y.create.l HWIO_A2_DBG_TRBLK_TRIGGER_ADDR A:0x4320b70
y.create.l HWIO_A2_DBG_TRBLK_STATUS_ADDR A:0x4320b74
y.create.l HWIO_A2_DBG_STRM_ID_ADDR A:0x4320b80
y.create.l HWIO_A2_DBG_DMA_SRC_ADDR A:0x4320b84
y.create.l HWIO_A2_DBG_DMA_DST_ADDR A:0x4320b8c
y.create.l HWIO_A2_DBG_DMA_CTL_ADDR A:0x4320b90
y.create.l HWIO_A2_DBG_TASK_FETCHER_ADDR A:0x4320b94
y.create.l HWIO_A2_DBG_DL0_BAM_ADDR A:0x4320b98
y.create.l HWIO_A2_DBG_DL1_BAM_ADDR A:0x4320b9c
y.create.l HWIO_A2_DBG_DL2_BAM_ADDR A:0x4320ba0
y.create.l HWIO_A2_DBG_UL0_BAM_ADDR A:0x4320ba4
y.create.l HWIO_A2_DBG_UL1_BAM_ADDR A:0x4320ba8
y.create.l HWIO_A2_DBG_UL2_BAM_ADDR A:0x4320bac
y.create.l HWIO_A2_DBG_FRM_ADDR A:0x4320bb0
y.create.l HWIO_A2_DBG_DFRM_ADDR A:0x4320bb4
y.create.l HWIO_A2_DBG_CIPH_ADDR A:0x4320bb8
y.create.l HWIO_A2_DBG_IPF_ADDR A:0x4320bbc
y.create.l HWIO_A2_DBG_MIU0_ADDR A:0x4320bc0
y.create.l HWIO_A2_DBG_MIU1_ADDR A:0x4320bc4
y.create.l HWIO_A2_DBG_MIU2_ADDR A:0x4320bc8
y.create.l HWIO_A2_DBG_MIU3_ADDR A:0x4320bcc
y.create.l HWIO_A2_DBG_TASK_WORD_ADDR A:0x4320bd0
y.create.l HWIO_A2_DBG_UL_CKSUM0_ADDR A:0x4320bd4
y.create.l HWIO_A2_DBG_UL_CKSUM1_ADDR A:0x4320bd8
y.create.l HWIO_A2_DBG_DL_CKSUM0_ADDR A:0x4320bdc
y.create.l HWIO_A2_DBG_DL_CKSUM1_ADDR A:0x4320be0
y.create.l HWIO_A2_DBG_CKSUM_UL_EOT_ADDR A:0x4320be4
y.create.l HWIO_DBG_REG_BASE_START_ADDR A:0x4320c00
y.create.l HWIO_DBG_REG_BASE_LAST_ADDR A:0x4320c88
y.create.l HWIO_DBG_REG_BASE_END_ADDR A:0x4321000
y.create.l HWIO_DBG_RESET_ADDR A:0x4320c00
y.create.l HWIO_DBG_ENABLE_ADDR A:0x4320c04
y.create.l HWIO_DBG_LOG_STATUS_ADDR A:0x4320c08
y.create.l HWIO_DBG_MUX_MASK_0_ADDR A:0x4320c0c
y.create.l HWIO_DBG_MUX_MASK_1_ADDR A:0x4320c10
y.create.l HWIO_DBG_MUX_MASK_2_ADDR A:0x4320c14
y.create.l HWIO_DBG_MUX_MASK_3_ADDR A:0x4320c18
y.create.l HWIO_DBG_MUX_MASK_4_ADDR A:0x4320c1c
y.create.l HWIO_DBG_MUX_MASK_5_ADDR A:0x4320c20
y.create.l HWIO_DBG_MUX_MASK_6_ADDR A:0x4320c24
y.create.l HWIO_DBG_MUX_MASK_7_ADDR A:0x4320c28
y.create.l HWIO_DBG_MUX_MASK_8_ADDR A:0x4320c2c
y.create.l HWIO_DBG_MUX_MASK_9_ADDR A:0x4320c30
y.create.l HWIO_DBG_PORT_MUX_ADDR A:0x4320c4c
y.create.l HWIO_DBG_ERR_IRQ_MASK0_ADDR A:0x4320c50
y.create.l HWIO_DBG_ERR_IRQ_MASK1_ADDR A:0x4320c54
y.create.l HWIO_DBG_SW_LOG_ADDR A:0x4320c58
y.create.l HWIO_DBG_DATA_DST_ADDR A:0x4320c5c
y.create.l HWIO_DBG_START_ADDR_ADDR A:0x4320c60
y.create.l HWIO_DBG_EXT_MEM_CNT_VAL_ADDR A:0x4320c64
y.create.l HWIO_DBG_SHRD_START_ADDR_ADDR A:0x4320c68
y.create.l HWIO_DBG_SHRD_END_ADDR_ADDR A:0x4320c6c
y.create.l HWIO_DBG_MAX_OST_BURSTS_ADDR A:0x4320c70
y.create.l HWIO_DBG_ERR_IRQ_EN0_ADDR A:0x4320c74
y.create.l HWIO_DBG_ERR_IRQ_EN1_ADDR A:0x4320c78
y.create.l HWIO_DBG_ERR_IRQ_CLR0_ADDR A:0x4320c7c
y.create.l HWIO_DBG_ERR_IRQ_CLR1_ADDR A:0x4320c80
y.create.l HWIO_DBG_ERR_IRQ_STATUS0_ADDR A:0x4320c84
y.create.l HWIO_DBG_ERR_IRQ_STATUS1_ADDR A:0x4320c88
y.create.l HWIO_MTC_BRDG_REG_BASE_START_ADDR A:0x4321000
y.create.l HWIO_MTC_BRDG_REG_BASE_LAST_ADDR A:0x4321014
y.create.l HWIO_MTC_BRDG_REG_BASE_END_ADDR A:0x4321400
y.create.l HWIO_MTC_BRDG_MCDMA_RD_ENABLE_ADDR A:0x432100c
y.create.l HWIO_MTC_BRDG_MCDMA_WR_ENABLE_ADDR A:0x4321010
y.create.l HWIO_MTC_BRDG_A2_RD_ENABLE_ADDR A:0x4321014
y.create.l HWIO_MTC_BRDG_CTL_ADDR A:0x4321000
y.create.l HWIO_MTC_BRDG_STATUS_ADDR A:0x4321004
y.create.l HWIO_MTC_BRDG_CLEAR_ADDR A:0x4321008
y.create.l HWIO_A2_MEM_REG_BASE_START_ADDR A:0x4322000
y.create.l HWIO_A2_MEM_REG_BASE_LAST_ADDR A:0x432367c
y.create.l HWIO_A2_MEM_REG_BASE_END_ADDR A:0x4324000
y.create.l HWIO_A2_SHRD_MEM_BASE_MIN_ADDR A:0x4322000
y.create.l HWIO_A2_SHRD_MEM_BASE_MAX_ADDR A:0x432367c
y.create.l HWIO_MCDMA_TS_TRIF_REG_BASE_START_ADDR A:0x4324000
y.create.l HWIO_MCDMA_TS_TRIF_REG_BASE_LAST_ADDR A:0x4324508
y.create.l HWIO_MCDMA_TS_TRIF_REG_BASE_END_ADDR A:0x4324600
y.create.l HWIO_MCDMA_TS_STATUS_WORD0_ADDR A:0x4324000
y.create.l HWIO_MCDMA_TS_VBUF_CFG_WORD0_ADDR A:0x4324100
y.create.l HWIO_MCDMA_TS_VBUF_CFG_WORD1_ADDR A:0x4324104
y.create.l HWIO_MCDMA_TS_DMA_CH0_WORD0_ADDR A:0x4324200
y.create.l HWIO_MCDMA_TS_DMA_CH0_WORD1_ADDR A:0x4324204
y.create.l HWIO_MCDMA_TS_DMA_CH0_WORD2_ADDR A:0x4324208
y.create.l HWIO_MCDMA_TS_DMA_CH1_WORD0_ADDR A:0x4324300
y.create.l HWIO_MCDMA_TS_DMA_CH1_WORD1_ADDR A:0x4324304
y.create.l HWIO_MCDMA_TS_DMA_CH1_WORD2_ADDR A:0x4324308
y.create.l HWIO_MCDMA_TS_DMA_CH2_WORD0_ADDR A:0x4324400
y.create.l HWIO_MCDMA_TS_DMA_CH2_WORD1_ADDR A:0x4324404
y.create.l HWIO_MCDMA_TS_DMA_CH2_WORD2_ADDR A:0x4324408
y.create.l HWIO_MCDMA_TS_DMA_CH3_WORD0_ADDR A:0x4324500
y.create.l HWIO_MCDMA_TS_DMA_CH3_WORD1_ADDR A:0x4324504
y.create.l HWIO_MCDMA_TS_DMA_CH3_WORD2_ADDR A:0x4324508
y.create.l HWIO_DBG_TS_TRIF_REG_BASE_START_ADDR A:0x4324800
y.create.l HWIO_DBG_TS_TRIF_REG_BASE_LAST_ADDR A:0x4324904
y.create.l HWIO_DBG_TS_TRIF_REG_BASE_END_ADDR A:0x4324a00
y.create.l HWIO_DBG_STATUS_WORD0_ADDR A:0x4324800
y.create.l HWIO_DBG_TASK_WORD0_ADDR A:0x4324900
y.create.l HWIO_DBG_TASK_WORD1_ADDR A:0x4324904
y.create.l HWIO_STMR_EXPY_REG_BASE_START_ADDR A:0x4324c00
y.create.l HWIO_STMR_EXPY_REG_BASE_LAST_ADDR A:0x4324c00
y.create.l HWIO_STMR_EXPY_REG_BASE_END_ADDR A:0x4325000
y.create.l HWIO_UNIV_STMR_MSTMR_EXPY_ADDR A:0x4324c00
y.create.l HWIO_ENCRYPT_REG_BASE_START_ADDR A:0x4325000
y.create.l HWIO_ENCRYPT_REG_BASE_LAST_ADDR A:0x4325078
y.create.l HWIO_ENCRYPT_REG_BASE_END_ADDR A:0x43250fd
y.create.l HWIO_ENCRYPT_ACC_RESET_ADDR A:0x4325000
y.create.l HWIO_ENCRYPT_ACC_CGC_CTL_ADDR A:0x4325004
y.create.l HWIO_ENCRYPT_ACC_CGC_STATUS_ADDR A:0x4325008
y.create.l HWIO_GEA_CONFIG_0_ADDR A:0x432500c
y.create.l HWIO_GEA_INPUT_ADDR A:0x4325010
y.create.l HWIO_GEA_KC_0_ADDR A:0x4325014
y.create.l HWIO_GEA_KC_1_ADDR A:0x4325018
y.create.l HWIO_AMBA_KEY_STRM_WORD0_RD_ADDR A:0x432501c
y.create.l HWIO_AMBA_KEY_STRM_WORD1_RD_ADDR A:0x4325020
y.create.l HWIO_AMBA_KEY_STRM_WORD2_RD_ADDR A:0x4325024
y.create.l HWIO_AMBA_KEY_STRM_WORD3_RD_ADDR A:0x4325028
y.create.l HWIO_AMBA_KEY_STRM_WORD4_RD_ADDR A:0x432502c
y.create.l HWIO_AMBA_KEY_STRM_WORD5_RD_ADDR A:0x4325030
y.create.l HWIO_AMBA_KEY_STRM_WORD6_RD_ADDR A:0x4325034
y.create.l HWIO_AMBA_KEY_STRM_WORD7_RD_ADDR A:0x4325038
y.create.l HWIO_AMBA_KEY_STRM_STATUS_ADDR A:0x432503c
y.create.l HWIO_AFIVE_CONFIG_0_ADDR A:0x4325040
y.create.l HWIO_AFIVE_INPUT_ADDR A:0x4325044
y.create.l HWIO_AFIVE_KC_0_ADDR A:0x4325048
y.create.l HWIO_AFIVE_KC_1_ADDR A:0x432504c
y.create.l HWIO_AFIVE_KEY_STRM_WORD0_RD_ADDR A:0x4325050
y.create.l HWIO_AFIVE_KEY_STRM_WORD1_RD_ADDR A:0x4325054
y.create.l HWIO_AFIVE_KEY_STRM_WORD2_RD_ADDR A:0x4325058
y.create.l HWIO_AFIVE_KEY_STRM_WORD3_RD_ADDR A:0x432505c
y.create.l HWIO_AFIVE_KEY_STRM_WORD4_RD_ADDR A:0x4325060
y.create.l HWIO_AFIVE_KEY_STRM_WORD5_RD_ADDR A:0x4325064
y.create.l HWIO_AFIVE_KEY_STRM_WORD6_RD_ADDR A:0x4325068
y.create.l HWIO_AFIVE_KEY_STRM_WORD7_RD_ADDR A:0x432506c
y.create.l HWIO_AFIVE_KEY_STRM_WORD8_RD_ADDR A:0x4325070
y.create.l HWIO_AFIVE_KEY_STRM_WORD9_RD_ADDR A:0x4325074
y.create.l HWIO_UNIV_STMR_REG_BASE_START_ADDR A:0x4328800
y.create.l HWIO_UNIV_STMR_REG_BASE_LAST_ADDR A:0x4328b80
y.create.l HWIO_UNIV_STMR_REG_BASE_END_ADDR A:0x4328c00
y.create.l HWIO_UNIV_STMR_RESET_ADDR A:0x4328800
y.create.l HWIO_UNIV_STMR_ENABLE_ADDR A:0x4328804
y.create.l HWIO_UNIV_STMR_MSTMR_ADDR A:0x4328808
y.create.l HWIO_UNIV_STMR_SYNC_CMD_ADDR A:0x432880c
y.create.l HWIO_UNIV_STMR_MODIFIER_ADJ_ADDR A:0x4328810
y.create.l HWIO_UNIV_STMR_STATUS_ADDR A:0x4328814
y.create.l HWIO_UNIV_STMR_STATUS_DUMP_CMD_ADDR A:0x4328834
y.create.l HWIO_UNIV_STMR_TIME_STATUS_RD_ADDR A:0x4328838
y.create.l HWIO_TX_C0_CTRL_SEL_ADDR A:0x4328880
y.create.l HWIO_TX_C0_TRIG_CMD_ADDR A:0x4328888
y.create.l HWIO_TX_C0_TRIG_VAL_ADDR A:0x4328890
y.create.l HWIO_TX_TRIG_STATUS_ADDR A:0x43288a8
y.create.l HWIO_TX_C0_TRIG_RD_ADDR A:0x43288b0
y.create.l HWIO_UNIV_STMR_TX_SYNC_TIME0_ADDR A:0x43288d0
y.create.l HWIO_UNIV_STMR_TRIG_CTRL_ADDR A:0x43288d8
y.create.l HWIO_UNIV_STMR_TRIG_MASK_ADDR A:0x43288dc
y.create.l HWIO_VFR_SEL_ADDR A:0x43288e0
y.create.l HWIO_UNIV_STMR_SPARE_ADDR A:0x43288e4
y.create.l HWIO_UNIV_STMR_LD_CMD_ADDR A:0x43288ec
y.create.l HWIO_UNIV_STMR_MODIFIER_LD_ADDR A:0x43288f0
y.create.l HWIO_TX_DAC0_UPDATE_STRT_TRIG_CMD_ADDR A:0x4328908
y.create.l HWIO_TX_DAC0_UPDATE_STRT_VAL_ADDR A:0x4328910
y.create.l HWIO_TX_DAC0_UPDATE_STOP_TRIG_CMD_ADDR A:0x4328918
y.create.l HWIO_TX_DAC0_UPDATE_STOP_VAL_ADDR A:0x4328920
y.create.l HWIO_TX_DAC0_IREF_GAIN_ADDR A:0x4328928
y.create.l HWIO_DACCOMP_MUX_CHAIN0_STRT_TRIG_CMD_ADDR A:0x4328930
y.create.l HWIO_DACCOMP_MUX_CHAIN0_STRT_VAL_ADDR A:0x4328938
y.create.l HWIO_DACCOMP_MUX_CHAIN0_STOP_TRIG_CMD_ADDR A:0x4328940
y.create.l HWIO_DACCOMP_MUX_CHAIN0_STOP_VAL_ADDR A:0x4328948
y.create.l HWIO_DACCOMP_MUX_CHAIN0_STRT_TRIG_RD_ADDR A:0x4328950
y.create.l HWIO_DACCOMP_MUX_CHAIN0_STOP_TRIG_RD_ADDR A:0x4328958
y.create.l HWIO_RXFE_C0_TRIG_CMD_ADDR A:0x4328980
y.create.l HWIO_RXFE_C1_TRIG_CMD_ADDR A:0x4328984
y.create.l HWIO_RXFE_C0_TRIG_VAL_ADDR A:0x43289a0
y.create.l HWIO_RXFE_C1_TRIG_VAL_ADDR A:0x43289a4
y.create.l HWIO_RXFE_TRIG_STATUS_ADDR A:0x43289c0
y.create.l HWIO_RXFE_C0_TRIG_RD_ADDR A:0x43289d0
y.create.l HWIO_RXFE_C1_TRIG_RD_ADDR A:0x43289d4
y.create.l HWIO_STMR_TIME_RD_ADDR A:0x4328b00
y.create.l HWIO_STMR_EVT_MATCH_0_ADDR A:0x4328b04
y.create.l HWIO_STMR_EVT_MATCH_1_ADDR A:0x4328b08
y.create.l HWIO_STMR_EVT_MATCH_2_ADDR A:0x4328b0c
y.create.l HWIO_STMR_EVT_MATCH_3_ADDR A:0x4328b10
y.create.l HWIO_STMR_EVT_MATCH_4_ADDR A:0x4328b14
y.create.l HWIO_STMR_EVT_MATCH_5_ADDR A:0x4328b18
y.create.l HWIO_STMR_EVT_MATCH_6_ADDR A:0x4328b1c
y.create.l HWIO_STMR_EVT_MATCH_7_ADDR A:0x4328b20
y.create.l HWIO_STMR_EVT_MATCH_8_ADDR A:0x4328b24
y.create.l HWIO_STMR_EVT_MATCH_9_ADDR A:0x4328b28
y.create.l HWIO_OCIMEM_CSR_REG_BASE_START_ADDR A:0x50000
y.create.l HWIO_OCIMEM_CSR_REG_BASE_LAST_ADDR A:0x50068
y.create.l HWIO_OCIMEM_CSR_REG_BASE_END_ADDR A:0x50800
y.create.l HWIO_OCIMEM_HW_VERSION_ADDR A:0x50000
y.create.l HWIO_OCIMEM_HW_PROFILE_ADDR A:0x50004
y.create.l HWIO_OCIMEM_GEN_CTL_ADDR A:0x50008
y.create.l HWIO_OCIMEM_GEN_STAT_ADDR A:0x5000c
y.create.l HWIO_OCIMEM_INTC_CLR_ADDR A:0x50010
y.create.l HWIO_OCIMEM_INTC_MASK_ADDR A:0x50014
y.create.l HWIO_OCIMEM_INTC_STAT_ADDR A:0x50018
y.create.l HWIO_OCIMEM_OSW_STATUS_ADDR A:0x5001c
y.create.l HWIO_OCIMEM_PSCGC_TIMERS_ADDR A:0x50034
y.create.l HWIO_OCIMEM_PSCGC_STAT_ADDR A:0x50038
y.create.l HWIO_OCIMEM_PSCGC_M0_M7_CTL_ADDR A:0x5003c
y.create.l HWIO_OCIMEM_ERR_ADDRESS_ADDR A:0x50060
y.create.l HWIO_OCIMEM_AXI_ERR_SYNDROME_ADDR A:0x50064
y.create.l HWIO_OCIMEM_DEBUG_CTL_ADDR A:0x50068
y.create.l HWIO_OCIMEM_MPU_REG_BASE_START_ADDR A:0x53000
y.create.l HWIO_OCIMEM_MPU_REG_BASE_LAST_ADDR A:0x535dc
y.create.l HWIO_OCIMEM_MPU_REG_BASE_END_ADDR A:0x53600
y.create.l HWIO_OCIMEM_MPU_XPU_SCR_ADDR A:0x53000
y.create.l HWIO_OCIMEM_MPU_XPU_SWDR_ADDR A:0x53004
y.create.l HWIO_OCIMEM_MPU_XPU_PRTN_RACR_SSHADOW_ADDR A:0x53008
y.create.l HWIO_OCIMEM_MPU_XPU_PRTN_WACR_SSHADOW_ADDR A:0x5300c
y.create.l HWIO_OCIMEM_MPU_XPU_PRTN_START_SSHADOW0_ADDR A:0x53010
y.create.l HWIO_OCIMEM_MPU_XPU_PRTN_END_SSHADOW0_ADDR A:0x53018
y.create.l HWIO_OCIMEM_MPU_XPU_SEAR0_ADDR A:0x53040
y.create.l HWIO_OCIMEM_MPU_XPU_SESR_ADDR A:0x53048
y.create.l HWIO_OCIMEM_MPU_XPU_SESRRESTORE_ADDR A:0x5304c
y.create.l HWIO_OCIMEM_MPU_XPU_SESYNR0_ADDR A:0x53050
y.create.l HWIO_OCIMEM_MPU_XPU_SESYNR1_ADDR A:0x53054
y.create.l HWIO_OCIMEM_MPU_XPU_SESYNR2_ADDR A:0x53058
y.create.l HWIO_OCIMEM_MPU_XPU_MCR_ADDR A:0x53100
y.create.l HWIO_OCIMEM_MPU_XPU_MEAR0_ADDR A:0x53140
y.create.l HWIO_OCIMEM_MPU_XPU_MESR_ADDR A:0x53148
y.create.l HWIO_OCIMEM_MPU_XPU_MESRRESTORE_ADDR A:0x5314c
y.create.l HWIO_OCIMEM_MPU_XPU_MESYNR0_ADDR A:0x53150
y.create.l HWIO_OCIMEM_MPU_XPU_MESYNR1_ADDR A:0x53154
y.create.l HWIO_OCIMEM_MPU_XPU_MESYNR2_ADDR A:0x53158
y.create.l HWIO_OCIMEM_MPU_XPU_CR_ADDR A:0x53080
y.create.l HWIO_OCIMEM_MPU_XPU_PRTN_RACR_SHADOW_ADDR A:0x53088
y.create.l HWIO_OCIMEM_MPU_XPU_PRTN_WACR_SHADOW_ADDR A:0x5308c
y.create.l HWIO_OCIMEM_MPU_XPU_PRTN_START_SHADOW0_ADDR A:0x53090
y.create.l HWIO_OCIMEM_MPU_XPU_PRTN_END_SHADOW0_ADDR A:0x53098
y.create.l HWIO_OCIMEM_MPU_XPU_RPU_ACR0_ADDR A:0x530a0
y.create.l HWIO_OCIMEM_MPU_XPU_EAR0_ADDR A:0x530c0
y.create.l HWIO_OCIMEM_MPU_XPU_ESR_ADDR A:0x530c8
y.create.l HWIO_OCIMEM_MPU_XPU_ESRRESTORE_ADDR A:0x530cc
y.create.l HWIO_OCIMEM_MPU_XPU_ESYNR0_ADDR A:0x530d0
y.create.l HWIO_OCIMEM_MPU_XPU_ESYNR1_ADDR A:0x530d4
y.create.l HWIO_OCIMEM_MPU_XPU_ESYNR2_ADDR A:0x530d8
y.create.l HWIO_OCIMEM_MPU_XPU_UMR_RACR_ADDR A:0x530e0
y.create.l HWIO_OCIMEM_MPU_XPU_UMR_WACR_ADDR A:0x530e4
y.create.l HWIO_OCIMEM_MPU_XPU_UMR_CNTL_ADDR A:0x530f0
y.create.l HWIO_OCIMEM_MPU_XPU_IDR0_ADDR A:0x53074
y.create.l HWIO_OCIMEM_MPU_XPU_IDR1_ADDR A:0x53078
y.create.l HWIO_OCIMEM_MPU_XPU_REV_ADDR A:0x5307c
y.create.l HWIO_OCIMEM_MPU_XPU_PRT0_RACR0_ADDR A:0x53200
y.create.l HWIO_OCIMEM_MPU_XPU_PRT1_RACR0_ADDR A:0x53280
y.create.l HWIO_OCIMEM_MPU_XPU_PRT2_RACR0_ADDR A:0x53300
y.create.l HWIO_OCIMEM_MPU_XPU_PRT3_RACR0_ADDR A:0x53380
y.create.l HWIO_OCIMEM_MPU_XPU_PRT4_RACR0_ADDR A:0x53400
y.create.l HWIO_OCIMEM_MPU_XPU_PRT5_RACR0_ADDR A:0x53480
y.create.l HWIO_OCIMEM_MPU_XPU_PRT6_RACR0_ADDR A:0x53500
y.create.l HWIO_OCIMEM_MPU_XPU_PRT7_RACR0_ADDR A:0x53580
y.create.l HWIO_OCIMEM_MPU_XPU_PRT0_WACR0_ADDR A:0x53220
y.create.l HWIO_OCIMEM_MPU_XPU_PRT1_WACR0_ADDR A:0x532a0
y.create.l HWIO_OCIMEM_MPU_XPU_PRT2_WACR0_ADDR A:0x53320
y.create.l HWIO_OCIMEM_MPU_XPU_PRT3_WACR0_ADDR A:0x533a0
y.create.l HWIO_OCIMEM_MPU_XPU_PRT4_WACR0_ADDR A:0x53420
y.create.l HWIO_OCIMEM_MPU_XPU_PRT5_WACR0_ADDR A:0x534a0
y.create.l HWIO_OCIMEM_MPU_XPU_PRT6_WACR0_ADDR A:0x53520
y.create.l HWIO_OCIMEM_MPU_XPU_PRT7_WACR0_ADDR A:0x535a0
y.create.l HWIO_OCIMEM_MPU_XPU_PRT0_START0_ADDR A:0x53240
y.create.l HWIO_OCIMEM_MPU_XPU_PRT1_START0_ADDR A:0x532c0
y.create.l HWIO_OCIMEM_MPU_XPU_PRT2_START0_ADDR A:0x53340
y.create.l HWIO_OCIMEM_MPU_XPU_PRT3_START0_ADDR A:0x533c0
y.create.l HWIO_OCIMEM_MPU_XPU_PRT4_START0_ADDR A:0x53440
y.create.l HWIO_OCIMEM_MPU_XPU_PRT5_START0_ADDR A:0x534c0
y.create.l HWIO_OCIMEM_MPU_XPU_PRT6_START0_ADDR A:0x53540
y.create.l HWIO_OCIMEM_MPU_XPU_PRT7_START0_ADDR A:0x535c0
y.create.l HWIO_OCIMEM_MPU_XPU_PRT0_END0_ADDR A:0x53248
y.create.l HWIO_OCIMEM_MPU_XPU_PRT1_END0_ADDR A:0x532c8
y.create.l HWIO_OCIMEM_MPU_XPU_PRT2_END0_ADDR A:0x53348
y.create.l HWIO_OCIMEM_MPU_XPU_PRT3_END0_ADDR A:0x533c8
y.create.l HWIO_OCIMEM_MPU_XPU_PRT4_END0_ADDR A:0x53448
y.create.l HWIO_OCIMEM_MPU_XPU_PRT5_END0_ADDR A:0x534c8
y.create.l HWIO_OCIMEM_MPU_XPU_PRT6_END0_ADDR A:0x53548
y.create.l HWIO_OCIMEM_MPU_XPU_PRT7_END0_ADDR A:0x535c8
y.create.l HWIO_OCIMEM_MPU_XPU_PRT0_SCR_ADDR A:0x53250
y.create.l HWIO_OCIMEM_MPU_XPU_PRT1_SCR_ADDR A:0x532d0
y.create.l HWIO_OCIMEM_MPU_XPU_PRT2_SCR_ADDR A:0x53350
y.create.l HWIO_OCIMEM_MPU_XPU_PRT3_SCR_ADDR A:0x533d0
y.create.l HWIO_OCIMEM_MPU_XPU_PRT4_SCR_ADDR A:0x53450
y.create.l HWIO_OCIMEM_MPU_XPU_PRT5_SCR_ADDR A:0x534d0
y.create.l HWIO_OCIMEM_MPU_XPU_PRT6_SCR_ADDR A:0x53550
y.create.l HWIO_OCIMEM_MPU_XPU_PRT7_SCR_ADDR A:0x535d0
y.create.l HWIO_OCIMEM_MPU_XPU_PRT0_MCR_ADDR A:0x53254
y.create.l HWIO_OCIMEM_MPU_XPU_PRT1_MCR_ADDR A:0x532d4
y.create.l HWIO_OCIMEM_MPU_XPU_PRT2_MCR_ADDR A:0x53354
y.create.l HWIO_OCIMEM_MPU_XPU_PRT3_MCR_ADDR A:0x533d4
y.create.l HWIO_OCIMEM_MPU_XPU_PRT4_MCR_ADDR A:0x53454
y.create.l HWIO_OCIMEM_MPU_XPU_PRT5_MCR_ADDR A:0x534d4
y.create.l HWIO_OCIMEM_MPU_XPU_PRT6_MCR_ADDR A:0x53554
y.create.l HWIO_OCIMEM_MPU_XPU_PRT7_MCR_ADDR A:0x535d4
y.create.l HWIO_OCIMEM_MPU_XPU_PRT0_CNTL0_ADDR A:0x53258
y.create.l HWIO_OCIMEM_MPU_XPU_PRT1_CNTL0_ADDR A:0x532d8
y.create.l HWIO_OCIMEM_MPU_XPU_PRT2_CNTL0_ADDR A:0x53358
y.create.l HWIO_OCIMEM_MPU_XPU_PRT3_CNTL0_ADDR A:0x533d8
y.create.l HWIO_OCIMEM_MPU_XPU_PRT4_CNTL0_ADDR A:0x53458
y.create.l HWIO_OCIMEM_MPU_XPU_PRT5_CNTL0_ADDR A:0x534d8
y.create.l HWIO_OCIMEM_MPU_XPU_PRT6_CNTL0_ADDR A:0x53558
y.create.l HWIO_OCIMEM_MPU_XPU_PRT7_CNTL0_ADDR A:0x535d8
y.create.l HWIO_OCIMEM_MPU_XPU_PRT0_CNTL1_ADDR A:0x5325c
y.create.l HWIO_OCIMEM_MPU_XPU_PRT1_CNTL1_ADDR A:0x532dc
y.create.l HWIO_OCIMEM_MPU_XPU_PRT2_CNTL1_ADDR A:0x5335c
y.create.l HWIO_OCIMEM_MPU_XPU_PRT3_CNTL1_ADDR A:0x533dc
y.create.l HWIO_OCIMEM_MPU_XPU_PRT4_CNTL1_ADDR A:0x5345c
y.create.l HWIO_OCIMEM_MPU_XPU_PRT5_CNTL1_ADDR A:0x534dc
y.create.l HWIO_OCIMEM_MPU_XPU_PRT6_CNTL1_ADDR A:0x5355c
y.create.l HWIO_OCIMEM_MPU_XPU_PRT7_CNTL1_ADDR A:0x535dc
y.create.l HWIO_PCNOC_0_BUS_TIMEOUT_REG_BASE_START_ADDR A:0x23000
y.create.l HWIO_PCNOC_0_BUS_TIMEOUT_REG_BASE_LAST_ADDR A:0x23034
y.create.l HWIO_PCNOC_0_BUS_TIMEOUT_REG_BASE_END_ADDR A:0x24000
y.create.l HWIO_PCNOC_0_ABT_HW_VERSION_ADDR A:0x23000
y.create.l HWIO_PCNOC_0_ABT_INST_ID_ADDR A:0x23004
y.create.l HWIO_PCNOC_0_ABT_NUM_SLAVES_ADDR A:0x23008
y.create.l HWIO_PCNOC_0_ABT_TIMER_LOADVAL_ADDR A:0x2300c
y.create.l HWIO_PCNOC_0_ABT_TIMER_MODE_ADDR A:0x23010
y.create.l HWIO_PCNOC_0_ABT_INTR_STATUS_ADDR A:0x23014
y.create.l HWIO_PCNOC_0_ABT_INTR_CLEAR_ADDR A:0x23018
y.create.l HWIO_PCNOC_0_ABT_INTR_ENABLE_ADDR A:0x2301c
y.create.l HWIO_PCNOC_0_ABT_SYND_VALID_ADDR A:0x23020
y.create.l HWIO_PCNOC_0_ABT_SYND_CLEAR_ADDR A:0x23024
y.create.l HWIO_PCNOC_0_ABT_SYND_ID_ADDR A:0x23028
y.create.l HWIO_PCNOC_0_ABT_SYND_ADDR0_ADDR A:0x2302c
y.create.l HWIO_PCNOC_0_ABT_SYND_ADDR1_ADDR A:0x23030
y.create.l HWIO_PCNOC_0_ABT_SYND_HREADY_ADDR A:0x23034
y.create.l HWIO_PCNOC_1_BUS_TIMEOUT_REG_BASE_START_ADDR A:0x24000
y.create.l HWIO_PCNOC_1_BUS_TIMEOUT_REG_BASE_LAST_ADDR A:0x24034
y.create.l HWIO_PCNOC_1_BUS_TIMEOUT_REG_BASE_END_ADDR A:0x25000
y.create.l HWIO_PCNOC_1_ABT_HW_VERSION_ADDR A:0x24000
y.create.l HWIO_PCNOC_1_ABT_INST_ID_ADDR A:0x24004
y.create.l HWIO_PCNOC_1_ABT_NUM_SLAVES_ADDR A:0x24008
y.create.l HWIO_PCNOC_1_ABT_TIMER_LOADVAL_ADDR A:0x2400c
y.create.l HWIO_PCNOC_1_ABT_TIMER_MODE_ADDR A:0x24010
y.create.l HWIO_PCNOC_1_ABT_INTR_STATUS_ADDR A:0x24014
y.create.l HWIO_PCNOC_1_ABT_INTR_CLEAR_ADDR A:0x24018
y.create.l HWIO_PCNOC_1_ABT_INTR_ENABLE_ADDR A:0x2401c
y.create.l HWIO_PCNOC_1_ABT_SYND_VALID_ADDR A:0x24020
y.create.l HWIO_PCNOC_1_ABT_SYND_CLEAR_ADDR A:0x24024
y.create.l HWIO_PCNOC_1_ABT_SYND_ID_ADDR A:0x24028
y.create.l HWIO_PCNOC_1_ABT_SYND_ADDR0_ADDR A:0x2402c
y.create.l HWIO_PCNOC_1_ABT_SYND_ADDR1_ADDR A:0x24030
y.create.l HWIO_PCNOC_1_ABT_SYND_HREADY_ADDR A:0x24034
y.create.l HWIO_PCNOC_2_BUS_TIMEOUT_REG_BASE_START_ADDR A:0x25000
y.create.l HWIO_PCNOC_2_BUS_TIMEOUT_REG_BASE_LAST_ADDR A:0x25034
y.create.l HWIO_PCNOC_2_BUS_TIMEOUT_REG_BASE_END_ADDR A:0x26000
y.create.l HWIO_PCNOC_2_ABT_HW_VERSION_ADDR A:0x25000
y.create.l HWIO_PCNOC_2_ABT_INST_ID_ADDR A:0x25004
y.create.l HWIO_PCNOC_2_ABT_NUM_SLAVES_ADDR A:0x25008
y.create.l HWIO_PCNOC_2_ABT_TIMER_LOADVAL_ADDR A:0x2500c
y.create.l HWIO_PCNOC_2_ABT_TIMER_MODE_ADDR A:0x25010
y.create.l HWIO_PCNOC_2_ABT_INTR_STATUS_ADDR A:0x25014
y.create.l HWIO_PCNOC_2_ABT_INTR_CLEAR_ADDR A:0x25018
y.create.l HWIO_PCNOC_2_ABT_INTR_ENABLE_ADDR A:0x2501c
y.create.l HWIO_PCNOC_2_ABT_SYND_VALID_ADDR A:0x25020
y.create.l HWIO_PCNOC_2_ABT_SYND_CLEAR_ADDR A:0x25024
y.create.l HWIO_PCNOC_2_ABT_SYND_ID_ADDR A:0x25028
y.create.l HWIO_PCNOC_2_ABT_SYND_ADDR0_ADDR A:0x2502c
y.create.l HWIO_PCNOC_2_ABT_SYND_ADDR1_ADDR A:0x25030
y.create.l HWIO_PCNOC_2_ABT_SYND_HREADY_ADDR A:0x25034
y.create.l HWIO_PCNOC_3_BUS_TIMEOUT_REG_BASE_START_ADDR A:0x26000
y.create.l HWIO_PCNOC_3_BUS_TIMEOUT_REG_BASE_LAST_ADDR A:0x26034
y.create.l HWIO_PCNOC_3_BUS_TIMEOUT_REG_BASE_END_ADDR A:0x27000
y.create.l HWIO_PCNOC_3_ABT_HW_VERSION_ADDR A:0x26000
y.create.l HWIO_PCNOC_3_ABT_INST_ID_ADDR A:0x26004
y.create.l HWIO_PCNOC_3_ABT_NUM_SLAVES_ADDR A:0x26008
y.create.l HWIO_PCNOC_3_ABT_TIMER_LOADVAL_ADDR A:0x2600c
y.create.l HWIO_PCNOC_3_ABT_TIMER_MODE_ADDR A:0x26010
y.create.l HWIO_PCNOC_3_ABT_INTR_STATUS_ADDR A:0x26014
y.create.l HWIO_PCNOC_3_ABT_INTR_CLEAR_ADDR A:0x26018
y.create.l HWIO_PCNOC_3_ABT_INTR_ENABLE_ADDR A:0x2601c
y.create.l HWIO_PCNOC_3_ABT_SYND_VALID_ADDR A:0x26020
y.create.l HWIO_PCNOC_3_ABT_SYND_CLEAR_ADDR A:0x26024
y.create.l HWIO_PCNOC_3_ABT_SYND_ID_ADDR A:0x26028
y.create.l HWIO_PCNOC_3_ABT_SYND_ADDR0_ADDR A:0x2602c
y.create.l HWIO_PCNOC_3_ABT_SYND_ADDR1_ADDR A:0x26030
y.create.l HWIO_PCNOC_3_ABT_SYND_HREADY_ADDR A:0x26034
y.create.l HWIO_PCNOC_4_BUS_TIMEOUT_REG_BASE_START_ADDR A:0x8801000
y.create.l HWIO_PCNOC_4_BUS_TIMEOUT_REG_BASE_LAST_ADDR A:0x8801034
y.create.l HWIO_PCNOC_4_BUS_TIMEOUT_REG_BASE_END_ADDR A:0x8802000
y.create.l HWIO_PCNOC_4_ABT_HW_VERSION_ADDR A:0x8801000
y.create.l HWIO_PCNOC_4_ABT_INST_ID_ADDR A:0x8801004
y.create.l HWIO_PCNOC_4_ABT_NUM_SLAVES_ADDR A:0x8801008
y.create.l HWIO_PCNOC_4_ABT_TIMER_LOADVAL_ADDR A:0x880100c
y.create.l HWIO_PCNOC_4_ABT_TIMER_MODE_ADDR A:0x8801010
y.create.l HWIO_PCNOC_4_ABT_INTR_STATUS_ADDR A:0x8801014
y.create.l HWIO_PCNOC_4_ABT_INTR_CLEAR_ADDR A:0x8801018
y.create.l HWIO_PCNOC_4_ABT_INTR_ENABLE_ADDR A:0x880101c
y.create.l HWIO_PCNOC_4_ABT_SYND_VALID_ADDR A:0x8801020
y.create.l HWIO_PCNOC_4_ABT_SYND_CLEAR_ADDR A:0x8801024
y.create.l HWIO_PCNOC_4_ABT_SYND_ID_ADDR A:0x8801028
y.create.l HWIO_PCNOC_4_ABT_SYND_ADDR0_ADDR A:0x880102c
y.create.l HWIO_PCNOC_4_ABT_SYND_ADDR1_ADDR A:0x8801030
y.create.l HWIO_PCNOC_4_ABT_SYND_HREADY_ADDR A:0x8801034
y.create.l HWIO_PCNOC_5_BUS_TIMEOUT_REG_BASE_START_ADDR A:0x28000
y.create.l HWIO_PCNOC_5_BUS_TIMEOUT_REG_BASE_LAST_ADDR A:0x28034
y.create.l HWIO_PCNOC_5_BUS_TIMEOUT_REG_BASE_END_ADDR A:0x29000
y.create.l HWIO_PCNOC_5_ABT_HW_VERSION_ADDR A:0x28000
y.create.l HWIO_PCNOC_5_ABT_INST_ID_ADDR A:0x28004
y.create.l HWIO_PCNOC_5_ABT_NUM_SLAVES_ADDR A:0x28008
y.create.l HWIO_PCNOC_5_ABT_TIMER_LOADVAL_ADDR A:0x2800c
y.create.l HWIO_PCNOC_5_ABT_TIMER_MODE_ADDR A:0x28010
y.create.l HWIO_PCNOC_5_ABT_INTR_STATUS_ADDR A:0x28014
y.create.l HWIO_PCNOC_5_ABT_INTR_CLEAR_ADDR A:0x28018
y.create.l HWIO_PCNOC_5_ABT_INTR_ENABLE_ADDR A:0x2801c
y.create.l HWIO_PCNOC_5_ABT_SYND_VALID_ADDR A:0x28020
y.create.l HWIO_PCNOC_5_ABT_SYND_CLEAR_ADDR A:0x28024
y.create.l HWIO_PCNOC_5_ABT_SYND_ID_ADDR A:0x28028
y.create.l HWIO_PCNOC_5_ABT_SYND_ADDR0_ADDR A:0x2802c
y.create.l HWIO_PCNOC_5_ABT_SYND_ADDR1_ADDR A:0x28030
y.create.l HWIO_PCNOC_5_ABT_SYND_HREADY_ADDR A:0x28034
y.create.l HWIO_PCNOC_6_BUS_TIMEOUT_REG_BASE_START_ADDR A:0x29000
y.create.l HWIO_PCNOC_6_BUS_TIMEOUT_REG_BASE_LAST_ADDR A:0x29034
y.create.l HWIO_PCNOC_6_BUS_TIMEOUT_REG_BASE_END_ADDR A:0x2a000
y.create.l HWIO_PCNOC_6_ABT_HW_VERSION_ADDR A:0x29000
y.create.l HWIO_PCNOC_6_ABT_INST_ID_ADDR A:0x29004
y.create.l HWIO_PCNOC_6_ABT_NUM_SLAVES_ADDR A:0x29008
y.create.l HWIO_PCNOC_6_ABT_TIMER_LOADVAL_ADDR A:0x2900c
y.create.l HWIO_PCNOC_6_ABT_TIMER_MODE_ADDR A:0x29010
y.create.l HWIO_PCNOC_6_ABT_INTR_STATUS_ADDR A:0x29014
y.create.l HWIO_PCNOC_6_ABT_INTR_CLEAR_ADDR A:0x29018
y.create.l HWIO_PCNOC_6_ABT_INTR_ENABLE_ADDR A:0x2901c
y.create.l HWIO_PCNOC_6_ABT_SYND_VALID_ADDR A:0x29020
y.create.l HWIO_PCNOC_6_ABT_SYND_CLEAR_ADDR A:0x29024
y.create.l HWIO_PCNOC_6_ABT_SYND_ID_ADDR A:0x29028
y.create.l HWIO_PCNOC_6_ABT_SYND_ADDR0_ADDR A:0x2902c
y.create.l HWIO_PCNOC_6_ABT_SYND_ADDR1_ADDR A:0x29030
y.create.l HWIO_PCNOC_6_ABT_SYND_HREADY_ADDR A:0x29034
y.create.l HWIO_PCNOC_7_BUS_TIMEOUT_REG_BASE_START_ADDR A:0x2a000
y.create.l HWIO_PCNOC_7_BUS_TIMEOUT_REG_BASE_LAST_ADDR A:0x2a034
y.create.l HWIO_PCNOC_7_BUS_TIMEOUT_REG_BASE_END_ADDR A:0x2b000
y.create.l HWIO_PCNOC_7_ABT_HW_VERSION_ADDR A:0x2a000
y.create.l HWIO_PCNOC_7_ABT_INST_ID_ADDR A:0x2a004
y.create.l HWIO_PCNOC_7_ABT_NUM_SLAVES_ADDR A:0x2a008
y.create.l HWIO_PCNOC_7_ABT_TIMER_LOADVAL_ADDR A:0x2a00c
y.create.l HWIO_PCNOC_7_ABT_TIMER_MODE_ADDR A:0x2a010
y.create.l HWIO_PCNOC_7_ABT_INTR_STATUS_ADDR A:0x2a014
y.create.l HWIO_PCNOC_7_ABT_INTR_CLEAR_ADDR A:0x2a018
y.create.l HWIO_PCNOC_7_ABT_INTR_ENABLE_ADDR A:0x2a01c
y.create.l HWIO_PCNOC_7_ABT_SYND_VALID_ADDR A:0x2a020
y.create.l HWIO_PCNOC_7_ABT_SYND_CLEAR_ADDR A:0x2a024
y.create.l HWIO_PCNOC_7_ABT_SYND_ID_ADDR A:0x2a028
y.create.l HWIO_PCNOC_7_ABT_SYND_ADDR0_ADDR A:0x2a02c
y.create.l HWIO_PCNOC_7_ABT_SYND_ADDR1_ADDR A:0x2a030
y.create.l HWIO_PCNOC_7_ABT_SYND_HREADY_ADDR A:0x2a034
y.create.l HWIO_PCNOC_SNOC_MPU_MPU1132_32_M31L10_AHB_REG_BASE_START_ADDR A:0x92000
y.create.l HWIO_PCNOC_SNOC_MPU_MPU1132_32_M31L10_AHB_REG_BASE_LAST_ADDR A:0x931dc
y.create.l HWIO_PCNOC_SNOC_MPU_MPU1132_32_M31L10_AHB_REG_BASE_END_ADDR A:0x93200
y.create.l HWIO_PCNOC_SNOC_MPU_XPU_SCR_ADDR A:0x92000
y.create.l HWIO_PCNOC_SNOC_MPU_XPU_SWDR_ADDR A:0x92004
y.create.l HWIO_PCNOC_SNOC_MPU_XPU_PRTN_RACR_SSHADOW_ADDR A:0x92008
y.create.l HWIO_PCNOC_SNOC_MPU_XPU_PRTN_WACR_SSHADOW_ADDR A:0x9200c
y.create.l HWIO_PCNOC_SNOC_MPU_XPU_PRTN_START_SSHADOW0_ADDR A:0x92010
y.create.l HWIO_PCNOC_SNOC_MPU_XPU_PRTN_END_SSHADOW0_ADDR A:0x92018
y.create.l HWIO_PCNOC_SNOC_MPU_XPU_SEAR0_ADDR A:0x92040
y.create.l HWIO_PCNOC_SNOC_MPU_XPU_SESR_ADDR A:0x92048
y.create.l HWIO_PCNOC_SNOC_MPU_XPU_SESRRESTORE_ADDR A:0x9204c
y.create.l HWIO_PCNOC_SNOC_MPU_XPU_SESYNR0_ADDR A:0x92050
y.create.l HWIO_PCNOC_SNOC_MPU_XPU_SESYNR1_ADDR A:0x92054
y.create.l HWIO_PCNOC_SNOC_MPU_XPU_SESYNR2_ADDR A:0x92058
y.create.l HWIO_PCNOC_SNOC_MPU_XPU_MCR_ADDR A:0x92100
y.create.l HWIO_PCNOC_SNOC_MPU_XPU_MEAR0_ADDR A:0x92140
y.create.l HWIO_PCNOC_SNOC_MPU_XPU_MESR_ADDR A:0x92148
y.create.l HWIO_PCNOC_SNOC_MPU_XPU_MESRRESTORE_ADDR A:0x9214c
y.create.l HWIO_PCNOC_SNOC_MPU_XPU_MESYNR0_ADDR A:0x92150
y.create.l HWIO_PCNOC_SNOC_MPU_XPU_MESYNR1_ADDR A:0x92154
y.create.l HWIO_PCNOC_SNOC_MPU_XPU_MESYNR2_ADDR A:0x92158
y.create.l HWIO_PCNOC_SNOC_MPU_XPU_CR_ADDR A:0x92080
y.create.l HWIO_PCNOC_SNOC_MPU_XPU_PRTN_RACR_SHADOW_ADDR A:0x92088
y.create.l HWIO_PCNOC_SNOC_MPU_XPU_PRTN_WACR_SHADOW_ADDR A:0x9208c
y.create.l HWIO_PCNOC_SNOC_MPU_XPU_PRTN_START_SHADOW0_ADDR A:0x92090
y.create.l HWIO_PCNOC_SNOC_MPU_XPU_PRTN_END_SHADOW0_ADDR A:0x92098
y.create.l HWIO_PCNOC_SNOC_MPU_XPU_RPU_ACR0_ADDR A:0x920a0
y.create.l HWIO_PCNOC_SNOC_MPU_XPU_EAR0_ADDR A:0x920c0
y.create.l HWIO_PCNOC_SNOC_MPU_XPU_ESR_ADDR A:0x920c8
y.create.l HWIO_PCNOC_SNOC_MPU_XPU_ESRRESTORE_ADDR A:0x920cc
y.create.l HWIO_PCNOC_SNOC_MPU_XPU_ESYNR0_ADDR A:0x920d0
y.create.l HWIO_PCNOC_SNOC_MPU_XPU_ESYNR1_ADDR A:0x920d4
y.create.l HWIO_PCNOC_SNOC_MPU_XPU_ESYNR2_ADDR A:0x920d8
y.create.l HWIO_PCNOC_SNOC_MPU_XPU_UMR_RACR_ADDR A:0x920e0
y.create.l HWIO_PCNOC_SNOC_MPU_XPU_UMR_WACR_ADDR A:0x920e4
y.create.l HWIO_PCNOC_SNOC_MPU_XPU_UMR_CNTL_ADDR A:0x920f0
y.create.l HWIO_PCNOC_SNOC_MPU_XPU_IDR0_ADDR A:0x92074
y.create.l HWIO_PCNOC_SNOC_MPU_XPU_IDR1_ADDR A:0x92078
y.create.l HWIO_PCNOC_SNOC_MPU_XPU_REV_ADDR A:0x9207c
y.create.l HWIO_PCNOC_SNOC_MPU_XPU_PRT0_RACR0_ADDR A:0x92200
y.create.l HWIO_PCNOC_SNOC_MPU_XPU_PRT1_RACR0_ADDR A:0x92280
y.create.l HWIO_PCNOC_SNOC_MPU_XPU_PRT2_RACR0_ADDR A:0x92300
y.create.l HWIO_PCNOC_SNOC_MPU_XPU_PRT3_RACR0_ADDR A:0x92380
y.create.l HWIO_PCNOC_SNOC_MPU_XPU_PRT4_RACR0_ADDR A:0x92400
y.create.l HWIO_PCNOC_SNOC_MPU_XPU_PRT5_RACR0_ADDR A:0x92480
y.create.l HWIO_PCNOC_SNOC_MPU_XPU_PRT6_RACR0_ADDR A:0x92500
y.create.l HWIO_PCNOC_SNOC_MPU_XPU_PRT7_RACR0_ADDR A:0x92580
y.create.l HWIO_PCNOC_SNOC_MPU_XPU_PRT8_RACR0_ADDR A:0x92600
y.create.l HWIO_PCNOC_SNOC_MPU_XPU_PRT9_RACR0_ADDR A:0x92680
y.create.l HWIO_PCNOC_SNOC_MPU_XPU_PRT0_WACR0_ADDR A:0x92220
y.create.l HWIO_PCNOC_SNOC_MPU_XPU_PRT1_WACR0_ADDR A:0x922a0
y.create.l HWIO_PCNOC_SNOC_MPU_XPU_PRT2_WACR0_ADDR A:0x92320
y.create.l HWIO_PCNOC_SNOC_MPU_XPU_PRT3_WACR0_ADDR A:0x923a0
y.create.l HWIO_PCNOC_SNOC_MPU_XPU_PRT4_WACR0_ADDR A:0x92420
y.create.l HWIO_PCNOC_SNOC_MPU_XPU_PRT5_WACR0_ADDR A:0x924a0
y.create.l HWIO_PCNOC_SNOC_MPU_XPU_PRT6_WACR0_ADDR A:0x92520
y.create.l HWIO_PCNOC_SNOC_MPU_XPU_PRT7_WACR0_ADDR A:0x925a0
y.create.l HWIO_PCNOC_SNOC_MPU_XPU_PRT8_WACR0_ADDR A:0x92620
y.create.l HWIO_PCNOC_SNOC_MPU_XPU_PRT9_WACR0_ADDR A:0x926a0
y.create.l HWIO_PCNOC_SNOC_MPU_XPU_PRT0_START0_ADDR A:0x92240
y.create.l HWIO_PCNOC_SNOC_MPU_XPU_PRT1_START0_ADDR A:0x922c0
y.create.l HWIO_PCNOC_SNOC_MPU_XPU_PRT2_START0_ADDR A:0x92340
y.create.l HWIO_PCNOC_SNOC_MPU_XPU_PRT3_START0_ADDR A:0x923c0
y.create.l HWIO_PCNOC_SNOC_MPU_XPU_PRT4_START0_ADDR A:0x92440
y.create.l HWIO_PCNOC_SNOC_MPU_XPU_PRT5_START0_ADDR A:0x924c0
y.create.l HWIO_PCNOC_SNOC_MPU_XPU_PRT6_START0_ADDR A:0x92540
y.create.l HWIO_PCNOC_SNOC_MPU_XPU_PRT7_START0_ADDR A:0x925c0
y.create.l HWIO_PCNOC_SNOC_MPU_XPU_PRT8_START0_ADDR A:0x92640
y.create.l HWIO_PCNOC_SNOC_MPU_XPU_PRT9_START0_ADDR A:0x926c0
y.create.l HWIO_PCNOC_SNOC_MPU_XPU_PRT0_END0_ADDR A:0x92248
y.create.l HWIO_PCNOC_SNOC_MPU_XPU_PRT1_END0_ADDR A:0x922c8
y.create.l HWIO_PCNOC_SNOC_MPU_XPU_PRT2_END0_ADDR A:0x92348
y.create.l HWIO_PCNOC_SNOC_MPU_XPU_PRT3_END0_ADDR A:0x923c8
y.create.l HWIO_PCNOC_SNOC_MPU_XPU_PRT4_END0_ADDR A:0x92448
y.create.l HWIO_PCNOC_SNOC_MPU_XPU_PRT5_END0_ADDR A:0x924c8
y.create.l HWIO_PCNOC_SNOC_MPU_XPU_PRT6_END0_ADDR A:0x92548
y.create.l HWIO_PCNOC_SNOC_MPU_XPU_PRT7_END0_ADDR A:0x925c8
y.create.l HWIO_PCNOC_SNOC_MPU_XPU_PRT8_END0_ADDR A:0x92648
y.create.l HWIO_PCNOC_SNOC_MPU_XPU_PRT9_END0_ADDR A:0x926c8
y.create.l HWIO_PCNOC_SNOC_MPU_XPU_PRT0_SCR_ADDR A:0x92250
y.create.l HWIO_PCNOC_SNOC_MPU_XPU_PRT1_SCR_ADDR A:0x922d0
y.create.l HWIO_PCNOC_SNOC_MPU_XPU_PRT2_SCR_ADDR A:0x92350
y.create.l HWIO_PCNOC_SNOC_MPU_XPU_PRT3_SCR_ADDR A:0x923d0
y.create.l HWIO_PCNOC_SNOC_MPU_XPU_PRT4_SCR_ADDR A:0x92450
y.create.l HWIO_PCNOC_SNOC_MPU_XPU_PRT5_SCR_ADDR A:0x924d0
y.create.l HWIO_PCNOC_SNOC_MPU_XPU_PRT6_SCR_ADDR A:0x92550
y.create.l HWIO_PCNOC_SNOC_MPU_XPU_PRT7_SCR_ADDR A:0x925d0
y.create.l HWIO_PCNOC_SNOC_MPU_XPU_PRT8_SCR_ADDR A:0x92650
y.create.l HWIO_PCNOC_SNOC_MPU_XPU_PRT9_SCR_ADDR A:0x926d0
y.create.l HWIO_PCNOC_SNOC_MPU_XPU_PRT0_MCR_ADDR A:0x92254
y.create.l HWIO_PCNOC_SNOC_MPU_XPU_PRT1_MCR_ADDR A:0x922d4
y.create.l HWIO_PCNOC_SNOC_MPU_XPU_PRT2_MCR_ADDR A:0x92354
y.create.l HWIO_PCNOC_SNOC_MPU_XPU_PRT3_MCR_ADDR A:0x923d4
y.create.l HWIO_PCNOC_SNOC_MPU_XPU_PRT4_MCR_ADDR A:0x92454
y.create.l HWIO_PCNOC_SNOC_MPU_XPU_PRT5_MCR_ADDR A:0x924d4
y.create.l HWIO_PCNOC_SNOC_MPU_XPU_PRT6_MCR_ADDR A:0x92554
y.create.l HWIO_PCNOC_SNOC_MPU_XPU_PRT7_MCR_ADDR A:0x925d4
y.create.l HWIO_PCNOC_SNOC_MPU_XPU_PRT8_MCR_ADDR A:0x92654
y.create.l HWIO_PCNOC_SNOC_MPU_XPU_PRT9_MCR_ADDR A:0x926d4
y.create.l HWIO_PCNOC_SNOC_MPU_XPU_PRT0_CNTL0_ADDR A:0x92258
y.create.l HWIO_PCNOC_SNOC_MPU_XPU_PRT1_CNTL0_ADDR A:0x922d8
y.create.l HWIO_PCNOC_SNOC_MPU_XPU_PRT2_CNTL0_ADDR A:0x92358
y.create.l HWIO_PCNOC_SNOC_MPU_XPU_PRT3_CNTL0_ADDR A:0x923d8
y.create.l HWIO_PCNOC_SNOC_MPU_XPU_PRT4_CNTL0_ADDR A:0x92458
y.create.l HWIO_PCNOC_SNOC_MPU_XPU_PRT5_CNTL0_ADDR A:0x924d8
y.create.l HWIO_PCNOC_SNOC_MPU_XPU_PRT6_CNTL0_ADDR A:0x92558
y.create.l HWIO_PCNOC_SNOC_MPU_XPU_PRT7_CNTL0_ADDR A:0x925d8
y.create.l HWIO_PCNOC_SNOC_MPU_XPU_PRT8_CNTL0_ADDR A:0x92658
y.create.l HWIO_PCNOC_SNOC_MPU_XPU_PRT9_CNTL0_ADDR A:0x926d8
y.create.l HWIO_PCNOC_SNOC_MPU_XPU_PRT0_CNTL1_ADDR A:0x9225c
y.create.l HWIO_PCNOC_SNOC_MPU_XPU_PRT1_CNTL1_ADDR A:0x922dc
y.create.l HWIO_PCNOC_SNOC_MPU_XPU_PRT2_CNTL1_ADDR A:0x9235c
y.create.l HWIO_PCNOC_SNOC_MPU_XPU_PRT3_CNTL1_ADDR A:0x923dc
y.create.l HWIO_PCNOC_SNOC_MPU_XPU_PRT4_CNTL1_ADDR A:0x9245c
y.create.l HWIO_PCNOC_SNOC_MPU_XPU_PRT5_CNTL1_ADDR A:0x924dc
y.create.l HWIO_PCNOC_SNOC_MPU_XPU_PRT6_CNTL1_ADDR A:0x9255c
y.create.l HWIO_PCNOC_SNOC_MPU_XPU_PRT7_CNTL1_ADDR A:0x925dc
y.create.l HWIO_PCNOC_SNOC_MPU_XPU_PRT8_CNTL1_ADDR A:0x9265c
y.create.l HWIO_PCNOC_SNOC_MPU_XPU_PRT9_CNTL1_ADDR A:0x926dc
y.create.l HWIO_PC_NOC_REG_BASE_START_ADDR A:0x500000
y.create.l HWIO_PC_NOC_REG_BASE_LAST_ADDR A:0x51700c
y.create.l HWIO_PC_NOC_REG_BASE_END_ADDR A:0x517080
y.create.l HWIO_PCNOC_OBS_ID_COREID_ADDR A:0x500000
y.create.l HWIO_PCNOC_OBS_ID_REVISIONID_ADDR A:0x500004
y.create.l HWIO_PCNOC_OBS_FAULTEN_ADDR A:0x500008
y.create.l HWIO_PCNOC_OBS_ERRVLD_ADDR A:0x50000c
y.create.l HWIO_PCNOC_OBS_ERRCLR_ADDR A:0x500010
y.create.l HWIO_PCNOC_OBS_ERRLOG0_ADDR A:0x500014
y.create.l HWIO_PCNOC_OBS_ERRLOG1_ADDR A:0x500018
y.create.l HWIO_PCNOC_OBS_ERRLOG2_ADDR A:0x50001c
y.create.l HWIO_PCNOC_OBS_ERRLOG3_ADDR A:0x500020
y.create.l HWIO_PCNOC_OBS_ERRLOG4_ADDR A:0x500024
y.create.l HWIO_PCNOC_OBS_ERRLOG5_ADDR A:0x500028
y.create.l HWIO_PCNOC_OBS_STALLEN_ADDR A:0x500038
y.create.l HWIO_PCNOC_OBS_DBG_ID_COREID_ADDR A:0x500080
y.create.l HWIO_PCNOC_OBS_DBG_ID_REVISIONID_ADDR A:0x500084
y.create.l HWIO_PCNOC_OBS_DBG_ATBID_ADDR A:0x500088
y.create.l HWIO_PCNOC_OBS_DBG_ATBEN_ADDR A:0x50008c
y.create.l HWIO_PCNOC_OBS_STPV2_CONVERTER_ID_COREID_ADDR A:0x500200
y.create.l HWIO_PCNOC_OBS_STPV2_CONVERTER_ID_REVISIONID_ADDR A:0x500204
y.create.l HWIO_PCNOC_OBS_STPV2_CONVERTER_ASYNCPERIOD_ADDR A:0x500208
y.create.l HWIO_PCNOC_OBS_STPV2_CONVERTER_STPV2EN_ADDR A:0x50020c
y.create.l HWIO_PCNOC_QXM_CRYPTO0_TFILT_ID_COREID_ADDR A:0x501000
y.create.l HWIO_PCNOC_QXM_CRYPTO0_TFILT_ID_REVISIONID_ADDR A:0x501004
y.create.l HWIO_PCNOC_QXM_CRYPTO0_TFILT_MODE_ADDR A:0x501008
y.create.l HWIO_PCNOC_QXM_CRYPTO0_TFILT_ADDRBASE_LOW_ADDR A:0x50100c
y.create.l HWIO_PCNOC_QXM_CRYPTO0_TFILT_ADDRBASE_HIGH_ADDR A:0x501010
y.create.l HWIO_PCNOC_QXM_CRYPTO0_TFILT_ADDRWINDOWSIZE_ADDR A:0x501014
y.create.l HWIO_PCNOC_QXM_CRYPTO0_TFILT_SRCIDBASE_ADDR A:0x501018
y.create.l HWIO_PCNOC_QXM_CRYPTO0_TFILT_SRCIDMASK_ADDR A:0x50101c
y.create.l HWIO_PCNOC_QXM_CRYPTO0_TFILT_OPCODE_ADDR A:0x501020
y.create.l HWIO_PCNOC_QXM_CRYPTO0_TFILT_USERBASE_ADDR A:0x501024
y.create.l HWIO_PCNOC_QXM_CRYPTO0_TFILT_USERMASK_ADDR A:0x501028
y.create.l HWIO_PCNOC_QHM2_TFILT_ID_COREID_ADDR A:0x501180
y.create.l HWIO_PCNOC_QHM2_TFILT_ID_REVISIONID_ADDR A:0x501184
y.create.l HWIO_PCNOC_QHM2_TFILT_MODE_ADDR A:0x501188
y.create.l HWIO_PCNOC_QHM2_TFILT_ADDRBASE_LOW_ADDR A:0x50118c
y.create.l HWIO_PCNOC_QHM2_TFILT_ADDRWINDOWSIZE_ADDR A:0x501194
y.create.l HWIO_PCNOC_QHM2_TFILT_SRCIDBASE_ADDR A:0x501198
y.create.l HWIO_PCNOC_QHM2_TFILT_SRCIDMASK_ADDR A:0x50119c
y.create.l HWIO_PCNOC_QHM2_TFILT_OPCODE_ADDR A:0x5011a0
y.create.l HWIO_PCNOC_QHM2_TFILT_USERBASE_ADDR A:0x5011a4
y.create.l HWIO_PCNOC_QHM2_TFILT_USERMASK_ADDR A:0x5011a8
y.create.l HWIO_PCNOC_QHM1_TFILT_ID_COREID_ADDR A:0x501200
y.create.l HWIO_PCNOC_QHM1_TFILT_ID_REVISIONID_ADDR A:0x501204
y.create.l HWIO_PCNOC_QHM1_TFILT_MODE_ADDR A:0x501208
y.create.l HWIO_PCNOC_QHM1_TFILT_ADDRBASE_LOW_ADDR A:0x50120c
y.create.l HWIO_PCNOC_QHM1_TFILT_ADDRWINDOWSIZE_ADDR A:0x501214
y.create.l HWIO_PCNOC_QHM1_TFILT_SRCIDBASE_ADDR A:0x501218
y.create.l HWIO_PCNOC_QHM1_TFILT_SRCIDMASK_ADDR A:0x50121c
y.create.l HWIO_PCNOC_QHM1_TFILT_OPCODE_ADDR A:0x501220
y.create.l HWIO_PCNOC_QHM1_TFILT_USERBASE_ADDR A:0x501224
y.create.l HWIO_PCNOC_QHM1_TFILT_USERMASK_ADDR A:0x501228
y.create.l HWIO_PCNOC_QXM_BIMC_TFILT_ID_COREID_ADDR A:0x501280
y.create.l HWIO_PCNOC_QXM_BIMC_TFILT_ID_REVISIONID_ADDR A:0x501284
y.create.l HWIO_PCNOC_QXM_BIMC_TFILT_MODE_ADDR A:0x501288
y.create.l HWIO_PCNOC_QXM_BIMC_TFILT_ADDRBASE_LOW_ADDR A:0x50128c
y.create.l HWIO_PCNOC_QXM_BIMC_TFILT_ADDRBASE_HIGH_ADDR A:0x501290
y.create.l HWIO_PCNOC_QXM_BIMC_TFILT_ADDRWINDOWSIZE_ADDR A:0x501294
y.create.l HWIO_PCNOC_QXM_BIMC_TFILT_SRCIDBASE_ADDR A:0x501298
y.create.l HWIO_PCNOC_QXM_BIMC_TFILT_SRCIDMASK_ADDR A:0x50129c
y.create.l HWIO_PCNOC_QXM_BIMC_TFILT_OPCODE_ADDR A:0x5012a0
y.create.l HWIO_PCNOC_QXM_BIMC_TFILT_USERBASE_ADDR A:0x5012a4
y.create.l HWIO_PCNOC_QXM_BIMC_TFILT_USERMASK_ADDR A:0x5012a8
y.create.l HWIO_PCNOC_QDSS_BAM_TFILT_ID_COREID_ADDR A:0x501300
y.create.l HWIO_PCNOC_QDSS_BAM_TFILT_ID_REVISIONID_ADDR A:0x501304
y.create.l HWIO_PCNOC_QDSS_BAM_TFILT_MODE_ADDR A:0x501308
y.create.l HWIO_PCNOC_QDSS_BAM_TFILT_ADDRBASE_LOW_ADDR A:0x50130c
y.create.l HWIO_PCNOC_QDSS_BAM_TFILT_ADDRWINDOWSIZE_ADDR A:0x501314
y.create.l HWIO_PCNOC_QDSS_BAM_TFILT_SRCIDBASE_ADDR A:0x501318
y.create.l HWIO_PCNOC_QDSS_BAM_TFILT_SRCIDMASK_ADDR A:0x50131c
y.create.l HWIO_PCNOC_QDSS_BAM_TFILT_OPCODE_ADDR A:0x501320
y.create.l HWIO_PCNOC_QDSS_BAM_TFILT_USERBASE_ADDR A:0x501324
y.create.l HWIO_PCNOC_QDSS_BAM_TFILT_USERMASK_ADDR A:0x501328
y.create.l HWIO_PCNOC_USB_HS1_TFILT_ID_COREID_ADDR A:0x501480
y.create.l HWIO_PCNOC_USB_HS1_TFILT_ID_REVISIONID_ADDR A:0x501484
y.create.l HWIO_PCNOC_USB_HS1_TFILT_MODE_ADDR A:0x501488
y.create.l HWIO_PCNOC_USB_HS1_TFILT_ADDRBASE_LOW_ADDR A:0x50148c
y.create.l HWIO_PCNOC_USB_HS1_TFILT_ADDRWINDOWSIZE_ADDR A:0x501494
y.create.l HWIO_PCNOC_USB_HS1_TFILT_SRCIDBASE_ADDR A:0x501498
y.create.l HWIO_PCNOC_USB_HS1_TFILT_SRCIDMASK_ADDR A:0x50149c
y.create.l HWIO_PCNOC_USB_HS1_TFILT_OPCODE_ADDR A:0x5014a0
y.create.l HWIO_PCNOC_USB_HS1_TFILT_USERBASE_ADDR A:0x5014a4
y.create.l HWIO_PCNOC_USB_HS1_TFILT_USERMASK_ADDR A:0x5014a8
y.create.l HWIO_PCNOC_QDSS_ETR_TFILT_ID_COREID_ADDR A:0x501580
y.create.l HWIO_PCNOC_QDSS_ETR_TFILT_ID_REVISIONID_ADDR A:0x501584
y.create.l HWIO_PCNOC_QDSS_ETR_TFILT_MODE_ADDR A:0x501588
y.create.l HWIO_PCNOC_QDSS_ETR_TFILT_ADDRBASE_LOW_ADDR A:0x50158c
y.create.l HWIO_PCNOC_QDSS_ETR_TFILT_ADDRWINDOWSIZE_ADDR A:0x501594
y.create.l HWIO_PCNOC_QDSS_ETR_TFILT_SRCIDBASE_ADDR A:0x501598
y.create.l HWIO_PCNOC_QDSS_ETR_TFILT_SRCIDMASK_ADDR A:0x50159c
y.create.l HWIO_PCNOC_QDSS_ETR_TFILT_OPCODE_ADDR A:0x5015a0
y.create.l HWIO_PCNOC_QDSS_ETR_TFILT_USERBASE_ADDR A:0x5015a4
y.create.l HWIO_PCNOC_QDSS_ETR_TFILT_USERMASK_ADDR A:0x5015a8
y.create.l HWIO_PCNOC_QXM_NOC_TFILT_ID_COREID_ADDR A:0x501600
y.create.l HWIO_PCNOC_QXM_NOC_TFILT_ID_REVISIONID_ADDR A:0x501604
y.create.l HWIO_PCNOC_QXM_NOC_TFILT_MODE_ADDR A:0x501608
y.create.l HWIO_PCNOC_QXM_NOC_TFILT_ADDRBASE_LOW_ADDR A:0x50160c
y.create.l HWIO_PCNOC_QXM_NOC_TFILT_ADDRBASE_HIGH_ADDR A:0x501610
y.create.l HWIO_PCNOC_QXM_NOC_TFILT_ADDRWINDOWSIZE_ADDR A:0x501614
y.create.l HWIO_PCNOC_QXM_NOC_TFILT_SRCIDBASE_ADDR A:0x501618
y.create.l HWIO_PCNOC_QXM_NOC_TFILT_SRCIDMASK_ADDR A:0x50161c
y.create.l HWIO_PCNOC_QXM_NOC_TFILT_OPCODE_ADDR A:0x501620
y.create.l HWIO_PCNOC_QXM_NOC_TFILT_USERBASE_ADDR A:0x501624
y.create.l HWIO_PCNOC_QXM_NOC_TFILT_USERMASK_ADDR A:0x501628
y.create.l HWIO_PCNOC_TPRB0_TPROF_ID_COREID_ADDR A:0x502000
y.create.l HWIO_PCNOC_TPRB0_TPROF_ID_REVISIONID_ADDR A:0x502004
y.create.l HWIO_PCNOC_TPRB0_TPROF_EN_ADDR A:0x502008
y.create.l HWIO_PCNOC_TPRB0_TPROF_MODE_ADDR A:0x50200c
y.create.l HWIO_PCNOC_TPRB0_TPROF_OBSERVEDSEL_0_ADDR A:0x502010
y.create.l HWIO_PCNOC_TPRB0_TPROF_OBSERVEDSEL_1_ADDR A:0x502014
y.create.l HWIO_PCNOC_TPRB0_TPROF_OBSERVEDSEL_2_ADDR A:0x502018
y.create.l HWIO_PCNOC_TPRB0_TPROF_OBSERVEDSEL_3_ADDR A:0x50201c
y.create.l HWIO_PCNOC_TPRB0_TPROF_NTENURELINES_0_ADDR A:0x502020
y.create.l HWIO_PCNOC_TPRB0_TPROF_NTENURELINES_1_ADDR A:0x502024
y.create.l HWIO_PCNOC_TPRB0_TPROF_NTENURELINES_2_ADDR A:0x502028
y.create.l HWIO_PCNOC_TPRB0_TPROF_THRESHOLDS_0_0_ADDR A:0x50202c
y.create.l HWIO_PCNOC_TPRB0_TPROF_THRESHOLDS_0_1_ADDR A:0x502030
y.create.l HWIO_PCNOC_TPRB0_TPROF_THRESHOLDS_0_2_ADDR A:0x502034
y.create.l HWIO_PCNOC_TPRB0_TPROF_THRESHOLDS_0_3_ADDR A:0x502038
y.create.l HWIO_PCNOC_TPRB0_TPROF_THRESHOLDS_0_4_ADDR A:0x50203c
y.create.l HWIO_PCNOC_TPRB0_TPROF_THRESHOLDS_0_5_ADDR A:0x502040
y.create.l HWIO_PCNOC_TPRB0_TPROF_THRESHOLDS_0_6_ADDR A:0x502044
y.create.l HWIO_PCNOC_TPRB0_TPROF_THRESHOLDS_0_7_ADDR A:0x502048
y.create.l HWIO_PCNOC_TPRB0_TPROF_THRESHOLDS_0_8_ADDR A:0x50204c
y.create.l HWIO_PCNOC_TPRB0_TPROF_THRESHOLDS_0_9_ADDR A:0x502050
y.create.l HWIO_PCNOC_TPRB0_TPROF_THRESHOLDS_0_10_ADDR A:0x502054
y.create.l HWIO_PCNOC_TPRB0_TPROF_THRESHOLDS_0_11_ADDR A:0x502058
y.create.l HWIO_PCNOC_TPRB0_TPROF_THRESHOLDS_0_12_ADDR A:0x50205c
y.create.l HWIO_PCNOC_TPRB0_TPROF_THRESHOLDS_0_13_ADDR A:0x502060
y.create.l HWIO_PCNOC_TPRB0_TPROF_THRESHOLDS_0_14_ADDR A:0x502064
y.create.l HWIO_PCNOC_TPRB0_TPROF_THRESHOLDS_1_0_ADDR A:0x502068
y.create.l HWIO_PCNOC_TPRB0_TPROF_THRESHOLDS_1_1_ADDR A:0x50206c
y.create.l HWIO_PCNOC_TPRB0_TPROF_THRESHOLDS_1_2_ADDR A:0x502070
y.create.l HWIO_PCNOC_TPRB0_TPROF_THRESHOLDS_1_3_ADDR A:0x502074
y.create.l HWIO_PCNOC_TPRB0_TPROF_THRESHOLDS_1_4_ADDR A:0x502078
y.create.l HWIO_PCNOC_TPRB0_TPROF_THRESHOLDS_1_5_ADDR A:0x50207c
y.create.l HWIO_PCNOC_TPRB0_TPROF_THRESHOLDS_1_6_ADDR A:0x502080
y.create.l HWIO_PCNOC_TPRB0_TPROF_THRESHOLDS_1_7_ADDR A:0x502084
y.create.l HWIO_PCNOC_TPRB0_TPROF_THRESHOLDS_1_8_ADDR A:0x502088
y.create.l HWIO_PCNOC_TPRB0_TPROF_THRESHOLDS_1_9_ADDR A:0x50208c
y.create.l HWIO_PCNOC_TPRB0_TPROF_THRESHOLDS_1_10_ADDR A:0x502090
y.create.l HWIO_PCNOC_TPRB0_TPROF_THRESHOLDS_1_11_ADDR A:0x502094
y.create.l HWIO_PCNOC_TPRB0_TPROF_THRESHOLDS_1_12_ADDR A:0x502098
y.create.l HWIO_PCNOC_TPRB0_TPROF_THRESHOLDS_1_13_ADDR A:0x50209c
y.create.l HWIO_PCNOC_TPRB0_TPROF_THRESHOLDS_1_14_ADDR A:0x5020a0
y.create.l HWIO_PCNOC_TPRB0_TPROF_THRESHOLDS_2_0_ADDR A:0x5020a4
y.create.l HWIO_PCNOC_TPRB0_TPROF_THRESHOLDS_2_1_ADDR A:0x5020a8
y.create.l HWIO_PCNOC_TPRB0_TPROF_THRESHOLDS_2_2_ADDR A:0x5020ac
y.create.l HWIO_PCNOC_TPRB0_TPROF_THRESHOLDS_2_3_ADDR A:0x5020b0
y.create.l HWIO_PCNOC_TPRB0_TPROF_THRESHOLDS_2_4_ADDR A:0x5020b4
y.create.l HWIO_PCNOC_TPRB0_TPROF_THRESHOLDS_2_5_ADDR A:0x5020b8
y.create.l HWIO_PCNOC_TPRB0_TPROF_THRESHOLDS_2_6_ADDR A:0x5020bc
y.create.l HWIO_PCNOC_TPRB0_TPROF_THRESHOLDS_2_7_ADDR A:0x5020c0
y.create.l HWIO_PCNOC_TPRB0_TPROF_THRESHOLDS_2_8_ADDR A:0x5020c4
y.create.l HWIO_PCNOC_TPRB0_TPROF_THRESHOLDS_2_9_ADDR A:0x5020c8
y.create.l HWIO_PCNOC_TPRB0_TPROF_THRESHOLDS_2_10_ADDR A:0x5020cc
y.create.l HWIO_PCNOC_TPRB0_TPROF_THRESHOLDS_2_11_ADDR A:0x5020d0
y.create.l HWIO_PCNOC_TPRB0_TPROF_THRESHOLDS_2_12_ADDR A:0x5020d4
y.create.l HWIO_PCNOC_TPRB0_TPROF_THRESHOLDS_2_13_ADDR A:0x5020d8
y.create.l HWIO_PCNOC_TPRB0_TPROF_THRESHOLDS_2_14_ADDR A:0x5020dc
y.create.l HWIO_PCNOC_TPRB0_TPROF_THRESHOLDS_3_0_ADDR A:0x5020e0
y.create.l HWIO_PCNOC_TPRB0_TPROF_THRESHOLDS_3_1_ADDR A:0x5020e4
y.create.l HWIO_PCNOC_TPRB0_TPROF_THRESHOLDS_3_2_ADDR A:0x5020e8
y.create.l HWIO_PCNOC_TPRB0_TPROF_THRESHOLDS_3_3_ADDR A:0x5020ec
y.create.l HWIO_PCNOC_TPRB0_TPROF_THRESHOLDS_3_4_ADDR A:0x5020f0
y.create.l HWIO_PCNOC_TPRB0_TPROF_THRESHOLDS_3_5_ADDR A:0x5020f4
y.create.l HWIO_PCNOC_TPRB0_TPROF_THRESHOLDS_3_6_ADDR A:0x5020f8
y.create.l HWIO_PCNOC_TPRB0_TPROF_THRESHOLDS_3_7_ADDR A:0x5020fc
y.create.l HWIO_PCNOC_TPRB0_TPROF_THRESHOLDS_3_8_ADDR A:0x502100
y.create.l HWIO_PCNOC_TPRB0_TPROF_THRESHOLDS_3_9_ADDR A:0x502104
y.create.l HWIO_PCNOC_TPRB0_TPROF_THRESHOLDS_3_10_ADDR A:0x502108
y.create.l HWIO_PCNOC_TPRB0_TPROF_THRESHOLDS_3_11_ADDR A:0x50210c
y.create.l HWIO_PCNOC_TPRB0_TPROF_THRESHOLDS_3_12_ADDR A:0x502110
y.create.l HWIO_PCNOC_TPRB0_TPROF_THRESHOLDS_3_13_ADDR A:0x502114
y.create.l HWIO_PCNOC_TPRB0_TPROF_THRESHOLDS_3_14_ADDR A:0x502118
y.create.l HWIO_PCNOC_TPRB0_TPROF_OVERFLOWSTATUS_ADDR A:0x50211c
y.create.l HWIO_PCNOC_TPRB0_TPROF_OVERFLOWRESET_ADDR A:0x502120
y.create.l HWIO_PCNOC_TPRB0_TPROF_PENDINGEVENTMODE_ADDR A:0x502124
y.create.l HWIO_PCNOC_TPRB0_TPROF_PRESCALER_ADDR A:0x502128
y.create.l HWIO_PCNOC_TPRB1_TPROF_ID_COREID_ADDR A:0x502200
y.create.l HWIO_PCNOC_TPRB1_TPROF_ID_REVISIONID_ADDR A:0x502204
y.create.l HWIO_PCNOC_TPRB1_TPROF_EN_ADDR A:0x502208
y.create.l HWIO_PCNOC_TPRB1_TPROF_MODE_ADDR A:0x50220c
y.create.l HWIO_PCNOC_TPRB1_TPROF_OBSERVEDSEL_0_ADDR A:0x502210
y.create.l HWIO_PCNOC_TPRB1_TPROF_OBSERVEDSEL_1_ADDR A:0x502214
y.create.l HWIO_PCNOC_TPRB1_TPROF_OBSERVEDSEL_2_ADDR A:0x502218
y.create.l HWIO_PCNOC_TPRB1_TPROF_OBSERVEDSEL_3_ADDR A:0x50221c
y.create.l HWIO_PCNOC_TPRB1_TPROF_NTENURELINES_0_ADDR A:0x502220
y.create.l HWIO_PCNOC_TPRB1_TPROF_NTENURELINES_1_ADDR A:0x502224
y.create.l HWIO_PCNOC_TPRB1_TPROF_NTENURELINES_2_ADDR A:0x502228
y.create.l HWIO_PCNOC_TPRB1_TPROF_THRESHOLDS_0_0_ADDR A:0x50222c
y.create.l HWIO_PCNOC_TPRB1_TPROF_THRESHOLDS_0_1_ADDR A:0x502230
y.create.l HWIO_PCNOC_TPRB1_TPROF_THRESHOLDS_0_2_ADDR A:0x502234
y.create.l HWIO_PCNOC_TPRB1_TPROF_THRESHOLDS_0_3_ADDR A:0x502238
y.create.l HWIO_PCNOC_TPRB1_TPROF_THRESHOLDS_0_4_ADDR A:0x50223c
y.create.l HWIO_PCNOC_TPRB1_TPROF_THRESHOLDS_0_5_ADDR A:0x502240
y.create.l HWIO_PCNOC_TPRB1_TPROF_THRESHOLDS_0_6_ADDR A:0x502244
y.create.l HWIO_PCNOC_TPRB1_TPROF_THRESHOLDS_0_7_ADDR A:0x502248
y.create.l HWIO_PCNOC_TPRB1_TPROF_THRESHOLDS_0_8_ADDR A:0x50224c
y.create.l HWIO_PCNOC_TPRB1_TPROF_THRESHOLDS_0_9_ADDR A:0x502250
y.create.l HWIO_PCNOC_TPRB1_TPROF_THRESHOLDS_0_10_ADDR A:0x502254
y.create.l HWIO_PCNOC_TPRB1_TPROF_THRESHOLDS_0_11_ADDR A:0x502258
y.create.l HWIO_PCNOC_TPRB1_TPROF_THRESHOLDS_0_12_ADDR A:0x50225c
y.create.l HWIO_PCNOC_TPRB1_TPROF_THRESHOLDS_0_13_ADDR A:0x502260
y.create.l HWIO_PCNOC_TPRB1_TPROF_THRESHOLDS_0_14_ADDR A:0x502264
y.create.l HWIO_PCNOC_TPRB1_TPROF_THRESHOLDS_1_0_ADDR A:0x502268
y.create.l HWIO_PCNOC_TPRB1_TPROF_THRESHOLDS_1_1_ADDR A:0x50226c
y.create.l HWIO_PCNOC_TPRB1_TPROF_THRESHOLDS_1_2_ADDR A:0x502270
y.create.l HWIO_PCNOC_TPRB1_TPROF_THRESHOLDS_1_3_ADDR A:0x502274
y.create.l HWIO_PCNOC_TPRB1_TPROF_THRESHOLDS_1_4_ADDR A:0x502278
y.create.l HWIO_PCNOC_TPRB1_TPROF_THRESHOLDS_1_5_ADDR A:0x50227c
y.create.l HWIO_PCNOC_TPRB1_TPROF_THRESHOLDS_1_6_ADDR A:0x502280
y.create.l HWIO_PCNOC_TPRB1_TPROF_THRESHOLDS_1_7_ADDR A:0x502284
y.create.l HWIO_PCNOC_TPRB1_TPROF_THRESHOLDS_1_8_ADDR A:0x502288
y.create.l HWIO_PCNOC_TPRB1_TPROF_THRESHOLDS_1_9_ADDR A:0x50228c
y.create.l HWIO_PCNOC_TPRB1_TPROF_THRESHOLDS_1_10_ADDR A:0x502290
y.create.l HWIO_PCNOC_TPRB1_TPROF_THRESHOLDS_1_11_ADDR A:0x502294
y.create.l HWIO_PCNOC_TPRB1_TPROF_THRESHOLDS_1_12_ADDR A:0x502298
y.create.l HWIO_PCNOC_TPRB1_TPROF_THRESHOLDS_1_13_ADDR A:0x50229c
y.create.l HWIO_PCNOC_TPRB1_TPROF_THRESHOLDS_1_14_ADDR A:0x5022a0
y.create.l HWIO_PCNOC_TPRB1_TPROF_THRESHOLDS_2_0_ADDR A:0x5022a4
y.create.l HWIO_PCNOC_TPRB1_TPROF_THRESHOLDS_2_1_ADDR A:0x5022a8
y.create.l HWIO_PCNOC_TPRB1_TPROF_THRESHOLDS_2_2_ADDR A:0x5022ac
y.create.l HWIO_PCNOC_TPRB1_TPROF_THRESHOLDS_2_3_ADDR A:0x5022b0
y.create.l HWIO_PCNOC_TPRB1_TPROF_THRESHOLDS_2_4_ADDR A:0x5022b4
y.create.l HWIO_PCNOC_TPRB1_TPROF_THRESHOLDS_2_5_ADDR A:0x5022b8
y.create.l HWIO_PCNOC_TPRB1_TPROF_THRESHOLDS_2_6_ADDR A:0x5022bc
y.create.l HWIO_PCNOC_TPRB1_TPROF_THRESHOLDS_2_7_ADDR A:0x5022c0
y.create.l HWIO_PCNOC_TPRB1_TPROF_THRESHOLDS_2_8_ADDR A:0x5022c4
y.create.l HWIO_PCNOC_TPRB1_TPROF_THRESHOLDS_2_9_ADDR A:0x5022c8
y.create.l HWIO_PCNOC_TPRB1_TPROF_THRESHOLDS_2_10_ADDR A:0x5022cc
y.create.l HWIO_PCNOC_TPRB1_TPROF_THRESHOLDS_2_11_ADDR A:0x5022d0
y.create.l HWIO_PCNOC_TPRB1_TPROF_THRESHOLDS_2_12_ADDR A:0x5022d4
y.create.l HWIO_PCNOC_TPRB1_TPROF_THRESHOLDS_2_13_ADDR A:0x5022d8
y.create.l HWIO_PCNOC_TPRB1_TPROF_THRESHOLDS_2_14_ADDR A:0x5022dc
y.create.l HWIO_PCNOC_TPRB1_TPROF_THRESHOLDS_3_0_ADDR A:0x5022e0
y.create.l HWIO_PCNOC_TPRB1_TPROF_THRESHOLDS_3_1_ADDR A:0x5022e4
y.create.l HWIO_PCNOC_TPRB1_TPROF_THRESHOLDS_3_2_ADDR A:0x5022e8
y.create.l HWIO_PCNOC_TPRB1_TPROF_THRESHOLDS_3_3_ADDR A:0x5022ec
y.create.l HWIO_PCNOC_TPRB1_TPROF_THRESHOLDS_3_4_ADDR A:0x5022f0
y.create.l HWIO_PCNOC_TPRB1_TPROF_THRESHOLDS_3_5_ADDR A:0x5022f4
y.create.l HWIO_PCNOC_TPRB1_TPROF_THRESHOLDS_3_6_ADDR A:0x5022f8
y.create.l HWIO_PCNOC_TPRB1_TPROF_THRESHOLDS_3_7_ADDR A:0x5022fc
y.create.l HWIO_PCNOC_TPRB1_TPROF_THRESHOLDS_3_8_ADDR A:0x502300
y.create.l HWIO_PCNOC_TPRB1_TPROF_THRESHOLDS_3_9_ADDR A:0x502304
y.create.l HWIO_PCNOC_TPRB1_TPROF_THRESHOLDS_3_10_ADDR A:0x502308
y.create.l HWIO_PCNOC_TPRB1_TPROF_THRESHOLDS_3_11_ADDR A:0x50230c
y.create.l HWIO_PCNOC_TPRB1_TPROF_THRESHOLDS_3_12_ADDR A:0x502310
y.create.l HWIO_PCNOC_TPRB1_TPROF_THRESHOLDS_3_13_ADDR A:0x502314
y.create.l HWIO_PCNOC_TPRB1_TPROF_THRESHOLDS_3_14_ADDR A:0x502318
y.create.l HWIO_PCNOC_TPRB1_TPROF_OVERFLOWSTATUS_ADDR A:0x50231c
y.create.l HWIO_PCNOC_TPRB1_TPROF_OVERFLOWRESET_ADDR A:0x502320
y.create.l HWIO_PCNOC_TPRB1_TPROF_PENDINGEVENTMODE_ADDR A:0x502324
y.create.l HWIO_PCNOC_TPRB1_TPROF_PRESCALER_ADDR A:0x502328
y.create.l HWIO_PCNOC_TPRB2_TPROF_ID_COREID_ADDR A:0x502400
y.create.l HWIO_PCNOC_TPRB2_TPROF_ID_REVISIONID_ADDR A:0x502404
y.create.l HWIO_PCNOC_TPRB2_TPROF_EN_ADDR A:0x502408
y.create.l HWIO_PCNOC_TPRB2_TPROF_MODE_ADDR A:0x50240c
y.create.l HWIO_PCNOC_TPRB2_TPROF_NTENURELINES_0_ADDR A:0x502420
y.create.l HWIO_PCNOC_TPRB2_TPROF_THRESHOLDS_0_0_ADDR A:0x50242c
y.create.l HWIO_PCNOC_TPRB2_TPROF_THRESHOLDS_0_1_ADDR A:0x502430
y.create.l HWIO_PCNOC_TPRB2_TPROF_THRESHOLDS_0_2_ADDR A:0x502434
y.create.l HWIO_PCNOC_TPRB2_TPROF_THRESHOLDS_0_3_ADDR A:0x502438
y.create.l HWIO_PCNOC_TPRB2_TPROF_THRESHOLDS_0_4_ADDR A:0x50243c
y.create.l HWIO_PCNOC_TPRB2_TPROF_THRESHOLDS_0_5_ADDR A:0x502440
y.create.l HWIO_PCNOC_TPRB2_TPROF_THRESHOLDS_0_6_ADDR A:0x502444
y.create.l HWIO_PCNOC_TPRB2_TPROF_THRESHOLDS_0_7_ADDR A:0x502448
y.create.l HWIO_PCNOC_TPRB2_TPROF_THRESHOLDS_0_8_ADDR A:0x50244c
y.create.l HWIO_PCNOC_TPRB2_TPROF_THRESHOLDS_0_9_ADDR A:0x502450
y.create.l HWIO_PCNOC_TPRB2_TPROF_THRESHOLDS_0_10_ADDR A:0x502454
y.create.l HWIO_PCNOC_TPRB2_TPROF_THRESHOLDS_0_11_ADDR A:0x502458
y.create.l HWIO_PCNOC_TPRB2_TPROF_THRESHOLDS_0_12_ADDR A:0x50245c
y.create.l HWIO_PCNOC_TPRB2_TPROF_THRESHOLDS_0_13_ADDR A:0x502460
y.create.l HWIO_PCNOC_TPRB2_TPROF_THRESHOLDS_0_14_ADDR A:0x502464
y.create.l HWIO_PCNOC_TPRB2_TPROF_THRESHOLDS_1_0_ADDR A:0x502468
y.create.l HWIO_PCNOC_TPRB2_TPROF_THRESHOLDS_1_1_ADDR A:0x50246c
y.create.l HWIO_PCNOC_TPRB2_TPROF_THRESHOLDS_1_2_ADDR A:0x502470
y.create.l HWIO_PCNOC_TPRB2_TPROF_THRESHOLDS_1_3_ADDR A:0x502474
y.create.l HWIO_PCNOC_TPRB2_TPROF_THRESHOLDS_1_4_ADDR A:0x502478
y.create.l HWIO_PCNOC_TPRB2_TPROF_THRESHOLDS_1_5_ADDR A:0x50247c
y.create.l HWIO_PCNOC_TPRB2_TPROF_THRESHOLDS_1_6_ADDR A:0x502480
y.create.l HWIO_PCNOC_TPRB2_TPROF_THRESHOLDS_1_7_ADDR A:0x502484
y.create.l HWIO_PCNOC_TPRB2_TPROF_THRESHOLDS_1_8_ADDR A:0x502488
y.create.l HWIO_PCNOC_TPRB2_TPROF_THRESHOLDS_1_9_ADDR A:0x50248c
y.create.l HWIO_PCNOC_TPRB2_TPROF_THRESHOLDS_1_10_ADDR A:0x502490
y.create.l HWIO_PCNOC_TPRB2_TPROF_THRESHOLDS_1_11_ADDR A:0x502494
y.create.l HWIO_PCNOC_TPRB2_TPROF_THRESHOLDS_1_12_ADDR A:0x502498
y.create.l HWIO_PCNOC_TPRB2_TPROF_THRESHOLDS_1_13_ADDR A:0x50249c
y.create.l HWIO_PCNOC_TPRB2_TPROF_THRESHOLDS_1_14_ADDR A:0x5024a0
y.create.l HWIO_PCNOC_TPRB2_TPROF_OVERFLOWSTATUS_ADDR A:0x50251c
y.create.l HWIO_PCNOC_TPRB2_TPROF_OVERFLOWRESET_ADDR A:0x502520
y.create.l HWIO_PCNOC_TPRB2_TPROF_PENDINGEVENTMODE_ADDR A:0x502524
y.create.l HWIO_PCNOC_TPRB2_TPROF_PRESCALER_ADDR A:0x502528
y.create.l HWIO_PCNOC_EPRB0_SPROF_ID_COREID_ADDR A:0x503000
y.create.l HWIO_PCNOC_EPRB0_SPROF_ID_REVISIONID_ADDR A:0x503004
y.create.l HWIO_PCNOC_EPRB0_SPROF_MAINCTL_ADDR A:0x503008
y.create.l HWIO_PCNOC_EPRB0_SPROF_CFGCTL_ADDR A:0x50300c
y.create.l HWIO_PCNOC_EPRB0_SPROF_TRACEPORTSEL_ADDR A:0x503010
y.create.l HWIO_PCNOC_EPRB0_SPROF_FILTERLUT_ADDR A:0x503014
y.create.l HWIO_PCNOC_EPRB0_SPROF_TRACEALARMEN_ADDR A:0x503018
y.create.l HWIO_PCNOC_EPRB0_SPROF_TRACEALARMSTATUS_ADDR A:0x50301c
y.create.l HWIO_PCNOC_EPRB0_SPROF_TRACEALARMCLR_ADDR A:0x503020
y.create.l HWIO_PCNOC_EPRB0_SPROF_STATPERIOD_ADDR A:0x503024
y.create.l HWIO_PCNOC_EPRB0_SPROF_STATGO_ADDR A:0x503028
y.create.l HWIO_PCNOC_EPRB0_SPROF_STATALARMMIN_ADDR A:0x50302c
y.create.l HWIO_PCNOC_EPRB0_SPROF_STATALARMMAX_ADDR A:0x503030
y.create.l HWIO_PCNOC_EPRB0_SPROF_STATALARMSTATUS_ADDR A:0x503034
y.create.l HWIO_PCNOC_EPRB0_SPROF_STATALARMCLR_ADDR A:0x503038
y.create.l HWIO_PCNOC_EPRB0_SPROF_STATALARMEN_ADDR A:0x50303c
y.create.l HWIO_PCNOC_EPRB0_SPROF_FILTERS_0_ROUTEIDBASE_ADDR A:0x503044
y.create.l HWIO_PCNOC_EPRB0_SPROF_FILTERS_0_ROUTEIDMASK_ADDR A:0x503048
y.create.l HWIO_PCNOC_EPRB0_SPROF_FILTERS_0_ADDRBASE_LOW_ADDR A:0x50304c
y.create.l HWIO_PCNOC_EPRB0_SPROF_FILTERS_0_ADDRBASE_HIGH_ADDR A:0x503050
y.create.l HWIO_PCNOC_EPRB0_SPROF_FILTERS_0_WINDOWSIZE_ADDR A:0x503054
y.create.l HWIO_PCNOC_EPRB0_SPROF_FILTERS_0_OPCODE_ADDR A:0x503060
y.create.l HWIO_PCNOC_EPRB0_SPROF_FILTERS_0_STATUS_ADDR A:0x503064
y.create.l HWIO_PCNOC_EPRB0_SPROF_FILTERS_0_LENGTH_ADDR A:0x503068
y.create.l HWIO_PCNOC_EPRB0_SPROF_FILTERS_0_URGENCY_ADDR A:0x50306c
y.create.l HWIO_PCNOC_EPRB0_SPROF_FILTERS_1_ROUTEIDBASE_ADDR A:0x503080
y.create.l HWIO_PCNOC_EPRB0_SPROF_FILTERS_1_ROUTEIDMASK_ADDR A:0x503084
y.create.l HWIO_PCNOC_EPRB0_SPROF_FILTERS_1_ADDRBASE_LOW_ADDR A:0x503088
y.create.l HWIO_PCNOC_EPRB0_SPROF_FILTERS_1_ADDRBASE_HIGH_ADDR A:0x50308c
y.create.l HWIO_PCNOC_EPRB0_SPROF_FILTERS_1_WINDOWSIZE_ADDR A:0x503090
y.create.l HWIO_PCNOC_EPRB0_SPROF_FILTERS_1_OPCODE_ADDR A:0x50309c
y.create.l HWIO_PCNOC_EPRB0_SPROF_FILTERS_1_STATUS_ADDR A:0x5030a0
y.create.l HWIO_PCNOC_EPRB0_SPROF_FILTERS_1_LENGTH_ADDR A:0x5030a4
y.create.l HWIO_PCNOC_EPRB0_SPROF_FILTERS_1_URGENCY_ADDR A:0x5030a8
y.create.l HWIO_PCNOC_EPRB0_SPROF_FILTERS_2_ROUTEIDBASE_ADDR A:0x5030bc
y.create.l HWIO_PCNOC_EPRB0_SPROF_FILTERS_2_ROUTEIDMASK_ADDR A:0x5030c0
y.create.l HWIO_PCNOC_EPRB0_SPROF_FILTERS_2_ADDRBASE_LOW_ADDR A:0x5030c4
y.create.l HWIO_PCNOC_EPRB0_SPROF_FILTERS_2_ADDRBASE_HIGH_ADDR A:0x5030c8
y.create.l HWIO_PCNOC_EPRB0_SPROF_FILTERS_2_WINDOWSIZE_ADDR A:0x5030cc
y.create.l HWIO_PCNOC_EPRB0_SPROF_FILTERS_2_OPCODE_ADDR A:0x5030d8
y.create.l HWIO_PCNOC_EPRB0_SPROF_FILTERS_2_STATUS_ADDR A:0x5030dc
y.create.l HWIO_PCNOC_EPRB0_SPROF_FILTERS_2_LENGTH_ADDR A:0x5030e0
y.create.l HWIO_PCNOC_EPRB0_SPROF_FILTERS_2_URGENCY_ADDR A:0x5030e4
y.create.l HWIO_PCNOC_EPRB0_SPROF_FILTERS_3_ROUTEIDBASE_ADDR A:0x5030f8
y.create.l HWIO_PCNOC_EPRB0_SPROF_FILTERS_3_ROUTEIDMASK_ADDR A:0x5030fc
y.create.l HWIO_PCNOC_EPRB0_SPROF_FILTERS_3_ADDRBASE_LOW_ADDR A:0x503100
y.create.l HWIO_PCNOC_EPRB0_SPROF_FILTERS_3_ADDRBASE_HIGH_ADDR A:0x503104
y.create.l HWIO_PCNOC_EPRB0_SPROF_FILTERS_3_WINDOWSIZE_ADDR A:0x503108
y.create.l HWIO_PCNOC_EPRB0_SPROF_FILTERS_3_OPCODE_ADDR A:0x503114
y.create.l HWIO_PCNOC_EPRB0_SPROF_FILTERS_3_STATUS_ADDR A:0x503118
y.create.l HWIO_PCNOC_EPRB0_SPROF_FILTERS_3_LENGTH_ADDR A:0x50311c
y.create.l HWIO_PCNOC_EPRB0_SPROF_FILTERS_3_URGENCY_ADDR A:0x503120
y.create.l HWIO_PCNOC_EPRB0_SPROF_COUNTERS_0_PORTSEL_ADDR A:0x503134
y.create.l HWIO_PCNOC_EPRB0_SPROF_COUNTERS_0_SRC_ADDR A:0x503138
y.create.l HWIO_PCNOC_EPRB0_SPROF_COUNTERS_0_ALARMMODE_ADDR A:0x50313c
y.create.l HWIO_PCNOC_EPRB0_SPROF_COUNTERS_0_VAL_ADDR A:0x503140
y.create.l HWIO_PCNOC_EPRB0_SPROF_COUNTERS_1_PORTSEL_ADDR A:0x503148
y.create.l HWIO_PCNOC_EPRB0_SPROF_COUNTERS_1_SRC_ADDR A:0x50314c
y.create.l HWIO_PCNOC_EPRB0_SPROF_COUNTERS_1_ALARMMODE_ADDR A:0x503150
y.create.l HWIO_PCNOC_EPRB0_SPROF_COUNTERS_1_VAL_ADDR A:0x503154
y.create.l HWIO_PCNOC_EPRB0_SPROF_COUNTERS_2_PORTSEL_ADDR A:0x50315c
y.create.l HWIO_PCNOC_EPRB0_SPROF_COUNTERS_2_SRC_ADDR A:0x503160
y.create.l HWIO_PCNOC_EPRB0_SPROF_COUNTERS_2_ALARMMODE_ADDR A:0x503164
y.create.l HWIO_PCNOC_EPRB0_SPROF_COUNTERS_2_VAL_ADDR A:0x503168
y.create.l HWIO_PCNOC_EPRB0_SPROF_COUNTERS_3_PORTSEL_ADDR A:0x503170
y.create.l HWIO_PCNOC_EPRB0_SPROF_COUNTERS_3_SRC_ADDR A:0x503174
y.create.l HWIO_PCNOC_EPRB0_SPROF_COUNTERS_3_ALARMMODE_ADDR A:0x503178
y.create.l HWIO_PCNOC_EPRB0_SPROF_COUNTERS_3_VAL_ADDR A:0x50317c
y.create.l HWIO_PCNOC_EPRB0_SPROF_COUNTERS_4_PORTSEL_ADDR A:0x503184
y.create.l HWIO_PCNOC_EPRB0_SPROF_COUNTERS_4_SRC_ADDR A:0x503188
y.create.l HWIO_PCNOC_EPRB0_SPROF_COUNTERS_4_ALARMMODE_ADDR A:0x50318c
y.create.l HWIO_PCNOC_EPRB0_SPROF_COUNTERS_4_VAL_ADDR A:0x503190
y.create.l HWIO_PCNOC_EPRB0_SPROF_COUNTERS_5_PORTSEL_ADDR A:0x503198
y.create.l HWIO_PCNOC_EPRB0_SPROF_COUNTERS_5_SRC_ADDR A:0x50319c
y.create.l HWIO_PCNOC_EPRB0_SPROF_COUNTERS_5_ALARMMODE_ADDR A:0x5031a0
y.create.l HWIO_PCNOC_EPRB0_SPROF_COUNTERS_5_VAL_ADDR A:0x5031a4
y.create.l HWIO_PCNOC_EPRB0_SPROF_COUNTERS_6_PORTSEL_ADDR A:0x5031ac
y.create.l HWIO_PCNOC_EPRB0_SPROF_COUNTERS_6_SRC_ADDR A:0x5031b0
y.create.l HWIO_PCNOC_EPRB0_SPROF_COUNTERS_6_ALARMMODE_ADDR A:0x5031b4
y.create.l HWIO_PCNOC_EPRB0_SPROF_COUNTERS_6_VAL_ADDR A:0x5031b8
y.create.l HWIO_PCNOC_EPRB0_SPROF_COUNTERS_7_PORTSEL_ADDR A:0x5031c0
y.create.l HWIO_PCNOC_EPRB0_SPROF_COUNTERS_7_SRC_ADDR A:0x5031c4
y.create.l HWIO_PCNOC_EPRB0_SPROF_COUNTERS_7_ALARMMODE_ADDR A:0x5031c8
y.create.l HWIO_PCNOC_EPRB0_SPROF_COUNTERS_7_VAL_ADDR A:0x5031cc
y.create.l HWIO_PCNOC_EPRB0_SPROF_COUNTERS_8_PORTSEL_ADDR A:0x5031d4
y.create.l HWIO_PCNOC_EPRB0_SPROF_COUNTERS_8_SRC_ADDR A:0x5031d8
y.create.l HWIO_PCNOC_EPRB0_SPROF_COUNTERS_8_ALARMMODE_ADDR A:0x5031dc
y.create.l HWIO_PCNOC_EPRB0_SPROF_COUNTERS_8_VAL_ADDR A:0x5031e0
y.create.l HWIO_PCNOC_EPRB0_SPROF_COUNTERS_9_PORTSEL_ADDR A:0x5031e8
y.create.l HWIO_PCNOC_EPRB0_SPROF_COUNTERS_9_SRC_ADDR A:0x5031ec
y.create.l HWIO_PCNOC_EPRB0_SPROF_COUNTERS_9_ALARMMODE_ADDR A:0x5031f0
y.create.l HWIO_PCNOC_EPRB0_SPROF_COUNTERS_9_VAL_ADDR A:0x5031f4
y.create.l HWIO_PCNOC_EPRB1_SPROF_ID_COREID_ADDR A:0x503400
y.create.l HWIO_PCNOC_EPRB1_SPROF_ID_REVISIONID_ADDR A:0x503404
y.create.l HWIO_PCNOC_EPRB1_SPROF_MAINCTL_ADDR A:0x503408
y.create.l HWIO_PCNOC_EPRB1_SPROF_CFGCTL_ADDR A:0x50340c
y.create.l HWIO_PCNOC_EPRB1_SPROF_TRACEPORTSEL_ADDR A:0x503410
y.create.l HWIO_PCNOC_EPRB1_SPROF_FILTERLUT_ADDR A:0x503414
y.create.l HWIO_PCNOC_EPRB1_SPROF_TRACEALARMEN_ADDR A:0x503418
y.create.l HWIO_PCNOC_EPRB1_SPROF_TRACEALARMSTATUS_ADDR A:0x50341c
y.create.l HWIO_PCNOC_EPRB1_SPROF_TRACEALARMCLR_ADDR A:0x503420
y.create.l HWIO_PCNOC_EPRB1_SPROF_STATPERIOD_ADDR A:0x503424
y.create.l HWIO_PCNOC_EPRB1_SPROF_STATGO_ADDR A:0x503428
y.create.l HWIO_PCNOC_EPRB1_SPROF_STATALARMMIN_ADDR A:0x50342c
y.create.l HWIO_PCNOC_EPRB1_SPROF_STATALARMMAX_ADDR A:0x503430
y.create.l HWIO_PCNOC_EPRB1_SPROF_STATALARMSTATUS_ADDR A:0x503434
y.create.l HWIO_PCNOC_EPRB1_SPROF_STATALARMCLR_ADDR A:0x503438
y.create.l HWIO_PCNOC_EPRB1_SPROF_STATALARMEN_ADDR A:0x50343c
y.create.l HWIO_PCNOC_EPRB1_SPROF_FILTERS_0_ROUTEIDBASE_ADDR A:0x503444
y.create.l HWIO_PCNOC_EPRB1_SPROF_FILTERS_0_ROUTEIDMASK_ADDR A:0x503448
y.create.l HWIO_PCNOC_EPRB1_SPROF_FILTERS_0_ADDRBASE_LOW_ADDR A:0x50344c
y.create.l HWIO_PCNOC_EPRB1_SPROF_FILTERS_0_ADDRBASE_HIGH_ADDR A:0x503450
y.create.l HWIO_PCNOC_EPRB1_SPROF_FILTERS_0_WINDOWSIZE_ADDR A:0x503454
y.create.l HWIO_PCNOC_EPRB1_SPROF_FILTERS_0_OPCODE_ADDR A:0x503460
y.create.l HWIO_PCNOC_EPRB1_SPROF_FILTERS_0_STATUS_ADDR A:0x503464
y.create.l HWIO_PCNOC_EPRB1_SPROF_FILTERS_0_LENGTH_ADDR A:0x503468
y.create.l HWIO_PCNOC_EPRB1_SPROF_FILTERS_0_URGENCY_ADDR A:0x50346c
y.create.l HWIO_PCNOC_EPRB1_SPROF_FILTERS_1_ROUTEIDBASE_ADDR A:0x503480
y.create.l HWIO_PCNOC_EPRB1_SPROF_FILTERS_1_ROUTEIDMASK_ADDR A:0x503484
y.create.l HWIO_PCNOC_EPRB1_SPROF_FILTERS_1_ADDRBASE_LOW_ADDR A:0x503488
y.create.l HWIO_PCNOC_EPRB1_SPROF_FILTERS_1_ADDRBASE_HIGH_ADDR A:0x50348c
y.create.l HWIO_PCNOC_EPRB1_SPROF_FILTERS_1_WINDOWSIZE_ADDR A:0x503490
y.create.l HWIO_PCNOC_EPRB1_SPROF_FILTERS_1_OPCODE_ADDR A:0x50349c
y.create.l HWIO_PCNOC_EPRB1_SPROF_FILTERS_1_STATUS_ADDR A:0x5034a0
y.create.l HWIO_PCNOC_EPRB1_SPROF_FILTERS_1_LENGTH_ADDR A:0x5034a4
y.create.l HWIO_PCNOC_EPRB1_SPROF_FILTERS_1_URGENCY_ADDR A:0x5034a8
y.create.l HWIO_PCNOC_EPRB1_SPROF_FILTERS_2_ROUTEIDBASE_ADDR A:0x5034bc
y.create.l HWIO_PCNOC_EPRB1_SPROF_FILTERS_2_ROUTEIDMASK_ADDR A:0x5034c0
y.create.l HWIO_PCNOC_EPRB1_SPROF_FILTERS_2_ADDRBASE_LOW_ADDR A:0x5034c4
y.create.l HWIO_PCNOC_EPRB1_SPROF_FILTERS_2_ADDRBASE_HIGH_ADDR A:0x5034c8
y.create.l HWIO_PCNOC_EPRB1_SPROF_FILTERS_2_WINDOWSIZE_ADDR A:0x5034cc
y.create.l HWIO_PCNOC_EPRB1_SPROF_FILTERS_2_OPCODE_ADDR A:0x5034d8
y.create.l HWIO_PCNOC_EPRB1_SPROF_FILTERS_2_STATUS_ADDR A:0x5034dc
y.create.l HWIO_PCNOC_EPRB1_SPROF_FILTERS_2_LENGTH_ADDR A:0x5034e0
y.create.l HWIO_PCNOC_EPRB1_SPROF_FILTERS_2_URGENCY_ADDR A:0x5034e4
y.create.l HWIO_PCNOC_EPRB1_SPROF_FILTERS_3_ROUTEIDBASE_ADDR A:0x5034f8
y.create.l HWIO_PCNOC_EPRB1_SPROF_FILTERS_3_ROUTEIDMASK_ADDR A:0x5034fc
y.create.l HWIO_PCNOC_EPRB1_SPROF_FILTERS_3_ADDRBASE_LOW_ADDR A:0x503500
y.create.l HWIO_PCNOC_EPRB1_SPROF_FILTERS_3_ADDRBASE_HIGH_ADDR A:0x503504
y.create.l HWIO_PCNOC_EPRB1_SPROF_FILTERS_3_WINDOWSIZE_ADDR A:0x503508
y.create.l HWIO_PCNOC_EPRB1_SPROF_FILTERS_3_OPCODE_ADDR A:0x503514
y.create.l HWIO_PCNOC_EPRB1_SPROF_FILTERS_3_STATUS_ADDR A:0x503518
y.create.l HWIO_PCNOC_EPRB1_SPROF_FILTERS_3_LENGTH_ADDR A:0x50351c
y.create.l HWIO_PCNOC_EPRB1_SPROF_FILTERS_3_URGENCY_ADDR A:0x503520
y.create.l HWIO_PCNOC_EPRB1_SPROF_COUNTERS_0_PORTSEL_ADDR A:0x503534
y.create.l HWIO_PCNOC_EPRB1_SPROF_COUNTERS_0_SRC_ADDR A:0x503538
y.create.l HWIO_PCNOC_EPRB1_SPROF_COUNTERS_0_ALARMMODE_ADDR A:0x50353c
y.create.l HWIO_PCNOC_EPRB1_SPROF_COUNTERS_0_VAL_ADDR A:0x503540
y.create.l HWIO_PCNOC_EPRB1_SPROF_COUNTERS_1_PORTSEL_ADDR A:0x503548
y.create.l HWIO_PCNOC_EPRB1_SPROF_COUNTERS_1_SRC_ADDR A:0x50354c
y.create.l HWIO_PCNOC_EPRB1_SPROF_COUNTERS_1_ALARMMODE_ADDR A:0x503550
y.create.l HWIO_PCNOC_EPRB1_SPROF_COUNTERS_1_VAL_ADDR A:0x503554
y.create.l HWIO_PCNOC_EPRB1_SPROF_COUNTERS_2_PORTSEL_ADDR A:0x50355c
y.create.l HWIO_PCNOC_EPRB1_SPROF_COUNTERS_2_SRC_ADDR A:0x503560
y.create.l HWIO_PCNOC_EPRB1_SPROF_COUNTERS_2_ALARMMODE_ADDR A:0x503564
y.create.l HWIO_PCNOC_EPRB1_SPROF_COUNTERS_2_VAL_ADDR A:0x503568
y.create.l HWIO_PCNOC_EPRB1_SPROF_COUNTERS_3_PORTSEL_ADDR A:0x503570
y.create.l HWIO_PCNOC_EPRB1_SPROF_COUNTERS_3_SRC_ADDR A:0x503574
y.create.l HWIO_PCNOC_EPRB1_SPROF_COUNTERS_3_ALARMMODE_ADDR A:0x503578
y.create.l HWIO_PCNOC_EPRB1_SPROF_COUNTERS_3_VAL_ADDR A:0x50357c
y.create.l HWIO_PCNOC_EPRB1_SPROF_COUNTERS_4_PORTSEL_ADDR A:0x503584
y.create.l HWIO_PCNOC_EPRB1_SPROF_COUNTERS_4_SRC_ADDR A:0x503588
y.create.l HWIO_PCNOC_EPRB1_SPROF_COUNTERS_4_ALARMMODE_ADDR A:0x50358c
y.create.l HWIO_PCNOC_EPRB1_SPROF_COUNTERS_4_VAL_ADDR A:0x503590
y.create.l HWIO_PCNOC_EPRB1_SPROF_COUNTERS_5_PORTSEL_ADDR A:0x503598
y.create.l HWIO_PCNOC_EPRB1_SPROF_COUNTERS_5_SRC_ADDR A:0x50359c
y.create.l HWIO_PCNOC_EPRB1_SPROF_COUNTERS_5_ALARMMODE_ADDR A:0x5035a0
y.create.l HWIO_PCNOC_EPRB1_SPROF_COUNTERS_5_VAL_ADDR A:0x5035a4
y.create.l HWIO_PCNOC_EPRB1_SPROF_COUNTERS_6_PORTSEL_ADDR A:0x5035ac
y.create.l HWIO_PCNOC_EPRB1_SPROF_COUNTERS_6_SRC_ADDR A:0x5035b0
y.create.l HWIO_PCNOC_EPRB1_SPROF_COUNTERS_6_ALARMMODE_ADDR A:0x5035b4
y.create.l HWIO_PCNOC_EPRB1_SPROF_COUNTERS_6_VAL_ADDR A:0x5035b8
y.create.l HWIO_PCNOC_EPRB1_SPROF_COUNTERS_7_PORTSEL_ADDR A:0x5035c0
y.create.l HWIO_PCNOC_EPRB1_SPROF_COUNTERS_7_SRC_ADDR A:0x5035c4
y.create.l HWIO_PCNOC_EPRB1_SPROF_COUNTERS_7_ALARMMODE_ADDR A:0x5035c8
y.create.l HWIO_PCNOC_EPRB1_SPROF_COUNTERS_7_VAL_ADDR A:0x5035cc
y.create.l HWIO_PCNOC_EPRB1_SPROF_COUNTERS_8_PORTSEL_ADDR A:0x5035d4
y.create.l HWIO_PCNOC_EPRB1_SPROF_COUNTERS_8_SRC_ADDR A:0x5035d8
y.create.l HWIO_PCNOC_EPRB1_SPROF_COUNTERS_8_ALARMMODE_ADDR A:0x5035dc
y.create.l HWIO_PCNOC_EPRB1_SPROF_COUNTERS_8_VAL_ADDR A:0x5035e0
y.create.l HWIO_PCNOC_EPRB1_SPROF_COUNTERS_9_PORTSEL_ADDR A:0x5035e8
y.create.l HWIO_PCNOC_EPRB1_SPROF_COUNTERS_9_SRC_ADDR A:0x5035ec
y.create.l HWIO_PCNOC_EPRB1_SPROF_COUNTERS_9_ALARMMODE_ADDR A:0x5035f0
y.create.l HWIO_PCNOC_EPRB1_SPROF_COUNTERS_9_VAL_ADDR A:0x5035f4
y.create.l HWIO_PCNOC_TPRB0_SPROF_ID_COREID_ADDR A:0x504000
y.create.l HWIO_PCNOC_TPRB0_SPROF_ID_REVISIONID_ADDR A:0x504004
y.create.l HWIO_PCNOC_TPRB0_SPROF_MAINCTL_ADDR A:0x504008
y.create.l HWIO_PCNOC_TPRB0_SPROF_CFGCTL_ADDR A:0x50400c
y.create.l HWIO_PCNOC_TPRB0_SPROF_STATPERIOD_ADDR A:0x504024
y.create.l HWIO_PCNOC_TPRB0_SPROF_STATGO_ADDR A:0x504028
y.create.l HWIO_PCNOC_TPRB0_SPROF_STATALARMMIN_ADDR A:0x50402c
y.create.l HWIO_PCNOC_TPRB0_SPROF_STATALARMMAX_ADDR A:0x504030
y.create.l HWIO_PCNOC_TPRB0_SPROF_STATALARMSTATUS_ADDR A:0x504034
y.create.l HWIO_PCNOC_TPRB0_SPROF_STATALARMCLR_ADDR A:0x504038
y.create.l HWIO_PCNOC_TPRB0_SPROF_STATALARMEN_ADDR A:0x50403c
y.create.l HWIO_PCNOC_TPRB0_SPROF_COUNTERS_0_SRC_ADDR A:0x504138
y.create.l HWIO_PCNOC_TPRB0_SPROF_COUNTERS_0_ALARMMODE_ADDR A:0x50413c
y.create.l HWIO_PCNOC_TPRB0_SPROF_COUNTERS_0_VAL_ADDR A:0x504140
y.create.l HWIO_PCNOC_TPRB0_SPROF_COUNTERS_1_SRC_ADDR A:0x50414c
y.create.l HWIO_PCNOC_TPRB0_SPROF_COUNTERS_1_ALARMMODE_ADDR A:0x504150
y.create.l HWIO_PCNOC_TPRB0_SPROF_COUNTERS_1_VAL_ADDR A:0x504154
y.create.l HWIO_PCNOC_TPRB0_SPROF_COUNTERS_2_SRC_ADDR A:0x504160
y.create.l HWIO_PCNOC_TPRB0_SPROF_COUNTERS_2_ALARMMODE_ADDR A:0x504164
y.create.l HWIO_PCNOC_TPRB0_SPROF_COUNTERS_2_VAL_ADDR A:0x504168
y.create.l HWIO_PCNOC_TPRB0_SPROF_COUNTERS_3_SRC_ADDR A:0x504174
y.create.l HWIO_PCNOC_TPRB0_SPROF_COUNTERS_3_ALARMMODE_ADDR A:0x504178
y.create.l HWIO_PCNOC_TPRB0_SPROF_COUNTERS_3_VAL_ADDR A:0x50417c
y.create.l HWIO_PCNOC_TPRB0_SPROF_COUNTERS_4_SRC_ADDR A:0x504188
y.create.l HWIO_PCNOC_TPRB0_SPROF_COUNTERS_4_ALARMMODE_ADDR A:0x50418c
y.create.l HWIO_PCNOC_TPRB0_SPROF_COUNTERS_4_VAL_ADDR A:0x504190
y.create.l HWIO_PCNOC_TPRB0_SPROF_COUNTERS_5_SRC_ADDR A:0x50419c
y.create.l HWIO_PCNOC_TPRB0_SPROF_COUNTERS_5_ALARMMODE_ADDR A:0x5041a0
y.create.l HWIO_PCNOC_TPRB0_SPROF_COUNTERS_5_VAL_ADDR A:0x5041a4
y.create.l HWIO_PCNOC_TPRB0_SPROF_COUNTERS_6_SRC_ADDR A:0x5041b0
y.create.l HWIO_PCNOC_TPRB0_SPROF_COUNTERS_6_ALARMMODE_ADDR A:0x5041b4
y.create.l HWIO_PCNOC_TPRB0_SPROF_COUNTERS_6_VAL_ADDR A:0x5041b8
y.create.l HWIO_PCNOC_TPRB0_SPROF_COUNTERS_7_SRC_ADDR A:0x5041c4
y.create.l HWIO_PCNOC_TPRB0_SPROF_COUNTERS_7_ALARMMODE_ADDR A:0x5041c8
y.create.l HWIO_PCNOC_TPRB0_SPROF_COUNTERS_7_VAL_ADDR A:0x5041cc
y.create.l HWIO_PCNOC_TPRB0_SPROF_COUNTERS_8_SRC_ADDR A:0x5041d8
y.create.l HWIO_PCNOC_TPRB0_SPROF_COUNTERS_8_ALARMMODE_ADDR A:0x5041dc
y.create.l HWIO_PCNOC_TPRB0_SPROF_COUNTERS_8_VAL_ADDR A:0x5041e0
y.create.l HWIO_PCNOC_TPRB0_SPROF_COUNTERS_9_SRC_ADDR A:0x5041ec
y.create.l HWIO_PCNOC_TPRB0_SPROF_COUNTERS_9_ALARMMODE_ADDR A:0x5041f0
y.create.l HWIO_PCNOC_TPRB0_SPROF_COUNTERS_9_VAL_ADDR A:0x5041f4
y.create.l HWIO_PCNOC_TPRB0_SPROF_COUNTERS_10_SRC_ADDR A:0x504200
y.create.l HWIO_PCNOC_TPRB0_SPROF_COUNTERS_10_ALARMMODE_ADDR A:0x504204
y.create.l HWIO_PCNOC_TPRB0_SPROF_COUNTERS_10_VAL_ADDR A:0x504208
y.create.l HWIO_PCNOC_TPRB0_SPROF_COUNTERS_11_SRC_ADDR A:0x504214
y.create.l HWIO_PCNOC_TPRB0_SPROF_COUNTERS_11_ALARMMODE_ADDR A:0x504218
y.create.l HWIO_PCNOC_TPRB0_SPROF_COUNTERS_11_VAL_ADDR A:0x50421c
y.create.l HWIO_PCNOC_TPRB0_SPROF_COUNTERS_12_SRC_ADDR A:0x504228
y.create.l HWIO_PCNOC_TPRB0_SPROF_COUNTERS_12_ALARMMODE_ADDR A:0x50422c
y.create.l HWIO_PCNOC_TPRB0_SPROF_COUNTERS_12_VAL_ADDR A:0x504230
y.create.l HWIO_PCNOC_TPRB0_SPROF_COUNTERS_13_SRC_ADDR A:0x50423c
y.create.l HWIO_PCNOC_TPRB0_SPROF_COUNTERS_13_ALARMMODE_ADDR A:0x504240
y.create.l HWIO_PCNOC_TPRB0_SPROF_COUNTERS_13_VAL_ADDR A:0x504244
y.create.l HWIO_PCNOC_TPRB0_SPROF_COUNTERS_14_SRC_ADDR A:0x504250
y.create.l HWIO_PCNOC_TPRB0_SPROF_COUNTERS_14_ALARMMODE_ADDR A:0x504254
y.create.l HWIO_PCNOC_TPRB0_SPROF_COUNTERS_14_VAL_ADDR A:0x504258
y.create.l HWIO_PCNOC_TPRB0_SPROF_COUNTERS_15_SRC_ADDR A:0x504264
y.create.l HWIO_PCNOC_TPRB0_SPROF_COUNTERS_15_ALARMMODE_ADDR A:0x504268
y.create.l HWIO_PCNOC_TPRB0_SPROF_COUNTERS_15_VAL_ADDR A:0x50426c
y.create.l HWIO_PCNOC_TPRB0_SPROF_COUNTERS_16_SRC_ADDR A:0x504278
y.create.l HWIO_PCNOC_TPRB0_SPROF_COUNTERS_16_ALARMMODE_ADDR A:0x50427c
y.create.l HWIO_PCNOC_TPRB0_SPROF_COUNTERS_16_VAL_ADDR A:0x504280
y.create.l HWIO_PCNOC_TPRB0_SPROF_COUNTERS_17_SRC_ADDR A:0x50428c
y.create.l HWIO_PCNOC_TPRB0_SPROF_COUNTERS_17_ALARMMODE_ADDR A:0x504290
y.create.l HWIO_PCNOC_TPRB0_SPROF_COUNTERS_17_VAL_ADDR A:0x504294
y.create.l HWIO_PCNOC_TPRB0_SPROF_COUNTERS_18_SRC_ADDR A:0x5042a0
y.create.l HWIO_PCNOC_TPRB0_SPROF_COUNTERS_18_ALARMMODE_ADDR A:0x5042a4
y.create.l HWIO_PCNOC_TPRB0_SPROF_COUNTERS_18_VAL_ADDR A:0x5042a8
y.create.l HWIO_PCNOC_TPRB0_SPROF_COUNTERS_19_SRC_ADDR A:0x5042b4
y.create.l HWIO_PCNOC_TPRB0_SPROF_COUNTERS_19_ALARMMODE_ADDR A:0x5042b8
y.create.l HWIO_PCNOC_TPRB0_SPROF_COUNTERS_19_VAL_ADDR A:0x5042bc
y.create.l HWIO_PCNOC_TPRB0_SPROF_COUNTERS_20_SRC_ADDR A:0x5042c8
y.create.l HWIO_PCNOC_TPRB0_SPROF_COUNTERS_20_ALARMMODE_ADDR A:0x5042cc
y.create.l HWIO_PCNOC_TPRB0_SPROF_COUNTERS_20_VAL_ADDR A:0x5042d0
y.create.l HWIO_PCNOC_TPRB0_SPROF_COUNTERS_21_SRC_ADDR A:0x5042dc
y.create.l HWIO_PCNOC_TPRB0_SPROF_COUNTERS_21_ALARMMODE_ADDR A:0x5042e0
y.create.l HWIO_PCNOC_TPRB0_SPROF_COUNTERS_21_VAL_ADDR A:0x5042e4
y.create.l HWIO_PCNOC_TPRB0_SPROF_COUNTERS_22_SRC_ADDR A:0x5042f0
y.create.l HWIO_PCNOC_TPRB0_SPROF_COUNTERS_22_ALARMMODE_ADDR A:0x5042f4
y.create.l HWIO_PCNOC_TPRB0_SPROF_COUNTERS_22_VAL_ADDR A:0x5042f8
y.create.l HWIO_PCNOC_TPRB0_SPROF_COUNTERS_23_SRC_ADDR A:0x504304
y.create.l HWIO_PCNOC_TPRB0_SPROF_COUNTERS_23_ALARMMODE_ADDR A:0x504308
y.create.l HWIO_PCNOC_TPRB0_SPROF_COUNTERS_23_VAL_ADDR A:0x50430c
y.create.l HWIO_PCNOC_TPRB1_SPROF_ID_COREID_ADDR A:0x504400
y.create.l HWIO_PCNOC_TPRB1_SPROF_ID_REVISIONID_ADDR A:0x504404
y.create.l HWIO_PCNOC_TPRB1_SPROF_MAINCTL_ADDR A:0x504408
y.create.l HWIO_PCNOC_TPRB1_SPROF_CFGCTL_ADDR A:0x50440c
y.create.l HWIO_PCNOC_TPRB1_SPROF_STATPERIOD_ADDR A:0x504424
y.create.l HWIO_PCNOC_TPRB1_SPROF_STATGO_ADDR A:0x504428
y.create.l HWIO_PCNOC_TPRB1_SPROF_STATALARMMIN_ADDR A:0x50442c
y.create.l HWIO_PCNOC_TPRB1_SPROF_STATALARMMAX_ADDR A:0x504430
y.create.l HWIO_PCNOC_TPRB1_SPROF_STATALARMSTATUS_ADDR A:0x504434
y.create.l HWIO_PCNOC_TPRB1_SPROF_STATALARMCLR_ADDR A:0x504438
y.create.l HWIO_PCNOC_TPRB1_SPROF_STATALARMEN_ADDR A:0x50443c
y.create.l HWIO_PCNOC_TPRB1_SPROF_COUNTERS_0_SRC_ADDR A:0x504538
y.create.l HWIO_PCNOC_TPRB1_SPROF_COUNTERS_0_ALARMMODE_ADDR A:0x50453c
y.create.l HWIO_PCNOC_TPRB1_SPROF_COUNTERS_0_VAL_ADDR A:0x504540
y.create.l HWIO_PCNOC_TPRB1_SPROF_COUNTERS_1_SRC_ADDR A:0x50454c
y.create.l HWIO_PCNOC_TPRB1_SPROF_COUNTERS_1_ALARMMODE_ADDR A:0x504550
y.create.l HWIO_PCNOC_TPRB1_SPROF_COUNTERS_1_VAL_ADDR A:0x504554
y.create.l HWIO_PCNOC_TPRB1_SPROF_COUNTERS_2_SRC_ADDR A:0x504560
y.create.l HWIO_PCNOC_TPRB1_SPROF_COUNTERS_2_ALARMMODE_ADDR A:0x504564
y.create.l HWIO_PCNOC_TPRB1_SPROF_COUNTERS_2_VAL_ADDR A:0x504568
y.create.l HWIO_PCNOC_TPRB1_SPROF_COUNTERS_3_SRC_ADDR A:0x504574
y.create.l HWIO_PCNOC_TPRB1_SPROF_COUNTERS_3_ALARMMODE_ADDR A:0x504578
y.create.l HWIO_PCNOC_TPRB1_SPROF_COUNTERS_3_VAL_ADDR A:0x50457c
y.create.l HWIO_PCNOC_TPRB1_SPROF_COUNTERS_4_SRC_ADDR A:0x504588
y.create.l HWIO_PCNOC_TPRB1_SPROF_COUNTERS_4_ALARMMODE_ADDR A:0x50458c
y.create.l HWIO_PCNOC_TPRB1_SPROF_COUNTERS_4_VAL_ADDR A:0x504590
y.create.l HWIO_PCNOC_TPRB1_SPROF_COUNTERS_5_SRC_ADDR A:0x50459c
y.create.l HWIO_PCNOC_TPRB1_SPROF_COUNTERS_5_ALARMMODE_ADDR A:0x5045a0
y.create.l HWIO_PCNOC_TPRB1_SPROF_COUNTERS_5_VAL_ADDR A:0x5045a4
y.create.l HWIO_PCNOC_TPRB1_SPROF_COUNTERS_6_SRC_ADDR A:0x5045b0
y.create.l HWIO_PCNOC_TPRB1_SPROF_COUNTERS_6_ALARMMODE_ADDR A:0x5045b4
y.create.l HWIO_PCNOC_TPRB1_SPROF_COUNTERS_6_VAL_ADDR A:0x5045b8
y.create.l HWIO_PCNOC_TPRB1_SPROF_COUNTERS_7_SRC_ADDR A:0x5045c4
y.create.l HWIO_PCNOC_TPRB1_SPROF_COUNTERS_7_ALARMMODE_ADDR A:0x5045c8
y.create.l HWIO_PCNOC_TPRB1_SPROF_COUNTERS_7_VAL_ADDR A:0x5045cc
y.create.l HWIO_PCNOC_TPRB1_SPROF_COUNTERS_8_SRC_ADDR A:0x5045d8
y.create.l HWIO_PCNOC_TPRB1_SPROF_COUNTERS_8_ALARMMODE_ADDR A:0x5045dc
y.create.l HWIO_PCNOC_TPRB1_SPROF_COUNTERS_8_VAL_ADDR A:0x5045e0
y.create.l HWIO_PCNOC_TPRB1_SPROF_COUNTERS_9_SRC_ADDR A:0x5045ec
y.create.l HWIO_PCNOC_TPRB1_SPROF_COUNTERS_9_ALARMMODE_ADDR A:0x5045f0
y.create.l HWIO_PCNOC_TPRB1_SPROF_COUNTERS_9_VAL_ADDR A:0x5045f4
y.create.l HWIO_PCNOC_TPRB1_SPROF_COUNTERS_10_SRC_ADDR A:0x504600
y.create.l HWIO_PCNOC_TPRB1_SPROF_COUNTERS_10_ALARMMODE_ADDR A:0x504604
y.create.l HWIO_PCNOC_TPRB1_SPROF_COUNTERS_10_VAL_ADDR A:0x504608
y.create.l HWIO_PCNOC_TPRB1_SPROF_COUNTERS_11_SRC_ADDR A:0x504614
y.create.l HWIO_PCNOC_TPRB1_SPROF_COUNTERS_11_ALARMMODE_ADDR A:0x504618
y.create.l HWIO_PCNOC_TPRB1_SPROF_COUNTERS_11_VAL_ADDR A:0x50461c
y.create.l HWIO_PCNOC_TPRB1_SPROF_COUNTERS_12_SRC_ADDR A:0x504628
y.create.l HWIO_PCNOC_TPRB1_SPROF_COUNTERS_12_ALARMMODE_ADDR A:0x50462c
y.create.l HWIO_PCNOC_TPRB1_SPROF_COUNTERS_12_VAL_ADDR A:0x504630
y.create.l HWIO_PCNOC_TPRB1_SPROF_COUNTERS_13_SRC_ADDR A:0x50463c
y.create.l HWIO_PCNOC_TPRB1_SPROF_COUNTERS_13_ALARMMODE_ADDR A:0x504640
y.create.l HWIO_PCNOC_TPRB1_SPROF_COUNTERS_13_VAL_ADDR A:0x504644
y.create.l HWIO_PCNOC_TPRB1_SPROF_COUNTERS_14_SRC_ADDR A:0x504650
y.create.l HWIO_PCNOC_TPRB1_SPROF_COUNTERS_14_ALARMMODE_ADDR A:0x504654
y.create.l HWIO_PCNOC_TPRB1_SPROF_COUNTERS_14_VAL_ADDR A:0x504658
y.create.l HWIO_PCNOC_TPRB1_SPROF_COUNTERS_15_SRC_ADDR A:0x504664
y.create.l HWIO_PCNOC_TPRB1_SPROF_COUNTERS_15_ALARMMODE_ADDR A:0x504668
y.create.l HWIO_PCNOC_TPRB1_SPROF_COUNTERS_15_VAL_ADDR A:0x50466c
y.create.l HWIO_PCNOC_TPRB1_SPROF_COUNTERS_16_SRC_ADDR A:0x504678
y.create.l HWIO_PCNOC_TPRB1_SPROF_COUNTERS_16_ALARMMODE_ADDR A:0x50467c
y.create.l HWIO_PCNOC_TPRB1_SPROF_COUNTERS_16_VAL_ADDR A:0x504680
y.create.l HWIO_PCNOC_TPRB1_SPROF_COUNTERS_17_SRC_ADDR A:0x50468c
y.create.l HWIO_PCNOC_TPRB1_SPROF_COUNTERS_17_ALARMMODE_ADDR A:0x504690
y.create.l HWIO_PCNOC_TPRB1_SPROF_COUNTERS_17_VAL_ADDR A:0x504694
y.create.l HWIO_PCNOC_TPRB1_SPROF_COUNTERS_18_SRC_ADDR A:0x5046a0
y.create.l HWIO_PCNOC_TPRB1_SPROF_COUNTERS_18_ALARMMODE_ADDR A:0x5046a4
y.create.l HWIO_PCNOC_TPRB1_SPROF_COUNTERS_18_VAL_ADDR A:0x5046a8
y.create.l HWIO_PCNOC_TPRB1_SPROF_COUNTERS_19_SRC_ADDR A:0x5046b4
y.create.l HWIO_PCNOC_TPRB1_SPROF_COUNTERS_19_ALARMMODE_ADDR A:0x5046b8
y.create.l HWIO_PCNOC_TPRB1_SPROF_COUNTERS_19_VAL_ADDR A:0x5046bc
y.create.l HWIO_PCNOC_TPRB1_SPROF_COUNTERS_20_SRC_ADDR A:0x5046c8
y.create.l HWIO_PCNOC_TPRB1_SPROF_COUNTERS_20_ALARMMODE_ADDR A:0x5046cc
y.create.l HWIO_PCNOC_TPRB1_SPROF_COUNTERS_20_VAL_ADDR A:0x5046d0
y.create.l HWIO_PCNOC_TPRB1_SPROF_COUNTERS_21_SRC_ADDR A:0x5046dc
y.create.l HWIO_PCNOC_TPRB1_SPROF_COUNTERS_21_ALARMMODE_ADDR A:0x5046e0
y.create.l HWIO_PCNOC_TPRB1_SPROF_COUNTERS_21_VAL_ADDR A:0x5046e4
y.create.l HWIO_PCNOC_TPRB1_SPROF_COUNTERS_22_SRC_ADDR A:0x5046f0
y.create.l HWIO_PCNOC_TPRB1_SPROF_COUNTERS_22_ALARMMODE_ADDR A:0x5046f4
y.create.l HWIO_PCNOC_TPRB1_SPROF_COUNTERS_22_VAL_ADDR A:0x5046f8
y.create.l HWIO_PCNOC_TPRB1_SPROF_COUNTERS_23_SRC_ADDR A:0x504704
y.create.l HWIO_PCNOC_TPRB1_SPROF_COUNTERS_23_ALARMMODE_ADDR A:0x504708
y.create.l HWIO_PCNOC_TPRB1_SPROF_COUNTERS_23_VAL_ADDR A:0x50470c
y.create.l HWIO_PCNOC_TPRB2_SPROF_ID_COREID_ADDR A:0x504800
y.create.l HWIO_PCNOC_TPRB2_SPROF_ID_REVISIONID_ADDR A:0x504804
y.create.l HWIO_PCNOC_TPRB2_SPROF_MAINCTL_ADDR A:0x504808
y.create.l HWIO_PCNOC_TPRB2_SPROF_CFGCTL_ADDR A:0x50480c
y.create.l HWIO_PCNOC_TPRB2_SPROF_STATPERIOD_ADDR A:0x504824
y.create.l HWIO_PCNOC_TPRB2_SPROF_STATGO_ADDR A:0x504828
y.create.l HWIO_PCNOC_TPRB2_SPROF_STATALARMMIN_ADDR A:0x50482c
y.create.l HWIO_PCNOC_TPRB2_SPROF_STATALARMMAX_ADDR A:0x504830
y.create.l HWIO_PCNOC_TPRB2_SPROF_STATALARMSTATUS_ADDR A:0x504834
y.create.l HWIO_PCNOC_TPRB2_SPROF_STATALARMCLR_ADDR A:0x504838
y.create.l HWIO_PCNOC_TPRB2_SPROF_STATALARMEN_ADDR A:0x50483c
y.create.l HWIO_PCNOC_TPRB2_SPROF_COUNTERS_0_SRC_ADDR A:0x504938
y.create.l HWIO_PCNOC_TPRB2_SPROF_COUNTERS_0_ALARMMODE_ADDR A:0x50493c
y.create.l HWIO_PCNOC_TPRB2_SPROF_COUNTERS_0_VAL_ADDR A:0x504940
y.create.l HWIO_PCNOC_TPRB2_SPROF_COUNTERS_1_SRC_ADDR A:0x50494c
y.create.l HWIO_PCNOC_TPRB2_SPROF_COUNTERS_1_ALARMMODE_ADDR A:0x504950
y.create.l HWIO_PCNOC_TPRB2_SPROF_COUNTERS_1_VAL_ADDR A:0x504954
y.create.l HWIO_PCNOC_TPRB2_SPROF_COUNTERS_2_SRC_ADDR A:0x504960
y.create.l HWIO_PCNOC_TPRB2_SPROF_COUNTERS_2_ALARMMODE_ADDR A:0x504964
y.create.l HWIO_PCNOC_TPRB2_SPROF_COUNTERS_2_VAL_ADDR A:0x504968
y.create.l HWIO_PCNOC_TPRB2_SPROF_COUNTERS_3_SRC_ADDR A:0x504974
y.create.l HWIO_PCNOC_TPRB2_SPROF_COUNTERS_3_ALARMMODE_ADDR A:0x504978
y.create.l HWIO_PCNOC_TPRB2_SPROF_COUNTERS_3_VAL_ADDR A:0x50497c
y.create.l HWIO_PCNOC_TPRB2_SPROF_COUNTERS_4_SRC_ADDR A:0x504988
y.create.l HWIO_PCNOC_TPRB2_SPROF_COUNTERS_4_ALARMMODE_ADDR A:0x50498c
y.create.l HWIO_PCNOC_TPRB2_SPROF_COUNTERS_4_VAL_ADDR A:0x504990
y.create.l HWIO_PCNOC_TPRB2_SPROF_COUNTERS_5_SRC_ADDR A:0x50499c
y.create.l HWIO_PCNOC_TPRB2_SPROF_COUNTERS_5_ALARMMODE_ADDR A:0x5049a0
y.create.l HWIO_PCNOC_TPRB2_SPROF_COUNTERS_5_VAL_ADDR A:0x5049a4
y.create.l HWIO_PCNOC_TPRB2_SPROF_COUNTERS_6_SRC_ADDR A:0x5049b0
y.create.l HWIO_PCNOC_TPRB2_SPROF_COUNTERS_6_ALARMMODE_ADDR A:0x5049b4
y.create.l HWIO_PCNOC_TPRB2_SPROF_COUNTERS_6_VAL_ADDR A:0x5049b8
y.create.l HWIO_PCNOC_TPRB2_SPROF_COUNTERS_7_SRC_ADDR A:0x5049c4
y.create.l HWIO_PCNOC_TPRB2_SPROF_COUNTERS_7_ALARMMODE_ADDR A:0x5049c8
y.create.l HWIO_PCNOC_TPRB2_SPROF_COUNTERS_7_VAL_ADDR A:0x5049cc
y.create.l HWIO_PCNOC_TPRB2_SPROF_COUNTERS_8_SRC_ADDR A:0x5049d8
y.create.l HWIO_PCNOC_TPRB2_SPROF_COUNTERS_8_ALARMMODE_ADDR A:0x5049dc
y.create.l HWIO_PCNOC_TPRB2_SPROF_COUNTERS_8_VAL_ADDR A:0x5049e0
y.create.l HWIO_PCNOC_TPRB2_SPROF_COUNTERS_9_SRC_ADDR A:0x5049ec
y.create.l HWIO_PCNOC_TPRB2_SPROF_COUNTERS_9_ALARMMODE_ADDR A:0x5049f0
y.create.l HWIO_PCNOC_TPRB2_SPROF_COUNTERS_9_VAL_ADDR A:0x5049f4
y.create.l HWIO_PCNOC_TPRB2_SPROF_COUNTERS_10_SRC_ADDR A:0x504a00
y.create.l HWIO_PCNOC_TPRB2_SPROF_COUNTERS_10_ALARMMODE_ADDR A:0x504a04
y.create.l HWIO_PCNOC_TPRB2_SPROF_COUNTERS_10_VAL_ADDR A:0x504a08
y.create.l HWIO_PCNOC_TPRB2_SPROF_COUNTERS_11_SRC_ADDR A:0x504a14
y.create.l HWIO_PCNOC_TPRB2_SPROF_COUNTERS_11_ALARMMODE_ADDR A:0x504a18
y.create.l HWIO_PCNOC_TPRB2_SPROF_COUNTERS_11_VAL_ADDR A:0x504a1c
y.create.l HWIO_PCNOC_TPRB2_SPROF_COUNTERS_12_SRC_ADDR A:0x504a28
y.create.l HWIO_PCNOC_TPRB2_SPROF_COUNTERS_12_ALARMMODE_ADDR A:0x504a2c
y.create.l HWIO_PCNOC_TPRB2_SPROF_COUNTERS_12_VAL_ADDR A:0x504a30
y.create.l HWIO_PCNOC_TPRB2_SPROF_COUNTERS_13_SRC_ADDR A:0x504a3c
y.create.l HWIO_PCNOC_TPRB2_SPROF_COUNTERS_13_ALARMMODE_ADDR A:0x504a40
y.create.l HWIO_PCNOC_TPRB2_SPROF_COUNTERS_13_VAL_ADDR A:0x504a44
y.create.l HWIO_PCNOC_TPRB2_SPROF_COUNTERS_14_SRC_ADDR A:0x504a50
y.create.l HWIO_PCNOC_TPRB2_SPROF_COUNTERS_14_ALARMMODE_ADDR A:0x504a54
y.create.l HWIO_PCNOC_TPRB2_SPROF_COUNTERS_14_VAL_ADDR A:0x504a58
y.create.l HWIO_PCNOC_TPRB2_SPROF_COUNTERS_15_SRC_ADDR A:0x504a64
y.create.l HWIO_PCNOC_TPRB2_SPROF_COUNTERS_15_ALARMMODE_ADDR A:0x504a68
y.create.l HWIO_PCNOC_TPRB2_SPROF_COUNTERS_15_VAL_ADDR A:0x504a6c
y.create.l HWIO_PCNOC_TPRB2_SPROF_COUNTERS_16_SRC_ADDR A:0x504a78
y.create.l HWIO_PCNOC_TPRB2_SPROF_COUNTERS_16_ALARMMODE_ADDR A:0x504a7c
y.create.l HWIO_PCNOC_TPRB2_SPROF_COUNTERS_16_VAL_ADDR A:0x504a80
y.create.l HWIO_PCNOC_TPRB2_SPROF_COUNTERS_17_SRC_ADDR A:0x504a8c
y.create.l HWIO_PCNOC_TPRB2_SPROF_COUNTERS_17_ALARMMODE_ADDR A:0x504a90
y.create.l HWIO_PCNOC_TPRB2_SPROF_COUNTERS_17_VAL_ADDR A:0x504a94
y.create.l HWIO_PCNOC_TPRB2_SPROF_COUNTERS_18_SRC_ADDR A:0x504aa0
y.create.l HWIO_PCNOC_TPRB2_SPROF_COUNTERS_18_ALARMMODE_ADDR A:0x504aa4
y.create.l HWIO_PCNOC_TPRB2_SPROF_COUNTERS_18_VAL_ADDR A:0x504aa8
y.create.l HWIO_PCNOC_TPRB2_SPROF_COUNTERS_19_SRC_ADDR A:0x504ab4
y.create.l HWIO_PCNOC_TPRB2_SPROF_COUNTERS_19_ALARMMODE_ADDR A:0x504ab8
y.create.l HWIO_PCNOC_TPRB2_SPROF_COUNTERS_19_VAL_ADDR A:0x504abc
y.create.l HWIO_PCNOC_TPRB2_SPROF_COUNTERS_20_SRC_ADDR A:0x504ac8
y.create.l HWIO_PCNOC_TPRB2_SPROF_COUNTERS_20_ALARMMODE_ADDR A:0x504acc
y.create.l HWIO_PCNOC_TPRB2_SPROF_COUNTERS_20_VAL_ADDR A:0x504ad0
y.create.l HWIO_PCNOC_TPRB2_SPROF_COUNTERS_21_SRC_ADDR A:0x504adc
y.create.l HWIO_PCNOC_TPRB2_SPROF_COUNTERS_21_ALARMMODE_ADDR A:0x504ae0
y.create.l HWIO_PCNOC_TPRB2_SPROF_COUNTERS_21_VAL_ADDR A:0x504ae4
y.create.l HWIO_PCNOC_TPRB2_SPROF_COUNTERS_22_SRC_ADDR A:0x504af0
y.create.l HWIO_PCNOC_TPRB2_SPROF_COUNTERS_22_ALARMMODE_ADDR A:0x504af4
y.create.l HWIO_PCNOC_TPRB2_SPROF_COUNTERS_22_VAL_ADDR A:0x504af8
y.create.l HWIO_PCNOC_TPRB2_SPROF_COUNTERS_23_SRC_ADDR A:0x504b04
y.create.l HWIO_PCNOC_TPRB2_SPROF_COUNTERS_23_ALARMMODE_ADDR A:0x504b08
y.create.l HWIO_PCNOC_TPRB2_SPROF_COUNTERS_23_VAL_ADDR A:0x504b0c
y.create.l HWIO_PCNOC_CRYPTO0_QOS_ID_COREID_ADDR A:0x507000
y.create.l HWIO_PCNOC_CRYPTO0_QOS_ID_REVISIONID_ADDR A:0x507004
y.create.l HWIO_PCNOC_CRYPTO0_QOS_PRIORITY_ADDR A:0x507008
y.create.l HWIO_PCNOC_CRYPTO0_QOS_MODE_ADDR A:0x50700c
y.create.l HWIO_PCNOC_CRYPTO0_QOS_EXTCONTROL_ADDR A:0x507018
y.create.l HWIO_PCNOC_QHM1_QOS_ID_COREID_ADDR A:0x50c000
y.create.l HWIO_PCNOC_QHM1_QOS_ID_REVISIONID_ADDR A:0x50c004
y.create.l HWIO_PCNOC_QHM1_QOS_PRIORITY_ADDR A:0x50c008
y.create.l HWIO_PCNOC_QHM1_QOS_MODE_ADDR A:0x50c00c
y.create.l HWIO_PCNOC_QHM1_QOS_EXTCONTROL_ADDR A:0x50c018
y.create.l HWIO_PCNOC_QHM2_QOS_ID_COREID_ADDR A:0x50d000
y.create.l HWIO_PCNOC_QHM2_QOS_ID_REVISIONID_ADDR A:0x50d004
y.create.l HWIO_PCNOC_QHM2_QOS_PRIORITY_ADDR A:0x50d008
y.create.l HWIO_PCNOC_QHM2_QOS_MODE_ADDR A:0x50d00c
y.create.l HWIO_PCNOC_QHM2_QOS_EXTCONTROL_ADDR A:0x50d018
y.create.l HWIO_PCNOC_QXM_NOC_QOS_ID_COREID_ADDR A:0x510000
y.create.l HWIO_PCNOC_QXM_NOC_QOS_ID_REVISIONID_ADDR A:0x510004
y.create.l HWIO_PCNOC_QXM_NOC_QOS_PRIORITY_ADDR A:0x510008
y.create.l HWIO_PCNOC_QXM_NOC_QOS_MODE_ADDR A:0x51000c
y.create.l HWIO_PCNOC_QXM_NOC_QOS_EXTCONTROL_ADDR A:0x510018
y.create.l HWIO_PCNOC_USB_HS1_QOS_ID_COREID_ADDR A:0x513000
y.create.l HWIO_PCNOC_USB_HS1_QOS_ID_REVISIONID_ADDR A:0x513004
y.create.l HWIO_PCNOC_USB_HS1_QOS_PRIORITY_ADDR A:0x513008
y.create.l HWIO_PCNOC_USB_HS1_QOS_MODE_ADDR A:0x51300c
y.create.l HWIO_PCNOC_USB_HS1_QOS_EXTCONTROL_ADDR A:0x513018
y.create.l HWIO_PCNOC_QDSS_BAM_QOS_ID_COREID_ADDR A:0x514000
y.create.l HWIO_PCNOC_QDSS_BAM_QOS_ID_REVISIONID_ADDR A:0x514004
y.create.l HWIO_PCNOC_QDSS_BAM_QOS_PRIORITY_ADDR A:0x514008
y.create.l HWIO_PCNOC_QDSS_BAM_QOS_MODE_ADDR A:0x51400c
y.create.l HWIO_PCNOC_QDSS_BAM_QOS_EXTCONTROL_ADDR A:0x514018
y.create.l HWIO_PCNOC_QDSS_ETR_QOS_ID_COREID_ADDR A:0x515000
y.create.l HWIO_PCNOC_QDSS_ETR_QOS_ID_REVISIONID_ADDR A:0x515004
y.create.l HWIO_PCNOC_QDSS_ETR_QOS_PRIORITY_ADDR A:0x515008
y.create.l HWIO_PCNOC_QDSS_ETR_QOS_MODE_ADDR A:0x51500c
y.create.l HWIO_PCNOC_QDSS_ETR_QOS_EXTCONTROL_ADDR A:0x515018
y.create.l HWIO_PCNOC_SBM_ID_COREID_ADDR A:0x516000
y.create.l HWIO_PCNOC_SBM_ID_REVISIONID_ADDR A:0x516004
y.create.l HWIO_PCNOC_SBM_FAULTEN_ADDR A:0x516008
y.create.l HWIO_PCNOC_SBM_FAULTSTATUS_ADDR A:0x51600c
y.create.l HWIO_PCNOC_SBM_FLAGINEN0_ADDR A:0x516010
y.create.l HWIO_PCNOC_SBM_FLAGINSTATUS0_ADDR A:0x516014
y.create.l HWIO_PCNOC_SBM_FLAGOUTSET0_ADDR A:0x516050
y.create.l HWIO_PCNOC_SBM_FLAGOUTCLR0_ADDR A:0x516054
y.create.l HWIO_PCNOC_SBM_FLAGOUTSTATUS0_ADDR A:0x516058
y.create.l HWIO_PCNOC_SBM_SENSEIN0_ADDR A:0x5160b0
y.create.l HWIO_PCNOC_SBM_SENSEIN1_ADDR A:0x5160b4
y.create.l HWIO_PCNOC_SBM_SENSEIN2_ADDR A:0x5160b8
y.create.l HWIO_PCNOC_DCD_QXCLK_ID_COREID_ADDR A:0x517000
y.create.l HWIO_PCNOC_DCD_QXCLK_ID_REVISIONID_ADDR A:0x517004
y.create.l HWIO_PCNOC_DCD_QXCLK_CONFIG_ADDR A:0x517008
y.create.l HWIO_PCNOC_DCD_QXCLK_HYSTCNT_ADDR A:0x51700c
y.create.l HWIO_PDM_WEB_PWM_REG_BASE_START_ADDR A:0xc0000
y.create.l HWIO_PDM_WEB_PWM_REG_BASE_LAST_ADDR A:0xca014
y.create.l HWIO_PDM_WEB_PWM_REG_BASE_END_ADDR A:0xcc000
y.create.l HWIO_PDM_WEB_PWM_TOPCTL0_ADDR A:0xc0000
y.create.l HWIO_PDM_WEB_PWM_TOPCTL1_ADDR A:0xc0004
y.create.l HWIO_PDM_WEB_PWM_VERSION_ADDR A:0xc0008
y.create.l HWIO_PDM_WEB_PWM_EN_STATUS_ADDR A:0xc000c
y.create.l HWIO_PDM_WEB_PWM0_CTL0_ADDR A:0xc1000
y.create.l HWIO_PDM_WEB_PWM0_CTL1_ADDR A:0xc1004
y.create.l HWIO_PDM_WEB_PWM0_CTL2_ADDR A:0xc1008
y.create.l HWIO_PDM_WEB_PWM0_CYC_CFG_ADDR A:0xc100c
y.create.l HWIO_PDM_WEB_PWM0_UPDATE_ADDR A:0xc1010
y.create.l HWIO_PDM_WEB_PWM0_PERIOD_CNT_ADDR A:0xc1014
y.create.l HWIO_PDM_WEB_PWM1_CTL0_ADDR A:0xc2000
y.create.l HWIO_PDM_WEB_PWM1_CTL1_ADDR A:0xc2004
y.create.l HWIO_PDM_WEB_PWM1_CTL2_ADDR A:0xc2008
y.create.l HWIO_PDM_WEB_PWM1_CYC_CFG_ADDR A:0xc200c
y.create.l HWIO_PDM_WEB_PWM1_UPDATE_ADDR A:0xc2010
y.create.l HWIO_PDM_WEB_PWM1_PERIOD_CNT_ADDR A:0xc2014
y.create.l HWIO_PDM_WEB_PWM2_CTL0_ADDR A:0xc3000
y.create.l HWIO_PDM_WEB_PWM2_CTL1_ADDR A:0xc3004
y.create.l HWIO_PDM_WEB_PWM2_CTL2_ADDR A:0xc3008
y.create.l HWIO_PDM_WEB_PWM2_CYC_CFG_ADDR A:0xc300c
y.create.l HWIO_PDM_WEB_PWM2_UPDATE_ADDR A:0xc3010
y.create.l HWIO_PDM_WEB_PWM2_PERIOD_CNT_ADDR A:0xc3014
y.create.l HWIO_PDM_WEB_PWM3_CTL0_ADDR A:0xc4000
y.create.l HWIO_PDM_WEB_PWM3_CTL1_ADDR A:0xc4004
y.create.l HWIO_PDM_WEB_PWM3_CTL2_ADDR A:0xc4008
y.create.l HWIO_PDM_WEB_PWM3_CYC_CFG_ADDR A:0xc400c
y.create.l HWIO_PDM_WEB_PWM3_UPDATE_ADDR A:0xc4010
y.create.l HWIO_PDM_WEB_PWM3_PERIOD_CNT_ADDR A:0xc4014
y.create.l HWIO_PDM_WEB_PWM4_CTL0_ADDR A:0xc5000
y.create.l HWIO_PDM_WEB_PWM4_CTL1_ADDR A:0xc5004
y.create.l HWIO_PDM_WEB_PWM4_CTL2_ADDR A:0xc5008
y.create.l HWIO_PDM_WEB_PWM4_CYC_CFG_ADDR A:0xc500c
y.create.l HWIO_PDM_WEB_PWM4_UPDATE_ADDR A:0xc5010
y.create.l HWIO_PDM_WEB_PWM4_PERIOD_CNT_ADDR A:0xc5014
y.create.l HWIO_PDM_WEB_PWM5_CTL0_ADDR A:0xc6000
y.create.l HWIO_PDM_WEB_PWM5_CTL1_ADDR A:0xc6004
y.create.l HWIO_PDM_WEB_PWM5_CTL2_ADDR A:0xc6008
y.create.l HWIO_PDM_WEB_PWM5_CYC_CFG_ADDR A:0xc600c
y.create.l HWIO_PDM_WEB_PWM5_UPDATE_ADDR A:0xc6010
y.create.l HWIO_PDM_WEB_PWM5_PERIOD_CNT_ADDR A:0xc6014
y.create.l HWIO_PDM_WEB_PWM6_CTL0_ADDR A:0xc7000
y.create.l HWIO_PDM_WEB_PWM6_CTL1_ADDR A:0xc7004
y.create.l HWIO_PDM_WEB_PWM6_CTL2_ADDR A:0xc7008
y.create.l HWIO_PDM_WEB_PWM6_CYC_CFG_ADDR A:0xc700c
y.create.l HWIO_PDM_WEB_PWM6_UPDATE_ADDR A:0xc7010
y.create.l HWIO_PDM_WEB_PWM6_PERIOD_CNT_ADDR A:0xc7014
y.create.l HWIO_PDM_WEB_PWM7_CTL0_ADDR A:0xc8000
y.create.l HWIO_PDM_WEB_PWM7_CTL1_ADDR A:0xc8004
y.create.l HWIO_PDM_WEB_PWM7_CTL2_ADDR A:0xc8008
y.create.l HWIO_PDM_WEB_PWM7_CYC_CFG_ADDR A:0xc800c
y.create.l HWIO_PDM_WEB_PWM7_UPDATE_ADDR A:0xc8010
y.create.l HWIO_PDM_WEB_PWM7_PERIOD_CNT_ADDR A:0xc8014
y.create.l HWIO_PDM_WEB_PWM8_CTL0_ADDR A:0xc9000
y.create.l HWIO_PDM_WEB_PWM8_CTL1_ADDR A:0xc9004
y.create.l HWIO_PDM_WEB_PWM8_CTL2_ADDR A:0xc9008
y.create.l HWIO_PDM_WEB_PWM8_CYC_CFG_ADDR A:0xc900c
y.create.l HWIO_PDM_WEB_PWM8_UPDATE_ADDR A:0xc9010
y.create.l HWIO_PDM_WEB_PWM8_PERIOD_CNT_ADDR A:0xc9014
y.create.l HWIO_PDM_WEB_PWM9_CTL0_ADDR A:0xca000
y.create.l HWIO_PDM_WEB_PWM9_CTL1_ADDR A:0xca004
y.create.l HWIO_PDM_WEB_PWM9_CTL2_ADDR A:0xca008
y.create.l HWIO_PDM_WEB_PWM9_CYC_CFG_ADDR A:0xca00c
y.create.l HWIO_PDM_WEB_PWM9_UPDATE_ADDR A:0xca010
y.create.l HWIO_PDM_WEB_PWM9_PERIOD_CNT_ADDR A:0xca014
y.create.l HWIO_PDM_WEB_TCXO4_REG_BASE_START_ADDR A:0xd0000
y.create.l HWIO_PDM_WEB_TCXO4_REG_BASE_LAST_ADDR A:0xd3008
y.create.l HWIO_PDM_WEB_TCXO4_REG_BASE_END_ADDR A:0xd4000
y.create.l HWIO_PDM_TCXO_PDM0_TOP_CTL_ADDR A:0xd0000
y.create.l HWIO_PDM_PDM0_CTL_ADDR A:0xd0004
y.create.l HWIO_PDM_WEB_TCXO4_TEST_ADDR A:0xd0008
y.create.l HWIO_PDM_TCXO_PDM1_TOP_CTL_ADDR A:0xd1000
y.create.l HWIO_PDM_PDM1_CTL_ADDR A:0xd1004
y.create.l HWIO_PDM_TCXO_PDM2_TOP_CTL_ADDR A:0xd2000
y.create.l HWIO_PDM_PDM2_CTL_ADDR A:0xd2004
y.create.l HWIO_PDM_GP_MN_CLK_MDIV_ADDR A:0xd3000
y.create.l HWIO_PDM_GP_MN_CLK_NDIV_ADDR A:0xd3004
y.create.l HWIO_PDM_GP_MN_CLK_DUTY_ADDR A:0xd3008
y.create.l HWIO_PKA_WRAPPER_REGS_REG_BASE_START_ADDR A:0x7900000
y.create.l HWIO_PKA_WRAPPER_REGS_REG_BASE_LAST_ADDR A:0x7940000
y.create.l HWIO_PKA_WRAPPER_REGS_REG_BASE_END_ADDR A:0x7948040
y.create.l HWIO_EE0_CONTRL_ADDR A:0x7900000
y.create.l HWIO_EE1_CONTRL_ADDR A:0x7910000
y.create.l HWIO_EE2_CONTRL_ADDR A:0x7920000
y.create.l HWIO_EE3_CONTRL_ADDR A:0x7930000
y.create.l HWIO_EE0_PRG_ENTRY_ADDR_ADDR A:0x7900004
y.create.l HWIO_EE1_PRG_ENTRY_ADDR_ADDR A:0x7910004
y.create.l HWIO_EE2_PRG_ENTRY_ADDR_ADDR A:0x7920004
y.create.l HWIO_EE3_PRG_ENTRY_ADDR_ADDR A:0x7930004
y.create.l HWIO_EE0_RETURN_CODE_ADDR A:0x7900008
y.create.l HWIO_EE1_RETURN_CODE_ADDR A:0x7910008
y.create.l HWIO_EE2_RETURN_CODE_ADDR A:0x7920008
y.create.l HWIO_EE3_RETURN_CODE_ADDR A:0x7930008
y.create.l HWIO_EE0_BUILD_CFG_ADDR A:0x790000c
y.create.l HWIO_EE1_BUILD_CFG_ADDR A:0x791000c
y.create.l HWIO_EE2_BUILD_CFG_ADDR A:0x792000c
y.create.l HWIO_EE3_BUILD_CFG_ADDR A:0x793000c
y.create.l HWIO_EE0_F_STACK_PNTR_ADDR A:0x7900010
y.create.l HWIO_EE1_F_STACK_PNTR_ADDR A:0x7910010
y.create.l HWIO_EE2_F_STACK_PNTR_ADDR A:0x7920010
y.create.l HWIO_EE3_F_STACK_PNTR_ADDR A:0x7930010
y.create.l HWIO_EE0_INSTRUCT_SINCE_GO_ADDR A:0x7900014
y.create.l HWIO_EE1_INSTRUCT_SINCE_GO_ADDR A:0x7910014
y.create.l HWIO_EE2_INSTRUCT_SINCE_GO_ADDR A:0x7920014
y.create.l HWIO_EE3_INSTRUCT_SINCE_GO_ADDR A:0x7930014
y.create.l HWIO_EE0_P_STACK_PNTR_ADDR A:0x7900018
y.create.l HWIO_EE1_P_STACK_PNTR_ADDR A:0x7910018
y.create.l HWIO_EE2_P_STACK_PNTR_ADDR A:0x7920018
y.create.l HWIO_EE3_P_STACK_PNTR_ADDR A:0x7930018
y.create.l HWIO_EE0_CFG_ADDR A:0x790001c
y.create.l HWIO_EE1_CFG_ADDR A:0x791001c
y.create.l HWIO_EE2_CFG_ADDR A:0x792001c
y.create.l HWIO_EE3_CFG_ADDR A:0x793001c
y.create.l HWIO_EE0_STATUS_IRQ_ADDR A:0x7900020
y.create.l HWIO_EE1_STATUS_IRQ_ADDR A:0x7910020
y.create.l HWIO_EE2_STATUS_IRQ_ADDR A:0x7920020
y.create.l HWIO_EE3_STATUS_IRQ_ADDR A:0x7930020
y.create.l HWIO_EE0_FLAGS_ADDR A:0x7900024
y.create.l HWIO_EE1_FLAGS_ADDR A:0x7910024
y.create.l HWIO_EE2_FLAGS_ADDR A:0x7920024
y.create.l HWIO_EE3_FLAGS_ADDR A:0x7930024
y.create.l HWIO_EE0_WATCHDOG_ADDR A:0x7900028
y.create.l HWIO_EE1_WATCHDOG_ADDR A:0x7910028
y.create.l HWIO_EE2_WATCHDOG_ADDR A:0x7920028
y.create.l HWIO_EE3_WATCHDOG_ADDR A:0x7930028
y.create.l HWIO_EE0_CYCLES_SINCE_GO_ADDR A:0x790002c
y.create.l HWIO_EE1_CYCLES_SINCE_GO_ADDR A:0x791002c
y.create.l HWIO_EE2_CYCLES_SINCE_GO_ADDR A:0x792002c
y.create.l HWIO_EE3_CYCLES_SINCE_GO_ADDR A:0x793002c
y.create.l HWIO_EE0_INDEX_I_ADDR A:0x7900030
y.create.l HWIO_EE1_INDEX_I_ADDR A:0x7910030
y.create.l HWIO_EE2_INDEX_I_ADDR A:0x7920030
y.create.l HWIO_EE3_INDEX_I_ADDR A:0x7930030
y.create.l HWIO_EE0_INDEX_J_ADDR A:0x7900034
y.create.l HWIO_EE1_INDEX_J_ADDR A:0x7910034
y.create.l HWIO_EE2_INDEX_J_ADDR A:0x7920034
y.create.l HWIO_EE3_INDEX_J_ADDR A:0x7930034
y.create.l HWIO_EE0_INDEX_K_ADDR A:0x7900038
y.create.l HWIO_EE1_INDEX_K_ADDR A:0x7910038
y.create.l HWIO_EE2_INDEX_K_ADDR A:0x7920038
y.create.l HWIO_EE3_INDEX_K_ADDR A:0x7930038
y.create.l HWIO_EE0_INDEX_L_ADDR A:0x790003c
y.create.l HWIO_EE1_INDEX_L_ADDR A:0x791003c
y.create.l HWIO_EE2_INDEX_L_ADDR A:0x792003c
y.create.l HWIO_EE3_INDEX_L_ADDR A:0x793003c
y.create.l HWIO_EE0_INT_EN_ADDR A:0x7900040
y.create.l HWIO_EE1_INT_EN_ADDR A:0x7910040
y.create.l HWIO_EE2_INT_EN_ADDR A:0x7920040
y.create.l HWIO_EE3_INT_EN_ADDR A:0x7930040
y.create.l HWIO_EE0_JMP_PRB_ADDR A:0x7900044
y.create.l HWIO_EE1_JMP_PRB_ADDR A:0x7910044
y.create.l HWIO_EE2_JMP_PRB_ADDR A:0x7920044
y.create.l HWIO_EE3_JMP_PRB_ADDR A:0x7930044
y.create.l HWIO_EE0_PRB_LFSR_SEED_ADDR A:0x7900048
y.create.l HWIO_EE1_PRB_LFSR_SEED_ADDR A:0x7910048
y.create.l HWIO_EE2_PRB_LFSR_SEED_ADDR A:0x7920048
y.create.l HWIO_EE3_PRB_LFSR_SEED_ADDR A:0x7930048
y.create.l HWIO_EE0_BANK_SWITCH_A_ADDR A:0x7900050
y.create.l HWIO_EE1_BANK_SWITCH_A_ADDR A:0x7910050
y.create.l HWIO_EE2_BANK_SWITCH_A_ADDR A:0x7920050
y.create.l HWIO_EE3_BANK_SWITCH_A_ADDR A:0x7930050
y.create.l HWIO_EE0_BANK_SWITCH_B_ADDR A:0x7900054
y.create.l HWIO_EE1_BANK_SWITCH_B_ADDR A:0x7910054
y.create.l HWIO_EE2_BANK_SWITCH_B_ADDR A:0x7920054
y.create.l HWIO_EE3_BANK_SWITCH_B_ADDR A:0x7930054
y.create.l HWIO_EE0_BANK_SWITCH_C_ADDR A:0x7900058
y.create.l HWIO_EE1_BANK_SWITCH_C_ADDR A:0x7910058
y.create.l HWIO_EE2_BANK_SWITCH_C_ADDR A:0x7920058
y.create.l HWIO_EE3_BANK_SWITCH_C_ADDR A:0x7930058
y.create.l HWIO_EE0_BANK_SWITCH_D_ADDR A:0x790005c
y.create.l HWIO_EE1_BANK_SWITCH_D_ADDR A:0x791005c
y.create.l HWIO_EE2_BANK_SWITCH_D_ADDR A:0x792005c
y.create.l HWIO_EE3_BANK_SWITCH_D_ADDR A:0x793005c
y.create.l HWIO_EE0_LOCK_STATUS_ADDR A:0x7908000
y.create.l HWIO_EE1_LOCK_STATUS_ADDR A:0x7918000
y.create.l HWIO_EE2_LOCK_STATUS_ADDR A:0x7928000
y.create.l HWIO_EE3_LOCK_STATUS_ADDR A:0x7938000
y.create.l HWIO_EE0_LOCK_REQ_ADDR A:0x7908004
y.create.l HWIO_EE1_LOCK_REQ_ADDR A:0x7918004
y.create.l HWIO_EE2_LOCK_REQ_ADDR A:0x7928004
y.create.l HWIO_EE3_LOCK_REQ_ADDR A:0x7938004
y.create.l HWIO_EE0_LOCK_GRANT_ADDR A:0x7908008
y.create.l HWIO_EE1_LOCK_GRANT_ADDR A:0x7918008
y.create.l HWIO_EE2_LOCK_GRANT_ADDR A:0x7928008
y.create.l HWIO_EE3_LOCK_GRANT_ADDR A:0x7938008
y.create.l HWIO_EE0_IRQ_OUT_SEL_ADDR A:0x790800c
y.create.l HWIO_EE1_IRQ_OUT_SEL_ADDR A:0x791800c
y.create.l HWIO_EE2_IRQ_OUT_SEL_ADDR A:0x792800c
y.create.l HWIO_EE3_IRQ_OUT_SEL_ADDR A:0x793800c
y.create.l HWIO_EE0_VERSION_ADDR A:0x7908010
y.create.l HWIO_EE1_VERSION_ADDR A:0x7918010
y.create.l HWIO_EE2_VERSION_ADDR A:0x7928010
y.create.l HWIO_EE3_VERSION_ADDR A:0x7938010
y.create.l HWIO_DEBUG_CTRL_ADDR A:0x7940000
y.create.l HWIO_PKA_WRAPPER_XPU2_REG_BASE_START_ADDR A:0x7970000
y.create.l HWIO_PKA_WRAPPER_XPU2_REG_BASE_LAST_ADDR A:0x7970454
y.create.l HWIO_PKA_WRAPPER_XPU2_REG_BASE_END_ADDR A:0x7970480
y.create.l HWIO_PKA_WRAPPER_XPU_SCR_ADDR A:0x7970000
y.create.l HWIO_PKA_WRAPPER_XPU_SWDR_ADDR A:0x7970004
y.create.l HWIO_PKA_WRAPPER_XPU_SEAR0_ADDR A:0x7970040
y.create.l HWIO_PKA_WRAPPER_XPU_SESR_ADDR A:0x7970048
y.create.l HWIO_PKA_WRAPPER_XPU_SESRRESTORE_ADDR A:0x797004c
y.create.l HWIO_PKA_WRAPPER_XPU_SESYNR0_ADDR A:0x7970050
y.create.l HWIO_PKA_WRAPPER_XPU_SESYNR1_ADDR A:0x7970054
y.create.l HWIO_PKA_WRAPPER_XPU_SESYNR2_ADDR A:0x7970058
y.create.l HWIO_PKA_WRAPPER_XPU_MCR_ADDR A:0x7970100
y.create.l HWIO_PKA_WRAPPER_XPU_MEAR0_ADDR A:0x7970140
y.create.l HWIO_PKA_WRAPPER_XPU_MESR_ADDR A:0x7970148
y.create.l HWIO_PKA_WRAPPER_XPU_MESRRESTORE_ADDR A:0x797014c
y.create.l HWIO_PKA_WRAPPER_XPU_MESYNR0_ADDR A:0x7970150
y.create.l HWIO_PKA_WRAPPER_XPU_MESYNR1_ADDR A:0x7970154
y.create.l HWIO_PKA_WRAPPER_XPU_MESYNR2_ADDR A:0x7970158
y.create.l HWIO_PKA_WRAPPER_XPU_CR_ADDR A:0x7970080
y.create.l HWIO_PKA_WRAPPER_XPU_RPU_ACR0_ADDR A:0x79700a0
y.create.l HWIO_PKA_WRAPPER_XPU_EAR0_ADDR A:0x79700c0
y.create.l HWIO_PKA_WRAPPER_XPU_ESR_ADDR A:0x79700c8
y.create.l HWIO_PKA_WRAPPER_XPU_ESRRESTORE_ADDR A:0x79700cc
y.create.l HWIO_PKA_WRAPPER_XPU_ESYNR0_ADDR A:0x79700d0
y.create.l HWIO_PKA_WRAPPER_XPU_ESYNR1_ADDR A:0x79700d4
y.create.l HWIO_PKA_WRAPPER_XPU_ESYNR2_ADDR A:0x79700d8
y.create.l HWIO_PKA_WRAPPER_XPU_IDR0_ADDR A:0x7970074
y.create.l HWIO_PKA_WRAPPER_XPU_IDR1_ADDR A:0x7970078
y.create.l HWIO_PKA_WRAPPER_XPU_REV_ADDR A:0x797007c
y.create.l HWIO_PKA_WRAPPER_XPU_RG0_RACR0_ADDR A:0x7970200
y.create.l HWIO_PKA_WRAPPER_XPU_RG1_RACR0_ADDR A:0x7970280
y.create.l HWIO_PKA_WRAPPER_XPU_RG2_RACR0_ADDR A:0x7970300
y.create.l HWIO_PKA_WRAPPER_XPU_RG3_RACR0_ADDR A:0x7970380
y.create.l HWIO_PKA_WRAPPER_XPU_RG4_RACR0_ADDR A:0x7970400
y.create.l HWIO_PKA_WRAPPER_XPU_RG0_SCR_ADDR A:0x7970250
y.create.l HWIO_PKA_WRAPPER_XPU_RG1_SCR_ADDR A:0x79702d0
y.create.l HWIO_PKA_WRAPPER_XPU_RG2_SCR_ADDR A:0x7970350
y.create.l HWIO_PKA_WRAPPER_XPU_RG3_SCR_ADDR A:0x79703d0
y.create.l HWIO_PKA_WRAPPER_XPU_RG4_SCR_ADDR A:0x7970450
y.create.l HWIO_PKA_WRAPPER_XPU_RG0_MCR_ADDR A:0x7970254
y.create.l HWIO_PKA_WRAPPER_XPU_RG1_MCR_ADDR A:0x79702d4
y.create.l HWIO_PKA_WRAPPER_XPU_RG2_MCR_ADDR A:0x7970354
y.create.l HWIO_PKA_WRAPPER_XPU_RG3_MCR_ADDR A:0x79703d4
y.create.l HWIO_PKA_WRAPPER_XPU_RG4_MCR_ADDR A:0x7970454
y.create.l HWIO_SPMI_GENI_CFG_REG_BASE_START_ADDR A:0x200a000
y.create.l HWIO_SPMI_GENI_CFG_REG_BASE_LAST_ADDR A:0x200a5fc
y.create.l HWIO_SPMI_GENI_CFG_REG_BASE_END_ADDR A:0x200a700
y.create.l HWIO_SPMI_GENI_CLK_CTRL_ADDR A:0x200a000
y.create.l HWIO_SPMI_GENI_HW_VERSION_ADDR A:0x200a004
y.create.l HWIO_SPMI_GENI_FW_REVISION_ADDR A:0x200a008
y.create.l HWIO_SPMI_GENI_S_FW_REVISION_ADDR A:0x200a00c
y.create.l HWIO_SPMI_GENI_FORCE_DEFAULT_REG_ADDR A:0x200a010
y.create.l HWIO_SPMI_GENI_OUTPUT_CTRL_ADDR A:0x200a014
y.create.l HWIO_SPMI_GENI_CGC_CTRL_ADDR A:0x200a018
y.create.l HWIO_SPMI_GENI_CHAR_CFG_ADDR A:0x200a01c
y.create.l HWIO_SPMI_GENI_CHAR_DATA_0_ADDR A:0x200a020
y.create.l HWIO_SPMI_GENI_CHAR_DATA_1_ADDR A:0x200a024
y.create.l HWIO_SPMI_GENI_CTRL_ADDR A:0x200a028
y.create.l HWIO_SPMI_GENI_STATUS_ADDR A:0x200a02c
y.create.l HWIO_SPMI_GENI_TEST_BUS_CTRL_ADDR A:0x200a030
y.create.l HWIO_SPMI_GENI_SER_CLK_CFG_ADDR A:0x200a034
y.create.l HWIO_SPMI_GENI_TX_WATERMARK_REG_ADDR A:0x200a038
y.create.l HWIO_SPMI_GENI_RX_WATERMARK_REG_ADDR A:0x200a03c
y.create.l HWIO_SPMI_GENI_STOP_REG_ADDR A:0x200a040
y.create.l HWIO_SPMI_GENI_SW_COMP_REG_ADDR A:0x200a044
y.create.l HWIO_SPMI_GENI_PROG_ROM_CTRL_REG_ADDR A:0x200a048
y.create.l HWIO_SPMI_GENI_CFG_REG0_ADDR A:0x200a100
y.create.l HWIO_SPMI_GENI_CFG_REG1_ADDR A:0x200a104
y.create.l HWIO_SPMI_GENI_CFG_REG2_ADDR A:0x200a108
y.create.l HWIO_SPMI_GENI_CFG_REG3_ADDR A:0x200a10c
y.create.l HWIO_SPMI_GENI_CFG_REG4_ADDR A:0x200a110
y.create.l HWIO_SPMI_GENI_CFG_REG5_ADDR A:0x200a114
y.create.l HWIO_SPMI_GENI_CFG_REG6_ADDR A:0x200a118
y.create.l HWIO_SPMI_GENI_CFG_REG7_ADDR A:0x200a11c
y.create.l HWIO_SPMI_GENI_CFG_REG8_ADDR A:0x200a120
y.create.l HWIO_SPMI_GENI_CFG_REG9_ADDR A:0x200a124
y.create.l HWIO_SPMI_GENI_CFG_REG10_ADDR A:0x200a128
y.create.l HWIO_SPMI_GENI_CFG_REG11_ADDR A:0x200a12c
y.create.l HWIO_SPMI_GENI_CFG_REG12_ADDR A:0x200a130
y.create.l HWIO_SPMI_GENI_CFG_REG13_ADDR A:0x200a134
y.create.l HWIO_SPMI_GENI_CFG_REG14_ADDR A:0x200a138
y.create.l HWIO_SPMI_GENI_CFG_REG15_ADDR A:0x200a13c
y.create.l HWIO_SPMI_GENI_CFG_REG16_ADDR A:0x200a140
y.create.l HWIO_SPMI_GENI_CFG_REG17_ADDR A:0x200a144
y.create.l HWIO_SPMI_GENI_CFG_REG18_ADDR A:0x200a148
y.create.l HWIO_SPMI_GENI_CFG_REG19_ADDR A:0x200a14c
y.create.l HWIO_SPMI_GENI_CFG_REG20_ADDR A:0x200a150
y.create.l HWIO_SPMI_GENI_CFG_REG21_ADDR A:0x200a154
y.create.l HWIO_SPMI_GENI_CFG_REG22_ADDR A:0x200a158
y.create.l HWIO_SPMI_GENI_CFG_REG23_ADDR A:0x200a15c
y.create.l HWIO_SPMI_GENI_CFG_REG24_ADDR A:0x200a160
y.create.l HWIO_SPMI_GENI_CFG_REG25_ADDR A:0x200a164
y.create.l HWIO_SPMI_GENI_CFG_REG26_ADDR A:0x200a168
y.create.l HWIO_SPMI_GENI_CFG_REG27_ADDR A:0x200a16c
y.create.l HWIO_SPMI_GENI_CFG_REG28_ADDR A:0x200a170
y.create.l HWIO_SPMI_GENI_CFG_REG29_ADDR A:0x200a174
y.create.l HWIO_SPMI_GENI_CFG_REG30_ADDR A:0x200a178
y.create.l HWIO_SPMI_GENI_CFG_RAM0_ADDR A:0x200a200
y.create.l HWIO_SPMI_GENI_CFG_RAM1_ADDR A:0x200a204
y.create.l HWIO_SPMI_GENI_CFG_RAM2_ADDR A:0x200a208
y.create.l HWIO_SPMI_GENI_CFG_RAM3_ADDR A:0x200a20c
y.create.l HWIO_SPMI_GENI_CFG_RAM4_ADDR A:0x200a210
y.create.l HWIO_SPMI_GENI_CFG_RAM5_ADDR A:0x200a214
y.create.l HWIO_SPMI_GENI_CFG_RAM6_ADDR A:0x200a218
y.create.l HWIO_SPMI_GENI_CFG_RAM7_ADDR A:0x200a21c
y.create.l HWIO_SPMI_GENI_CFG_RAM8_ADDR A:0x200a220
y.create.l HWIO_SPMI_GENI_CFG_RAM9_ADDR A:0x200a224
y.create.l HWIO_SPMI_CFG_REG_BASE_START_ADDR A:0x200a700
y.create.l HWIO_SPMI_CFG_REG_BASE_LAST_ADDR A:0x200c028
y.create.l HWIO_SPMI_CFG_REG_BASE_END_ADDR A:0x200c100
y.create.l HWIO_SPMI_PERIPH0_2OWNER_TABLE_REG_ADDR A:0x200a700
y.create.l HWIO_SPMI_PERIPH1_2OWNER_TABLE_REG_ADDR A:0x200a704
y.create.l HWIO_SPMI_PERIPH2_2OWNER_TABLE_REG_ADDR A:0x200a708
y.create.l HWIO_SPMI_PERIPH3_2OWNER_TABLE_REG_ADDR A:0x200a70c
y.create.l HWIO_SPMI_PERIPH4_2OWNER_TABLE_REG_ADDR A:0x200a710
y.create.l HWIO_SPMI_PERIPH5_2OWNER_TABLE_REG_ADDR A:0x200a714
y.create.l HWIO_SPMI_PERIPH6_2OWNER_TABLE_REG_ADDR A:0x200a718
y.create.l HWIO_SPMI_PERIPH7_2OWNER_TABLE_REG_ADDR A:0x200a71c
y.create.l HWIO_SPMI_PERIPH8_2OWNER_TABLE_REG_ADDR A:0x200a720
y.create.l HWIO_SPMI_PERIPH9_2OWNER_TABLE_REG_ADDR A:0x200a724
y.create.l HWIO_SPMI_MAPPING_TABLE_REG0_ADDR A:0x200ab00
y.create.l HWIO_SPMI_MAPPING_TABLE_REG1_ADDR A:0x200ab04
y.create.l HWIO_SPMI_MAPPING_TABLE_REG2_ADDR A:0x200ab08
y.create.l HWIO_SPMI_MAPPING_TABLE_REG3_ADDR A:0x200ab0c
y.create.l HWIO_SPMI_MAPPING_TABLE_REG4_ADDR A:0x200ab10
y.create.l HWIO_SPMI_MAPPING_TABLE_REG5_ADDR A:0x200ab14
y.create.l HWIO_SPMI_MAPPING_TABLE_REG6_ADDR A:0x200ab18
y.create.l HWIO_SPMI_MAPPING_TABLE_REG7_ADDR A:0x200ab1c
y.create.l HWIO_SPMI_MAPPING_TABLE_REG8_ADDR A:0x200ab20
y.create.l HWIO_SPMI_MAPPING_TABLE_REG9_ADDR A:0x200ab24
y.create.l HWIO_SPMI_MID_REG_ADDR A:0x200af00
y.create.l HWIO_SPMI_CFG_REG_ADDR A:0x200af04
y.create.l HWIO_SPMI_SEC_DISABLE_REG_ADDR A:0x200af08
y.create.l HWIO_SPMI_HW_VERSION_ADDR A:0x200af0c
y.create.l HWIO_SPMI_CGC_CTRL_ADDR A:0x200af10
y.create.l HWIO_SPMI_MWB_ENABLE_REG_ADDR A:0x200af14
y.create.l HWIO_SPMI_CHAR_CFG_ADDR A:0x200af40
y.create.l HWIO_SPMI_CHAR_DATA_0_ADDR A:0x200af44
y.create.l HWIO_SPMI_CHAR_DATA_1_ADDR A:0x200af48
y.create.l HWIO_SPMI_CMPR_EN_REG_ADDR A:0x200af54
y.create.l HWIO_SPMI_PROTOCOL_IRQ_STATUS_ADDR A:0x200b000
y.create.l HWIO_SPMI_PROTOCOL_IRQ_ENABLE_ADDR A:0x200b004
y.create.l HWIO_SPMI_PROTOCOL_IRQ_CLEAR_ADDR A:0x200b008
y.create.l HWIO_SPMI_PROTOCOL_IRQ_EN_SET_ADDR A:0x200b00c
y.create.l HWIO_SPMI_PROTOCOL_IRQ_EN_CLEAR_ADDR A:0x200b010
y.create.l HWIO_SPMI_TEST_BUS_CTRL_ADDR A:0x200c000
y.create.l HWIO_SPMI_HW_SW_EVENTS_CTRL_ADDR A:0x200c004
y.create.l HWIO_SPMI_HW_SW_EVENTS_BITWISE_REG0_ADDR A:0x200c008
y.create.l HWIO_SPMI_HW_SW_EVENTS_BITWISE_REG1_ADDR A:0x200c00c
y.create.l HWIO_SPMI_HW_SW_EVENTS_BITWISE_REG2_ADDR A:0x200c010
y.create.l HWIO_SPMI_HW_SW_EVENTS_BITWISE_REG3_ADDR A:0x200c014
y.create.l HWIO_SPMI_HW_SW_EVENTS_BITWISE_REG4_ADDR A:0x200c018
y.create.l HWIO_SPMI_HW_SW_EVENTS_BITWISE_REG5_ADDR A:0x200c01c
y.create.l HWIO_SPMI_HW_SW_EVENTS_BITWISE_REG6_ADDR A:0x200c020
y.create.l HWIO_SPMI_HW_SW_EVENTS_BITWISE_REG7_ADDR A:0x200c024
y.create.l HWIO_SPMI_DEBUG_REG_ADDR A:0x200c028
y.create.l HWIO_SPMI_PIC_REG_BASE_START_ADDR A:0x3800000
y.create.l HWIO_SPMI_PIC_REG_BASE_LAST_ADDR A:0x390701c
y.create.l HWIO_SPMI_PIC_REG_BASE_END_ADDR A:0x3a00000
y.create.l HWIO_SPMI_PIC_OWNER0_ACC_STATUS0_ADDR A:0x3900000
y.create.l HWIO_SPMI_PIC_OWNER0_ACC_STATUS1_ADDR A:0x3900004
y.create.l HWIO_SPMI_PIC_OWNER0_ACC_STATUS2_ADDR A:0x3900008
y.create.l HWIO_SPMI_PIC_OWNER0_ACC_STATUS3_ADDR A:0x390000c
y.create.l HWIO_SPMI_PIC_OWNER1_ACC_STATUS0_ADDR A:0x3901000
y.create.l HWIO_SPMI_PIC_OWNER1_ACC_STATUS1_ADDR A:0x3901004
y.create.l HWIO_SPMI_PIC_OWNER1_ACC_STATUS2_ADDR A:0x3901008
y.create.l HWIO_SPMI_PIC_OWNER1_ACC_STATUS3_ADDR A:0x390100c
y.create.l HWIO_SPMI_PIC_OWNER2_ACC_STATUS0_ADDR A:0x3902000
y.create.l HWIO_SPMI_PIC_OWNER2_ACC_STATUS1_ADDR A:0x3902004
y.create.l HWIO_SPMI_PIC_OWNER2_ACC_STATUS2_ADDR A:0x3902008
y.create.l HWIO_SPMI_PIC_OWNER2_ACC_STATUS3_ADDR A:0x390200c
y.create.l HWIO_SPMI_PIC_OWNER3_ACC_STATUS0_ADDR A:0x3903000
y.create.l HWIO_SPMI_PIC_OWNER3_ACC_STATUS1_ADDR A:0x3903004
y.create.l HWIO_SPMI_PIC_OWNER3_ACC_STATUS2_ADDR A:0x3903008
y.create.l HWIO_SPMI_PIC_OWNER3_ACC_STATUS3_ADDR A:0x390300c
y.create.l HWIO_SPMI_PIC_OWNER4_ACC_STATUS0_ADDR A:0x3904000
y.create.l HWIO_SPMI_PIC_OWNER4_ACC_STATUS1_ADDR A:0x3904004
y.create.l HWIO_SPMI_PIC_OWNER4_ACC_STATUS2_ADDR A:0x3904008
y.create.l HWIO_SPMI_PIC_OWNER4_ACC_STATUS3_ADDR A:0x390400c
y.create.l HWIO_SPMI_PIC_OWNER5_ACC_STATUS0_ADDR A:0x3905000
y.create.l HWIO_SPMI_PIC_OWNER5_ACC_STATUS1_ADDR A:0x3905004
y.create.l HWIO_SPMI_PIC_OWNER5_ACC_STATUS2_ADDR A:0x3905008
y.create.l HWIO_SPMI_PIC_OWNER5_ACC_STATUS3_ADDR A:0x390500c
y.create.l HWIO_SPMI_PIC_OWNER6_ACC_STATUS0_ADDR A:0x3906000
y.create.l HWIO_SPMI_PIC_OWNER6_ACC_STATUS1_ADDR A:0x3906004
y.create.l HWIO_SPMI_PIC_OWNER6_ACC_STATUS2_ADDR A:0x3906008
y.create.l HWIO_SPMI_PIC_OWNER6_ACC_STATUS3_ADDR A:0x390600c
y.create.l HWIO_SPMI_PIC_OWNER7_ACC_STATUS0_ADDR A:0x3907000
y.create.l HWIO_SPMI_PIC_OWNER7_ACC_STATUS1_ADDR A:0x3907004
y.create.l HWIO_SPMI_PIC_OWNER7_ACC_STATUS2_ADDR A:0x3907008
y.create.l HWIO_SPMI_PIC_OWNER7_ACC_STATUS3_ADDR A:0x390700c
y.create.l HWIO_SPMI_PIC_ACC_ENABLE0_ADDR A:0x3800000
y.create.l HWIO_SPMI_PIC_ACC_ENABLE1_ADDR A:0x3801000
y.create.l HWIO_SPMI_PIC_ACC_ENABLE2_ADDR A:0x3802000
y.create.l HWIO_SPMI_PIC_ACC_ENABLE3_ADDR A:0x3803000
y.create.l HWIO_SPMI_PIC_ACC_ENABLE4_ADDR A:0x3804000
y.create.l HWIO_SPMI_PIC_ACC_ENABLE5_ADDR A:0x3805000
y.create.l HWIO_SPMI_PIC_ACC_ENABLE6_ADDR A:0x3806000
y.create.l HWIO_SPMI_PIC_ACC_ENABLE7_ADDR A:0x3807000
y.create.l HWIO_SPMI_PIC_ACC_ENABLE8_ADDR A:0x3808000
y.create.l HWIO_SPMI_PIC_ACC_ENABLE9_ADDR A:0x3809000
y.create.l HWIO_SPMI_PIC_IRQ_STATUS0_ADDR A:0x3800004
y.create.l HWIO_SPMI_PIC_IRQ_STATUS1_ADDR A:0x3801004
y.create.l HWIO_SPMI_PIC_IRQ_STATUS2_ADDR A:0x3802004
y.create.l HWIO_SPMI_PIC_IRQ_STATUS3_ADDR A:0x3803004
y.create.l HWIO_SPMI_PIC_IRQ_STATUS4_ADDR A:0x3804004
y.create.l HWIO_SPMI_PIC_IRQ_STATUS5_ADDR A:0x3805004
y.create.l HWIO_SPMI_PIC_IRQ_STATUS6_ADDR A:0x3806004
y.create.l HWIO_SPMI_PIC_IRQ_STATUS7_ADDR A:0x3807004
y.create.l HWIO_SPMI_PIC_IRQ_STATUS8_ADDR A:0x3808004
y.create.l HWIO_SPMI_PIC_IRQ_STATUS9_ADDR A:0x3809004
y.create.l HWIO_SPMI_PIC_IRQ_CLEAR0_ADDR A:0x3800008
y.create.l HWIO_SPMI_PIC_IRQ_CLEAR1_ADDR A:0x3801008
y.create.l HWIO_SPMI_PIC_IRQ_CLEAR2_ADDR A:0x3802008
y.create.l HWIO_SPMI_PIC_IRQ_CLEAR3_ADDR A:0x3803008
y.create.l HWIO_SPMI_PIC_IRQ_CLEAR4_ADDR A:0x3804008
y.create.l HWIO_SPMI_PIC_IRQ_CLEAR5_ADDR A:0x3805008
y.create.l HWIO_SPMI_PIC_IRQ_CLEAR6_ADDR A:0x3806008
y.create.l HWIO_SPMI_PIC_IRQ_CLEAR7_ADDR A:0x3807008
y.create.l HWIO_SPMI_PIC_IRQ_CLEAR8_ADDR A:0x3808008
y.create.l HWIO_SPMI_PIC_IRQ_CLEAR9_ADDR A:0x3809008
y.create.l HWIO_PMIC_ARB_MPU1132_25_M25L12_AHB_REG_BASE_START_ADDR A:0x200e000
y.create.l HWIO_PMIC_ARB_MPU1132_25_M25L12_AHB_REG_BASE_LAST_ADDR A:0x200ee5c
y.create.l HWIO_PMIC_ARB_MPU1132_25_M25L12_AHB_REG_BASE_END_ADDR A:0x200ee6d
y.create.l HWIO_PMIC_ARB_XPU_SCR_ADDR A:0x200e000
y.create.l HWIO_PMIC_ARB_XPU_SWDR_ADDR A:0x200e004
y.create.l HWIO_PMIC_ARB_XPU_PRTN_RACR_SSHADOW_ADDR A:0x200e008
y.create.l HWIO_PMIC_ARB_XPU_PRTN_WACR_SSHADOW_ADDR A:0x200e00c
y.create.l HWIO_PMIC_ARB_XPU_PRTN_START_SSHADOW0_ADDR A:0x200e010
y.create.l HWIO_PMIC_ARB_XPU_PRTN_END_SSHADOW0_ADDR A:0x200e018
y.create.l HWIO_PMIC_ARB_XPU_SEAR0_ADDR A:0x200e040
y.create.l HWIO_PMIC_ARB_XPU_SESR_ADDR A:0x200e048
y.create.l HWIO_PMIC_ARB_XPU_SESRRESTORE_ADDR A:0x200e04c
y.create.l HWIO_PMIC_ARB_XPU_SESYNR0_ADDR A:0x200e050
y.create.l HWIO_PMIC_ARB_XPU_SESYNR1_ADDR A:0x200e054
y.create.l HWIO_PMIC_ARB_XPU_SESYNR2_ADDR A:0x200e058
y.create.l HWIO_PMIC_ARB_XPU_MCR_ADDR A:0x200e100
y.create.l HWIO_PMIC_ARB_XPU_MEAR0_ADDR A:0x200e140
y.create.l HWIO_PMIC_ARB_XPU_MESR_ADDR A:0x200e148
y.create.l HWIO_PMIC_ARB_XPU_MESRRESTORE_ADDR A:0x200e14c
y.create.l HWIO_PMIC_ARB_XPU_MESYNR0_ADDR A:0x200e150
y.create.l HWIO_PMIC_ARB_XPU_MESYNR1_ADDR A:0x200e154
y.create.l HWIO_PMIC_ARB_XPU_MESYNR2_ADDR A:0x200e158
y.create.l HWIO_PMIC_ARB_XPU_CR_ADDR A:0x200e080
y.create.l HWIO_PMIC_ARB_XPU_PRTN_RACR_SHADOW_ADDR A:0x200e088
y.create.l HWIO_PMIC_ARB_XPU_PRTN_WACR_SHADOW_ADDR A:0x200e08c
y.create.l HWIO_PMIC_ARB_XPU_PRTN_START_SHADOW0_ADDR A:0x200e090
y.create.l HWIO_PMIC_ARB_XPU_PRTN_END_SHADOW0_ADDR A:0x200e098
y.create.l HWIO_PMIC_ARB_XPU_RPU_ACR0_ADDR A:0x200e0a0
y.create.l HWIO_PMIC_ARB_XPU_EAR0_ADDR A:0x200e0c0
y.create.l HWIO_PMIC_ARB_XPU_ESR_ADDR A:0x200e0c8
y.create.l HWIO_PMIC_ARB_XPU_ESRRESTORE_ADDR A:0x200e0cc
y.create.l HWIO_PMIC_ARB_XPU_ESYNR0_ADDR A:0x200e0d0
y.create.l HWIO_PMIC_ARB_XPU_ESYNR1_ADDR A:0x200e0d4
y.create.l HWIO_PMIC_ARB_XPU_ESYNR2_ADDR A:0x200e0d8
y.create.l HWIO_PMIC_ARB_XPU_UMR_RACR_ADDR A:0x200e0e0
y.create.l HWIO_PMIC_ARB_XPU_UMR_WACR_ADDR A:0x200e0e4
y.create.l HWIO_PMIC_ARB_XPU_UMR_CNTL_ADDR A:0x200e0f0
y.create.l HWIO_PMIC_ARB_XPU_IDR0_ADDR A:0x200e074
y.create.l HWIO_PMIC_ARB_XPU_IDR1_ADDR A:0x200e078
y.create.l HWIO_PMIC_ARB_XPU_REV_ADDR A:0x200e07c
y.create.l HWIO_PMIC_ARB_XPU_PRT0_RACR0_ADDR A:0x200e200
y.create.l HWIO_PMIC_ARB_XPU_PRT1_RACR0_ADDR A:0x200e280
y.create.l HWIO_PMIC_ARB_XPU_PRT2_RACR0_ADDR A:0x200e300
y.create.l HWIO_PMIC_ARB_XPU_PRT3_RACR0_ADDR A:0x200e380
y.create.l HWIO_PMIC_ARB_XPU_PRT4_RACR0_ADDR A:0x200e400
y.create.l HWIO_PMIC_ARB_XPU_PRT5_RACR0_ADDR A:0x200e480
y.create.l HWIO_PMIC_ARB_XPU_PRT6_RACR0_ADDR A:0x200e500
y.create.l HWIO_PMIC_ARB_XPU_PRT7_RACR0_ADDR A:0x200e580
y.create.l HWIO_PMIC_ARB_XPU_PRT8_RACR0_ADDR A:0x200e600
y.create.l HWIO_PMIC_ARB_XPU_PRT9_RACR0_ADDR A:0x200e680
y.create.l HWIO_PMIC_ARB_XPU_PRT0_WACR0_ADDR A:0x200e220
y.create.l HWIO_PMIC_ARB_XPU_PRT1_WACR0_ADDR A:0x200e2a0
y.create.l HWIO_PMIC_ARB_XPU_PRT2_WACR0_ADDR A:0x200e320
y.create.l HWIO_PMIC_ARB_XPU_PRT3_WACR0_ADDR A:0x200e3a0
y.create.l HWIO_PMIC_ARB_XPU_PRT4_WACR0_ADDR A:0x200e420
y.create.l HWIO_PMIC_ARB_XPU_PRT5_WACR0_ADDR A:0x200e4a0
y.create.l HWIO_PMIC_ARB_XPU_PRT6_WACR0_ADDR A:0x200e520
y.create.l HWIO_PMIC_ARB_XPU_PRT7_WACR0_ADDR A:0x200e5a0
y.create.l HWIO_PMIC_ARB_XPU_PRT8_WACR0_ADDR A:0x200e620
y.create.l HWIO_PMIC_ARB_XPU_PRT9_WACR0_ADDR A:0x200e6a0
y.create.l HWIO_PMIC_ARB_XPU_PRT0_START0_ADDR A:0x200e240
y.create.l HWIO_PMIC_ARB_XPU_PRT1_START0_ADDR A:0x200e2c0
y.create.l HWIO_PMIC_ARB_XPU_PRT2_START0_ADDR A:0x200e340
y.create.l HWIO_PMIC_ARB_XPU_PRT3_START0_ADDR A:0x200e3c0
y.create.l HWIO_PMIC_ARB_XPU_PRT4_START0_ADDR A:0x200e440
y.create.l HWIO_PMIC_ARB_XPU_PRT5_START0_ADDR A:0x200e4c0
y.create.l HWIO_PMIC_ARB_XPU_PRT6_START0_ADDR A:0x200e540
y.create.l HWIO_PMIC_ARB_XPU_PRT7_START0_ADDR A:0x200e5c0
y.create.l HWIO_PMIC_ARB_XPU_PRT8_START0_ADDR A:0x200e640
y.create.l HWIO_PMIC_ARB_XPU_PRT9_START0_ADDR A:0x200e6c0
y.create.l HWIO_PMIC_ARB_XPU_PRT0_END0_ADDR A:0x200e248
y.create.l HWIO_PMIC_ARB_XPU_PRT1_END0_ADDR A:0x200e2c8
y.create.l HWIO_PMIC_ARB_XPU_PRT2_END0_ADDR A:0x200e348
y.create.l HWIO_PMIC_ARB_XPU_PRT3_END0_ADDR A:0x200e3c8
y.create.l HWIO_PMIC_ARB_XPU_PRT4_END0_ADDR A:0x200e448
y.create.l HWIO_PMIC_ARB_XPU_PRT5_END0_ADDR A:0x200e4c8
y.create.l HWIO_PMIC_ARB_XPU_PRT6_END0_ADDR A:0x200e548
y.create.l HWIO_PMIC_ARB_XPU_PRT7_END0_ADDR A:0x200e5c8
y.create.l HWIO_PMIC_ARB_XPU_PRT8_END0_ADDR A:0x200e648
y.create.l HWIO_PMIC_ARB_XPU_PRT9_END0_ADDR A:0x200e6c8
y.create.l HWIO_PMIC_ARB_XPU_PRT0_SCR_ADDR A:0x200e250
y.create.l HWIO_PMIC_ARB_XPU_PRT1_SCR_ADDR A:0x200e2d0
y.create.l HWIO_PMIC_ARB_XPU_PRT2_SCR_ADDR A:0x200e350
y.create.l HWIO_PMIC_ARB_XPU_PRT3_SCR_ADDR A:0x200e3d0
y.create.l HWIO_PMIC_ARB_XPU_PRT4_SCR_ADDR A:0x200e450
y.create.l HWIO_PMIC_ARB_XPU_PRT5_SCR_ADDR A:0x200e4d0
y.create.l HWIO_PMIC_ARB_XPU_PRT6_SCR_ADDR A:0x200e550
y.create.l HWIO_PMIC_ARB_XPU_PRT7_SCR_ADDR A:0x200e5d0
y.create.l HWIO_PMIC_ARB_XPU_PRT8_SCR_ADDR A:0x200e650
y.create.l HWIO_PMIC_ARB_XPU_PRT9_SCR_ADDR A:0x200e6d0
y.create.l HWIO_PMIC_ARB_XPU_PRT0_MCR_ADDR A:0x200e254
y.create.l HWIO_PMIC_ARB_XPU_PRT1_MCR_ADDR A:0x200e2d4
y.create.l HWIO_PMIC_ARB_XPU_PRT2_MCR_ADDR A:0x200e354
y.create.l HWIO_PMIC_ARB_XPU_PRT3_MCR_ADDR A:0x200e3d4
y.create.l HWIO_PMIC_ARB_XPU_PRT4_MCR_ADDR A:0x200e454
y.create.l HWIO_PMIC_ARB_XPU_PRT5_MCR_ADDR A:0x200e4d4
y.create.l HWIO_PMIC_ARB_XPU_PRT6_MCR_ADDR A:0x200e554
y.create.l HWIO_PMIC_ARB_XPU_PRT7_MCR_ADDR A:0x200e5d4
y.create.l HWIO_PMIC_ARB_XPU_PRT8_MCR_ADDR A:0x200e654
y.create.l HWIO_PMIC_ARB_XPU_PRT9_MCR_ADDR A:0x200e6d4
y.create.l HWIO_PMIC_ARB_XPU_PRT0_CNTL0_ADDR A:0x200e258
y.create.l HWIO_PMIC_ARB_XPU_PRT1_CNTL0_ADDR A:0x200e2d8
y.create.l HWIO_PMIC_ARB_XPU_PRT2_CNTL0_ADDR A:0x200e358
y.create.l HWIO_PMIC_ARB_XPU_PRT3_CNTL0_ADDR A:0x200e3d8
y.create.l HWIO_PMIC_ARB_XPU_PRT4_CNTL0_ADDR A:0x200e458
y.create.l HWIO_PMIC_ARB_XPU_PRT5_CNTL0_ADDR A:0x200e4d8
y.create.l HWIO_PMIC_ARB_XPU_PRT6_CNTL0_ADDR A:0x200e558
y.create.l HWIO_PMIC_ARB_XPU_PRT7_CNTL0_ADDR A:0x200e5d8
y.create.l HWIO_PMIC_ARB_XPU_PRT8_CNTL0_ADDR A:0x200e658
y.create.l HWIO_PMIC_ARB_XPU_PRT9_CNTL0_ADDR A:0x200e6d8
y.create.l HWIO_PMIC_ARB_XPU_PRT0_CNTL1_ADDR A:0x200e25c
y.create.l HWIO_PMIC_ARB_XPU_PRT1_CNTL1_ADDR A:0x200e2dc
y.create.l HWIO_PMIC_ARB_XPU_PRT2_CNTL1_ADDR A:0x200e35c
y.create.l HWIO_PMIC_ARB_XPU_PRT3_CNTL1_ADDR A:0x200e3dc
y.create.l HWIO_PMIC_ARB_XPU_PRT4_CNTL1_ADDR A:0x200e45c
y.create.l HWIO_PMIC_ARB_XPU_PRT5_CNTL1_ADDR A:0x200e4dc
y.create.l HWIO_PMIC_ARB_XPU_PRT6_CNTL1_ADDR A:0x200e55c
y.create.l HWIO_PMIC_ARB_XPU_PRT7_CNTL1_ADDR A:0x200e5dc
y.create.l HWIO_PMIC_ARB_XPU_PRT8_CNTL1_ADDR A:0x200e65c
y.create.l HWIO_PMIC_ARB_XPU_PRT9_CNTL1_ADDR A:0x200e6dc
y.create.l HWIO_PMIC_ARB_CORE_REG_BASE_START_ADDR A:0x200f000
y.create.l HWIO_PMIC_ARB_CORE_REG_BASE_LAST_ADDR A:0x200f9fc
y.create.l HWIO_PMIC_ARB_CORE_REG_BASE_END_ADDR A:0x2010000
y.create.l HWIO_PMIC_ARB_HW_VERSION_ADDR A:0x200f000
y.create.l HWIO_PMIC_ARB_MISC_CONFIG_ADDR A:0x200f004
y.create.l HWIO_PMIC_ARB_PVC_INTF_CTL_ADDR A:0x200f008
y.create.l HWIO_PMIC_ARB_PVC_INTF_STATUS_ADDR A:0x200f00c
y.create.l HWIO_PMIC_ARB_PRIORITIES0_ADDR A:0x200f100
y.create.l HWIO_PMIC_ARB_PRIORITIES1_ADDR A:0x200f104
y.create.l HWIO_PMIC_ARB_PRIORITIES2_ADDR A:0x200f108
y.create.l HWIO_PMIC_ARB_PRIORITIES3_ADDR A:0x200f10c
y.create.l HWIO_PMIC_ARB_PRIORITIES4_ADDR A:0x200f110
y.create.l HWIO_PMIC_ARB_PRIORITIES5_ADDR A:0x200f114
y.create.l HWIO_PMIC_ARB_PRIORITIES6_ADDR A:0x200f118
y.create.l HWIO_PMIC_ARB_PVC_PORT0_CTL_ADDR A:0x200f200
y.create.l HWIO_PMIC_ARB_PVC_PORT1_CTL_ADDR A:0x200f204
y.create.l HWIO_PMIC_ARB_PVC_PORT2_CTL_ADDR A:0x200f208
y.create.l HWIO_PMIC_ARB_PVC_PORT3_CTL_ADDR A:0x200f20c
y.create.l HWIO_PMIC_ARB_PVC_PORT4_CTL_ADDR A:0x200f210
y.create.l HWIO_PMIC_ARB_PVC_PORT5_CTL_ADDR A:0x200f214
y.create.l HWIO_PMIC_ARB_PVC_PORT0_STATUS_ADDR A:0x200f280
y.create.l HWIO_PMIC_ARB_PVC_PORT1_STATUS_ADDR A:0x200f284
y.create.l HWIO_PMIC_ARB_PVC_PORT2_STATUS_ADDR A:0x200f288
y.create.l HWIO_PMIC_ARB_PVC_PORT3_STATUS_ADDR A:0x200f28c
y.create.l HWIO_PMIC_ARB_PVC_PORT4_STATUS_ADDR A:0x200f290
y.create.l HWIO_PMIC_ARB_PVC_PORT5_STATUS_ADDR A:0x200f294
y.create.l HWIO_PMIC_ARB_PVC0_ADDR0_ADDR A:0x200f400
y.create.l HWIO_PMIC_ARB_PVC0_ADDR1_ADDR A:0x200f404
y.create.l HWIO_PMIC_ARB_PVC0_ADDR2_ADDR A:0x200f408
y.create.l HWIO_PMIC_ARB_PVC0_ADDR3_ADDR A:0x200f40c
y.create.l HWIO_PMIC_ARB_PVC1_ADDR0_ADDR A:0x200f420
y.create.l HWIO_PMIC_ARB_PVC1_ADDR1_ADDR A:0x200f424
y.create.l HWIO_PMIC_ARB_PVC1_ADDR2_ADDR A:0x200f428
y.create.l HWIO_PMIC_ARB_PVC1_ADDR3_ADDR A:0x200f42c
y.create.l HWIO_PMIC_ARB_PVC2_ADDR0_ADDR A:0x200f440
y.create.l HWIO_PMIC_ARB_PVC2_ADDR1_ADDR A:0x200f444
y.create.l HWIO_PMIC_ARB_PVC2_ADDR2_ADDR A:0x200f448
y.create.l HWIO_PMIC_ARB_PVC2_ADDR3_ADDR A:0x200f44c
y.create.l HWIO_PMIC_ARB_PVC3_ADDR0_ADDR A:0x200f460
y.create.l HWIO_PMIC_ARB_PVC3_ADDR1_ADDR A:0x200f464
y.create.l HWIO_PMIC_ARB_PVC3_ADDR2_ADDR A:0x200f468
y.create.l HWIO_PMIC_ARB_PVC3_ADDR3_ADDR A:0x200f46c
y.create.l HWIO_PMIC_ARB_PVC4_ADDR0_ADDR A:0x200f480
y.create.l HWIO_PMIC_ARB_PVC4_ADDR1_ADDR A:0x200f484
y.create.l HWIO_PMIC_ARB_PVC4_ADDR2_ADDR A:0x200f488
y.create.l HWIO_PMIC_ARB_PVC4_ADDR3_ADDR A:0x200f48c
y.create.l HWIO_PMIC_ARB_PVC5_ADDR0_ADDR A:0x200f4a0
y.create.l HWIO_PMIC_ARB_PVC5_ADDR1_ADDR A:0x200f4a4
y.create.l HWIO_PMIC_ARB_PVC5_ADDR2_ADDR A:0x200f4a8
y.create.l HWIO_PMIC_ARB_PVC5_ADDR3_ADDR A:0x200f4ac
y.create.l HWIO_PMIC_ARB_REG_CHNL0_ADDR A:0x200f800
y.create.l HWIO_PMIC_ARB_REG_CHNL1_ADDR A:0x200f804
y.create.l HWIO_PMIC_ARB_REG_CHNL2_ADDR A:0x200f808
y.create.l HWIO_PMIC_ARB_REG_CHNL3_ADDR A:0x200f80c
y.create.l HWIO_PMIC_ARB_REG_CHNL4_ADDR A:0x200f810
y.create.l HWIO_PMIC_ARB_REG_CHNL5_ADDR A:0x200f814
y.create.l HWIO_PMIC_ARB_REG_CHNL6_ADDR A:0x200f818
y.create.l HWIO_PMIC_ARB_REG_CHNL7_ADDR A:0x200f81c
y.create.l HWIO_PMIC_ARB_REG_CHNL8_ADDR A:0x200f820
y.create.l HWIO_PMIC_ARB_REG_CHNL9_ADDR A:0x200f824
y.create.l HWIO_PMIC_ARB_CORE_REGISTERS_REG_BASE_START_ADDR A:0x2400000
y.create.l HWIO_PMIC_ARB_CORE_REGISTERS_REG_BASE_LAST_ADDR A:0x27fd020
y.create.l HWIO_PMIC_ARB_CORE_REGISTERS_REG_BASE_END_ADDR A:0x2c00000
y.create.l HWIO_PMIC_ARB0_CHNL0_CMD_ADDR A:0x2400000
y.create.l HWIO_PMIC_ARB0_CHNL1_CMD_ADDR A:0x2408000
y.create.l HWIO_PMIC_ARB0_CHNL2_CMD_ADDR A:0x2410000
y.create.l HWIO_PMIC_ARB0_CHNL3_CMD_ADDR A:0x2418000
y.create.l HWIO_PMIC_ARB1_CHNL0_CMD_ADDR A:0x2401000
y.create.l HWIO_PMIC_ARB1_CHNL1_CMD_ADDR A:0x2409000
y.create.l HWIO_PMIC_ARB1_CHNL2_CMD_ADDR A:0x2411000
y.create.l HWIO_PMIC_ARB1_CHNL3_CMD_ADDR A:0x2419000
y.create.l HWIO_PMIC_ARB2_CHNL0_CMD_ADDR A:0x2402000
y.create.l HWIO_PMIC_ARB2_CHNL1_CMD_ADDR A:0x240a000
y.create.l HWIO_PMIC_ARB2_CHNL2_CMD_ADDR A:0x2412000
y.create.l HWIO_PMIC_ARB2_CHNL3_CMD_ADDR A:0x241a000
y.create.l HWIO_PMIC_ARB3_CHNL0_CMD_ADDR A:0x2403000
y.create.l HWIO_PMIC_ARB3_CHNL1_CMD_ADDR A:0x240b000
y.create.l HWIO_PMIC_ARB3_CHNL2_CMD_ADDR A:0x2413000
y.create.l HWIO_PMIC_ARB3_CHNL3_CMD_ADDR A:0x241b000
y.create.l HWIO_PMIC_ARB4_CHNL0_CMD_ADDR A:0x2404000
y.create.l HWIO_PMIC_ARB4_CHNL1_CMD_ADDR A:0x240c000
y.create.l HWIO_PMIC_ARB4_CHNL2_CMD_ADDR A:0x2414000
y.create.l HWIO_PMIC_ARB4_CHNL3_CMD_ADDR A:0x241c000
y.create.l HWIO_PMIC_ARB5_CHNL0_CMD_ADDR A:0x2405000
y.create.l HWIO_PMIC_ARB5_CHNL1_CMD_ADDR A:0x240d000
y.create.l HWIO_PMIC_ARB5_CHNL2_CMD_ADDR A:0x2415000
y.create.l HWIO_PMIC_ARB5_CHNL3_CMD_ADDR A:0x241d000
y.create.l HWIO_PMIC_ARB0_CHNL0_CONFIG_ADDR A:0x2400004
y.create.l HWIO_PMIC_ARB0_CHNL1_CONFIG_ADDR A:0x2408004
y.create.l HWIO_PMIC_ARB0_CHNL2_CONFIG_ADDR A:0x2410004
y.create.l HWIO_PMIC_ARB0_CHNL3_CONFIG_ADDR A:0x2418004
y.create.l HWIO_PMIC_ARB1_CHNL0_CONFIG_ADDR A:0x2401004
y.create.l HWIO_PMIC_ARB1_CHNL1_CONFIG_ADDR A:0x2409004
y.create.l HWIO_PMIC_ARB1_CHNL2_CONFIG_ADDR A:0x2411004
y.create.l HWIO_PMIC_ARB1_CHNL3_CONFIG_ADDR A:0x2419004
y.create.l HWIO_PMIC_ARB2_CHNL0_CONFIG_ADDR A:0x2402004
y.create.l HWIO_PMIC_ARB2_CHNL1_CONFIG_ADDR A:0x240a004
y.create.l HWIO_PMIC_ARB2_CHNL2_CONFIG_ADDR A:0x2412004
y.create.l HWIO_PMIC_ARB2_CHNL3_CONFIG_ADDR A:0x241a004
y.create.l HWIO_PMIC_ARB3_CHNL0_CONFIG_ADDR A:0x2403004
y.create.l HWIO_PMIC_ARB3_CHNL1_CONFIG_ADDR A:0x240b004
y.create.l HWIO_PMIC_ARB3_CHNL2_CONFIG_ADDR A:0x2413004
y.create.l HWIO_PMIC_ARB3_CHNL3_CONFIG_ADDR A:0x241b004
y.create.l HWIO_PMIC_ARB4_CHNL0_CONFIG_ADDR A:0x2404004
y.create.l HWIO_PMIC_ARB4_CHNL1_CONFIG_ADDR A:0x240c004
y.create.l HWIO_PMIC_ARB4_CHNL2_CONFIG_ADDR A:0x2414004
y.create.l HWIO_PMIC_ARB4_CHNL3_CONFIG_ADDR A:0x241c004
y.create.l HWIO_PMIC_ARB5_CHNL0_CONFIG_ADDR A:0x2405004
y.create.l HWIO_PMIC_ARB5_CHNL1_CONFIG_ADDR A:0x240d004
y.create.l HWIO_PMIC_ARB5_CHNL2_CONFIG_ADDR A:0x2415004
y.create.l HWIO_PMIC_ARB5_CHNL3_CONFIG_ADDR A:0x241d004
y.create.l HWIO_PMIC_ARB0_CHNL0_STATUS_ADDR A:0x2400008
y.create.l HWIO_PMIC_ARB0_CHNL1_STATUS_ADDR A:0x2408008
y.create.l HWIO_PMIC_ARB0_CHNL2_STATUS_ADDR A:0x2410008
y.create.l HWIO_PMIC_ARB0_CHNL3_STATUS_ADDR A:0x2418008
y.create.l HWIO_PMIC_ARB1_CHNL0_STATUS_ADDR A:0x2401008
y.create.l HWIO_PMIC_ARB1_CHNL1_STATUS_ADDR A:0x2409008
y.create.l HWIO_PMIC_ARB1_CHNL2_STATUS_ADDR A:0x2411008
y.create.l HWIO_PMIC_ARB1_CHNL3_STATUS_ADDR A:0x2419008
y.create.l HWIO_PMIC_ARB2_CHNL0_STATUS_ADDR A:0x2402008
y.create.l HWIO_PMIC_ARB2_CHNL1_STATUS_ADDR A:0x240a008
y.create.l HWIO_PMIC_ARB2_CHNL2_STATUS_ADDR A:0x2412008
y.create.l HWIO_PMIC_ARB2_CHNL3_STATUS_ADDR A:0x241a008
y.create.l HWIO_PMIC_ARB3_CHNL0_STATUS_ADDR A:0x2403008
y.create.l HWIO_PMIC_ARB3_CHNL1_STATUS_ADDR A:0x240b008
y.create.l HWIO_PMIC_ARB3_CHNL2_STATUS_ADDR A:0x2413008
y.create.l HWIO_PMIC_ARB3_CHNL3_STATUS_ADDR A:0x241b008
y.create.l HWIO_PMIC_ARB4_CHNL0_STATUS_ADDR A:0x2404008
y.create.l HWIO_PMIC_ARB4_CHNL1_STATUS_ADDR A:0x240c008
y.create.l HWIO_PMIC_ARB4_CHNL2_STATUS_ADDR A:0x2414008
y.create.l HWIO_PMIC_ARB4_CHNL3_STATUS_ADDR A:0x241c008
y.create.l HWIO_PMIC_ARB5_CHNL0_STATUS_ADDR A:0x2405008
y.create.l HWIO_PMIC_ARB5_CHNL1_STATUS_ADDR A:0x240d008
y.create.l HWIO_PMIC_ARB5_CHNL2_STATUS_ADDR A:0x2415008
y.create.l HWIO_PMIC_ARB5_CHNL3_STATUS_ADDR A:0x241d008
y.create.l HWIO_PMIC_ARB0_CHNL0_WDATA0_ADDR A:0x2400010
y.create.l HWIO_PMIC_ARB0_CHNL1_WDATA0_ADDR A:0x2408010
y.create.l HWIO_PMIC_ARB0_CHNL2_WDATA0_ADDR A:0x2410010
y.create.l HWIO_PMIC_ARB0_CHNL3_WDATA0_ADDR A:0x2418010
y.create.l HWIO_PMIC_ARB1_CHNL0_WDATA0_ADDR A:0x2401010
y.create.l HWIO_PMIC_ARB1_CHNL1_WDATA0_ADDR A:0x2409010
y.create.l HWIO_PMIC_ARB1_CHNL2_WDATA0_ADDR A:0x2411010
y.create.l HWIO_PMIC_ARB1_CHNL3_WDATA0_ADDR A:0x2419010
y.create.l HWIO_PMIC_ARB2_CHNL0_WDATA0_ADDR A:0x2402010
y.create.l HWIO_PMIC_ARB2_CHNL1_WDATA0_ADDR A:0x240a010
y.create.l HWIO_PMIC_ARB2_CHNL2_WDATA0_ADDR A:0x2412010
y.create.l HWIO_PMIC_ARB2_CHNL3_WDATA0_ADDR A:0x241a010
y.create.l HWIO_PMIC_ARB3_CHNL0_WDATA0_ADDR A:0x2403010
y.create.l HWIO_PMIC_ARB3_CHNL1_WDATA0_ADDR A:0x240b010
y.create.l HWIO_PMIC_ARB3_CHNL2_WDATA0_ADDR A:0x2413010
y.create.l HWIO_PMIC_ARB3_CHNL3_WDATA0_ADDR A:0x241b010
y.create.l HWIO_PMIC_ARB4_CHNL0_WDATA0_ADDR A:0x2404010
y.create.l HWIO_PMIC_ARB4_CHNL1_WDATA0_ADDR A:0x240c010
y.create.l HWIO_PMIC_ARB4_CHNL2_WDATA0_ADDR A:0x2414010
y.create.l HWIO_PMIC_ARB4_CHNL3_WDATA0_ADDR A:0x241c010
y.create.l HWIO_PMIC_ARB5_CHNL0_WDATA0_ADDR A:0x2405010
y.create.l HWIO_PMIC_ARB5_CHNL1_WDATA0_ADDR A:0x240d010
y.create.l HWIO_PMIC_ARB5_CHNL2_WDATA0_ADDR A:0x2415010
y.create.l HWIO_PMIC_ARB5_CHNL3_WDATA0_ADDR A:0x241d010
y.create.l HWIO_PMIC_ARB0_CHNL0_WDATA1_ADDR A:0x2400014
y.create.l HWIO_PMIC_ARB0_CHNL1_WDATA1_ADDR A:0x2408014
y.create.l HWIO_PMIC_ARB0_CHNL2_WDATA1_ADDR A:0x2410014
y.create.l HWIO_PMIC_ARB0_CHNL3_WDATA1_ADDR A:0x2418014
y.create.l HWIO_PMIC_ARB1_CHNL0_WDATA1_ADDR A:0x2401014
y.create.l HWIO_PMIC_ARB1_CHNL1_WDATA1_ADDR A:0x2409014
y.create.l HWIO_PMIC_ARB1_CHNL2_WDATA1_ADDR A:0x2411014
y.create.l HWIO_PMIC_ARB1_CHNL3_WDATA1_ADDR A:0x2419014
y.create.l HWIO_PMIC_ARB2_CHNL0_WDATA1_ADDR A:0x2402014
y.create.l HWIO_PMIC_ARB2_CHNL1_WDATA1_ADDR A:0x240a014
y.create.l HWIO_PMIC_ARB2_CHNL2_WDATA1_ADDR A:0x2412014
y.create.l HWIO_PMIC_ARB2_CHNL3_WDATA1_ADDR A:0x241a014
y.create.l HWIO_PMIC_ARB3_CHNL0_WDATA1_ADDR A:0x2403014
y.create.l HWIO_PMIC_ARB3_CHNL1_WDATA1_ADDR A:0x240b014
y.create.l HWIO_PMIC_ARB3_CHNL2_WDATA1_ADDR A:0x2413014
y.create.l HWIO_PMIC_ARB3_CHNL3_WDATA1_ADDR A:0x241b014
y.create.l HWIO_PMIC_ARB4_CHNL0_WDATA1_ADDR A:0x2404014
y.create.l HWIO_PMIC_ARB4_CHNL1_WDATA1_ADDR A:0x240c014
y.create.l HWIO_PMIC_ARB4_CHNL2_WDATA1_ADDR A:0x2414014
y.create.l HWIO_PMIC_ARB4_CHNL3_WDATA1_ADDR A:0x241c014
y.create.l HWIO_PMIC_ARB5_CHNL0_WDATA1_ADDR A:0x2405014
y.create.l HWIO_PMIC_ARB5_CHNL1_WDATA1_ADDR A:0x240d014
y.create.l HWIO_PMIC_ARB5_CHNL2_WDATA1_ADDR A:0x2415014
y.create.l HWIO_PMIC_ARB5_CHNL3_WDATA1_ADDR A:0x241d014
y.create.l HWIO_PMIC_ARB0_CHNL0_RDATA0_ADDR A:0x2400018
y.create.l HWIO_PMIC_ARB0_CHNL1_RDATA0_ADDR A:0x2408018
y.create.l HWIO_PMIC_ARB0_CHNL2_RDATA0_ADDR A:0x2410018
y.create.l HWIO_PMIC_ARB0_CHNL3_RDATA0_ADDR A:0x2418018
y.create.l HWIO_PMIC_ARB1_CHNL0_RDATA0_ADDR A:0x2401018
y.create.l HWIO_PMIC_ARB1_CHNL1_RDATA0_ADDR A:0x2409018
y.create.l HWIO_PMIC_ARB1_CHNL2_RDATA0_ADDR A:0x2411018
y.create.l HWIO_PMIC_ARB1_CHNL3_RDATA0_ADDR A:0x2419018
y.create.l HWIO_PMIC_ARB2_CHNL0_RDATA0_ADDR A:0x2402018
y.create.l HWIO_PMIC_ARB2_CHNL1_RDATA0_ADDR A:0x240a018
y.create.l HWIO_PMIC_ARB2_CHNL2_RDATA0_ADDR A:0x2412018
y.create.l HWIO_PMIC_ARB2_CHNL3_RDATA0_ADDR A:0x241a018
y.create.l HWIO_PMIC_ARB3_CHNL0_RDATA0_ADDR A:0x2403018
y.create.l HWIO_PMIC_ARB3_CHNL1_RDATA0_ADDR A:0x240b018
y.create.l HWIO_PMIC_ARB3_CHNL2_RDATA0_ADDR A:0x2413018
y.create.l HWIO_PMIC_ARB3_CHNL3_RDATA0_ADDR A:0x241b018
y.create.l HWIO_PMIC_ARB4_CHNL0_RDATA0_ADDR A:0x2404018
y.create.l HWIO_PMIC_ARB4_CHNL1_RDATA0_ADDR A:0x240c018
y.create.l HWIO_PMIC_ARB4_CHNL2_RDATA0_ADDR A:0x2414018
y.create.l HWIO_PMIC_ARB4_CHNL3_RDATA0_ADDR A:0x241c018
y.create.l HWIO_PMIC_ARB5_CHNL0_RDATA0_ADDR A:0x2405018
y.create.l HWIO_PMIC_ARB5_CHNL1_RDATA0_ADDR A:0x240d018
y.create.l HWIO_PMIC_ARB5_CHNL2_RDATA0_ADDR A:0x2415018
y.create.l HWIO_PMIC_ARB5_CHNL3_RDATA0_ADDR A:0x241d018
y.create.l HWIO_PMIC_ARB0_CHNL0_RDATA1_ADDR A:0x240001c
y.create.l HWIO_PMIC_ARB0_CHNL1_RDATA1_ADDR A:0x240801c
y.create.l HWIO_PMIC_ARB0_CHNL2_RDATA1_ADDR A:0x241001c
y.create.l HWIO_PMIC_ARB0_CHNL3_RDATA1_ADDR A:0x241801c
y.create.l HWIO_PMIC_ARB1_CHNL0_RDATA1_ADDR A:0x240101c
y.create.l HWIO_PMIC_ARB1_CHNL1_RDATA1_ADDR A:0x240901c
y.create.l HWIO_PMIC_ARB1_CHNL2_RDATA1_ADDR A:0x241101c
y.create.l HWIO_PMIC_ARB1_CHNL3_RDATA1_ADDR A:0x241901c
y.create.l HWIO_PMIC_ARB2_CHNL0_RDATA1_ADDR A:0x240201c
y.create.l HWIO_PMIC_ARB2_CHNL1_RDATA1_ADDR A:0x240a01c
y.create.l HWIO_PMIC_ARB2_CHNL2_RDATA1_ADDR A:0x241201c
y.create.l HWIO_PMIC_ARB2_CHNL3_RDATA1_ADDR A:0x241a01c
y.create.l HWIO_PMIC_ARB3_CHNL0_RDATA1_ADDR A:0x240301c
y.create.l HWIO_PMIC_ARB3_CHNL1_RDATA1_ADDR A:0x240b01c
y.create.l HWIO_PMIC_ARB3_CHNL2_RDATA1_ADDR A:0x241301c
y.create.l HWIO_PMIC_ARB3_CHNL3_RDATA1_ADDR A:0x241b01c
y.create.l HWIO_PMIC_ARB4_CHNL0_RDATA1_ADDR A:0x240401c
y.create.l HWIO_PMIC_ARB4_CHNL1_RDATA1_ADDR A:0x240c01c
y.create.l HWIO_PMIC_ARB4_CHNL2_RDATA1_ADDR A:0x241401c
y.create.l HWIO_PMIC_ARB4_CHNL3_RDATA1_ADDR A:0x241c01c
y.create.l HWIO_PMIC_ARB5_CHNL0_RDATA1_ADDR A:0x240501c
y.create.l HWIO_PMIC_ARB5_CHNL1_RDATA1_ADDR A:0x240d01c
y.create.l HWIO_PMIC_ARB5_CHNL2_RDATA1_ADDR A:0x241501c
y.create.l HWIO_PMIC_ARB5_CHNL3_RDATA1_ADDR A:0x241d01c
y.create.l HWIO_PMIC_ARB0_CHNL0_RDATA2_ADDR A:0x2400020
y.create.l HWIO_PMIC_ARB0_CHNL1_RDATA2_ADDR A:0x2408020
y.create.l HWIO_PMIC_ARB0_CHNL2_RDATA2_ADDR A:0x2410020
y.create.l HWIO_PMIC_ARB0_CHNL3_RDATA2_ADDR A:0x2418020
y.create.l HWIO_PMIC_ARB1_CHNL0_RDATA2_ADDR A:0x2401020
y.create.l HWIO_PMIC_ARB1_CHNL1_RDATA2_ADDR A:0x2409020
y.create.l HWIO_PMIC_ARB1_CHNL2_RDATA2_ADDR A:0x2411020
y.create.l HWIO_PMIC_ARB1_CHNL3_RDATA2_ADDR A:0x2419020
y.create.l HWIO_PMIC_ARB2_CHNL0_RDATA2_ADDR A:0x2402020
y.create.l HWIO_PMIC_ARB2_CHNL1_RDATA2_ADDR A:0x240a020
y.create.l HWIO_PMIC_ARB2_CHNL2_RDATA2_ADDR A:0x2412020
y.create.l HWIO_PMIC_ARB2_CHNL3_RDATA2_ADDR A:0x241a020
y.create.l HWIO_PMIC_ARB3_CHNL0_RDATA2_ADDR A:0x2403020
y.create.l HWIO_PMIC_ARB3_CHNL1_RDATA2_ADDR A:0x240b020
y.create.l HWIO_PMIC_ARB3_CHNL2_RDATA2_ADDR A:0x2413020
y.create.l HWIO_PMIC_ARB3_CHNL3_RDATA2_ADDR A:0x241b020
y.create.l HWIO_PMIC_ARB4_CHNL0_RDATA2_ADDR A:0x2404020
y.create.l HWIO_PMIC_ARB4_CHNL1_RDATA2_ADDR A:0x240c020
y.create.l HWIO_PMIC_ARB4_CHNL2_RDATA2_ADDR A:0x2414020
y.create.l HWIO_PMIC_ARB4_CHNL3_RDATA2_ADDR A:0x241c020
y.create.l HWIO_PMIC_ARB5_CHNL0_RDATA2_ADDR A:0x2405020
y.create.l HWIO_PMIC_ARB5_CHNL1_RDATA2_ADDR A:0x240d020
y.create.l HWIO_PMIC_ARB5_CHNL2_RDATA2_ADDR A:0x2415020
y.create.l HWIO_PMIC_ARB5_CHNL3_RDATA2_ADDR A:0x241d020
y.create.l HWIO_PMIC_ARB_CORE_REGISTERS_OBS_REG_BASE_START_ADDR A:0x2c00000
y.create.l HWIO_PMIC_ARB_CORE_REGISTERS_OBS_REG_BASE_LAST_ADDR A:0x2ffd01c
y.create.l HWIO_PMIC_ARB_CORE_REGISTERS_OBS_REG_BASE_END_ADDR A:0x3400000
y.create.l HWIO_PMIC_ARB_OBS0_CHNL0_CMD_ADDR A:0x2c00000
y.create.l HWIO_PMIC_ARB_OBS0_CHNL1_CMD_ADDR A:0x2c08000
y.create.l HWIO_PMIC_ARB_OBS0_CHNL2_CMD_ADDR A:0x2c10000
y.create.l HWIO_PMIC_ARB_OBS0_CHNL3_CMD_ADDR A:0x2c18000
y.create.l HWIO_PMIC_ARB_OBS1_CHNL0_CMD_ADDR A:0x2c01000
y.create.l HWIO_PMIC_ARB_OBS1_CHNL1_CMD_ADDR A:0x2c09000
y.create.l HWIO_PMIC_ARB_OBS1_CHNL2_CMD_ADDR A:0x2c11000
y.create.l HWIO_PMIC_ARB_OBS1_CHNL3_CMD_ADDR A:0x2c19000
y.create.l HWIO_PMIC_ARB_OBS2_CHNL0_CMD_ADDR A:0x2c02000
y.create.l HWIO_PMIC_ARB_OBS2_CHNL1_CMD_ADDR A:0x2c0a000
y.create.l HWIO_PMIC_ARB_OBS2_CHNL2_CMD_ADDR A:0x2c12000
y.create.l HWIO_PMIC_ARB_OBS2_CHNL3_CMD_ADDR A:0x2c1a000
y.create.l HWIO_PMIC_ARB_OBS3_CHNL0_CMD_ADDR A:0x2c03000
y.create.l HWIO_PMIC_ARB_OBS3_CHNL1_CMD_ADDR A:0x2c0b000
y.create.l HWIO_PMIC_ARB_OBS3_CHNL2_CMD_ADDR A:0x2c13000
y.create.l HWIO_PMIC_ARB_OBS3_CHNL3_CMD_ADDR A:0x2c1b000
y.create.l HWIO_PMIC_ARB_OBS4_CHNL0_CMD_ADDR A:0x2c04000
y.create.l HWIO_PMIC_ARB_OBS4_CHNL1_CMD_ADDR A:0x2c0c000
y.create.l HWIO_PMIC_ARB_OBS4_CHNL2_CMD_ADDR A:0x2c14000
y.create.l HWIO_PMIC_ARB_OBS4_CHNL3_CMD_ADDR A:0x2c1c000
y.create.l HWIO_PMIC_ARB_OBS5_CHNL0_CMD_ADDR A:0x2c05000
y.create.l HWIO_PMIC_ARB_OBS5_CHNL1_CMD_ADDR A:0x2c0d000
y.create.l HWIO_PMIC_ARB_OBS5_CHNL2_CMD_ADDR A:0x2c15000
y.create.l HWIO_PMIC_ARB_OBS5_CHNL3_CMD_ADDR A:0x2c1d000
y.create.l HWIO_PMIC_ARB_OBS0_CHNL0_CONFIG_ADDR A:0x2c00004
y.create.l HWIO_PMIC_ARB_OBS0_CHNL1_CONFIG_ADDR A:0x2c08004
y.create.l HWIO_PMIC_ARB_OBS0_CHNL2_CONFIG_ADDR A:0x2c10004
y.create.l HWIO_PMIC_ARB_OBS0_CHNL3_CONFIG_ADDR A:0x2c18004
y.create.l HWIO_PMIC_ARB_OBS1_CHNL0_CONFIG_ADDR A:0x2c01004
y.create.l HWIO_PMIC_ARB_OBS1_CHNL1_CONFIG_ADDR A:0x2c09004
y.create.l HWIO_PMIC_ARB_OBS1_CHNL2_CONFIG_ADDR A:0x2c11004
y.create.l HWIO_PMIC_ARB_OBS1_CHNL3_CONFIG_ADDR A:0x2c19004
y.create.l HWIO_PMIC_ARB_OBS2_CHNL0_CONFIG_ADDR A:0x2c02004
y.create.l HWIO_PMIC_ARB_OBS2_CHNL1_CONFIG_ADDR A:0x2c0a004
y.create.l HWIO_PMIC_ARB_OBS2_CHNL2_CONFIG_ADDR A:0x2c12004
y.create.l HWIO_PMIC_ARB_OBS2_CHNL3_CONFIG_ADDR A:0x2c1a004
y.create.l HWIO_PMIC_ARB_OBS3_CHNL0_CONFIG_ADDR A:0x2c03004
y.create.l HWIO_PMIC_ARB_OBS3_CHNL1_CONFIG_ADDR A:0x2c0b004
y.create.l HWIO_PMIC_ARB_OBS3_CHNL2_CONFIG_ADDR A:0x2c13004
y.create.l HWIO_PMIC_ARB_OBS3_CHNL3_CONFIG_ADDR A:0x2c1b004
y.create.l HWIO_PMIC_ARB_OBS4_CHNL0_CONFIG_ADDR A:0x2c04004
y.create.l HWIO_PMIC_ARB_OBS4_CHNL1_CONFIG_ADDR A:0x2c0c004
y.create.l HWIO_PMIC_ARB_OBS4_CHNL2_CONFIG_ADDR A:0x2c14004
y.create.l HWIO_PMIC_ARB_OBS4_CHNL3_CONFIG_ADDR A:0x2c1c004
y.create.l HWIO_PMIC_ARB_OBS5_CHNL0_CONFIG_ADDR A:0x2c05004
y.create.l HWIO_PMIC_ARB_OBS5_CHNL1_CONFIG_ADDR A:0x2c0d004
y.create.l HWIO_PMIC_ARB_OBS5_CHNL2_CONFIG_ADDR A:0x2c15004
y.create.l HWIO_PMIC_ARB_OBS5_CHNL3_CONFIG_ADDR A:0x2c1d004
y.create.l HWIO_PMIC_ARB_OBS0_CHNL0_STATUS_ADDR A:0x2c00008
y.create.l HWIO_PMIC_ARB_OBS0_CHNL1_STATUS_ADDR A:0x2c08008
y.create.l HWIO_PMIC_ARB_OBS0_CHNL2_STATUS_ADDR A:0x2c10008
y.create.l HWIO_PMIC_ARB_OBS0_CHNL3_STATUS_ADDR A:0x2c18008
y.create.l HWIO_PMIC_ARB_OBS1_CHNL0_STATUS_ADDR A:0x2c01008
y.create.l HWIO_PMIC_ARB_OBS1_CHNL1_STATUS_ADDR A:0x2c09008
y.create.l HWIO_PMIC_ARB_OBS1_CHNL2_STATUS_ADDR A:0x2c11008
y.create.l HWIO_PMIC_ARB_OBS1_CHNL3_STATUS_ADDR A:0x2c19008
y.create.l HWIO_PMIC_ARB_OBS2_CHNL0_STATUS_ADDR A:0x2c02008
y.create.l HWIO_PMIC_ARB_OBS2_CHNL1_STATUS_ADDR A:0x2c0a008
y.create.l HWIO_PMIC_ARB_OBS2_CHNL2_STATUS_ADDR A:0x2c12008
y.create.l HWIO_PMIC_ARB_OBS2_CHNL3_STATUS_ADDR A:0x2c1a008
y.create.l HWIO_PMIC_ARB_OBS3_CHNL0_STATUS_ADDR A:0x2c03008
y.create.l HWIO_PMIC_ARB_OBS3_CHNL1_STATUS_ADDR A:0x2c0b008
y.create.l HWIO_PMIC_ARB_OBS3_CHNL2_STATUS_ADDR A:0x2c13008
y.create.l HWIO_PMIC_ARB_OBS3_CHNL3_STATUS_ADDR A:0x2c1b008
y.create.l HWIO_PMIC_ARB_OBS4_CHNL0_STATUS_ADDR A:0x2c04008
y.create.l HWIO_PMIC_ARB_OBS4_CHNL1_STATUS_ADDR A:0x2c0c008
y.create.l HWIO_PMIC_ARB_OBS4_CHNL2_STATUS_ADDR A:0x2c14008
y.create.l HWIO_PMIC_ARB_OBS4_CHNL3_STATUS_ADDR A:0x2c1c008
y.create.l HWIO_PMIC_ARB_OBS5_CHNL0_STATUS_ADDR A:0x2c05008
y.create.l HWIO_PMIC_ARB_OBS5_CHNL1_STATUS_ADDR A:0x2c0d008
y.create.l HWIO_PMIC_ARB_OBS5_CHNL2_STATUS_ADDR A:0x2c15008
y.create.l HWIO_PMIC_ARB_OBS5_CHNL3_STATUS_ADDR A:0x2c1d008
y.create.l HWIO_PMIC_ARB_OBS0_CHNL0_RDATA0_ADDR A:0x2c00018
y.create.l HWIO_PMIC_ARB_OBS0_CHNL1_RDATA0_ADDR A:0x2c08018
y.create.l HWIO_PMIC_ARB_OBS0_CHNL2_RDATA0_ADDR A:0x2c10018
y.create.l HWIO_PMIC_ARB_OBS0_CHNL3_RDATA0_ADDR A:0x2c18018
y.create.l HWIO_PMIC_ARB_OBS1_CHNL0_RDATA0_ADDR A:0x2c01018
y.create.l HWIO_PMIC_ARB_OBS1_CHNL1_RDATA0_ADDR A:0x2c09018
y.create.l HWIO_PMIC_ARB_OBS1_CHNL2_RDATA0_ADDR A:0x2c11018
y.create.l HWIO_PMIC_ARB_OBS1_CHNL3_RDATA0_ADDR A:0x2c19018
y.create.l HWIO_PMIC_ARB_OBS2_CHNL0_RDATA0_ADDR A:0x2c02018
y.create.l HWIO_PMIC_ARB_OBS2_CHNL1_RDATA0_ADDR A:0x2c0a018
y.create.l HWIO_PMIC_ARB_OBS2_CHNL2_RDATA0_ADDR A:0x2c12018
y.create.l HWIO_PMIC_ARB_OBS2_CHNL3_RDATA0_ADDR A:0x2c1a018
y.create.l HWIO_PMIC_ARB_OBS3_CHNL0_RDATA0_ADDR A:0x2c03018
y.create.l HWIO_PMIC_ARB_OBS3_CHNL1_RDATA0_ADDR A:0x2c0b018
y.create.l HWIO_PMIC_ARB_OBS3_CHNL2_RDATA0_ADDR A:0x2c13018
y.create.l HWIO_PMIC_ARB_OBS3_CHNL3_RDATA0_ADDR A:0x2c1b018
y.create.l HWIO_PMIC_ARB_OBS4_CHNL0_RDATA0_ADDR A:0x2c04018
y.create.l HWIO_PMIC_ARB_OBS4_CHNL1_RDATA0_ADDR A:0x2c0c018
y.create.l HWIO_PMIC_ARB_OBS4_CHNL2_RDATA0_ADDR A:0x2c14018
y.create.l HWIO_PMIC_ARB_OBS4_CHNL3_RDATA0_ADDR A:0x2c1c018
y.create.l HWIO_PMIC_ARB_OBS5_CHNL0_RDATA0_ADDR A:0x2c05018
y.create.l HWIO_PMIC_ARB_OBS5_CHNL1_RDATA0_ADDR A:0x2c0d018
y.create.l HWIO_PMIC_ARB_OBS5_CHNL2_RDATA0_ADDR A:0x2c15018
y.create.l HWIO_PMIC_ARB_OBS5_CHNL3_RDATA0_ADDR A:0x2c1d018
y.create.l HWIO_PMIC_ARB_OBS0_CHNL0_RDATA1_ADDR A:0x2c0001c
y.create.l HWIO_PMIC_ARB_OBS0_CHNL1_RDATA1_ADDR A:0x2c0801c
y.create.l HWIO_PMIC_ARB_OBS0_CHNL2_RDATA1_ADDR A:0x2c1001c
y.create.l HWIO_PMIC_ARB_OBS0_CHNL3_RDATA1_ADDR A:0x2c1801c
y.create.l HWIO_PMIC_ARB_OBS1_CHNL0_RDATA1_ADDR A:0x2c0101c
y.create.l HWIO_PMIC_ARB_OBS1_CHNL1_RDATA1_ADDR A:0x2c0901c
y.create.l HWIO_PMIC_ARB_OBS1_CHNL2_RDATA1_ADDR A:0x2c1101c
y.create.l HWIO_PMIC_ARB_OBS1_CHNL3_RDATA1_ADDR A:0x2c1901c
y.create.l HWIO_PMIC_ARB_OBS2_CHNL0_RDATA1_ADDR A:0x2c0201c
y.create.l HWIO_PMIC_ARB_OBS2_CHNL1_RDATA1_ADDR A:0x2c0a01c
y.create.l HWIO_PMIC_ARB_OBS2_CHNL2_RDATA1_ADDR A:0x2c1201c
y.create.l HWIO_PMIC_ARB_OBS2_CHNL3_RDATA1_ADDR A:0x2c1a01c
y.create.l HWIO_PMIC_ARB_OBS3_CHNL0_RDATA1_ADDR A:0x2c0301c
y.create.l HWIO_PMIC_ARB_OBS3_CHNL1_RDATA1_ADDR A:0x2c0b01c
y.create.l HWIO_PMIC_ARB_OBS3_CHNL2_RDATA1_ADDR A:0x2c1301c
y.create.l HWIO_PMIC_ARB_OBS3_CHNL3_RDATA1_ADDR A:0x2c1b01c
y.create.l HWIO_PMIC_ARB_OBS4_CHNL0_RDATA1_ADDR A:0x2c0401c
y.create.l HWIO_PMIC_ARB_OBS4_CHNL1_RDATA1_ADDR A:0x2c0c01c
y.create.l HWIO_PMIC_ARB_OBS4_CHNL2_RDATA1_ADDR A:0x2c1401c
y.create.l HWIO_PMIC_ARB_OBS4_CHNL3_RDATA1_ADDR A:0x2c1c01c
y.create.l HWIO_PMIC_ARB_OBS5_CHNL0_RDATA1_ADDR A:0x2c0501c
y.create.l HWIO_PMIC_ARB_OBS5_CHNL1_RDATA1_ADDR A:0x2c0d01c
y.create.l HWIO_PMIC_ARB_OBS5_CHNL2_RDATA1_ADDR A:0x2c1501c
y.create.l HWIO_PMIC_ARB_OBS5_CHNL3_RDATA1_ADDR A:0x2c1d01c
y.create.l HWIO_PRNG_CM_CM_PRNG_CM_REG_BASE_START_ADDR A:0xe0000
y.create.l HWIO_PRNG_CM_CM_PRNG_CM_REG_BASE_LAST_ADDR A:0xe0004
y.create.l HWIO_PRNG_CM_CM_PRNG_CM_REG_BASE_END_ADDR A:0xe1000
y.create.l HWIO_PRNG_CM_PRNG_HW_VERSION_ADDR A:0xe0000
y.create.l HWIO_PRNG_CM_PRNG_CHAR_STATUS_ADDR A:0xe0004
y.create.l HWIO_PRNG_TZ_TZ_PRNG_TZ_REG_BASE_START_ADDR A:0xe1000
y.create.l HWIO_PRNG_TZ_TZ_PRNG_TZ_REG_BASE_LAST_ADDR A:0xe1144
y.create.l HWIO_PRNG_TZ_TZ_PRNG_TZ_REG_BASE_END_ADDR A:0xe2000
y.create.l HWIO_PRNG_TZ_PRNG_DATA_OUT_ADDR A:0xe1000
y.create.l HWIO_PRNG_TZ_PRNG_STATUS_ADDR A:0xe1004
y.create.l HWIO_PRNG_TZ_PRNG_ENTROPY_CNTR_ADDR A:0xe1010
y.create.l HWIO_PRNG_TZ_PRNG_SAMPLE_CNTR_ADDR A:0xe1014
y.create.l HWIO_PRNG_TZ_PRNG_GEN_CNTR_ADDR A:0xe1018
y.create.l HWIO_PRNG_TZ_PRNG_RESEED_CNTR_ADDR A:0xe101c
y.create.l HWIO_PRNG_TZ_PRNG_INSTANTIATE_CNTR_ADDR A:0xe1020
y.create.l HWIO_PRNG_TZ_PRNG_DEBUG_ADDR A:0xe1024
y.create.l HWIO_PRNG_TZ_PRNG_ARB_DEBUG_ADDR A:0xe1028
y.create.l HWIO_PRNG_TZ_PRNG_LFSR_CFG_ADDR A:0xe1100
y.create.l HWIO_PRNG_TZ_PRNG_CONFIG_ADDR A:0xe1104
y.create.l HWIO_PRNG_TZ_PRNG_PERSONALIZATION_STRING_ADDR A:0xe1108
y.create.l HWIO_PRNG_TZ_PRNG_NUM_ENTROPY_ADDR A:0xe1110
y.create.l HWIO_PRNG_TZ_PRNG_SAMPLE_FREQ_ADDR A:0xe1114
y.create.l HWIO_PRNG_TZ_PRNG_GEN_WORDS_ADDR A:0xe1118
y.create.l HWIO_PRNG_TZ_PRNG_RESEED_FREQ_ADDR A:0xe111c
y.create.l HWIO_PRNG_TZ_PRNG_INSTANTIATE_FREQ_ADDR A:0xe1120
y.create.l HWIO_PRNG_TZ_PRNG_SWKAT_ENTROPY_WINDOW_IN_ADDR A:0xe1124
y.create.l HWIO_PRNG_TZ_PRNG_SWKAT_VC_WINDOW_IN_ADDR A:0xe1128
y.create.l HWIO_PRNG_TZ_PRNG_SWKAT_ENTROPY_WINDOW_OUT_ADDR A:0xe1130
y.create.l HWIO_PRNG_TZ_PRNG_SWKAT_VC_WINDOW_OUT_ADDR A:0xe1134
y.create.l HWIO_PRNG_TZ_PRNG_SWKAT_CONFIG_ADDR A:0xe113c
y.create.l HWIO_PRNG_TZ_PRNG_KAT_STATUS_ADDR A:0xe1140
y.create.l HWIO_PRNG_TZ_PRNG_AC_CONFIG_ADDR A:0xe1144
y.create.l HWIO_PRNG_MSA_MSA_PRNG_SUB_REG_BASE_START_ADDR A:0xe2000
y.create.l HWIO_PRNG_MSA_MSA_PRNG_SUB_REG_BASE_LAST_ADDR A:0xe2004
y.create.l HWIO_PRNG_MSA_MSA_PRNG_SUB_REG_BASE_END_ADDR A:0xe3000
y.create.l HWIO_PRNG_MSA_PRNG_DATA_OUT_ADDR A:0xe2000
y.create.l HWIO_PRNG_MSA_PRNG_STATUS_ADDR A:0xe2004
y.create.l HWIO_PRNG_EE2_EE2_PRNG_SUB_REG_BASE_START_ADDR A:0xe3000
y.create.l HWIO_PRNG_EE2_EE2_PRNG_SUB_REG_BASE_LAST_ADDR A:0xe3004
y.create.l HWIO_PRNG_EE2_EE2_PRNG_SUB_REG_BASE_END_ADDR A:0xe4000
y.create.l HWIO_PRNG_EE2_PRNG_DATA_OUT_ADDR A:0xe3000
y.create.l HWIO_PRNG_EE2_PRNG_STATUS_ADDR A:0xe3004
y.create.l HWIO_PRNG_EE3_EE3_PRNG_SUB_REG_BASE_START_ADDR A:0xe4000
y.create.l HWIO_PRNG_EE3_EE3_PRNG_SUB_REG_BASE_LAST_ADDR A:0xe4004
y.create.l HWIO_PRNG_EE3_EE3_PRNG_SUB_REG_BASE_END_ADDR A:0xe5000
y.create.l HWIO_PRNG_EE3_PRNG_DATA_OUT_ADDR A:0xe4000
y.create.l HWIO_PRNG_EE3_PRNG_STATUS_ADDR A:0xe4004
y.create.l HWIO_PRNG_EE4_EE4_PRNG_SUB_REG_BASE_START_ADDR A:0xe5000
y.create.l HWIO_PRNG_EE4_EE4_PRNG_SUB_REG_BASE_LAST_ADDR A:0xe5004
y.create.l HWIO_PRNG_EE4_EE4_PRNG_SUB_REG_BASE_END_ADDR A:0xe6000
y.create.l HWIO_PRNG_EE4_PRNG_DATA_OUT_ADDR A:0xe5000
y.create.l HWIO_PRNG_EE4_PRNG_STATUS_ADDR A:0xe5004
y.create.l HWIO_PRNG_EE5_EE5_PRNG_SUB_REG_BASE_START_ADDR A:0xe6000
y.create.l HWIO_PRNG_EE5_EE5_PRNG_SUB_REG_BASE_LAST_ADDR A:0xe6004
y.create.l HWIO_PRNG_EE5_EE5_PRNG_SUB_REG_BASE_END_ADDR A:0xe7000
y.create.l HWIO_PRNG_EE5_PRNG_DATA_OUT_ADDR A:0xe6000
y.create.l HWIO_PRNG_EE5_PRNG_STATUS_ADDR A:0xe6004
y.create.l HWIO_PRNG_EE6_EE6_PRNG_SUB_REG_BASE_START_ADDR A:0xe7000
y.create.l HWIO_PRNG_EE6_EE6_PRNG_SUB_REG_BASE_LAST_ADDR A:0xe7004
y.create.l HWIO_PRNG_EE6_EE6_PRNG_SUB_REG_BASE_END_ADDR A:0xe8000
y.create.l HWIO_PRNG_EE6_PRNG_DATA_OUT_ADDR A:0xe7000
y.create.l HWIO_PRNG_EE6_PRNG_STATUS_ADDR A:0xe7004
y.create.l HWIO_PRNG_EE7_EE7_PRNG_SUB_REG_BASE_START_ADDR A:0xe8000
y.create.l HWIO_PRNG_EE7_EE7_PRNG_SUB_REG_BASE_LAST_ADDR A:0xe8004
y.create.l HWIO_PRNG_EE7_EE7_PRNG_SUB_REG_BASE_END_ADDR A:0xe9000
y.create.l HWIO_PRNG_EE7_PRNG_DATA_OUT_ADDR A:0xe8000
y.create.l HWIO_PRNG_EE7_PRNG_STATUS_ADDR A:0xe8004
y.create.l HWIO_PRNG_EE8_EE8_PRNG_SUB_REG_BASE_START_ADDR A:0xe9000
y.create.l HWIO_PRNG_EE8_EE8_PRNG_SUB_REG_BASE_LAST_ADDR A:0xe9004
y.create.l HWIO_PRNG_EE8_EE8_PRNG_SUB_REG_BASE_END_ADDR A:0xea000
y.create.l HWIO_PRNG_EE8_PRNG_DATA_OUT_ADDR A:0xe9000
y.create.l HWIO_PRNG_EE8_PRNG_STATUS_ADDR A:0xe9004
y.create.l HWIO_PRNG_EE9_EE9_PRNG_SUB_REG_BASE_START_ADDR A:0xea000
y.create.l HWIO_PRNG_EE9_EE9_PRNG_SUB_REG_BASE_LAST_ADDR A:0xea004
y.create.l HWIO_PRNG_EE9_EE9_PRNG_SUB_REG_BASE_END_ADDR A:0xeb000
y.create.l HWIO_PRNG_EE9_PRNG_DATA_OUT_ADDR A:0xea000
y.create.l HWIO_PRNG_EE9_PRNG_STATUS_ADDR A:0xea004
y.create.l HWIO_PRNG_EE10_EE10_PRNG_SUB_REG_BASE_START_ADDR A:0xeb000
y.create.l HWIO_PRNG_EE10_EE10_PRNG_SUB_REG_BASE_LAST_ADDR A:0xeb004
y.create.l HWIO_PRNG_EE10_EE10_PRNG_SUB_REG_BASE_END_ADDR A:0xec000
y.create.l HWIO_PRNG_EE10_PRNG_DATA_OUT_ADDR A:0xeb000
y.create.l HWIO_PRNG_EE10_PRNG_STATUS_ADDR A:0xeb004
y.create.l HWIO_PRNG_EE11_EE11_PRNG_SUB_REG_BASE_START_ADDR A:0xec000
y.create.l HWIO_PRNG_EE11_EE11_PRNG_SUB_REG_BASE_LAST_ADDR A:0xec004
y.create.l HWIO_PRNG_EE11_EE11_PRNG_SUB_REG_BASE_END_ADDR A:0xed000
y.create.l HWIO_PRNG_EE11_PRNG_DATA_OUT_ADDR A:0xec000
y.create.l HWIO_PRNG_EE11_PRNG_STATUS_ADDR A:0xec004
y.create.l HWIO_PRNG_EE12_EE12_PRNG_SUB_REG_BASE_START_ADDR A:0xed000
y.create.l HWIO_PRNG_EE12_EE12_PRNG_SUB_REG_BASE_LAST_ADDR A:0xed004
y.create.l HWIO_PRNG_EE12_EE12_PRNG_SUB_REG_BASE_END_ADDR A:0xee000
y.create.l HWIO_PRNG_EE12_PRNG_DATA_OUT_ADDR A:0xed000
y.create.l HWIO_PRNG_EE12_PRNG_STATUS_ADDR A:0xed004
y.create.l HWIO_PRNG_EE13_EE13_PRNG_SUB_REG_BASE_START_ADDR A:0xee000
y.create.l HWIO_PRNG_EE13_EE13_PRNG_SUB_REG_BASE_LAST_ADDR A:0xee004
y.create.l HWIO_PRNG_EE13_EE13_PRNG_SUB_REG_BASE_END_ADDR A:0xef000
y.create.l HWIO_PRNG_EE13_PRNG_DATA_OUT_ADDR A:0xee000
y.create.l HWIO_PRNG_EE13_PRNG_STATUS_ADDR A:0xee004
y.create.l HWIO_PRNG_EE14_EE14_PRNG_SUB_REG_BASE_START_ADDR A:0xef000
y.create.l HWIO_PRNG_EE14_EE14_PRNG_SUB_REG_BASE_LAST_ADDR A:0xef004
y.create.l HWIO_PRNG_EE14_EE14_PRNG_SUB_REG_BASE_END_ADDR A:0xf0000
y.create.l HWIO_PRNG_EE14_PRNG_DATA_OUT_ADDR A:0xef000
y.create.l HWIO_PRNG_EE14_PRNG_STATUS_ADDR A:0xef004
y.create.l HWIO_DCC_APU_REG_BASE_START_ADDR A:0xb0000
y.create.l HWIO_DCC_APU_REG_BASE_LAST_ADDR A:0xb03d4
y.create.l HWIO_DCC_APU_REG_BASE_END_ADDR A:0xb0400
y.create.l HWIO_DCC_XPU_SCR_ADDR A:0xb0000
y.create.l HWIO_DCC_XPU_SWDR_ADDR A:0xb0004
y.create.l HWIO_DCC_XPU_SEAR0_ADDR A:0xb0040
y.create.l HWIO_DCC_XPU_SESR_ADDR A:0xb0048
y.create.l HWIO_DCC_XPU_SESRRESTORE_ADDR A:0xb004c
y.create.l HWIO_DCC_XPU_SESYNR0_ADDR A:0xb0050
y.create.l HWIO_DCC_XPU_SESYNR1_ADDR A:0xb0054
y.create.l HWIO_DCC_XPU_SESYNR2_ADDR A:0xb0058
y.create.l HWIO_DCC_XPU_MCR_ADDR A:0xb0100
y.create.l HWIO_DCC_XPU_MEAR0_ADDR A:0xb0140
y.create.l HWIO_DCC_XPU_MESR_ADDR A:0xb0148
y.create.l HWIO_DCC_XPU_MESRRESTORE_ADDR A:0xb014c
y.create.l HWIO_DCC_XPU_MESYNR0_ADDR A:0xb0150
y.create.l HWIO_DCC_XPU_MESYNR1_ADDR A:0xb0154
y.create.l HWIO_DCC_XPU_MESYNR2_ADDR A:0xb0158
y.create.l HWIO_DCC_XPU_CR_ADDR A:0xb0080
y.create.l HWIO_DCC_XPU_RPU_ACR0_ADDR A:0xb00a0
y.create.l HWIO_DCC_XPU_EAR0_ADDR A:0xb00c0
y.create.l HWIO_DCC_XPU_ESR_ADDR A:0xb00c8
y.create.l HWIO_DCC_XPU_ESRRESTORE_ADDR A:0xb00cc
y.create.l HWIO_DCC_XPU_ESYNR0_ADDR A:0xb00d0
y.create.l HWIO_DCC_XPU_ESYNR1_ADDR A:0xb00d4
y.create.l HWIO_DCC_XPU_ESYNR2_ADDR A:0xb00d8
y.create.l HWIO_DCC_XPU_IDR0_ADDR A:0xb0074
y.create.l HWIO_DCC_XPU_IDR1_ADDR A:0xb0078
y.create.l HWIO_DCC_XPU_REV_ADDR A:0xb007c
y.create.l HWIO_DCC_XPU_RG0_RACR0_ADDR A:0xb0200
y.create.l HWIO_DCC_XPU_RG1_RACR0_ADDR A:0xb0280
y.create.l HWIO_DCC_XPU_RG2_RACR0_ADDR A:0xb0300
y.create.l HWIO_DCC_XPU_RG3_RACR0_ADDR A:0xb0380
y.create.l HWIO_DCC_XPU_RG0_WACR0_ADDR A:0xb0220
y.create.l HWIO_DCC_XPU_RG1_WACR0_ADDR A:0xb02a0
y.create.l HWIO_DCC_XPU_RG2_WACR0_ADDR A:0xb0320
y.create.l HWIO_DCC_XPU_RG3_WACR0_ADDR A:0xb03a0
y.create.l HWIO_DCC_XPU_RG0_SCR_ADDR A:0xb0250
y.create.l HWIO_DCC_XPU_RG1_SCR_ADDR A:0xb02d0
y.create.l HWIO_DCC_XPU_RG2_SCR_ADDR A:0xb0350
y.create.l HWIO_DCC_XPU_RG3_SCR_ADDR A:0xb03d0
y.create.l HWIO_DCC_XPU_RG0_MCR_ADDR A:0xb0254
y.create.l HWIO_DCC_XPU_RG1_MCR_ADDR A:0xb02d4
y.create.l HWIO_DCC_XPU_RG2_MCR_ADDR A:0xb0354
y.create.l HWIO_DCC_XPU_RG3_MCR_ADDR A:0xb03d4
y.create.l HWIO_DCC_CFG_REG_BASE_START_ADDR A:0xb2000
y.create.l HWIO_DCC_CFG_REG_BASE_LAST_ADDR A:0xb20c8
y.create.l HWIO_DCC_CFG_REG_BASE_END_ADDR A:0xb3000
y.create.l HWIO_DCC_HW_VERSION_ADDR A:0xb2000
y.create.l HWIO_DCC_HW_INFO_ADDR A:0xb2004
y.create.l HWIO_DCC_EXEC_CTRL_ADDR A:0xb2008
y.create.l HWIO_DCC_DCC_STATUS_ADDR A:0xb200c
y.create.l HWIO_DCC_DCC_CFG_ADDR A:0xb2010
y.create.l HWIO_DCC_FDA_CURRENT_ADDR A:0xb2014
y.create.l HWIO_DCC_LLA_CURRENT_ADDR A:0xb2018
y.create.l HWIO_DCC_LL_LOCK0_ADDR A:0xb201c
y.create.l HWIO_DCC_LL_LOCK1_ADDR A:0xb209c
y.create.l HWIO_DCC_LL_CONFIG0_ADDR A:0xb2020
y.create.l HWIO_DCC_LL_CONFIG1_ADDR A:0xb20a0
y.create.l HWIO_DCC_LL_BASE0_ADDR A:0xb2024
y.create.l HWIO_DCC_LL_BASE1_ADDR A:0xb20a4
y.create.l HWIO_DCC_FD_BASE0_ADDR A:0xb2028
y.create.l HWIO_DCC_FD_BASE1_ADDR A:0xb20a8
y.create.l HWIO_DCC_LL_TIMEOUT0_ADDR A:0xb202c
y.create.l HWIO_DCC_LL_TIMEOUT1_ADDR A:0xb20ac
y.create.l HWIO_DCC_LL_INTERRUPT_ENABLE0_ADDR A:0xb2030
y.create.l HWIO_DCC_LL_INTERRUPT_ENABLE1_ADDR A:0xb20b0
y.create.l HWIO_DCC_LL_INTERRUPT_STATUS0_ADDR A:0xb2034
y.create.l HWIO_DCC_LL_INTERRUPT_STATUS1_ADDR A:0xb20b4
y.create.l HWIO_DCC_FDA_CAPTURED0_ADDR A:0xb2038
y.create.l HWIO_DCC_FDA_CAPTURED1_ADDR A:0xb20b8
y.create.l HWIO_DCC_LLA_CAPTURED0_ADDR A:0xb203c
y.create.l HWIO_DCC_LLA_CAPTURED1_ADDR A:0xb20bc
y.create.l HWIO_DCC_LL_CRC_CAPTURED0_ADDR A:0xb2040
y.create.l HWIO_DCC_LL_CRC_CAPTURED1_ADDR A:0xb20c0
y.create.l HWIO_DCC_LL_SW_TRIGGER0_ADDR A:0xb2044
y.create.l HWIO_DCC_LL_SW_TRIGGER1_ADDR A:0xb20c4
y.create.l HWIO_DCC_LL_BUS_ACCESS_STATUS0_ADDR A:0xb2048
y.create.l HWIO_DCC_LL_BUS_ACCESS_STATUS1_ADDR A:0xb20c8
y.create.l HWIO_QDSS_APSS_APCS_APB_APCS_APB_A7CORE_DEBUG_REG_BASE_START_ADDR A:0x6d00000
y.create.l HWIO_QDSS_APSS_APCS_APB_APCS_APB_A7CORE_DEBUG_REG_BASE_LAST_ADDR A:0x6d02ffc
y.create.l HWIO_QDSS_APSS_APCS_APB_APCS_APB_A7CORE_DEBUG_REG_BASE_END_ADDR A:0x6d03000
y.create.l HWIO_QDSS_APSS_APCS_APB_DIDR_ADDR A:0x6d00000
y.create.l HWIO_QDSS_APSS_APCS_APB_WFAR_ADDR A:0x6d00018
y.create.l HWIO_QDSS_APSS_APCS_APB_VCR_ADDR A:0x6d0001c
y.create.l HWIO_QDSS_APSS_APCS_APB_ECR_ADDR A:0x6d00024
y.create.l HWIO_QDSS_APSS_APCS_APB_DSCCR_ADDR A:0x6d00028
y.create.l HWIO_QDSS_APSS_APCS_APB_DSMCR_ADDR A:0x6d0002c
y.create.l HWIO_QDSS_APSS_APCS_APB_DTRRX_ADDR A:0x6d00080
y.create.l HWIO_QDSS_APSS_APCS_APB_ITR_ADDR A:0x6d00084
y.create.l HWIO_QDSS_APSS_APCS_APB_DSCR_ADDR A:0x6d00088
y.create.l HWIO_QDSS_APSS_APCS_APB_DTRTX_ADDR A:0x6d0008c
y.create.l HWIO_QDSS_APSS_APCS_APB_DRCR_ADDR A:0x6d00090
y.create.l HWIO_QDSS_APSS_APCS_APB_EACR_ADDR A:0x6d00094
y.create.l HWIO_QDSS_APSS_APCS_APB_PCSR_ADDR A:0x6d000a0
y.create.l HWIO_QDSS_APSS_APCS_APB_CIDSR_ADDR A:0x6d000a4
y.create.l HWIO_QDSS_APSS_APCS_APB_VIDSR_ADDR A:0x6d000a8
y.create.l HWIO_QDSS_APSS_APCS_APB_BVR0_ADDR A:0x6d00100
y.create.l HWIO_QDSS_APSS_APCS_APB_BVR1_ADDR A:0x6d00104
y.create.l HWIO_QDSS_APSS_APCS_APB_BVR2_ADDR A:0x6d00108
y.create.l HWIO_QDSS_APSS_APCS_APB_BVR3_ADDR A:0x6d0010c
y.create.l HWIO_QDSS_APSS_APCS_APB_BVR4_ADDR A:0x6d00110
y.create.l HWIO_QDSS_APSS_APCS_APB_BVR5_ADDR A:0x6d00114
y.create.l HWIO_QDSS_APSS_APCS_APB_BCR0_ADDR A:0x6d00140
y.create.l HWIO_QDSS_APSS_APCS_APB_BCR1_ADDR A:0x6d00144
y.create.l HWIO_QDSS_APSS_APCS_APB_BCR2_ADDR A:0x6d00148
y.create.l HWIO_QDSS_APSS_APCS_APB_BCR3_ADDR A:0x6d0014c
y.create.l HWIO_QDSS_APSS_APCS_APB_BCR4_ADDR A:0x6d00150
y.create.l HWIO_QDSS_APSS_APCS_APB_BCR5_ADDR A:0x6d00154
y.create.l HWIO_QDSS_APSS_APCS_APB_WVR0_ADDR A:0x6d00180
y.create.l HWIO_QDSS_APSS_APCS_APB_WVR1_ADDR A:0x6d00184
y.create.l HWIO_QDSS_APSS_APCS_APB_WVR2_ADDR A:0x6d00188
y.create.l HWIO_QDSS_APSS_APCS_APB_WVR3_ADDR A:0x6d0018c
y.create.l HWIO_QDSS_APSS_APCS_APB_WCR0_ADDR A:0x6d001c0
y.create.l HWIO_QDSS_APSS_APCS_APB_WCR1_ADDR A:0x6d001c4
y.create.l HWIO_QDSS_APSS_APCS_APB_WCR2_ADDR A:0x6d001c8
y.create.l HWIO_QDSS_APSS_APCS_APB_WCR3_ADDR A:0x6d001cc
y.create.l HWIO_QDSS_APSS_APCS_APB_BXVR4_ADDR A:0x6d00250
y.create.l HWIO_QDSS_APSS_APCS_APB_BXVR5_ADDR A:0x6d00254
y.create.l HWIO_QDSS_APSS_APCS_APB_OSLAR_ADDR A:0x6d00300
y.create.l HWIO_QDSS_APSS_APCS_APB_OSLSR_ADDR A:0x6d00304
y.create.l HWIO_QDSS_APSS_APCS_APB_PRCR_ADDR A:0x6d00310
y.create.l HWIO_QDSS_APSS_APCS_APB_PRSR_ADDR A:0x6d00314
y.create.l HWIO_QDSS_APSS_APCS_APB_MIDR_ADDR A:0x6d00d00
y.create.l HWIO_QDSS_APSS_APCS_APB_CTR_ADDR A:0x6d00d04
y.create.l HWIO_QDSS_APSS_APCS_APB_MPUIR_ADDR A:0x6d00d10
y.create.l HWIO_QDSS_APSS_APCS_APB_MPIDR_ADDR A:0x6d00d14
y.create.l HWIO_QDSS_APSS_APCS_APB_MIDRALIAS1_ADDR A:0x6d00d18
y.create.l HWIO_QDSS_APSS_APCS_APB_FEATID_ADDR A:0x6d00d1c
y.create.l HWIO_QDSS_APSS_APCS_APB_ID_PFR0_ADDR A:0x6d00d20
y.create.l HWIO_QDSS_APSS_APCS_APB_ID_PFR1_ADDR A:0x6d00d24
y.create.l HWIO_QDSS_APSS_APCS_APB_ID_DFR0_ADDR A:0x6d00d28
y.create.l HWIO_QDSS_APSS_APCS_APB_ID_AFR0_ADDR A:0x6d00d2c
y.create.l HWIO_QDSS_APSS_APCS_APB_ID_MMFR0_ADDR A:0x6d00d30
y.create.l HWIO_QDSS_APSS_APCS_APB_ID_MMFR1_ADDR A:0x6d00d34
y.create.l HWIO_QDSS_APSS_APCS_APB_ID_MMFR2_ADDR A:0x6d00d38
y.create.l HWIO_QDSS_APSS_APCS_APB_ID_MMFR3_ADDR A:0x6d00d3c
y.create.l HWIO_QDSS_APSS_APCS_APB_ID_ISAR0_ADDR A:0x6d00d40
y.create.l HWIO_QDSS_APSS_APCS_APB_ID_ISAR1_ADDR A:0x6d00d44
y.create.l HWIO_QDSS_APSS_APCS_APB_ID_ISAR2_ADDR A:0x6d00d48
y.create.l HWIO_QDSS_APSS_APCS_APB_ID_ISAR3_ADDR A:0x6d00d4c
y.create.l HWIO_QDSS_APSS_APCS_APB_ID_ISAR4_ADDR A:0x6d00d50
y.create.l HWIO_QDSS_APSS_APCS_APB_ID_ISAR5_ADDR A:0x6d00d54
y.create.l HWIO_QDSS_APSS_APCS_APB_ITMISCOUT_ADDR A:0x6d00ef8
y.create.l HWIO_QDSS_APSS_APCS_APB_ITMISCIN_ADDR A:0x6d00efc
y.create.l HWIO_QDSS_APSS_APCS_APB_ITCTRL_ADDR A:0x6d00f00
y.create.l HWIO_QDSS_APSS_APCS_APB_CLAIMSET_ADDR A:0x6d00fa0
y.create.l HWIO_QDSS_APSS_APCS_APB_CLAIMCLR_ADDR A:0x6d00fa4
y.create.l HWIO_QDSS_APSS_APCS_APB_LOCKACCESS_ADDR A:0x6d00fb0
y.create.l HWIO_QDSS_APSS_APCS_APB_LOCKSTATUS_ADDR A:0x6d00fb4
y.create.l HWIO_QDSS_APSS_APCS_APB_AUTHSTATUS_ADDR A:0x6d00fb8
y.create.l HWIO_QDSS_APSS_APCS_APB_DEVID1_ADDR A:0x6d00fc4
y.create.l HWIO_QDSS_APSS_APCS_APB_DEVID_ADDR A:0x6d00fc8
y.create.l HWIO_QDSS_APSS_APCS_APB_DEVTYPE_ADDR A:0x6d00fcc
y.create.l HWIO_QDSS_APSS_APCS_APB_PID4_ADDR A:0x6d00fd0
y.create.l HWIO_QDSS_APSS_APCS_APB_PID0_ADDR A:0x6d00fe0
y.create.l HWIO_QDSS_APSS_APCS_APB_PID1_ADDR A:0x6d00fe4
y.create.l HWIO_QDSS_APSS_APCS_APB_PID2_ADDR A:0x6d00fe8
y.create.l HWIO_QDSS_APSS_APCS_APB_PID3_ADDR A:0x6d00fec
y.create.l HWIO_QDSS_APSS_APCS_APB_CID0_ADDR A:0x6d00ff0
y.create.l HWIO_QDSS_APSS_APCS_APB_CID1_ADDR A:0x6d00ff4
y.create.l HWIO_QDSS_APSS_APCS_APB_CID2_ADDR A:0x6d00ff8
y.create.l HWIO_QDSS_APSS_APCS_APB_CID3_ADDR A:0x6d00ffc
y.create.l HWIO_QDSS_APSS_APCS_APB_PMXEVCNTR0_ADDR A:0x6d01000
y.create.l HWIO_QDSS_APSS_APCS_APB_PMXEVCNTR1_ADDR A:0x6d01004
y.create.l HWIO_QDSS_APSS_APCS_APB_PMXEVCNTR2_ADDR A:0x6d01008
y.create.l HWIO_QDSS_APSS_APCS_APB_PMXEVCNTR3_ADDR A:0x6d0100c
y.create.l HWIO_QDSS_APSS_APCS_APB_PMCCNTR_ADDR A:0x6d0107c
y.create.l HWIO_QDSS_APSS_APCS_APB_PMXEVTYPER0_ADDR A:0x6d01400
y.create.l HWIO_QDSS_APSS_APCS_APB_PMXEVTYPER1_ADDR A:0x6d01404
y.create.l HWIO_QDSS_APSS_APCS_APB_PMXEVTYPER2_ADDR A:0x6d01408
y.create.l HWIO_QDSS_APSS_APCS_APB_PMXEVTYPER3_ADDR A:0x6d0140c
y.create.l HWIO_QDSS_APSS_APCS_APB_PMCCFILTR_ADDR A:0x6d0147c
y.create.l HWIO_QDSS_APSS_APCS_APB_PMCNTENSET_ADDR A:0x6d01c00
y.create.l HWIO_QDSS_APSS_APCS_APB_PMCNTENCLR_ADDR A:0x6d01c20
y.create.l HWIO_QDSS_APSS_APCS_APB_PMINTENSET_ADDR A:0x6d01c40
y.create.l HWIO_QDSS_APSS_APCS_APB_PMINTENCLR_ADDR A:0x6d01c60
y.create.l HWIO_QDSS_APSS_APCS_APB_PMOVSR_ADDR A:0x6d01c80
y.create.l HWIO_QDSS_APSS_APCS_APB_PMSWINC_ADDR A:0x6d01ca0
y.create.l HWIO_QDSS_APSS_APCS_APB_PMOVSSET_ADDR A:0x6d01cc0
y.create.l HWIO_QDSS_APSS_APCS_APB_PMCFGR_ADDR A:0x6d01e00
y.create.l HWIO_QDSS_APSS_APCS_APB_PMCR_ADDR A:0x6d01e04
y.create.l HWIO_QDSS_APSS_APCS_APB_PMUSERENR_ADDR A:0x6d01e08
y.create.l HWIO_QDSS_APSS_APCS_APB_PMCEID0_ADDR A:0x6d01e20
y.create.l HWIO_QDSS_APSS_APCS_APB_PMLAR_ADDR A:0x6d01fb0
y.create.l HWIO_QDSS_APSS_APCS_APB_PMLSR_ADDR A:0x6d01fb4
y.create.l HWIO_QDSS_APSS_APCS_APB_PMAUTHSTATUS_ADDR A:0x6d01fb8
y.create.l HWIO_QDSS_APSS_APCS_APB_PMDEVTYPE_ADDR A:0x6d01fcc
y.create.l HWIO_QDSS_APSS_APCS_APB_PID4_2_ADDR A:0x6d01fd0
y.create.l HWIO_QDSS_APSS_APCS_APB_PID0_2_ADDR A:0x6d01fe0
y.create.l HWIO_QDSS_APSS_APCS_APB_PID1_2_ADDR A:0x6d01fe4
y.create.l HWIO_QDSS_APSS_APCS_APB_PID2_2_ADDR A:0x6d01fe8
y.create.l HWIO_QDSS_APSS_APCS_APB_PID3_2_ADDR A:0x6d01fec
y.create.l HWIO_QDSS_APSS_APCS_APB_CID0_2_ADDR A:0x6d01ff0
y.create.l HWIO_QDSS_APSS_APCS_APB_CID1_2_ADDR A:0x6d01ff4
y.create.l HWIO_QDSS_APSS_APCS_APB_CID2_2_ADDR A:0x6d01ff8
y.create.l HWIO_QDSS_APSS_APCS_APB_CID3_2_ADDR A:0x6d01ffc
y.create.l HWIO_QDSS_APSS_APCS_APB_CR_ADDR A:0x6d02000
y.create.l HWIO_QDSS_APSS_APCS_APB_CCR_ADDR A:0x6d02004
y.create.l HWIO_QDSS_APSS_APCS_APB_TRIGGER_ADDR A:0x6d02008
y.create.l HWIO_QDSS_APSS_APCS_APB_ASICCR_ADDR A:0x6d0200c
y.create.l HWIO_QDSS_APSS_APCS_APB_SR_ADDR A:0x6d02010
y.create.l HWIO_QDSS_APSS_APCS_APB_SCR_ADDR A:0x6d02014
y.create.l HWIO_QDSS_APSS_APCS_APB_TSSCR_ADDR A:0x6d02018
y.create.l HWIO_QDSS_APSS_APCS_APB_TECR2_ADDR A:0x6d0201c
y.create.l HWIO_QDSS_APSS_APCS_APB_TEEVR_ADDR A:0x6d02020
y.create.l HWIO_QDSS_APSS_APCS_APB_TECR1_ADDR A:0x6d02024
y.create.l HWIO_QDSS_APSS_APCS_APB_FFLR_ADDR A:0x6d0202c
y.create.l HWIO_QDSS_APSS_APCS_APB_DEVR_ADDR A:0x6d02030
y.create.l HWIO_QDSS_APSS_APCS_APB_VDCR1_ADDR A:0x6d02034
y.create.l HWIO_QDSS_APSS_APCS_APB_VDCR3_ADDR A:0x6d0203c
y.create.l HWIO_QDSS_APSS_APCS_APB_ACVR1_ADDR A:0x6d02040
y.create.l HWIO_QDSS_APSS_APCS_APB_ACVR2_ADDR A:0x6d02044
y.create.l HWIO_QDSS_APSS_APCS_APB_ACVR3_ADDR A:0x6d02048
y.create.l HWIO_QDSS_APSS_APCS_APB_ACVR4_ADDR A:0x6d0204c
y.create.l HWIO_QDSS_APSS_APCS_APB_ACVR5_ADDR A:0x6d02050
y.create.l HWIO_QDSS_APSS_APCS_APB_ACVR6_ADDR A:0x6d02054
y.create.l HWIO_QDSS_APSS_APCS_APB_ACVR7_ADDR A:0x6d02058
y.create.l HWIO_QDSS_APSS_APCS_APB_ACVR8_ADDR A:0x6d0205c
y.create.l HWIO_QDSS_APSS_APCS_APB_ACTR1_ADDR A:0x6d02080
y.create.l HWIO_QDSS_APSS_APCS_APB_ACTR2_ADDR A:0x6d02084
y.create.l HWIO_QDSS_APSS_APCS_APB_ACTR3_ADDR A:0x6d02088
y.create.l HWIO_QDSS_APSS_APCS_APB_ACTR4_ADDR A:0x6d0208c
y.create.l HWIO_QDSS_APSS_APCS_APB_ACTR5_ADDR A:0x6d02090
y.create.l HWIO_QDSS_APSS_APCS_APB_ACTR6_ADDR A:0x6d02094
y.create.l HWIO_QDSS_APSS_APCS_APB_ACTR7_ADDR A:0x6d02098
y.create.l HWIO_QDSS_APSS_APCS_APB_ACTR8_ADDR A:0x6d0209c
y.create.l HWIO_QDSS_APSS_APCS_APB_DCVR1_ADDR A:0x6d020c0
y.create.l HWIO_QDSS_APSS_APCS_APB_DCVR3_ADDR A:0x6d020c8
y.create.l HWIO_QDSS_APSS_APCS_APB_DCMR1_ADDR A:0x6d02100
y.create.l HWIO_QDSS_APSS_APCS_APB_DCMR3_ADDR A:0x6d02108
y.create.l HWIO_QDSS_APSS_APCS_APB_CNTRLDVR1_ADDR A:0x6d02140
y.create.l HWIO_QDSS_APSS_APCS_APB_CNTRLDVR2_ADDR A:0x6d02144
y.create.l HWIO_QDSS_APSS_APCS_APB_CNTENR1_ADDR A:0x6d02150
y.create.l HWIO_QDSS_APSS_APCS_APB_CNTENR2_ADDR A:0x6d02154
y.create.l HWIO_QDSS_APSS_APCS_APB_CNTRLDEVR1_ADDR A:0x6d02160
y.create.l HWIO_QDSS_APSS_APCS_APB_CNTRLDEVR2_ADDR A:0x6d02164
y.create.l HWIO_QDSS_APSS_APCS_APB_CNTVR1_ADDR A:0x6d02170
y.create.l HWIO_QDSS_APSS_APCS_APB_CNTVR2_ADDR A:0x6d02174
y.create.l HWIO_QDSS_APSS_APCS_APB_SQ12EVR_ADDR A:0x6d02180
y.create.l HWIO_QDSS_APSS_APCS_APB_SQ21EVR_ADDR A:0x6d02184
y.create.l HWIO_QDSS_APSS_APCS_APB_SQ23EVR_ADDR A:0x6d02188
y.create.l HWIO_QDSS_APSS_APCS_APB_SQ31EVR_ADDR A:0x6d0218c
y.create.l HWIO_QDSS_APSS_APCS_APB_SQ32EVR_ADDR A:0x6d02190
y.create.l HWIO_QDSS_APSS_APCS_APB_SQ13EVR_ADDR A:0x6d02194
y.create.l HWIO_QDSS_APSS_APCS_APB_SQR_ADDR A:0x6d0219c
y.create.l HWIO_QDSS_APSS_APCS_APB_EXTOUTEVR1_ADDR A:0x6d021a0
y.create.l HWIO_QDSS_APSS_APCS_APB_EXTOUTEVR2_ADDR A:0x6d021a4
y.create.l HWIO_QDSS_APSS_APCS_APB_CIDCVR1_ADDR A:0x6d021b0
y.create.l HWIO_QDSS_APSS_APCS_APB_CIDCMR_ADDR A:0x6d021bc
y.create.l HWIO_QDSS_APSS_APCS_APB_SYNCFR_ADDR A:0x6d021e0
y.create.l HWIO_QDSS_APSS_APCS_APB_MDIR_ADDR A:0x6d021e4
y.create.l HWIO_QDSS_APSS_APCS_APB_CCER_ADDR A:0x6d021e8
y.create.l HWIO_QDSS_APSS_APCS_APB_EXTINSELR_ADDR A:0x6d021ec
y.create.l HWIO_QDSS_APSS_APCS_APB_TSEVR_ADDR A:0x6d021f8
y.create.l HWIO_QDSS_APSS_APCS_APB_AUXCR_ADDR A:0x6d021fc
y.create.l HWIO_QDSS_APSS_APCS_APB_TRACEIDR_ADDR A:0x6d02200
y.create.l HWIO_QDSS_APSS_APCS_APB_MIDR2_ADDR A:0x6d02208
y.create.l HWIO_QDSS_APSS_APCS_APB_VMIDCVR_ADDR A:0x6d02240
y.create.l HWIO_QDSS_APSS_APCS_APB_OSLAR_2_ADDR A:0x6d02300
y.create.l HWIO_QDSS_APSS_APCS_APB_OSLSR_2_ADDR A:0x6d02304
y.create.l HWIO_QDSS_APSS_APCS_APB_OSSRR_ADDR A:0x6d02308
y.create.l HWIO_QDSS_APSS_APCS_APB_PDCR_ADDR A:0x6d02310
y.create.l HWIO_QDSS_APSS_APCS_APB_PDSR_ADDR A:0x6d02314
y.create.l HWIO_QDSS_APSS_APCS_APB_ITETMIF_ADDR A:0x6d02ed8
y.create.l HWIO_QDSS_APSS_APCS_APB_ITMISCOUT_2_ADDR A:0x6d02edc
y.create.l HWIO_QDSS_APSS_APCS_APB_ITMISCIN_2_ADDR A:0x6d02ee0
y.create.l HWIO_QDSS_APSS_APCS_APB_ITTRIGGERREQ_ADDR A:0x6d02ee8
y.create.l HWIO_QDSS_APSS_APCS_APB_ITATBDATA0_ADDR A:0x6d02eec
y.create.l HWIO_QDSS_APSS_APCS_APB_ITATBCTR2_ADDR A:0x6d02ef0
y.create.l HWIO_QDSS_APSS_APCS_APB_ITATBCTR1_ADDR A:0x6d02ef4
y.create.l HWIO_QDSS_APSS_APCS_APB_ITATBCTR0_ADDR A:0x6d02ef8
y.create.l HWIO_QDSS_APSS_APCS_APB_ITCTRL_2_ADDR A:0x6d02f00
y.create.l HWIO_QDSS_APSS_APCS_APB_CLAIMSET_2_ADDR A:0x6d02fa0
y.create.l HWIO_QDSS_APSS_APCS_APB_CLAIMCLR_2_ADDR A:0x6d02fa4
y.create.l HWIO_QDSS_APSS_APCS_APB_LAR_ADDR A:0x6d02fb0
y.create.l HWIO_QDSS_APSS_APCS_APB_LSR_ADDR A:0x6d02fb4
y.create.l HWIO_QDSS_APSS_APCS_APB_AUTHSTATUS_2_ADDR A:0x6d02fb8
y.create.l HWIO_QDSS_APSS_APCS_APB_DEVID_2_ADDR A:0x6d02fc8
y.create.l HWIO_QDSS_APSS_APCS_APB_DEVTYPE_2_ADDR A:0x6d02fcc
y.create.l HWIO_QDSS_APSS_APCS_APB_PIR4_ADDR A:0x6d02fd0
y.create.l HWIO_QDSS_APSS_APCS_APB_PIR5_ADDR A:0x6d02fd4
y.create.l HWIO_QDSS_APSS_APCS_APB_PIR6_ADDR A:0x6d02fd8
y.create.l HWIO_QDSS_APSS_APCS_APB_PIR7_ADDR A:0x6d02fdc
y.create.l HWIO_QDSS_APSS_APCS_APB_PIR0_ADDR A:0x6d02fe0
y.create.l HWIO_QDSS_APSS_APCS_APB_PIR1_ADDR A:0x6d02fe4
y.create.l HWIO_QDSS_APSS_APCS_APB_PIR2_ADDR A:0x6d02fe8
y.create.l HWIO_QDSS_APSS_APCS_APB_PIR3_ADDR A:0x6d02fec
y.create.l HWIO_QDSS_APSS_APCS_APB_CIR0_ADDR A:0x6d02ff0
y.create.l HWIO_QDSS_APSS_APCS_APB_CIR1_ADDR A:0x6d02ff4
y.create.l HWIO_QDSS_APSS_APCS_APB_CIR2_ADDR A:0x6d02ff8
y.create.l HWIO_QDSS_APSS_APCS_APB_CIR3_ADDR A:0x6d02ffc
y.create.l HWIO_QDSS_APSS_APCS_CTI_APCS_CTI_CSCTI_REG_BASE_START_ADDR A:0x6d03000
y.create.l HWIO_QDSS_APSS_APCS_CTI_APCS_CTI_CSCTI_REG_BASE_LAST_ADDR A:0x6d03ffc
y.create.l HWIO_QDSS_APSS_APCS_CTI_APCS_CTI_CSCTI_REG_BASE_END_ADDR A:0x6d04000
y.create.l HWIO_QDSS_APSS_APCS_CTI_CTICONTROL_ADDR A:0x6d03000
y.create.l HWIO_QDSS_APSS_APCS_CTI_CTIINTACK_ADDR A:0x6d03010
y.create.l HWIO_QDSS_APSS_APCS_CTI_CTIAPPSET_ADDR A:0x6d03014
y.create.l HWIO_QDSS_APSS_APCS_CTI_CTIAPPCLEAR_ADDR A:0x6d03018
y.create.l HWIO_QDSS_APSS_APCS_CTI_CTIAPPPULSE_ADDR A:0x6d0301c
y.create.l HWIO_QDSS_APSS_APCS_CTI_CTIINEN0_ADDR A:0x6d03020
y.create.l HWIO_QDSS_APSS_APCS_CTI_CTIINEN1_ADDR A:0x6d03024
y.create.l HWIO_QDSS_APSS_APCS_CTI_CTIINEN2_ADDR A:0x6d03028
y.create.l HWIO_QDSS_APSS_APCS_CTI_CTIINEN3_ADDR A:0x6d0302c
y.create.l HWIO_QDSS_APSS_APCS_CTI_CTIINEN4_ADDR A:0x6d03030
y.create.l HWIO_QDSS_APSS_APCS_CTI_CTIINEN5_ADDR A:0x6d03034
y.create.l HWIO_QDSS_APSS_APCS_CTI_CTIINEN6_ADDR A:0x6d03038
y.create.l HWIO_QDSS_APSS_APCS_CTI_CTIINEN7_ADDR A:0x6d0303c
y.create.l HWIO_QDSS_APSS_APCS_CTI_CTIOUTEN0_ADDR A:0x6d030a0
y.create.l HWIO_QDSS_APSS_APCS_CTI_CTIOUTEN1_ADDR A:0x6d030a4
y.create.l HWIO_QDSS_APSS_APCS_CTI_CTIOUTEN2_ADDR A:0x6d030a8
y.create.l HWIO_QDSS_APSS_APCS_CTI_CTIOUTEN3_ADDR A:0x6d030ac
y.create.l HWIO_QDSS_APSS_APCS_CTI_CTIOUTEN4_ADDR A:0x6d030b0
y.create.l HWIO_QDSS_APSS_APCS_CTI_CTIOUTEN5_ADDR A:0x6d030b4
y.create.l HWIO_QDSS_APSS_APCS_CTI_CTIOUTEN6_ADDR A:0x6d030b8
y.create.l HWIO_QDSS_APSS_APCS_CTI_CTIOUTEN7_ADDR A:0x6d030bc
y.create.l HWIO_QDSS_APSS_APCS_CTI_CTITRIGINSTATUS_ADDR A:0x6d03130
y.create.l HWIO_QDSS_APSS_APCS_CTI_CTITRIGOUTSTATUS_ADDR A:0x6d03134
y.create.l HWIO_QDSS_APSS_APCS_CTI_CTICHINSTATUS_ADDR A:0x6d03138
y.create.l HWIO_QDSS_APSS_APCS_CTI_CTICHOUTSTATUS_ADDR A:0x6d0313c
y.create.l HWIO_QDSS_APSS_APCS_CTI_CTIGATE_ADDR A:0x6d03140
y.create.l HWIO_QDSS_APSS_APCS_CTI_ASICCTL_ADDR A:0x6d03144
y.create.l HWIO_QDSS_APSS_APCS_CTI_ITCHINACK_ADDR A:0x6d03edc
y.create.l HWIO_QDSS_APSS_APCS_CTI_ITTRIGINACK_ADDR A:0x6d03ee0
y.create.l HWIO_QDSS_APSS_APCS_CTI_ITCHOUT_ADDR A:0x6d03ee4
y.create.l HWIO_QDSS_APSS_APCS_CTI_ITTRIGOUT_ADDR A:0x6d03ee8
y.create.l HWIO_QDSS_APSS_APCS_CTI_ITCHOUTACK_ADDR A:0x6d03eec
y.create.l HWIO_QDSS_APSS_APCS_CTI_ITTRIGOUTACK_ADDR A:0x6d03ef0
y.create.l HWIO_QDSS_APSS_APCS_CTI_ITCHIN_ADDR A:0x6d03ef4
y.create.l HWIO_QDSS_APSS_APCS_CTI_ITTRIGIN_ADDR A:0x6d03ef8
y.create.l HWIO_QDSS_APSS_APCS_CTI_ITCTRL_ADDR A:0x6d03f00
y.create.l HWIO_QDSS_APSS_APCS_CTI_CLAIMSET_ADDR A:0x6d03fa0
y.create.l HWIO_QDSS_APSS_APCS_CTI_CLAIMCLR_ADDR A:0x6d03fa4
y.create.l HWIO_QDSS_APSS_APCS_CTI_LAR_ADDR A:0x6d03fb0
y.create.l HWIO_QDSS_APSS_APCS_CTI_LSR_ADDR A:0x6d03fb4
y.create.l HWIO_QDSS_APSS_APCS_CTI_AUTHSTATUS_ADDR A:0x6d03fb8
y.create.l HWIO_QDSS_APSS_APCS_CTI_DEVID_ADDR A:0x6d03fc8
y.create.l HWIO_QDSS_APSS_APCS_CTI_DEVTYPE_ADDR A:0x6d03fcc
y.create.l HWIO_QDSS_APSS_APCS_CTI_PERIPHID0_ADDR A:0x6d03fe0
y.create.l HWIO_QDSS_APSS_APCS_CTI_PERIPHID1_ADDR A:0x6d03fe4
y.create.l HWIO_QDSS_APSS_APCS_CTI_PERIPHID2_ADDR A:0x6d03fe8
y.create.l HWIO_QDSS_APSS_APCS_CTI_PERIPHID3_ADDR A:0x6d03fec
y.create.l HWIO_QDSS_APSS_APCS_CTI_PERIPHID4_ADDR A:0x6d03fd0
y.create.l HWIO_QDSS_APSS_APCS_CTI_PERIPHID5_ADDR A:0x6d03fd4
y.create.l HWIO_QDSS_APSS_APCS_CTI_PERIPHID6_ADDR A:0x6d03fd8
y.create.l HWIO_QDSS_APSS_APCS_CTI_PERIPHID7_ADDR A:0x6d03fdc
y.create.l HWIO_QDSS_APSS_APCS_CTI_COMPID0_ADDR A:0x6d03ff0
y.create.l HWIO_QDSS_APSS_APCS_CTI_COMPID1_ADDR A:0x6d03ff4
y.create.l HWIO_QDSS_APSS_APCS_CTI_COMPID2_ADDR A:0x6d03ff8
y.create.l HWIO_QDSS_APSS_APCS_CTI_COMPID3_ADDR A:0x6d03ffc
y.create.l HWIO_QDSS_TPDM_TPDM_ATB64_APCLK_DSB256_SUB_REG_BASE_START_ADDR A:0x6c28280
y.create.l HWIO_QDSS_TPDM_TPDM_ATB64_APCLK_DSB256_SUB_REG_BASE_LAST_ADDR A:0x6c28ffc
y.create.l HWIO_QDSS_TPDM_TPDM_ATB64_APCLK_DSB256_SUB_REG_BASE_END_ADDR A:0x6c29000
y.create.l HWIO_QDSS_TPDM_TPDM_DSB_CR_ADDR A:0x6c28780
y.create.l HWIO_QDSS_TPDM_TPDM_DSB_TIER_ADDR A:0x6c28784
y.create.l HWIO_QDSS_TPDM_TPDM_DSB_TPR0_ADDR A:0x6c28788
y.create.l HWIO_QDSS_TPDM_TPDM_DSB_TPR1_ADDR A:0x6c2878c
y.create.l HWIO_QDSS_TPDM_TPDM_DSB_TPR2_ADDR A:0x6c28790
y.create.l HWIO_QDSS_TPDM_TPDM_DSB_TPR3_ADDR A:0x6c28794
y.create.l HWIO_QDSS_TPDM_TPDM_DSB_TPR4_ADDR A:0x6c28798
y.create.l HWIO_QDSS_TPDM_TPDM_DSB_TPR5_ADDR A:0x6c2879c
y.create.l HWIO_QDSS_TPDM_TPDM_DSB_TPR6_ADDR A:0x6c287a0
y.create.l HWIO_QDSS_TPDM_TPDM_DSB_TPR7_ADDR A:0x6c287a4
y.create.l HWIO_QDSS_TPDM_TPDM_DSB_TPMR0_ADDR A:0x6c287a8
y.create.l HWIO_QDSS_TPDM_TPDM_DSB_TPMR1_ADDR A:0x6c287ac
y.create.l HWIO_QDSS_TPDM_TPDM_DSB_TPMR2_ADDR A:0x6c287b0
y.create.l HWIO_QDSS_TPDM_TPDM_DSB_TPMR3_ADDR A:0x6c287b4
y.create.l HWIO_QDSS_TPDM_TPDM_DSB_TPMR4_ADDR A:0x6c287b8
y.create.l HWIO_QDSS_TPDM_TPDM_DSB_TPMR5_ADDR A:0x6c287bc
y.create.l HWIO_QDSS_TPDM_TPDM_DSB_TPMR6_ADDR A:0x6c287c0
y.create.l HWIO_QDSS_TPDM_TPDM_DSB_TPMR7_ADDR A:0x6c287c4
y.create.l HWIO_QDSS_TPDM_TPDM_DSB_XPR0_ADDR A:0x6c287c8
y.create.l HWIO_QDSS_TPDM_TPDM_DSB_XPR1_ADDR A:0x6c287cc
y.create.l HWIO_QDSS_TPDM_TPDM_DSB_XPR2_ADDR A:0x6c287d0
y.create.l HWIO_QDSS_TPDM_TPDM_DSB_XPR3_ADDR A:0x6c287d4
y.create.l HWIO_QDSS_TPDM_TPDM_DSB_XPR4_ADDR A:0x6c287d8
y.create.l HWIO_QDSS_TPDM_TPDM_DSB_XPR5_ADDR A:0x6c287dc
y.create.l HWIO_QDSS_TPDM_TPDM_DSB_XPR6_ADDR A:0x6c287e0
y.create.l HWIO_QDSS_TPDM_TPDM_DSB_XPR7_ADDR A:0x6c287e4
y.create.l HWIO_QDSS_TPDM_TPDM_DSB_XPMR0_ADDR A:0x6c287e8
y.create.l HWIO_QDSS_TPDM_TPDM_DSB_XPMR1_ADDR A:0x6c287ec
y.create.l HWIO_QDSS_TPDM_TPDM_DSB_XPMR2_ADDR A:0x6c287f0
y.create.l HWIO_QDSS_TPDM_TPDM_DSB_XPMR3_ADDR A:0x6c287f4
y.create.l HWIO_QDSS_TPDM_TPDM_DSB_XPMR4_ADDR A:0x6c287f8
y.create.l HWIO_QDSS_TPDM_TPDM_DSB_XPMR5_ADDR A:0x6c287fc
y.create.l HWIO_QDSS_TPDM_TPDM_DSB_XPMR6_ADDR A:0x6c28800
y.create.l HWIO_QDSS_TPDM_TPDM_DSB_XPMR7_ADDR A:0x6c28804
y.create.l HWIO_QDSS_TPDM_TPDM_DSB_EDCR0_ADDR A:0x6c28808
y.create.l HWIO_QDSS_TPDM_TPDM_DSB_EDCR1_ADDR A:0x6c2880c
y.create.l HWIO_QDSS_TPDM_TPDM_DSB_EDCR2_ADDR A:0x6c28810
y.create.l HWIO_QDSS_TPDM_TPDM_DSB_EDCR3_ADDR A:0x6c28814
y.create.l HWIO_QDSS_TPDM_TPDM_DSB_EDCR4_ADDR A:0x6c28818
y.create.l HWIO_QDSS_TPDM_TPDM_DSB_EDCR5_ADDR A:0x6c2881c
y.create.l HWIO_QDSS_TPDM_TPDM_DSB_EDCR6_ADDR A:0x6c28820
y.create.l HWIO_QDSS_TPDM_TPDM_DSB_EDCR7_ADDR A:0x6c28824
y.create.l HWIO_QDSS_TPDM_TPDM_DSB_EDCR8_ADDR A:0x6c28828
y.create.l HWIO_QDSS_TPDM_TPDM_DSB_EDCR9_ADDR A:0x6c2882c
y.create.l HWIO_QDSS_TPDM_TPDM_DSB_EDCR15_ADDR A:0x6c28844
y.create.l HWIO_QDSS_TPDM_TPDM_DSB_EDCMR0_ADDR A:0x6c28848
y.create.l HWIO_QDSS_TPDM_TPDM_DSB_EDCMR1_ADDR A:0x6c2884c
y.create.l HWIO_QDSS_TPDM_TPDM_DSB_EDCMR2_ADDR A:0x6c28850
y.create.l HWIO_QDSS_TPDM_TPDM_DSB_EDCMR3_ADDR A:0x6c28854
y.create.l HWIO_QDSS_TPDM_TPDM_DSB_EDCMR4_ADDR A:0x6c28858
y.create.l HWIO_QDSS_TPDM_TPDM_DSB_EDCMR5_ADDR A:0x6c2885c
y.create.l HWIO_QDSS_TPDM_TPDM_DSB_EDCMR6_ADDR A:0x6c28860
y.create.l HWIO_QDSS_TPDM_TPDM_DSB_EDCMR7_ADDR A:0x6c28864
y.create.l HWIO_QDSS_TPDM_TPDM_DSB_READCTL_ADDR A:0x6c28970
y.create.l HWIO_QDSS_TPDM_TPDM_DSB_READVAL_ADDR A:0x6c28974
y.create.l HWIO_QDSS_TPDM_TPDM_DSB_MSR0_ADDR A:0x6c28980
y.create.l HWIO_QDSS_TPDM_TPDM_DSB_MSR1_ADDR A:0x6c28984
y.create.l HWIO_QDSS_TPDM_TPDM_DSB_MSR2_ADDR A:0x6c28988
y.create.l HWIO_QDSS_TPDM_TPDM_DSB_MSR3_ADDR A:0x6c2898c
y.create.l HWIO_QDSS_TPDM_TPDM_DSB_MSR4_ADDR A:0x6c28990
y.create.l HWIO_QDSS_TPDM_TPDM_DSB_MSR5_ADDR A:0x6c28994
y.create.l HWIO_QDSS_TPDM_TPDM_DSB_MSR6_ADDR A:0x6c28998
y.create.l HWIO_QDSS_TPDM_TPDM_DSB_MSR7_ADDR A:0x6c2899c
y.create.l HWIO_QDSS_TPDM_TPDM_DSB_MSR8_ADDR A:0x6c289a0
y.create.l HWIO_QDSS_TPDM_TPDM_DSB_MSR9_ADDR A:0x6c289a4
y.create.l HWIO_QDSS_TPDM_TPDM_DSB_MSR10_ADDR A:0x6c289a8
y.create.l HWIO_QDSS_TPDM_TPDM_DSB_MSR11_ADDR A:0x6c289ac
y.create.l HWIO_QDSS_TPDM_TPDM_DSB_MSR12_ADDR A:0x6c289b0
y.create.l HWIO_QDSS_TPDM_TPDM_DSB_MSR13_ADDR A:0x6c289b4
y.create.l HWIO_QDSS_TPDM_TPDM_DSB_MSR14_ADDR A:0x6c289b8
y.create.l HWIO_QDSS_TPDM_TPDM_DSB_MSR15_ADDR A:0x6c289bc
y.create.l HWIO_QDSS_TPDM_TPDM_DSB_MSR16_ADDR A:0x6c289c0
y.create.l HWIO_QDSS_TPDM_TPDM_DSB_MSR17_ADDR A:0x6c289c4
y.create.l HWIO_QDSS_TPDM_TPDM_DSB_MSR18_ADDR A:0x6c289c8
y.create.l HWIO_QDSS_TPDM_TPDM_DSB_MSR19_ADDR A:0x6c289cc
y.create.l HWIO_QDSS_TPDM_TPDM_DSB_MSR20_ADDR A:0x6c289d0
y.create.l HWIO_QDSS_TPDM_TPDM_DSB_MSR21_ADDR A:0x6c289d4
y.create.l HWIO_QDSS_TPDM_TPDM_DSB_MSR22_ADDR A:0x6c289d8
y.create.l HWIO_QDSS_TPDM_TPDM_DSB_MSR23_ADDR A:0x6c289dc
y.create.l HWIO_QDSS_TPDM_TPDM_DSB_MSR24_ADDR A:0x6c289e0
y.create.l HWIO_QDSS_TPDM_TPDM_DSB_MSR25_ADDR A:0x6c289e4
y.create.l HWIO_QDSS_TPDM_TPDM_DSB_MSR26_ADDR A:0x6c289e8
y.create.l HWIO_QDSS_TPDM_TPDM_DSB_MSR27_ADDR A:0x6c289ec
y.create.l HWIO_QDSS_TPDM_TPDM_DSB_MSR28_ADDR A:0x6c289f0
y.create.l HWIO_QDSS_TPDM_TPDM_DSB_MSR29_ADDR A:0x6c289f4
y.create.l HWIO_QDSS_TPDM_TPDM_DSB_MSR30_ADDR A:0x6c289f8
y.create.l HWIO_QDSS_TPDM_TPDM_DSB_MSR31_ADDR A:0x6c289fc
y.create.l HWIO_QDSS_TPDM_TPDM_ITATBCNTRL_ADDR A:0x6c28ef0
y.create.l HWIO_QDSS_TPDM_TPDM_ITCNTRL_ADDR A:0x6c28f00
y.create.l HWIO_QDSS_TPDM_TPDM_CLAIMSET_ADDR A:0x6c28fa0
y.create.l HWIO_QDSS_TPDM_TPDM_CLAIMCLR_ADDR A:0x6c28fa4
y.create.l HWIO_QDSS_TPDM_TPDM_DEVAFF0_ADDR A:0x6c28fa8
y.create.l HWIO_QDSS_TPDM_TPDM_DEVAFF1_ADDR A:0x6c28fac
y.create.l HWIO_QDSS_TPDM_TPDM_LAR_ADDR A:0x6c28fb0
y.create.l HWIO_QDSS_TPDM_TPDM_LSR_ADDR A:0x6c28fb4
y.create.l HWIO_QDSS_TPDM_TPDM_AUTHSTATUS_ADDR A:0x6c28fb8
y.create.l HWIO_QDSS_TPDM_TPDM_DEVARCH_ADDR A:0x6c28fbc
y.create.l HWIO_QDSS_TPDM_TPDM_DEVID1_ADDR A:0x6c28fc4
y.create.l HWIO_QDSS_TPDM_TPDM_DEVID_ADDR A:0x6c28fc8
y.create.l HWIO_QDSS_TPDM_TPDM_DEVTYPE_ADDR A:0x6c28fcc
y.create.l HWIO_QDSS_TPDM_TPDM_PIDR4_ADDR A:0x6c28fd0
y.create.l HWIO_QDSS_TPDM_TPDM_PIDR5_ADDR A:0x6c28fd4
y.create.l HWIO_QDSS_TPDM_TPDM_PIDR6_ADDR A:0x6c28fd8
y.create.l HWIO_QDSS_TPDM_TPDM_PIDR7_ADDR A:0x6c28fdc
y.create.l HWIO_QDSS_TPDM_TPDM_PIDR0_ADDR A:0x6c28fe0
y.create.l HWIO_QDSS_TPDM_TPDM_PIDR1_ADDR A:0x6c28fe4
y.create.l HWIO_QDSS_TPDM_TPDM_PIDR2_ADDR A:0x6c28fe8
y.create.l HWIO_QDSS_TPDM_TPDM_PIDR3_ADDR A:0x6c28fec
y.create.l HWIO_QDSS_TPDM_TPDM_CIDR0_ADDR A:0x6c28ff0
y.create.l HWIO_QDSS_TPDM_TPDM_CIDR1_ADDR A:0x6c28ff4
y.create.l HWIO_QDSS_TPDM_TPDM_CIDR2_ADDR A:0x6c28ff8
y.create.l HWIO_QDSS_TPDM_TPDM_CIDR3_ADDR A:0x6c28ffc
y.create.l HWIO_QDSS_RPM_RPM_CSCTI_REG_BASE_START_ADDR A:0x6b00000
y.create.l HWIO_QDSS_RPM_RPM_CSCTI_REG_BASE_LAST_ADDR A:0x6b00ffc
y.create.l HWIO_QDSS_RPM_RPM_CSCTI_REG_BASE_END_ADDR A:0x6b01000
y.create.l HWIO_QDSS_RPM_CTICONTROL_ADDR A:0x6b00000
y.create.l HWIO_QDSS_RPM_CTIINTACK_ADDR A:0x6b00010
y.create.l HWIO_QDSS_RPM_CTIAPPSET_ADDR A:0x6b00014
y.create.l HWIO_QDSS_RPM_CTIAPPCLEAR_ADDR A:0x6b00018
y.create.l HWIO_QDSS_RPM_CTIAPPPULSE_ADDR A:0x6b0001c
y.create.l HWIO_QDSS_RPM_CTIINEN0_ADDR A:0x6b00020
y.create.l HWIO_QDSS_RPM_CTIINEN1_ADDR A:0x6b00024
y.create.l HWIO_QDSS_RPM_CTIINEN2_ADDR A:0x6b00028
y.create.l HWIO_QDSS_RPM_CTIINEN3_ADDR A:0x6b0002c
y.create.l HWIO_QDSS_RPM_CTIINEN4_ADDR A:0x6b00030
y.create.l HWIO_QDSS_RPM_CTIINEN5_ADDR A:0x6b00034
y.create.l HWIO_QDSS_RPM_CTIINEN6_ADDR A:0x6b00038
y.create.l HWIO_QDSS_RPM_CTIINEN7_ADDR A:0x6b0003c
y.create.l HWIO_QDSS_RPM_CTIOUTEN0_ADDR A:0x6b000a0
y.create.l HWIO_QDSS_RPM_CTIOUTEN1_ADDR A:0x6b000a4
y.create.l HWIO_QDSS_RPM_CTIOUTEN2_ADDR A:0x6b000a8
y.create.l HWIO_QDSS_RPM_CTIOUTEN3_ADDR A:0x6b000ac
y.create.l HWIO_QDSS_RPM_CTIOUTEN4_ADDR A:0x6b000b0
y.create.l HWIO_QDSS_RPM_CTIOUTEN5_ADDR A:0x6b000b4
y.create.l HWIO_QDSS_RPM_CTIOUTEN6_ADDR A:0x6b000b8
y.create.l HWIO_QDSS_RPM_CTIOUTEN7_ADDR A:0x6b000bc
y.create.l HWIO_QDSS_RPM_CTITRIGINSTATUS_ADDR A:0x6b00130
y.create.l HWIO_QDSS_RPM_CTITRIGOUTSTATUS_ADDR A:0x6b00134
y.create.l HWIO_QDSS_RPM_CTICHINSTATUS_ADDR A:0x6b00138
y.create.l HWIO_QDSS_RPM_CTICHOUTSTATUS_ADDR A:0x6b0013c
y.create.l HWIO_QDSS_RPM_CTIGATE_ADDR A:0x6b00140
y.create.l HWIO_QDSS_RPM_ASICCTL_ADDR A:0x6b00144
y.create.l HWIO_QDSS_RPM_ITCHINACK_ADDR A:0x6b00edc
y.create.l HWIO_QDSS_RPM_ITTRIGINACK_ADDR A:0x6b00ee0
y.create.l HWIO_QDSS_RPM_ITCHOUT_ADDR A:0x6b00ee4
y.create.l HWIO_QDSS_RPM_ITTRIGOUT_ADDR A:0x6b00ee8
y.create.l HWIO_QDSS_RPM_ITCHOUTACK_ADDR A:0x6b00eec
y.create.l HWIO_QDSS_RPM_ITTRIGOUTACK_ADDR A:0x6b00ef0
y.create.l HWIO_QDSS_RPM_ITCHIN_ADDR A:0x6b00ef4
y.create.l HWIO_QDSS_RPM_ITTRIGIN_ADDR A:0x6b00ef8
y.create.l HWIO_QDSS_RPM_ITCTRL_ADDR A:0x6b00f00
y.create.l HWIO_QDSS_RPM_CLAIMSET_ADDR A:0x6b00fa0
y.create.l HWIO_QDSS_RPM_CLAIMCLR_ADDR A:0x6b00fa4
y.create.l HWIO_QDSS_RPM_LAR_ADDR A:0x6b00fb0
y.create.l HWIO_QDSS_RPM_LSR_ADDR A:0x6b00fb4
y.create.l HWIO_QDSS_RPM_AUTHSTATUS_ADDR A:0x6b00fb8
y.create.l HWIO_QDSS_RPM_DEVID_ADDR A:0x6b00fc8
y.create.l HWIO_QDSS_RPM_DEVTYPE_ADDR A:0x6b00fcc
y.create.l HWIO_QDSS_RPM_PERIPHID0_ADDR A:0x6b00fe0
y.create.l HWIO_QDSS_RPM_PERIPHID1_ADDR A:0x6b00fe4
y.create.l HWIO_QDSS_RPM_PERIPHID2_ADDR A:0x6b00fe8
y.create.l HWIO_QDSS_RPM_PERIPHID3_ADDR A:0x6b00fec
y.create.l HWIO_QDSS_RPM_PERIPHID4_ADDR A:0x6b00fd0
y.create.l HWIO_QDSS_RPM_PERIPHID5_ADDR A:0x6b00fd4
y.create.l HWIO_QDSS_RPM_PERIPHID6_ADDR A:0x6b00fd8
y.create.l HWIO_QDSS_RPM_PERIPHID7_ADDR A:0x6b00fdc
y.create.l HWIO_QDSS_RPM_COMPID0_ADDR A:0x6b00ff0
y.create.l HWIO_QDSS_RPM_COMPID1_ADDR A:0x6b00ff4
y.create.l HWIO_QDSS_RPM_COMPID2_ADDR A:0x6b00ff8
y.create.l HWIO_QDSS_RPM_COMPID3_ADDR A:0x6b00ffc
y.create.l HWIO_QDSS_DCC_DCC_TPDM_TPDM_ATB8_ATCLK_CMB32_CS6DCF0636_SUB_REG_BASE_START_ADDR A:0x6870280
y.create.l HWIO_QDSS_DCC_DCC_TPDM_TPDM_ATB8_ATCLK_CMB32_CS6DCF0636_SUB_REG_BASE_LAST_ADDR A:0x6870ffc
y.create.l HWIO_QDSS_DCC_DCC_TPDM_TPDM_ATB8_ATCLK_CMB32_CS6DCF0636_SUB_REG_BASE_END_ADDR A:0x6871000
y.create.l HWIO_QDSS_DCC_DCC_TPDM_TPDM_CMB_CR_ADDR A:0x6870a00
y.create.l HWIO_QDSS_DCC_DCC_TPDM_TPDM_CMB_TIER_ADDR A:0x6870a04
y.create.l HWIO_QDSS_DCC_DCC_TPDM_TPDM_CMB_TPR0_ADDR A:0x6870a08
y.create.l HWIO_QDSS_DCC_DCC_TPDM_TPDM_CMB_TPMR0_ADDR A:0x6870a10
y.create.l HWIO_QDSS_DCC_DCC_TPDM_TPDM_CMB_XPR0_ADDR A:0x6870a18
y.create.l HWIO_QDSS_DCC_DCC_TPDM_TPDM_CMB_XPMR0_ADDR A:0x6870a20
y.create.l HWIO_QDSS_DCC_DCC_TPDM_TPDM_CMB_READVAL_ADDR A:0x6870a74
y.create.l HWIO_QDSS_DCC_DCC_TPDM_TPDM_ITATBCNTRL_ADDR A:0x6870ef0
y.create.l HWIO_QDSS_DCC_DCC_TPDM_TPDM_ITCNTRL_ADDR A:0x6870f00
y.create.l HWIO_QDSS_DCC_DCC_TPDM_TPDM_CLAIMSET_ADDR A:0x6870fa0
y.create.l HWIO_QDSS_DCC_DCC_TPDM_TPDM_CLAIMCLR_ADDR A:0x6870fa4
y.create.l HWIO_QDSS_DCC_DCC_TPDM_TPDM_DEVAFF0_ADDR A:0x6870fa8
y.create.l HWIO_QDSS_DCC_DCC_TPDM_TPDM_DEVAFF1_ADDR A:0x6870fac
y.create.l HWIO_QDSS_DCC_DCC_TPDM_TPDM_LAR_ADDR A:0x6870fb0
y.create.l HWIO_QDSS_DCC_DCC_TPDM_TPDM_LSR_ADDR A:0x6870fb4
y.create.l HWIO_QDSS_DCC_DCC_TPDM_TPDM_AUTHSTATUS_ADDR A:0x6870fb8
y.create.l HWIO_QDSS_DCC_DCC_TPDM_TPDM_DEVARCH_ADDR A:0x6870fbc
y.create.l HWIO_QDSS_DCC_DCC_TPDM_TPDM_DEVID1_ADDR A:0x6870fc4
y.create.l HWIO_QDSS_DCC_DCC_TPDM_TPDM_DEVID_ADDR A:0x6870fc8
y.create.l HWIO_QDSS_DCC_DCC_TPDM_TPDM_DEVTYPE_ADDR A:0x6870fcc
y.create.l HWIO_QDSS_DCC_DCC_TPDM_TPDM_PIDR4_ADDR A:0x6870fd0
y.create.l HWIO_QDSS_DCC_DCC_TPDM_TPDM_PIDR5_ADDR A:0x6870fd4
y.create.l HWIO_QDSS_DCC_DCC_TPDM_TPDM_PIDR6_ADDR A:0x6870fd8
y.create.l HWIO_QDSS_DCC_DCC_TPDM_TPDM_PIDR7_ADDR A:0x6870fdc
y.create.l HWIO_QDSS_DCC_DCC_TPDM_TPDM_PIDR0_ADDR A:0x6870fe0
y.create.l HWIO_QDSS_DCC_DCC_TPDM_TPDM_PIDR1_ADDR A:0x6870fe4
y.create.l HWIO_QDSS_DCC_DCC_TPDM_TPDM_PIDR2_ADDR A:0x6870fe8
y.create.l HWIO_QDSS_DCC_DCC_TPDM_TPDM_PIDR3_ADDR A:0x6870fec
y.create.l HWIO_QDSS_DCC_DCC_TPDM_TPDM_CIDR0_ADDR A:0x6870ff0
y.create.l HWIO_QDSS_DCC_DCC_TPDM_TPDM_CIDR1_ADDR A:0x6870ff4
y.create.l HWIO_QDSS_DCC_DCC_TPDM_TPDM_CIDR2_ADDR A:0x6870ff8
y.create.l HWIO_QDSS_DCC_DCC_TPDM_TPDM_CIDR3_ADDR A:0x6870ffc
y.create.l HWIO_QDSS_MSS_Q6_QDSP6SS_QDSP6SS_Q6V67X_ETM_REG_BASE_START_ADDR A:0x6800000
y.create.l HWIO_QDSS_MSS_Q6_QDSP6SS_QDSP6SS_Q6V67X_ETM_REG_BASE_LAST_ADDR A:0x68000d8
y.create.l HWIO_QDSS_MSS_Q6_QDSP6SS_QDSP6SS_Q6V67X_ETM_REG_BASE_END_ADDR A:0x6800800
y.create.l HWIO_QDSS_MSS_Q6_QDSP6SS_QDSP6_ETM_CLK_EN_ADDR A:0x6800000
y.create.l HWIO_QDSS_MSS_Q6_QDSP6SS_QDSP6_ETM_CTRL_ADDR A:0x6800004
y.create.l HWIO_QDSS_MSS_Q6_QDSP6SS_QDSP6_ETM_RESET_ADDR A:0x6800008
y.create.l HWIO_QDSS_MSS_Q6_QDSP6SS_QDSP6_ETM_VERSION_ADDR A:0x680000c
y.create.l HWIO_QDSS_MSS_Q6_QDSP6SS_QDSP6_ETM_ATID_ADDR A:0x68000d4
y.create.l HWIO_QDSS_MSS_Q6_QDSP6SS_QDSP6_ETM_SEQ_STATE_ADDR A:0x68000d0
y.create.l HWIO_QDSS_MSS_Q6_QDSP6SS_QDSP6_ETM_SEQ_TCTRL0_ADDR A:0x6800080
y.create.l HWIO_QDSS_MSS_Q6_QDSP6SS_QDSP6_ETM_SEQ_TCTRL1_ADDR A:0x6800084
y.create.l HWIO_QDSS_MSS_Q6_QDSP6SS_QDSP6_ETM_ASYNC_PERIOD_ADDR A:0x68000b8
y.create.l HWIO_QDSS_MSS_Q6_QDSP6SS_QDSP6_ETM_ISYNC_PERIOD_ADDR A:0x68000bc
y.create.l HWIO_QDSS_MSS_Q6_QDSP6SS_QDSP6_ETM_GSYNC_PERIOD_ADDR A:0x68000c0
y.create.l HWIO_QDSS_MSS_Q6_QDSP6SS_QDSP6_ETM_GSYNC_COUNTER_LOW_ADDR A:0x68000c4
y.create.l HWIO_QDSS_MSS_Q6_QDSP6SS_QDSP6_ETM_GSYNC_COUNTER_HIGHT_ADDR A:0x68000c8
y.create.l HWIO_QDSS_MSS_Q6_QDSP6SS_QDSP6_ETM_TEST_BUS_CTRL_ADDR A:0x68000cc
y.create.l HWIO_QDSS_MSS_Q6_QDSP6SS_QDSP6_ETM_ETB_RD_PTR_ADDR A:0x6800098
y.create.l HWIO_QDSS_MSS_Q6_QDSP6SS_QDSP6_ETM_ETB_WR_PTR_ADDR A:0x680009c
y.create.l HWIO_QDSS_MSS_Q6_QDSP6SS_QDSP6_ETM_ETB_TR_CNT_ADDR A:0x68000a0
y.create.l HWIO_QDSS_MSS_Q6_QDSP6SS_QDSP6_ETM_ETB_DEPTH_ADDR A:0x68000a4
y.create.l HWIO_QDSS_MSS_Q6_QDSP6SS_QDSP6_ETM_ETB_CTRL_ADDR A:0x68000a8
y.create.l HWIO_QDSS_MSS_Q6_QDSP6SS_QDSP6_ETM_ETB_STATUS_ADDR A:0x68000ac
y.create.l HWIO_QDSS_MSS_Q6_QDSP6SS_QDSP6_ETM_ETB_RD_BUF_ADDR A:0x68000b0
y.create.l HWIO_QDSS_MSS_Q6_QDSP6SS_QDSP6_ETM_ETB_WR_RAM_ADDR A:0x68000b4
y.create.l HWIO_QDSS_MSS_Q6_QDSP6SS_QDSP6_APB_TIMER_VALUE_ADDR A:0x68000d8
y.create.l HWIO_QDSS_MSS_Q6_QDSP6SS_QDSP6SS_Q6V67X_ISDB_REG_BASE_START_ADDR A:0x6801000
y.create.l HWIO_QDSS_MSS_Q6_QDSP6SS_QDSP6SS_Q6V67X_ISDB_REG_BASE_LAST_ADDR A:0x6801040
y.create.l HWIO_QDSS_MSS_Q6_QDSP6SS_QDSP6SS_Q6V67X_ISDB_REG_BASE_END_ADDR A:0x6802000
y.create.l HWIO_QDSS_MSS_Q6_QDSP6SS_QDSP6_ISDBST_ADDR A:0x6801000
y.create.l HWIO_QDSS_MSS_Q6_QDSP6SS_QDSP6_ISDBCFG0_ADDR A:0x6801004
y.create.l HWIO_QDSS_MSS_Q6_QDSP6SS_QDSP6_ISDBCFG1_ADDR A:0x6801008
y.create.l HWIO_QDSS_MSS_Q6_QDSP6SS_QDSP6_BRKPTINFO_ADDR A:0x680100c
y.create.l HWIO_QDSS_MSS_Q6_QDSP6SS_QDSP6_BRKPTPC0_ADDR A:0x6801010
y.create.l HWIO_QDSS_MSS_Q6_QDSP6SS_QDSP6_BRKPTCFG0_ADDR A:0x6801014
y.create.l HWIO_QDSS_MSS_Q6_QDSP6SS_QDSP6_BRKPTPC1_ADDR A:0x6801018
y.create.l HWIO_QDSS_MSS_Q6_QDSP6SS_QDSP6_BRKPTCFG1_ADDR A:0x680101c
y.create.l HWIO_QDSS_MSS_Q6_QDSP6SS_QDSP6_STFINST_ADDR A:0x6801020
y.create.l HWIO_QDSS_MSS_Q6_QDSP6SS_QDSP6_ISDBMBXIN_ADDR A:0x6801024
y.create.l HWIO_QDSS_MSS_Q6_QDSP6SS_QDSP6_ISDBMBXOUT_ADDR A:0x6801028
y.create.l HWIO_QDSS_MSS_Q6_QDSP6SS_QDSP6_ISDBCMD_ADDR A:0x680102c
y.create.l HWIO_QDSS_MSS_Q6_QDSP6SS_QDSP6_ISDBEN_ADDR A:0x6801030
y.create.l HWIO_QDSS_MSS_Q6_QDSP6SS_QDSP6_ISDBVER_ADDR A:0x6801034
y.create.l HWIO_QDSS_MSS_Q6_QDSP6SS_QDSP6_COREVER_ADDR A:0x6801038
y.create.l HWIO_QDSS_MSS_Q6_QDSP6SS_QDSP6_ISDBGPR_ADDR A:0x680103c
y.create.l HWIO_QDSS_MSS_Q6_QDSP6SS_QDSP6_ISDBCST_ADDR A:0x6801040
y.create.l HWIO_QDSS_MSS_Q6_QDSP6SS_QDSP6SS_CSCTI_REG_BASE_START_ADDR A:0x6803000
y.create.l HWIO_QDSS_MSS_Q6_QDSP6SS_QDSP6SS_CSCTI_REG_BASE_LAST_ADDR A:0x6803ffc
y.create.l HWIO_QDSS_MSS_Q6_QDSP6SS_QDSP6SS_CSCTI_REG_BASE_END_ADDR A:0x6804000
y.create.l HWIO_QDSS_MSS_Q6_QDSP6SS_CTICONTROL_ADDR A:0x6803000
y.create.l HWIO_QDSS_MSS_Q6_QDSP6SS_CTIINTACK_ADDR A:0x6803010
y.create.l HWIO_QDSS_MSS_Q6_QDSP6SS_CTIAPPSET_ADDR A:0x6803014
y.create.l HWIO_QDSS_MSS_Q6_QDSP6SS_CTIAPPCLEAR_ADDR A:0x6803018
y.create.l HWIO_QDSS_MSS_Q6_QDSP6SS_CTIAPPPULSE_ADDR A:0x680301c
y.create.l HWIO_QDSS_MSS_Q6_QDSP6SS_CTIINEN0_ADDR A:0x6803020
y.create.l HWIO_QDSS_MSS_Q6_QDSP6SS_CTIINEN1_ADDR A:0x6803024
y.create.l HWIO_QDSS_MSS_Q6_QDSP6SS_CTIINEN2_ADDR A:0x6803028
y.create.l HWIO_QDSS_MSS_Q6_QDSP6SS_CTIINEN3_ADDR A:0x680302c
y.create.l HWIO_QDSS_MSS_Q6_QDSP6SS_CTIINEN4_ADDR A:0x6803030
y.create.l HWIO_QDSS_MSS_Q6_QDSP6SS_CTIINEN5_ADDR A:0x6803034
y.create.l HWIO_QDSS_MSS_Q6_QDSP6SS_CTIINEN6_ADDR A:0x6803038
y.create.l HWIO_QDSS_MSS_Q6_QDSP6SS_CTIINEN7_ADDR A:0x680303c
y.create.l HWIO_QDSS_MSS_Q6_QDSP6SS_CTIOUTEN0_ADDR A:0x68030a0
y.create.l HWIO_QDSS_MSS_Q6_QDSP6SS_CTIOUTEN1_ADDR A:0x68030a4
y.create.l HWIO_QDSS_MSS_Q6_QDSP6SS_CTIOUTEN2_ADDR A:0x68030a8
y.create.l HWIO_QDSS_MSS_Q6_QDSP6SS_CTIOUTEN3_ADDR A:0x68030ac
y.create.l HWIO_QDSS_MSS_Q6_QDSP6SS_CTIOUTEN4_ADDR A:0x68030b0
y.create.l HWIO_QDSS_MSS_Q6_QDSP6SS_CTIOUTEN5_ADDR A:0x68030b4
y.create.l HWIO_QDSS_MSS_Q6_QDSP6SS_CTIOUTEN6_ADDR A:0x68030b8
y.create.l HWIO_QDSS_MSS_Q6_QDSP6SS_CTIOUTEN7_ADDR A:0x68030bc
y.create.l HWIO_QDSS_MSS_Q6_QDSP6SS_CTITRIGINSTATUS_ADDR A:0x6803130
y.create.l HWIO_QDSS_MSS_Q6_QDSP6SS_CTITRIGOUTSTATUS_ADDR A:0x6803134
y.create.l HWIO_QDSS_MSS_Q6_QDSP6SS_CTICHINSTATUS_ADDR A:0x6803138
y.create.l HWIO_QDSS_MSS_Q6_QDSP6SS_CTICHOUTSTATUS_ADDR A:0x680313c
y.create.l HWIO_QDSS_MSS_Q6_QDSP6SS_CTIGATE_ADDR A:0x6803140
y.create.l HWIO_QDSS_MSS_Q6_QDSP6SS_ASICCTL_ADDR A:0x6803144
y.create.l HWIO_QDSS_MSS_Q6_QDSP6SS_ITCHINACK_ADDR A:0x6803edc
y.create.l HWIO_QDSS_MSS_Q6_QDSP6SS_ITTRIGINACK_ADDR A:0x6803ee0
y.create.l HWIO_QDSS_MSS_Q6_QDSP6SS_ITCHOUT_ADDR A:0x6803ee4
y.create.l HWIO_QDSS_MSS_Q6_QDSP6SS_ITTRIGOUT_ADDR A:0x6803ee8
y.create.l HWIO_QDSS_MSS_Q6_QDSP6SS_ITCHOUTACK_ADDR A:0x6803eec
y.create.l HWIO_QDSS_MSS_Q6_QDSP6SS_ITTRIGOUTACK_ADDR A:0x6803ef0
y.create.l HWIO_QDSS_MSS_Q6_QDSP6SS_ITCHIN_ADDR A:0x6803ef4
y.create.l HWIO_QDSS_MSS_Q6_QDSP6SS_ITTRIGIN_ADDR A:0x6803ef8
y.create.l HWIO_QDSS_MSS_Q6_QDSP6SS_ITCTRL_ADDR A:0x6803f00
y.create.l HWIO_QDSS_MSS_Q6_QDSP6SS_CLAIMSET_ADDR A:0x6803fa0
y.create.l HWIO_QDSS_MSS_Q6_QDSP6SS_CLAIMCLR_ADDR A:0x6803fa4
y.create.l HWIO_QDSS_MSS_Q6_QDSP6SS_LAR_ADDR A:0x6803fb0
y.create.l HWIO_QDSS_MSS_Q6_QDSP6SS_LSR_ADDR A:0x6803fb4
y.create.l HWIO_QDSS_MSS_Q6_QDSP6SS_AUTHSTATUS_ADDR A:0x6803fb8
y.create.l HWIO_QDSS_MSS_Q6_QDSP6SS_DEVID_ADDR A:0x6803fc8
y.create.l HWIO_QDSS_MSS_Q6_QDSP6SS_DEVTYPE_ADDR A:0x6803fcc
y.create.l HWIO_QDSS_MSS_Q6_QDSP6SS_PERIPHID0_ADDR A:0x6803fe0
y.create.l HWIO_QDSS_MSS_Q6_QDSP6SS_PERIPHID1_ADDR A:0x6803fe4
y.create.l HWIO_QDSS_MSS_Q6_QDSP6SS_PERIPHID2_ADDR A:0x6803fe8
y.create.l HWIO_QDSS_MSS_Q6_QDSP6SS_PERIPHID3_ADDR A:0x6803fec
y.create.l HWIO_QDSS_MSS_Q6_QDSP6SS_PERIPHID4_ADDR A:0x6803fd0
y.create.l HWIO_QDSS_MSS_Q6_QDSP6SS_PERIPHID5_ADDR A:0x6803fd4
y.create.l HWIO_QDSS_MSS_Q6_QDSP6SS_PERIPHID6_ADDR A:0x6803fd8
y.create.l HWIO_QDSS_MSS_Q6_QDSP6SS_PERIPHID7_ADDR A:0x6803fdc
y.create.l HWIO_QDSS_MSS_Q6_QDSP6SS_COMPID0_ADDR A:0x6803ff0
y.create.l HWIO_QDSS_MSS_Q6_QDSP6SS_COMPID1_ADDR A:0x6803ff4
y.create.l HWIO_QDSS_MSS_Q6_QDSP6SS_COMPID2_ADDR A:0x6803ff8
y.create.l HWIO_QDSS_MSS_Q6_QDSP6SS_COMPID3_ADDR A:0x6803ffc
y.create.l HWIO_QDSS_QDSS_QDSS_CSR_REG_BASE_START_ADDR A:0x6001000
y.create.l HWIO_QDSS_QDSS_QDSS_CSR_REG_BASE_LAST_ADDR A:0x6001ffc
y.create.l HWIO_QDSS_QDSS_QDSS_CSR_REG_BASE_END_ADDR A:0x6002000
y.create.l HWIO_QDSS_QDSS_CS_QDSSCSR_SWDBGPWRCTRL_ADDR A:0x6001000
y.create.l HWIO_QDSS_QDSS_CS_QDSSCSR_SWDBGPWRACK_ADDR A:0x6001004
y.create.l HWIO_QDSS_QDSS_CS_QDSSCSR_SWSPADREG0_ADDR A:0x6001008
y.create.l HWIO_QDSS_QDSS_CS_QDSSCSR_SWSPADREG1_ADDR A:0x600100c
y.create.l HWIO_QDSS_QDSS_CS_QDSSCSR_STMTRANSCTRL_ADDR A:0x6001010
y.create.l HWIO_QDSS_QDSS_CS_QDSSCSR_STMAWIDCTRL_ADDR A:0x6001014
y.create.l HWIO_QDSS_QDSS_CS_QDSSCSR_STMCHNOFST0_ADDR A:0x6001018
y.create.l HWIO_QDSS_QDSS_CS_QDSSCSR_STMCHNOFST1_ADDR A:0x600101c
y.create.l HWIO_QDSS_QDSS_CS_QDSSCSR_STMEXTHWCTRL0_ADDR A:0x6001020
y.create.l HWIO_QDSS_QDSS_CS_QDSSCSR_STMEXTHWCTRL1_ADDR A:0x6001024
y.create.l HWIO_QDSS_QDSS_CS_QDSSCSR_STMEXTHWCTRL2_ADDR A:0x6001028
y.create.l HWIO_QDSS_QDSS_CS_QDSSCSR_STMEXTHWCTRL3_ADDR A:0x600102c
y.create.l HWIO_QDSS_QDSS_CS_QDSSCSR_USBBAMCTRL_ADDR A:0x6001030
y.create.l HWIO_QDSS_QDSS_CS_QDSSCSR_USBFLSHCTRL_ADDR A:0x6001034
y.create.l HWIO_QDSS_QDSS_CS_QDSSCSR_TIMESTAMPCTRL_ADDR A:0x6001038
y.create.l HWIO_QDSS_QDSS_CS_QDSSCSR_AOTIMEVAL0_ADDR A:0x600103c
y.create.l HWIO_QDSS_QDSS_CS_QDSSCSR_AOTIMEVAL1_ADDR A:0x6001040
y.create.l HWIO_QDSS_QDSS_CS_QDSSCSR_QDSSTIMEVAL0_ADDR A:0x6001044
y.create.l HWIO_QDSS_QDSS_CS_QDSSCSR_QDSSTIMEVAL1_ADDR A:0x6001048
y.create.l HWIO_QDSS_QDSS_CS_QDSSCSR_QDSSTIMELOAD0_ADDR A:0x600104c
y.create.l HWIO_QDSS_QDSS_CS_QDSSCSR_QDSSTIMELOAD1_ADDR A:0x6001050
y.create.l HWIO_QDSS_QDSS_CS_QDSSCSR_DAPAPATTR_ADDR A:0x6001054
y.create.l HWIO_QDSS_QDSS_CS_QDSSCSR_QDSSCLKVOTE_ADDR A:0x6001058
y.create.l HWIO_QDSS_QDSS_CS_QDSSCSR_QDSSCLKIPI_ADDR A:0x600105c
y.create.l HWIO_QDSS_QDSS_CS_QDSSCSR_QDSSPWRREQIGNORE_ADDR A:0x6001060
y.create.l HWIO_QDSS_QDSS_CS_QDSSCSR_QDSSSPARE_ADDR A:0x6001064
y.create.l HWIO_QDSS_QDSS_CS_QDSSCSR_IPCAT_ADDR A:0x6001068
y.create.l HWIO_QDSS_QDSS_CS_QDSSCSR_ETRIRQCTRL_ADDR A:0x600106c
y.create.l HWIO_QDSS_QDSS_CS_QDSSCSR_PRESERVEETF_ADDR A:0x6001070
y.create.l HWIO_QDSS_QDSS_CS_QDSSCSR_PRESERVEETR0_ADDR A:0x6001074
y.create.l HWIO_QDSS_QDSS_CS_QDSSCSR_PRESERVEETR1_ADDR A:0x6001078
y.create.l HWIO_QDSS_QDSS_CS_QDSSCSR_ETR_ARADDR_EXT_ADDR A:0x600107c
y.create.l HWIO_QDSS_QDSS_CS_QDSSCSR_ETR_AWADDR_EXT_ADDR A:0x6001080
y.create.l HWIO_QDSS_QDSS_CS_QDSSCSR_TS_HBEAT_VAL0_LO_ADDR A:0x6001084
y.create.l HWIO_QDSS_QDSS_CS_QDSSCSR_TS_HBEAT_VAL0_HI_ADDR A:0x6001088
y.create.l HWIO_QDSS_QDSS_CS_QDSSCSR_TS_HBEAT_VAL1_LO_ADDR A:0x600108c
y.create.l HWIO_QDSS_QDSS_CS_QDSSCSR_TS_HBEAT_VAL1_HI_ADDR A:0x6001090
y.create.l HWIO_QDSS_QDSS_CS_QDSSCSR_TS_HBEAT_MASK0_LO_ADDR A:0x6001094
y.create.l HWIO_QDSS_QDSS_CS_QDSSCSR_TS_HBEAT_MASK0_HI_ADDR A:0x6001098
y.create.l HWIO_QDSS_QDSS_CS_QDSSCSR_TS_HBEAT_MASK1_LO_ADDR A:0x600109c
y.create.l HWIO_QDSS_QDSS_CS_QDSSCSR_TS_HBEAT_MASK1_HI_ADDR A:0x60010a0
y.create.l HWIO_QDSS_QDSS_CS_QDSSCSR_TS_LEVEL_START_VAL0_LO_ADDR A:0x60010a4
y.create.l HWIO_QDSS_QDSS_CS_QDSSCSR_TS_LEVEL_START_VAL0_HI_ADDR A:0x60010a8
y.create.l HWIO_QDSS_QDSS_CS_QDSSCSR_TS_LEVEL_END_VAL0_LO_ADDR A:0x60010ac
y.create.l HWIO_QDSS_QDSS_CS_QDSSCSR_TS_LEVEL_END_VAL0_HI_ADDR A:0x60010b0
y.create.l HWIO_QDSS_QDSS_CS_QDSSCSR_TS_LEVEL_START_VAL1_LO_ADDR A:0x60010b4
y.create.l HWIO_QDSS_QDSS_CS_QDSSCSR_TS_LEVEL_START_VAL1_HI_ADDR A:0x60010b8
y.create.l HWIO_QDSS_QDSS_CS_QDSSCSR_TS_LEVEL_END_VAL1_LO_ADDR A:0x60010bc
y.create.l HWIO_QDSS_QDSS_CS_QDSSCSR_TS_LEVEL_END_VAL1_HI_ADDR A:0x60010c0
y.create.l HWIO_QDSS_QDSS_CS_QDSSCSR_HWE_TIMER_A_B_VAL_LO_ADDR A:0x60010c4
y.create.l HWIO_QDSS_QDSS_CS_QDSSCSR_HWE_TIMER_A_B_VAL_HI_ADDR A:0x60010c8
y.create.l HWIO_QDSS_QDSS_CS_QDSSCSR_HWE_TIMER_B_C_VAL_LO_ADDR A:0x60010cc
y.create.l HWIO_QDSS_QDSS_CS_QDSSCSR_HWE_TIMER_B_C_VAL_HI_ADDR A:0x60010d0
y.create.l HWIO_QDSS_QDSS_CS_QDSSCSR_HWE_SEQ_DETECT_CTRL0_ADDR A:0x60010d4
y.create.l HWIO_QDSS_QDSS_CS_QDSSCSR_QDSS_SRST_CTRL_ADDR A:0x60010d8
y.create.l HWIO_QDSS_QDSS_CS_QDSSCSR_ITCTL_ADDR A:0x6001f00
y.create.l HWIO_QDSS_QDSS_CS_QDSSCSR_CLAIMSET_ADDR A:0x6001fa0
y.create.l HWIO_QDSS_QDSS_CS_QDSSCSR_CLAIMCLR_ADDR A:0x6001fa4
y.create.l HWIO_QDSS_QDSS_CS_QDSSCSR_LOCKACCESS_ADDR A:0x6001fb0
y.create.l HWIO_QDSS_QDSS_CS_QDSSCSR_LOCKSTATUS_ADDR A:0x6001fb4
y.create.l HWIO_QDSS_QDSS_CS_QDSSCSR_AUTHSTATUS_ADDR A:0x6001fb8
y.create.l HWIO_QDSS_QDSS_CS_QDSSCSR_DEVICEID_ADDR A:0x6001fc8
y.create.l HWIO_QDSS_QDSS_CS_QDSSCSR_DEVICETYPE_ADDR A:0x6001fcc
y.create.l HWIO_QDSS_QDSS_CS_QDSSCSR_PERIPHID4_ADDR A:0x6001fd0
y.create.l HWIO_QDSS_QDSS_CS_QDSSCSR_PERIPHID5_ADDR A:0x6001fd4
y.create.l HWIO_QDSS_QDSS_CS_QDSSCSR_PERIPHID6_ADDR A:0x6001fd8
y.create.l HWIO_QDSS_QDSS_CS_QDSSCSR_PERIPHID7_ADDR A:0x6001fdc
y.create.l HWIO_QDSS_QDSS_CS_QDSSCSR_PERIPHID0_ADDR A:0x6001fe0
y.create.l HWIO_QDSS_QDSS_CS_QDSSCSR_PERIPHID1_ADDR A:0x6001fe4
y.create.l HWIO_QDSS_QDSS_CS_QDSSCSR_PERIPHID2_ADDR A:0x6001fe8
y.create.l HWIO_QDSS_QDSS_CS_QDSSCSR_PERIPHID3_ADDR A:0x6001fec
y.create.l HWIO_QDSS_QDSS_CS_QDSSCSR_COMPID0_ADDR A:0x6001ff0
y.create.l HWIO_QDSS_QDSS_CS_QDSSCSR_COMPID1_ADDR A:0x6001ff4
y.create.l HWIO_QDSS_QDSS_CS_QDSSCSR_COMPID2_ADDR A:0x6001ff8
y.create.l HWIO_QDSS_QDSS_CS_QDSSCSR_COMPID3_ADDR A:0x6001ffc
y.create.l HWIO_QDSS_QDSS_CXSTM_8_32_32_TRUE_REG_BASE_START_ADDR A:0x6002000
y.create.l HWIO_QDSS_QDSS_CXSTM_8_32_32_TRUE_REG_BASE_LAST_ADDR A:0x6002ffc
y.create.l HWIO_QDSS_QDSS_CXSTM_8_32_32_TRUE_REG_BASE_END_ADDR A:0x6003000
y.create.l HWIO_QDSS_QDSS_STMDMASTARTR_ADDR A:0x6002c04
y.create.l HWIO_QDSS_QDSS_STMDMASTOPR_ADDR A:0x6002c08
y.create.l HWIO_QDSS_QDSS_STMDMASTATR_ADDR A:0x6002c0c
y.create.l HWIO_QDSS_QDSS_STMDMACTLR_ADDR A:0x6002c10
y.create.l HWIO_QDSS_QDSS_STMDMAIDR_ADDR A:0x6002cfc
y.create.l HWIO_QDSS_QDSS_STMHEER_ADDR A:0x6002d00
y.create.l HWIO_QDSS_QDSS_STMHETER_ADDR A:0x6002d20
y.create.l HWIO_QDSS_QDSS_STMHEMCR_ADDR A:0x6002d64
y.create.l HWIO_QDSS_QDSS_STMHEMASTR_ADDR A:0x6002df4
y.create.l HWIO_QDSS_QDSS_STMHEFEAT1R_ADDR A:0x6002df8
y.create.l HWIO_QDSS_QDSS_STMHEIDR_ADDR A:0x6002dfc
y.create.l HWIO_QDSS_QDSS_STMSPER_ADDR A:0x6002e00
y.create.l HWIO_QDSS_QDSS_STMSPTER_ADDR A:0x6002e20
y.create.l HWIO_QDSS_QDSS_STMSPSCR_ADDR A:0x6002e60
y.create.l HWIO_QDSS_QDSS_STMSPMSCR_ADDR A:0x6002e64
y.create.l HWIO_QDSS_QDSS_STMSPOVERRIDER_ADDR A:0x6002e68
y.create.l HWIO_QDSS_QDSS_STMSPMOVERRIDER_ADDR A:0x6002e6c
y.create.l HWIO_QDSS_QDSS_STMSPTRIGCSR_ADDR A:0x6002e70
y.create.l HWIO_QDSS_QDSS_STMTCSR_ADDR A:0x6002e80
y.create.l HWIO_QDSS_QDSS_STMTSSTIMR_ADDR A:0x6002e84
y.create.l HWIO_QDSS_QDSS_STMTSFREQR_ADDR A:0x6002e8c
y.create.l HWIO_QDSS_QDSS_STMSYNCR_ADDR A:0x6002e90
y.create.l HWIO_QDSS_QDSS_STMAUXCR_ADDR A:0x6002e94
y.create.l HWIO_QDSS_QDSS_STMSPFEAT1R_ADDR A:0x6002ea0
y.create.l HWIO_QDSS_QDSS_STMSPFEAT2R_ADDR A:0x6002ea4
y.create.l HWIO_QDSS_QDSS_STMSPFEAT3R_ADDR A:0x6002ea8
y.create.l HWIO_QDSS_QDSS_STMITTRIGGER_ADDR A:0x6002ee8
y.create.l HWIO_QDSS_QDSS_STMITATBDATA0_ADDR A:0x6002eec
y.create.l HWIO_QDSS_QDSS_STMITATBCTR2_ADDR A:0x6002ef0
y.create.l HWIO_QDSS_QDSS_STMITATBID_ADDR A:0x6002ef4
y.create.l HWIO_QDSS_QDSS_STMITATBCTR0_ADDR A:0x6002ef8
y.create.l HWIO_QDSS_QDSS_STMITCTRL_ADDR A:0x6002f00
y.create.l HWIO_QDSS_QDSS_STMCLAIMSET_ADDR A:0x6002fa0
y.create.l HWIO_QDSS_QDSS_STMCLAIMCLR_ADDR A:0x6002fa4
y.create.l HWIO_QDSS_QDSS_STMLAR_ADDR A:0x6002fb0
y.create.l HWIO_QDSS_QDSS_STMLSR_ADDR A:0x6002fb4
y.create.l HWIO_QDSS_QDSS_STMAUTHSTATUS_ADDR A:0x6002fb8
y.create.l HWIO_QDSS_QDSS_STMDEVID_ADDR A:0x6002fc8
y.create.l HWIO_QDSS_QDSS_STMDEVTYPE_ADDR A:0x6002fcc
y.create.l HWIO_QDSS_QDSS_STMPIDR0_ADDR A:0x6002fe0
y.create.l HWIO_QDSS_QDSS_STMPIDR1_ADDR A:0x6002fe4
y.create.l HWIO_QDSS_QDSS_STMPIDR2_ADDR A:0x6002fe8
y.create.l HWIO_QDSS_QDSS_STMPIDR3_ADDR A:0x6002fec
y.create.l HWIO_QDSS_QDSS_STMPIDR4_ADDR A:0x6002fd0
y.create.l HWIO_QDSS_QDSS_STMPIDR5_ADDR A:0x6002fd4
y.create.l HWIO_QDSS_QDSS_STMPIDR6_ADDR A:0x6002fd8
y.create.l HWIO_QDSS_QDSS_STMPIDR7_ADDR A:0x6002fdc
y.create.l HWIO_QDSS_QDSS_STMCIDR0_ADDR A:0x6002ff0
y.create.l HWIO_QDSS_QDSS_STMCIDR1_ADDR A:0x6002ff4
y.create.l HWIO_QDSS_QDSS_STMCIDR2_ADDR A:0x6002ff8
y.create.l HWIO_QDSS_QDSS_STMCIDR3_ADDR A:0x6002ffc
y.create.l HWIO_QDSS_QDSS_QDSS_DL_SLV_TPDA_TPDA_TPDA_S16_W64_D8_M64_REG_BASE_START_ADDR A:0x6004000
y.create.l HWIO_QDSS_QDSS_QDSS_DL_SLV_TPDA_TPDA_TPDA_S16_W64_D8_M64_REG_BASE_LAST_ADDR A:0x6004ffc
y.create.l HWIO_QDSS_QDSS_QDSS_DL_SLV_TPDA_TPDA_TPDA_S16_W64_D8_M64_REG_BASE_END_ADDR A:0x6005000
y.create.l HWIO_QDSS_QDSS_QDSS_DL_SLV_TPDA_TPDA_CR_ADDR A:0x6004000
y.create.l HWIO_QDSS_QDSS_QDSS_DL_SLV_TPDA_TPDA_P0_CR_ADDR A:0x6004004
y.create.l HWIO_QDSS_QDSS_QDSS_DL_SLV_TPDA_TPDA_P1_CR_ADDR A:0x6004008
y.create.l HWIO_QDSS_QDSS_QDSS_DL_SLV_TPDA_TPDA_P2_CR_ADDR A:0x600400c
y.create.l HWIO_QDSS_QDSS_QDSS_DL_SLV_TPDA_TPDA_P3_CR_ADDR A:0x6004010
y.create.l HWIO_QDSS_QDSS_QDSS_DL_SLV_TPDA_TPDA_P4_CR_ADDR A:0x6004014
y.create.l HWIO_QDSS_QDSS_QDSS_DL_SLV_TPDA_TPDA_P5_CR_ADDR A:0x6004018
y.create.l HWIO_QDSS_QDSS_QDSS_DL_SLV_TPDA_TPDA_P6_CR_ADDR A:0x600401c
y.create.l HWIO_QDSS_QDSS_QDSS_DL_SLV_TPDA_TPDA_P7_CR_ADDR A:0x6004020
y.create.l HWIO_QDSS_QDSS_QDSS_DL_SLV_TPDA_TPDA_P8_CR_ADDR A:0x6004024
y.create.l HWIO_QDSS_QDSS_QDSS_DL_SLV_TPDA_TPDA_P9_CR_ADDR A:0x6004028
y.create.l HWIO_QDSS_QDSS_QDSS_DL_SLV_TPDA_TPDA_FPID_CR_ADDR A:0x6004084
y.create.l HWIO_QDSS_QDSS_QDSS_DL_SLV_TPDA_TPDA_FREQREQ_VAL_ADDR A:0x6004088
y.create.l HWIO_QDSS_QDSS_QDSS_DL_SLV_TPDA_TPDA_SYNCR_ADDR A:0x600408c
y.create.l HWIO_QDSS_QDSS_QDSS_DL_SLV_TPDA_TPDA_FLUSH_CR_ADDR A:0x6004090
y.create.l HWIO_QDSS_QDSS_QDSS_DL_SLV_TPDA_TPDA_FLUSH_SR_ADDR A:0x6004094
y.create.l HWIO_QDSS_QDSS_QDSS_DL_SLV_TPDA_TPDA_FLUSH_ERR_ADDR A:0x6004098
y.create.l HWIO_QDSS_QDSS_QDSS_DL_SLV_TPDA_TPDA_SPARE_ADDR A:0x6004efc
y.create.l HWIO_QDSS_QDSS_QDSS_DL_SLV_TPDA_TPDA_ITCTL_ADDR A:0x6004f00
y.create.l HWIO_QDSS_QDSS_QDSS_DL_SLV_TPDA_TPDA_CLAIMSET_ADDR A:0x6004fa0
y.create.l HWIO_QDSS_QDSS_QDSS_DL_SLV_TPDA_TPDA_CLAIMCLR_ADDR A:0x6004fa4
y.create.l HWIO_QDSS_QDSS_QDSS_DL_SLV_TPDA_TPDA_DEVAFF0_ADDR A:0x6004fa8
y.create.l HWIO_QDSS_QDSS_QDSS_DL_SLV_TPDA_TPDA_DEVAFF1_ADDR A:0x6004fac
y.create.l HWIO_QDSS_QDSS_QDSS_DL_SLV_TPDA_TPDA_LOCKACCESS_ADDR A:0x6004fb0
y.create.l HWIO_QDSS_QDSS_QDSS_DL_SLV_TPDA_TPDA_LOCKSTATUS_ADDR A:0x6004fb4
y.create.l HWIO_QDSS_QDSS_QDSS_DL_SLV_TPDA_TPDA_AUTHSTATUS_ADDR A:0x6004fb8
y.create.l HWIO_QDSS_QDSS_QDSS_DL_SLV_TPDA_TPDA_DEVARCH_ADDR A:0x6004fbc
y.create.l HWIO_QDSS_QDSS_QDSS_DL_SLV_TPDA_TPDA_DEVID2_ADDR A:0x6004fc0
y.create.l HWIO_QDSS_QDSS_QDSS_DL_SLV_TPDA_TPDA_DEVID1_ADDR A:0x6004fc4
y.create.l HWIO_QDSS_QDSS_QDSS_DL_SLV_TPDA_TPDA_DEVID_ADDR A:0x6004fc8
y.create.l HWIO_QDSS_QDSS_QDSS_DL_SLV_TPDA_TPDA_DEVTYPE_ADDR A:0x6004fcc
y.create.l HWIO_QDSS_QDSS_QDSS_DL_SLV_TPDA_TPDA_PERIPHID4_ADDR A:0x6004fd0
y.create.l HWIO_QDSS_QDSS_QDSS_DL_SLV_TPDA_TPDA_PERIPHID5_ADDR A:0x6004fd4
y.create.l HWIO_QDSS_QDSS_QDSS_DL_SLV_TPDA_TPDA_PERIPHID6_ADDR A:0x6004fd8
y.create.l HWIO_QDSS_QDSS_QDSS_DL_SLV_TPDA_TPDA_PERIPHID7_ADDR A:0x6004fdc
y.create.l HWIO_QDSS_QDSS_QDSS_DL_SLV_TPDA_TPDA_PERIPHID0_ADDR A:0x6004fe0
y.create.l HWIO_QDSS_QDSS_QDSS_DL_SLV_TPDA_TPDA_PERIPHID1_ADDR A:0x6004fe4
y.create.l HWIO_QDSS_QDSS_QDSS_DL_SLV_TPDA_TPDA_PERIPHID2_ADDR A:0x6004fe8
y.create.l HWIO_QDSS_QDSS_QDSS_DL_SLV_TPDA_TPDA_PERIPHID3_ADDR A:0x6004fec
y.create.l HWIO_QDSS_QDSS_QDSS_DL_SLV_TPDA_TPDA_COMPID0_ADDR A:0x6004ff0
y.create.l HWIO_QDSS_QDSS_QDSS_DL_SLV_TPDA_TPDA_COMPID1_ADDR A:0x6004ff4
y.create.l HWIO_QDSS_QDSS_QDSS_DL_SLV_TPDA_TPDA_COMPID2_ADDR A:0x6004ff8
y.create.l HWIO_QDSS_QDSS_QDSS_DL_SLV_TPDA_TPDA_COMPID3_ADDR A:0x6004ffc
y.create.l HWIO_QDSS_QDSS_QDSS_DL_SLV_QATBFUNNEL_QATBFUNNEL_QATBFUNNEL_64W8SP_REG_BASE_START_ADDR A:0x6005000
y.create.l HWIO_QDSS_QDSS_QDSS_DL_SLV_QATBFUNNEL_QATBFUNNEL_QATBFUNNEL_64W8SP_REG_BASE_LAST_ADDR A:0x6005ffc
y.create.l HWIO_QDSS_QDSS_QDSS_DL_SLV_QATBFUNNEL_QATBFUNNEL_QATBFUNNEL_64W8SP_REG_BASE_END_ADDR A:0x6006000
y.create.l HWIO_QDSS_QDSS_QDSS_DL_SLV_QATBFUNNEL_CTRL_REG_ADDR A:0x6005000
y.create.l HWIO_QDSS_QDSS_QDSS_DL_SLV_QATBFUNNEL_PRIORITY_CTRL_REG_ADDR A:0x6005004
y.create.l HWIO_QDSS_QDSS_QDSS_DL_SLV_QATBFUNNEL_ITATBDATA0_ADDR A:0x6005eec
y.create.l HWIO_QDSS_QDSS_QDSS_DL_SLV_QATBFUNNEL_ITATBCTR2_ADDR A:0x6005ef0
y.create.l HWIO_QDSS_QDSS_QDSS_DL_SLV_QATBFUNNEL_ITATBCTR1_ADDR A:0x6005ef4
y.create.l HWIO_QDSS_QDSS_QDSS_DL_SLV_QATBFUNNEL_ITATBCTR0_ADDR A:0x6005ef8
y.create.l HWIO_QDSS_QDSS_QDSS_DL_SLV_QATBFUNNEL_ITCTRL_ADDR A:0x6005f00
y.create.l HWIO_QDSS_QDSS_QDSS_DL_SLV_QATBFUNNEL_CLAIMSET_ADDR A:0x6005fa0
y.create.l HWIO_QDSS_QDSS_QDSS_DL_SLV_QATBFUNNEL_CLAIMCLR_ADDR A:0x6005fa4
y.create.l HWIO_QDSS_QDSS_QDSS_DL_SLV_QATBFUNNEL_LOCKACCESS_ADDR A:0x6005fb0
y.create.l HWIO_QDSS_QDSS_QDSS_DL_SLV_QATBFUNNEL_LOCKSTATUS_ADDR A:0x6005fb4
y.create.l HWIO_QDSS_QDSS_QDSS_DL_SLV_QATBFUNNEL_AUTHSTATUS_ADDR A:0x6005fb8
y.create.l HWIO_QDSS_QDSS_QDSS_DL_SLV_QATBFUNNEL_DEVID_ADDR A:0x6005fc8
y.create.l HWIO_QDSS_QDSS_QDSS_DL_SLV_QATBFUNNEL_DEVTYPE_ADDR A:0x6005fcc
y.create.l HWIO_QDSS_QDSS_QDSS_DL_SLV_QATBFUNNEL_PIDR0_ADDR A:0x6005fe0
y.create.l HWIO_QDSS_QDSS_QDSS_DL_SLV_QATBFUNNEL_PIDR1_ADDR A:0x6005fe4
y.create.l HWIO_QDSS_QDSS_QDSS_DL_SLV_QATBFUNNEL_PIDR2_ADDR A:0x6005fe8
y.create.l HWIO_QDSS_QDSS_QDSS_DL_SLV_QATBFUNNEL_PIDR3_ADDR A:0x6005fec
y.create.l HWIO_QDSS_QDSS_QDSS_DL_SLV_QATBFUNNEL_PIDR4_ADDR A:0x6005fd0
y.create.l HWIO_QDSS_QDSS_QDSS_DL_SLV_QATBFUNNEL_PERIPHID5_ADDR A:0x6005fd4
y.create.l HWIO_QDSS_QDSS_QDSS_DL_SLV_QATBFUNNEL_PERIPHID6_ADDR A:0x6005fd8
y.create.l HWIO_QDSS_QDSS_QDSS_DL_SLV_QATBFUNNEL_PERIPHID7_ADDR A:0x6005fdc
y.create.l HWIO_QDSS_QDSS_QDSS_DL_SLV_QATBFUNNEL_CID0_ADDR A:0x6005ff0
y.create.l HWIO_QDSS_QDSS_QDSS_DL_SLV_QATBFUNNEL_CID1_ADDR A:0x6005ff4
y.create.l HWIO_QDSS_QDSS_QDSS_DL_SLV_QATBFUNNEL_CID2_ADDR A:0x6005ff8
y.create.l HWIO_QDSS_QDSS_QDSS_DL_SLV_QATBFUNNEL_CID3_ADDR A:0x6005ffc
y.create.l HWIO_QDSS_QDSS_CTI0_CTI0_CSCTI_REG_BASE_START_ADDR A:0x6010000
y.create.l HWIO_QDSS_QDSS_CTI0_CTI0_CSCTI_REG_BASE_LAST_ADDR A:0x6010ffc
y.create.l HWIO_QDSS_QDSS_CTI0_CTI0_CSCTI_REG_BASE_END_ADDR A:0x6011000
y.create.l HWIO_QDSS_QDSS_CTI0_CTICONTROL_ADDR A:0x6010000
y.create.l HWIO_QDSS_QDSS_CTI0_CTIINTACK_ADDR A:0x6010010
y.create.l HWIO_QDSS_QDSS_CTI0_CTIAPPSET_ADDR A:0x6010014
y.create.l HWIO_QDSS_QDSS_CTI0_CTIAPPCLEAR_ADDR A:0x6010018
y.create.l HWIO_QDSS_QDSS_CTI0_CTIAPPPULSE_ADDR A:0x601001c
y.create.l HWIO_QDSS_QDSS_CTI0_CTIINEN0_ADDR A:0x6010020
y.create.l HWIO_QDSS_QDSS_CTI0_CTIINEN1_ADDR A:0x6010024
y.create.l HWIO_QDSS_QDSS_CTI0_CTIINEN2_ADDR A:0x6010028
y.create.l HWIO_QDSS_QDSS_CTI0_CTIINEN3_ADDR A:0x601002c
y.create.l HWIO_QDSS_QDSS_CTI0_CTIINEN4_ADDR A:0x6010030
y.create.l HWIO_QDSS_QDSS_CTI0_CTIINEN5_ADDR A:0x6010034
y.create.l HWIO_QDSS_QDSS_CTI0_CTIINEN6_ADDR A:0x6010038
y.create.l HWIO_QDSS_QDSS_CTI0_CTIINEN7_ADDR A:0x601003c
y.create.l HWIO_QDSS_QDSS_CTI0_CTIOUTEN0_ADDR A:0x60100a0
y.create.l HWIO_QDSS_QDSS_CTI0_CTIOUTEN1_ADDR A:0x60100a4
y.create.l HWIO_QDSS_QDSS_CTI0_CTIOUTEN2_ADDR A:0x60100a8
y.create.l HWIO_QDSS_QDSS_CTI0_CTIOUTEN3_ADDR A:0x60100ac
y.create.l HWIO_QDSS_QDSS_CTI0_CTIOUTEN4_ADDR A:0x60100b0
y.create.l HWIO_QDSS_QDSS_CTI0_CTIOUTEN5_ADDR A:0x60100b4
y.create.l HWIO_QDSS_QDSS_CTI0_CTIOUTEN6_ADDR A:0x60100b8
y.create.l HWIO_QDSS_QDSS_CTI0_CTIOUTEN7_ADDR A:0x60100bc
y.create.l HWIO_QDSS_QDSS_CTI0_CTITRIGINSTATUS_ADDR A:0x6010130
y.create.l HWIO_QDSS_QDSS_CTI0_CTITRIGOUTSTATUS_ADDR A:0x6010134
y.create.l HWIO_QDSS_QDSS_CTI0_CTICHINSTATUS_ADDR A:0x6010138
y.create.l HWIO_QDSS_QDSS_CTI0_CTICHOUTSTATUS_ADDR A:0x601013c
y.create.l HWIO_QDSS_QDSS_CTI0_CTIGATE_ADDR A:0x6010140
y.create.l HWIO_QDSS_QDSS_CTI0_ASICCTL_ADDR A:0x6010144
y.create.l HWIO_QDSS_QDSS_CTI0_ITCHINACK_ADDR A:0x6010edc
y.create.l HWIO_QDSS_QDSS_CTI0_ITTRIGINACK_ADDR A:0x6010ee0
y.create.l HWIO_QDSS_QDSS_CTI0_ITCHOUT_ADDR A:0x6010ee4
y.create.l HWIO_QDSS_QDSS_CTI0_ITTRIGOUT_ADDR A:0x6010ee8
y.create.l HWIO_QDSS_QDSS_CTI0_ITCHOUTACK_ADDR A:0x6010eec
y.create.l HWIO_QDSS_QDSS_CTI0_ITTRIGOUTACK_ADDR A:0x6010ef0
y.create.l HWIO_QDSS_QDSS_CTI0_ITCHIN_ADDR A:0x6010ef4
y.create.l HWIO_QDSS_QDSS_CTI0_ITTRIGIN_ADDR A:0x6010ef8
y.create.l HWIO_QDSS_QDSS_CTI0_ITCTRL_ADDR A:0x6010f00
y.create.l HWIO_QDSS_QDSS_CTI0_CLAIMSET_ADDR A:0x6010fa0
y.create.l HWIO_QDSS_QDSS_CTI0_CLAIMCLR_ADDR A:0x6010fa4
y.create.l HWIO_QDSS_QDSS_CTI0_LAR_ADDR A:0x6010fb0
y.create.l HWIO_QDSS_QDSS_CTI0_LSR_ADDR A:0x6010fb4
y.create.l HWIO_QDSS_QDSS_CTI0_AUTHSTATUS_ADDR A:0x6010fb8
y.create.l HWIO_QDSS_QDSS_CTI0_DEVID_ADDR A:0x6010fc8
y.create.l HWIO_QDSS_QDSS_CTI0_DEVTYPE_ADDR A:0x6010fcc
y.create.l HWIO_QDSS_QDSS_CTI0_PERIPHID0_ADDR A:0x6010fe0
y.create.l HWIO_QDSS_QDSS_CTI0_PERIPHID1_ADDR A:0x6010fe4
y.create.l HWIO_QDSS_QDSS_CTI0_PERIPHID2_ADDR A:0x6010fe8
y.create.l HWIO_QDSS_QDSS_CTI0_PERIPHID3_ADDR A:0x6010fec
y.create.l HWIO_QDSS_QDSS_CTI0_PERIPHID4_ADDR A:0x6010fd0
y.create.l HWIO_QDSS_QDSS_CTI0_PERIPHID5_ADDR A:0x6010fd4
y.create.l HWIO_QDSS_QDSS_CTI0_PERIPHID6_ADDR A:0x6010fd8
y.create.l HWIO_QDSS_QDSS_CTI0_PERIPHID7_ADDR A:0x6010fdc
y.create.l HWIO_QDSS_QDSS_CTI0_COMPID0_ADDR A:0x6010ff0
y.create.l HWIO_QDSS_QDSS_CTI0_COMPID1_ADDR A:0x6010ff4
y.create.l HWIO_QDSS_QDSS_CTI0_COMPID2_ADDR A:0x6010ff8
y.create.l HWIO_QDSS_QDSS_CTI0_COMPID3_ADDR A:0x6010ffc
y.create.l HWIO_QDSS_QDSS_CTI1_CTI1_CSCTI_REG_BASE_START_ADDR A:0x6011000
y.create.l HWIO_QDSS_QDSS_CTI1_CTI1_CSCTI_REG_BASE_LAST_ADDR A:0x6011ffc
y.create.l HWIO_QDSS_QDSS_CTI1_CTI1_CSCTI_REG_BASE_END_ADDR A:0x6012000
y.create.l HWIO_QDSS_QDSS_CTI1_CTICONTROL_ADDR A:0x6011000
y.create.l HWIO_QDSS_QDSS_CTI1_CTIINTACK_ADDR A:0x6011010
y.create.l HWIO_QDSS_QDSS_CTI1_CTIAPPSET_ADDR A:0x6011014
y.create.l HWIO_QDSS_QDSS_CTI1_CTIAPPCLEAR_ADDR A:0x6011018
y.create.l HWIO_QDSS_QDSS_CTI1_CTIAPPPULSE_ADDR A:0x601101c
y.create.l HWIO_QDSS_QDSS_CTI1_CTIINEN0_ADDR A:0x6011020
y.create.l HWIO_QDSS_QDSS_CTI1_CTIINEN1_ADDR A:0x6011024
y.create.l HWIO_QDSS_QDSS_CTI1_CTIINEN2_ADDR A:0x6011028
y.create.l HWIO_QDSS_QDSS_CTI1_CTIINEN3_ADDR A:0x601102c
y.create.l HWIO_QDSS_QDSS_CTI1_CTIINEN4_ADDR A:0x6011030
y.create.l HWIO_QDSS_QDSS_CTI1_CTIINEN5_ADDR A:0x6011034
y.create.l HWIO_QDSS_QDSS_CTI1_CTIINEN6_ADDR A:0x6011038
y.create.l HWIO_QDSS_QDSS_CTI1_CTIINEN7_ADDR A:0x601103c
y.create.l HWIO_QDSS_QDSS_CTI1_CTIOUTEN0_ADDR A:0x60110a0
y.create.l HWIO_QDSS_QDSS_CTI1_CTIOUTEN1_ADDR A:0x60110a4
y.create.l HWIO_QDSS_QDSS_CTI1_CTIOUTEN2_ADDR A:0x60110a8
y.create.l HWIO_QDSS_QDSS_CTI1_CTIOUTEN3_ADDR A:0x60110ac
y.create.l HWIO_QDSS_QDSS_CTI1_CTIOUTEN4_ADDR A:0x60110b0
y.create.l HWIO_QDSS_QDSS_CTI1_CTIOUTEN5_ADDR A:0x60110b4
y.create.l HWIO_QDSS_QDSS_CTI1_CTIOUTEN6_ADDR A:0x60110b8
y.create.l HWIO_QDSS_QDSS_CTI1_CTIOUTEN7_ADDR A:0x60110bc
y.create.l HWIO_QDSS_QDSS_CTI1_CTITRIGINSTATUS_ADDR A:0x6011130
y.create.l HWIO_QDSS_QDSS_CTI1_CTITRIGOUTSTATUS_ADDR A:0x6011134
y.create.l HWIO_QDSS_QDSS_CTI1_CTICHINSTATUS_ADDR A:0x6011138
y.create.l HWIO_QDSS_QDSS_CTI1_CTICHOUTSTATUS_ADDR A:0x601113c
y.create.l HWIO_QDSS_QDSS_CTI1_CTIGATE_ADDR A:0x6011140
y.create.l HWIO_QDSS_QDSS_CTI1_ASICCTL_ADDR A:0x6011144
y.create.l HWIO_QDSS_QDSS_CTI1_ITCHINACK_ADDR A:0x6011edc
y.create.l HWIO_QDSS_QDSS_CTI1_ITTRIGINACK_ADDR A:0x6011ee0
y.create.l HWIO_QDSS_QDSS_CTI1_ITCHOUT_ADDR A:0x6011ee4
y.create.l HWIO_QDSS_QDSS_CTI1_ITTRIGOUT_ADDR A:0x6011ee8
y.create.l HWIO_QDSS_QDSS_CTI1_ITCHOUTACK_ADDR A:0x6011eec
y.create.l HWIO_QDSS_QDSS_CTI1_ITTRIGOUTACK_ADDR A:0x6011ef0
y.create.l HWIO_QDSS_QDSS_CTI1_ITCHIN_ADDR A:0x6011ef4
y.create.l HWIO_QDSS_QDSS_CTI1_ITTRIGIN_ADDR A:0x6011ef8
y.create.l HWIO_QDSS_QDSS_CTI1_ITCTRL_ADDR A:0x6011f00
y.create.l HWIO_QDSS_QDSS_CTI1_CLAIMSET_ADDR A:0x6011fa0
y.create.l HWIO_QDSS_QDSS_CTI1_CLAIMCLR_ADDR A:0x6011fa4
y.create.l HWIO_QDSS_QDSS_CTI1_LAR_ADDR A:0x6011fb0
y.create.l HWIO_QDSS_QDSS_CTI1_LSR_ADDR A:0x6011fb4
y.create.l HWIO_QDSS_QDSS_CTI1_AUTHSTATUS_ADDR A:0x6011fb8
y.create.l HWIO_QDSS_QDSS_CTI1_DEVID_ADDR A:0x6011fc8
y.create.l HWIO_QDSS_QDSS_CTI1_DEVTYPE_ADDR A:0x6011fcc
y.create.l HWIO_QDSS_QDSS_CTI1_PERIPHID0_ADDR A:0x6011fe0
y.create.l HWIO_QDSS_QDSS_CTI1_PERIPHID1_ADDR A:0x6011fe4
y.create.l HWIO_QDSS_QDSS_CTI1_PERIPHID2_ADDR A:0x6011fe8
y.create.l HWIO_QDSS_QDSS_CTI1_PERIPHID3_ADDR A:0x6011fec
y.create.l HWIO_QDSS_QDSS_CTI1_PERIPHID4_ADDR A:0x6011fd0
y.create.l HWIO_QDSS_QDSS_CTI1_PERIPHID5_ADDR A:0x6011fd4
y.create.l HWIO_QDSS_QDSS_CTI1_PERIPHID6_ADDR A:0x6011fd8
y.create.l HWIO_QDSS_QDSS_CTI1_PERIPHID7_ADDR A:0x6011fdc
y.create.l HWIO_QDSS_QDSS_CTI1_COMPID0_ADDR A:0x6011ff0
y.create.l HWIO_QDSS_QDSS_CTI1_COMPID1_ADDR A:0x6011ff4
y.create.l HWIO_QDSS_QDSS_CTI1_COMPID2_ADDR A:0x6011ff8
y.create.l HWIO_QDSS_QDSS_CTI1_COMPID3_ADDR A:0x6011ffc
y.create.l HWIO_QDSS_QDSS_CTI2_CTI2_CSCTI_REG_BASE_START_ADDR A:0x6012000
y.create.l HWIO_QDSS_QDSS_CTI2_CTI2_CSCTI_REG_BASE_LAST_ADDR A:0x6012ffc
y.create.l HWIO_QDSS_QDSS_CTI2_CTI2_CSCTI_REG_BASE_END_ADDR A:0x6013000
y.create.l HWIO_QDSS_QDSS_CTI2_CTICONTROL_ADDR A:0x6012000
y.create.l HWIO_QDSS_QDSS_CTI2_CTIINTACK_ADDR A:0x6012010
y.create.l HWIO_QDSS_QDSS_CTI2_CTIAPPSET_ADDR A:0x6012014
y.create.l HWIO_QDSS_QDSS_CTI2_CTIAPPCLEAR_ADDR A:0x6012018
y.create.l HWIO_QDSS_QDSS_CTI2_CTIAPPPULSE_ADDR A:0x601201c
y.create.l HWIO_QDSS_QDSS_CTI2_CTIINEN0_ADDR A:0x6012020
y.create.l HWIO_QDSS_QDSS_CTI2_CTIINEN1_ADDR A:0x6012024
y.create.l HWIO_QDSS_QDSS_CTI2_CTIINEN2_ADDR A:0x6012028
y.create.l HWIO_QDSS_QDSS_CTI2_CTIINEN3_ADDR A:0x601202c
y.create.l HWIO_QDSS_QDSS_CTI2_CTIINEN4_ADDR A:0x6012030
y.create.l HWIO_QDSS_QDSS_CTI2_CTIINEN5_ADDR A:0x6012034
y.create.l HWIO_QDSS_QDSS_CTI2_CTIINEN6_ADDR A:0x6012038
y.create.l HWIO_QDSS_QDSS_CTI2_CTIINEN7_ADDR A:0x601203c
y.create.l HWIO_QDSS_QDSS_CTI2_CTIOUTEN0_ADDR A:0x60120a0
y.create.l HWIO_QDSS_QDSS_CTI2_CTIOUTEN1_ADDR A:0x60120a4
y.create.l HWIO_QDSS_QDSS_CTI2_CTIOUTEN2_ADDR A:0x60120a8
y.create.l HWIO_QDSS_QDSS_CTI2_CTIOUTEN3_ADDR A:0x60120ac
y.create.l HWIO_QDSS_QDSS_CTI2_CTIOUTEN4_ADDR A:0x60120b0
y.create.l HWIO_QDSS_QDSS_CTI2_CTIOUTEN5_ADDR A:0x60120b4
y.create.l HWIO_QDSS_QDSS_CTI2_CTIOUTEN6_ADDR A:0x60120b8
y.create.l HWIO_QDSS_QDSS_CTI2_CTIOUTEN7_ADDR A:0x60120bc
y.create.l HWIO_QDSS_QDSS_CTI2_CTITRIGINSTATUS_ADDR A:0x6012130
y.create.l HWIO_QDSS_QDSS_CTI2_CTITRIGOUTSTATUS_ADDR A:0x6012134
y.create.l HWIO_QDSS_QDSS_CTI2_CTICHINSTATUS_ADDR A:0x6012138
y.create.l HWIO_QDSS_QDSS_CTI2_CTICHOUTSTATUS_ADDR A:0x601213c
y.create.l HWIO_QDSS_QDSS_CTI2_CTIGATE_ADDR A:0x6012140
y.create.l HWIO_QDSS_QDSS_CTI2_ASICCTL_ADDR A:0x6012144
y.create.l HWIO_QDSS_QDSS_CTI2_ITCHINACK_ADDR A:0x6012edc
y.create.l HWIO_QDSS_QDSS_CTI2_ITTRIGINACK_ADDR A:0x6012ee0
y.create.l HWIO_QDSS_QDSS_CTI2_ITCHOUT_ADDR A:0x6012ee4
y.create.l HWIO_QDSS_QDSS_CTI2_ITTRIGOUT_ADDR A:0x6012ee8
y.create.l HWIO_QDSS_QDSS_CTI2_ITCHOUTACK_ADDR A:0x6012eec
y.create.l HWIO_QDSS_QDSS_CTI2_ITTRIGOUTACK_ADDR A:0x6012ef0
y.create.l HWIO_QDSS_QDSS_CTI2_ITCHIN_ADDR A:0x6012ef4
y.create.l HWIO_QDSS_QDSS_CTI2_ITTRIGIN_ADDR A:0x6012ef8
y.create.l HWIO_QDSS_QDSS_CTI2_ITCTRL_ADDR A:0x6012f00
y.create.l HWIO_QDSS_QDSS_CTI2_CLAIMSET_ADDR A:0x6012fa0
y.create.l HWIO_QDSS_QDSS_CTI2_CLAIMCLR_ADDR A:0x6012fa4
y.create.l HWIO_QDSS_QDSS_CTI2_LAR_ADDR A:0x6012fb0
y.create.l HWIO_QDSS_QDSS_CTI2_LSR_ADDR A:0x6012fb4
y.create.l HWIO_QDSS_QDSS_CTI2_AUTHSTATUS_ADDR A:0x6012fb8
y.create.l HWIO_QDSS_QDSS_CTI2_DEVID_ADDR A:0x6012fc8
y.create.l HWIO_QDSS_QDSS_CTI2_DEVTYPE_ADDR A:0x6012fcc
y.create.l HWIO_QDSS_QDSS_CTI2_PERIPHID0_ADDR A:0x6012fe0
y.create.l HWIO_QDSS_QDSS_CTI2_PERIPHID1_ADDR A:0x6012fe4
y.create.l HWIO_QDSS_QDSS_CTI2_PERIPHID2_ADDR A:0x6012fe8
y.create.l HWIO_QDSS_QDSS_CTI2_PERIPHID3_ADDR A:0x6012fec
y.create.l HWIO_QDSS_QDSS_CTI2_PERIPHID4_ADDR A:0x6012fd0
y.create.l HWIO_QDSS_QDSS_CTI2_PERIPHID5_ADDR A:0x6012fd4
y.create.l HWIO_QDSS_QDSS_CTI2_PERIPHID6_ADDR A:0x6012fd8
y.create.l HWIO_QDSS_QDSS_CTI2_PERIPHID7_ADDR A:0x6012fdc
y.create.l HWIO_QDSS_QDSS_CTI2_COMPID0_ADDR A:0x6012ff0
y.create.l HWIO_QDSS_QDSS_CTI2_COMPID1_ADDR A:0x6012ff4
y.create.l HWIO_QDSS_QDSS_CTI2_COMPID2_ADDR A:0x6012ff8
y.create.l HWIO_QDSS_QDSS_CTI2_COMPID3_ADDR A:0x6012ffc
y.create.l HWIO_QDSS_QDSS_CTI3_CTI3_CSCTI_REG_BASE_START_ADDR A:0x6013000
y.create.l HWIO_QDSS_QDSS_CTI3_CTI3_CSCTI_REG_BASE_LAST_ADDR A:0x6013ffc
y.create.l HWIO_QDSS_QDSS_CTI3_CTI3_CSCTI_REG_BASE_END_ADDR A:0x6014000
y.create.l HWIO_QDSS_QDSS_CTI3_CTICONTROL_ADDR A:0x6013000
y.create.l HWIO_QDSS_QDSS_CTI3_CTIINTACK_ADDR A:0x6013010
y.create.l HWIO_QDSS_QDSS_CTI3_CTIAPPSET_ADDR A:0x6013014
y.create.l HWIO_QDSS_QDSS_CTI3_CTIAPPCLEAR_ADDR A:0x6013018
y.create.l HWIO_QDSS_QDSS_CTI3_CTIAPPPULSE_ADDR A:0x601301c
y.create.l HWIO_QDSS_QDSS_CTI3_CTIINEN0_ADDR A:0x6013020
y.create.l HWIO_QDSS_QDSS_CTI3_CTIINEN1_ADDR A:0x6013024
y.create.l HWIO_QDSS_QDSS_CTI3_CTIINEN2_ADDR A:0x6013028
y.create.l HWIO_QDSS_QDSS_CTI3_CTIINEN3_ADDR A:0x601302c
y.create.l HWIO_QDSS_QDSS_CTI3_CTIINEN4_ADDR A:0x6013030
y.create.l HWIO_QDSS_QDSS_CTI3_CTIINEN5_ADDR A:0x6013034
y.create.l HWIO_QDSS_QDSS_CTI3_CTIINEN6_ADDR A:0x6013038
y.create.l HWIO_QDSS_QDSS_CTI3_CTIINEN7_ADDR A:0x601303c
y.create.l HWIO_QDSS_QDSS_CTI3_CTIOUTEN0_ADDR A:0x60130a0
y.create.l HWIO_QDSS_QDSS_CTI3_CTIOUTEN1_ADDR A:0x60130a4
y.create.l HWIO_QDSS_QDSS_CTI3_CTIOUTEN2_ADDR A:0x60130a8
y.create.l HWIO_QDSS_QDSS_CTI3_CTIOUTEN3_ADDR A:0x60130ac
y.create.l HWIO_QDSS_QDSS_CTI3_CTIOUTEN4_ADDR A:0x60130b0
y.create.l HWIO_QDSS_QDSS_CTI3_CTIOUTEN5_ADDR A:0x60130b4
y.create.l HWIO_QDSS_QDSS_CTI3_CTIOUTEN6_ADDR A:0x60130b8
y.create.l HWIO_QDSS_QDSS_CTI3_CTIOUTEN7_ADDR A:0x60130bc
y.create.l HWIO_QDSS_QDSS_CTI3_CTITRIGINSTATUS_ADDR A:0x6013130
y.create.l HWIO_QDSS_QDSS_CTI3_CTITRIGOUTSTATUS_ADDR A:0x6013134
y.create.l HWIO_QDSS_QDSS_CTI3_CTICHINSTATUS_ADDR A:0x6013138
y.create.l HWIO_QDSS_QDSS_CTI3_CTICHOUTSTATUS_ADDR A:0x601313c
y.create.l HWIO_QDSS_QDSS_CTI3_CTIGATE_ADDR A:0x6013140
y.create.l HWIO_QDSS_QDSS_CTI3_ASICCTL_ADDR A:0x6013144
y.create.l HWIO_QDSS_QDSS_CTI3_ITCHINACK_ADDR A:0x6013edc
y.create.l HWIO_QDSS_QDSS_CTI3_ITTRIGINACK_ADDR A:0x6013ee0
y.create.l HWIO_QDSS_QDSS_CTI3_ITCHOUT_ADDR A:0x6013ee4
y.create.l HWIO_QDSS_QDSS_CTI3_ITTRIGOUT_ADDR A:0x6013ee8
y.create.l HWIO_QDSS_QDSS_CTI3_ITCHOUTACK_ADDR A:0x6013eec
y.create.l HWIO_QDSS_QDSS_CTI3_ITTRIGOUTACK_ADDR A:0x6013ef0
y.create.l HWIO_QDSS_QDSS_CTI3_ITCHIN_ADDR A:0x6013ef4
y.create.l HWIO_QDSS_QDSS_CTI3_ITTRIGIN_ADDR A:0x6013ef8
y.create.l HWIO_QDSS_QDSS_CTI3_ITCTRL_ADDR A:0x6013f00
y.create.l HWIO_QDSS_QDSS_CTI3_CLAIMSET_ADDR A:0x6013fa0
y.create.l HWIO_QDSS_QDSS_CTI3_CLAIMCLR_ADDR A:0x6013fa4
y.create.l HWIO_QDSS_QDSS_CTI3_LAR_ADDR A:0x6013fb0
y.create.l HWIO_QDSS_QDSS_CTI3_LSR_ADDR A:0x6013fb4
y.create.l HWIO_QDSS_QDSS_CTI3_AUTHSTATUS_ADDR A:0x6013fb8
y.create.l HWIO_QDSS_QDSS_CTI3_DEVID_ADDR A:0x6013fc8
y.create.l HWIO_QDSS_QDSS_CTI3_DEVTYPE_ADDR A:0x6013fcc
y.create.l HWIO_QDSS_QDSS_CTI3_PERIPHID0_ADDR A:0x6013fe0
y.create.l HWIO_QDSS_QDSS_CTI3_PERIPHID1_ADDR A:0x6013fe4
y.create.l HWIO_QDSS_QDSS_CTI3_PERIPHID2_ADDR A:0x6013fe8
y.create.l HWIO_QDSS_QDSS_CTI3_PERIPHID3_ADDR A:0x6013fec
y.create.l HWIO_QDSS_QDSS_CTI3_PERIPHID4_ADDR A:0x6013fd0
y.create.l HWIO_QDSS_QDSS_CTI3_PERIPHID5_ADDR A:0x6013fd4
y.create.l HWIO_QDSS_QDSS_CTI3_PERIPHID6_ADDR A:0x6013fd8
y.create.l HWIO_QDSS_QDSS_CTI3_PERIPHID7_ADDR A:0x6013fdc
y.create.l HWIO_QDSS_QDSS_CTI3_COMPID0_ADDR A:0x6013ff0
y.create.l HWIO_QDSS_QDSS_CTI3_COMPID1_ADDR A:0x6013ff4
y.create.l HWIO_QDSS_QDSS_CTI3_COMPID2_ADDR A:0x6013ff8
y.create.l HWIO_QDSS_QDSS_CTI3_COMPID3_ADDR A:0x6013ffc
y.create.l HWIO_QDSS_QDSS_CTI4_CTI4_CSCTI_REG_BASE_START_ADDR A:0x6014000
y.create.l HWIO_QDSS_QDSS_CTI4_CTI4_CSCTI_REG_BASE_LAST_ADDR A:0x6014ffc
y.create.l HWIO_QDSS_QDSS_CTI4_CTI4_CSCTI_REG_BASE_END_ADDR A:0x6015000
y.create.l HWIO_QDSS_QDSS_CTI4_CTICONTROL_ADDR A:0x6014000
y.create.l HWIO_QDSS_QDSS_CTI4_CTIINTACK_ADDR A:0x6014010
y.create.l HWIO_QDSS_QDSS_CTI4_CTIAPPSET_ADDR A:0x6014014
y.create.l HWIO_QDSS_QDSS_CTI4_CTIAPPCLEAR_ADDR A:0x6014018
y.create.l HWIO_QDSS_QDSS_CTI4_CTIAPPPULSE_ADDR A:0x601401c
y.create.l HWIO_QDSS_QDSS_CTI4_CTIINEN0_ADDR A:0x6014020
y.create.l HWIO_QDSS_QDSS_CTI4_CTIINEN1_ADDR A:0x6014024
y.create.l HWIO_QDSS_QDSS_CTI4_CTIINEN2_ADDR A:0x6014028
y.create.l HWIO_QDSS_QDSS_CTI4_CTIINEN3_ADDR A:0x601402c
y.create.l HWIO_QDSS_QDSS_CTI4_CTIINEN4_ADDR A:0x6014030
y.create.l HWIO_QDSS_QDSS_CTI4_CTIINEN5_ADDR A:0x6014034
y.create.l HWIO_QDSS_QDSS_CTI4_CTIINEN6_ADDR A:0x6014038
y.create.l HWIO_QDSS_QDSS_CTI4_CTIINEN7_ADDR A:0x601403c
y.create.l HWIO_QDSS_QDSS_CTI4_CTIOUTEN0_ADDR A:0x60140a0
y.create.l HWIO_QDSS_QDSS_CTI4_CTIOUTEN1_ADDR A:0x60140a4
y.create.l HWIO_QDSS_QDSS_CTI4_CTIOUTEN2_ADDR A:0x60140a8
y.create.l HWIO_QDSS_QDSS_CTI4_CTIOUTEN3_ADDR A:0x60140ac
y.create.l HWIO_QDSS_QDSS_CTI4_CTIOUTEN4_ADDR A:0x60140b0
y.create.l HWIO_QDSS_QDSS_CTI4_CTIOUTEN5_ADDR A:0x60140b4
y.create.l HWIO_QDSS_QDSS_CTI4_CTIOUTEN6_ADDR A:0x60140b8
y.create.l HWIO_QDSS_QDSS_CTI4_CTIOUTEN7_ADDR A:0x60140bc
y.create.l HWIO_QDSS_QDSS_CTI4_CTITRIGINSTATUS_ADDR A:0x6014130
y.create.l HWIO_QDSS_QDSS_CTI4_CTITRIGOUTSTATUS_ADDR A:0x6014134
y.create.l HWIO_QDSS_QDSS_CTI4_CTICHINSTATUS_ADDR A:0x6014138
y.create.l HWIO_QDSS_QDSS_CTI4_CTICHOUTSTATUS_ADDR A:0x601413c
y.create.l HWIO_QDSS_QDSS_CTI4_CTIGATE_ADDR A:0x6014140
y.create.l HWIO_QDSS_QDSS_CTI4_ASICCTL_ADDR A:0x6014144
y.create.l HWIO_QDSS_QDSS_CTI4_ITCHINACK_ADDR A:0x6014edc
y.create.l HWIO_QDSS_QDSS_CTI4_ITTRIGINACK_ADDR A:0x6014ee0
y.create.l HWIO_QDSS_QDSS_CTI4_ITCHOUT_ADDR A:0x6014ee4
y.create.l HWIO_QDSS_QDSS_CTI4_ITTRIGOUT_ADDR A:0x6014ee8
y.create.l HWIO_QDSS_QDSS_CTI4_ITCHOUTACK_ADDR A:0x6014eec
y.create.l HWIO_QDSS_QDSS_CTI4_ITTRIGOUTACK_ADDR A:0x6014ef0
y.create.l HWIO_QDSS_QDSS_CTI4_ITCHIN_ADDR A:0x6014ef4
y.create.l HWIO_QDSS_QDSS_CTI4_ITTRIGIN_ADDR A:0x6014ef8
y.create.l HWIO_QDSS_QDSS_CTI4_ITCTRL_ADDR A:0x6014f00
y.create.l HWIO_QDSS_QDSS_CTI4_CLAIMSET_ADDR A:0x6014fa0
y.create.l HWIO_QDSS_QDSS_CTI4_CLAIMCLR_ADDR A:0x6014fa4
y.create.l HWIO_QDSS_QDSS_CTI4_LAR_ADDR A:0x6014fb0
y.create.l HWIO_QDSS_QDSS_CTI4_LSR_ADDR A:0x6014fb4
y.create.l HWIO_QDSS_QDSS_CTI4_AUTHSTATUS_ADDR A:0x6014fb8
y.create.l HWIO_QDSS_QDSS_CTI4_DEVID_ADDR A:0x6014fc8
y.create.l HWIO_QDSS_QDSS_CTI4_DEVTYPE_ADDR A:0x6014fcc
y.create.l HWIO_QDSS_QDSS_CTI4_PERIPHID0_ADDR A:0x6014fe0
y.create.l HWIO_QDSS_QDSS_CTI4_PERIPHID1_ADDR A:0x6014fe4
y.create.l HWIO_QDSS_QDSS_CTI4_PERIPHID2_ADDR A:0x6014fe8
y.create.l HWIO_QDSS_QDSS_CTI4_PERIPHID3_ADDR A:0x6014fec
y.create.l HWIO_QDSS_QDSS_CTI4_PERIPHID4_ADDR A:0x6014fd0
y.create.l HWIO_QDSS_QDSS_CTI4_PERIPHID5_ADDR A:0x6014fd4
y.create.l HWIO_QDSS_QDSS_CTI4_PERIPHID6_ADDR A:0x6014fd8
y.create.l HWIO_QDSS_QDSS_CTI4_PERIPHID7_ADDR A:0x6014fdc
y.create.l HWIO_QDSS_QDSS_CTI4_COMPID0_ADDR A:0x6014ff0
y.create.l HWIO_QDSS_QDSS_CTI4_COMPID1_ADDR A:0x6014ff4
y.create.l HWIO_QDSS_QDSS_CTI4_COMPID2_ADDR A:0x6014ff8
y.create.l HWIO_QDSS_QDSS_CTI4_COMPID3_ADDR A:0x6014ffc
y.create.l HWIO_QDSS_QDSS_CTI5_CTI5_CSCTI_REG_BASE_START_ADDR A:0x6015000
y.create.l HWIO_QDSS_QDSS_CTI5_CTI5_CSCTI_REG_BASE_LAST_ADDR A:0x6015ffc
y.create.l HWIO_QDSS_QDSS_CTI5_CTI5_CSCTI_REG_BASE_END_ADDR A:0x6016000
y.create.l HWIO_QDSS_QDSS_CTI5_CTICONTROL_ADDR A:0x6015000
y.create.l HWIO_QDSS_QDSS_CTI5_CTIINTACK_ADDR A:0x6015010
y.create.l HWIO_QDSS_QDSS_CTI5_CTIAPPSET_ADDR A:0x6015014
y.create.l HWIO_QDSS_QDSS_CTI5_CTIAPPCLEAR_ADDR A:0x6015018
y.create.l HWIO_QDSS_QDSS_CTI5_CTIAPPPULSE_ADDR A:0x601501c
y.create.l HWIO_QDSS_QDSS_CTI5_CTIINEN0_ADDR A:0x6015020
y.create.l HWIO_QDSS_QDSS_CTI5_CTIINEN1_ADDR A:0x6015024
y.create.l HWIO_QDSS_QDSS_CTI5_CTIINEN2_ADDR A:0x6015028
y.create.l HWIO_QDSS_QDSS_CTI5_CTIINEN3_ADDR A:0x601502c
y.create.l HWIO_QDSS_QDSS_CTI5_CTIINEN4_ADDR A:0x6015030
y.create.l HWIO_QDSS_QDSS_CTI5_CTIINEN5_ADDR A:0x6015034
y.create.l HWIO_QDSS_QDSS_CTI5_CTIINEN6_ADDR A:0x6015038
y.create.l HWIO_QDSS_QDSS_CTI5_CTIINEN7_ADDR A:0x601503c
y.create.l HWIO_QDSS_QDSS_CTI5_CTIOUTEN0_ADDR A:0x60150a0
y.create.l HWIO_QDSS_QDSS_CTI5_CTIOUTEN1_ADDR A:0x60150a4
y.create.l HWIO_QDSS_QDSS_CTI5_CTIOUTEN2_ADDR A:0x60150a8
y.create.l HWIO_QDSS_QDSS_CTI5_CTIOUTEN3_ADDR A:0x60150ac
y.create.l HWIO_QDSS_QDSS_CTI5_CTIOUTEN4_ADDR A:0x60150b0
y.create.l HWIO_QDSS_QDSS_CTI5_CTIOUTEN5_ADDR A:0x60150b4
y.create.l HWIO_QDSS_QDSS_CTI5_CTIOUTEN6_ADDR A:0x60150b8
y.create.l HWIO_QDSS_QDSS_CTI5_CTIOUTEN7_ADDR A:0x60150bc
y.create.l HWIO_QDSS_QDSS_CTI5_CTITRIGINSTATUS_ADDR A:0x6015130
y.create.l HWIO_QDSS_QDSS_CTI5_CTITRIGOUTSTATUS_ADDR A:0x6015134
y.create.l HWIO_QDSS_QDSS_CTI5_CTICHINSTATUS_ADDR A:0x6015138
y.create.l HWIO_QDSS_QDSS_CTI5_CTICHOUTSTATUS_ADDR A:0x601513c
y.create.l HWIO_QDSS_QDSS_CTI5_CTIGATE_ADDR A:0x6015140
y.create.l HWIO_QDSS_QDSS_CTI5_ASICCTL_ADDR A:0x6015144
y.create.l HWIO_QDSS_QDSS_CTI5_ITCHINACK_ADDR A:0x6015edc
y.create.l HWIO_QDSS_QDSS_CTI5_ITTRIGINACK_ADDR A:0x6015ee0
y.create.l HWIO_QDSS_QDSS_CTI5_ITCHOUT_ADDR A:0x6015ee4
y.create.l HWIO_QDSS_QDSS_CTI5_ITTRIGOUT_ADDR A:0x6015ee8
y.create.l HWIO_QDSS_QDSS_CTI5_ITCHOUTACK_ADDR A:0x6015eec
y.create.l HWIO_QDSS_QDSS_CTI5_ITTRIGOUTACK_ADDR A:0x6015ef0
y.create.l HWIO_QDSS_QDSS_CTI5_ITCHIN_ADDR A:0x6015ef4
y.create.l HWIO_QDSS_QDSS_CTI5_ITTRIGIN_ADDR A:0x6015ef8
y.create.l HWIO_QDSS_QDSS_CTI5_ITCTRL_ADDR A:0x6015f00
y.create.l HWIO_QDSS_QDSS_CTI5_CLAIMSET_ADDR A:0x6015fa0
y.create.l HWIO_QDSS_QDSS_CTI5_CLAIMCLR_ADDR A:0x6015fa4
y.create.l HWIO_QDSS_QDSS_CTI5_LAR_ADDR A:0x6015fb0
y.create.l HWIO_QDSS_QDSS_CTI5_LSR_ADDR A:0x6015fb4
y.create.l HWIO_QDSS_QDSS_CTI5_AUTHSTATUS_ADDR A:0x6015fb8
y.create.l HWIO_QDSS_QDSS_CTI5_DEVID_ADDR A:0x6015fc8
y.create.l HWIO_QDSS_QDSS_CTI5_DEVTYPE_ADDR A:0x6015fcc
y.create.l HWIO_QDSS_QDSS_CTI5_PERIPHID0_ADDR A:0x6015fe0
y.create.l HWIO_QDSS_QDSS_CTI5_PERIPHID1_ADDR A:0x6015fe4
y.create.l HWIO_QDSS_QDSS_CTI5_PERIPHID2_ADDR A:0x6015fe8
y.create.l HWIO_QDSS_QDSS_CTI5_PERIPHID3_ADDR A:0x6015fec
y.create.l HWIO_QDSS_QDSS_CTI5_PERIPHID4_ADDR A:0x6015fd0
y.create.l HWIO_QDSS_QDSS_CTI5_PERIPHID5_ADDR A:0x6015fd4
y.create.l HWIO_QDSS_QDSS_CTI5_PERIPHID6_ADDR A:0x6015fd8
y.create.l HWIO_QDSS_QDSS_CTI5_PERIPHID7_ADDR A:0x6015fdc
y.create.l HWIO_QDSS_QDSS_CTI5_COMPID0_ADDR A:0x6015ff0
y.create.l HWIO_QDSS_QDSS_CTI5_COMPID1_ADDR A:0x6015ff4
y.create.l HWIO_QDSS_QDSS_CTI5_COMPID2_ADDR A:0x6015ff8
y.create.l HWIO_QDSS_QDSS_CTI5_COMPID3_ADDR A:0x6015ffc
y.create.l HWIO_QDSS_QDSS_CTI6_CTI6_CSCTI_REG_BASE_START_ADDR A:0x6016000
y.create.l HWIO_QDSS_QDSS_CTI6_CTI6_CSCTI_REG_BASE_LAST_ADDR A:0x6016ffc
y.create.l HWIO_QDSS_QDSS_CTI6_CTI6_CSCTI_REG_BASE_END_ADDR A:0x6017000
y.create.l HWIO_QDSS_QDSS_CTI6_CTICONTROL_ADDR A:0x6016000
y.create.l HWIO_QDSS_QDSS_CTI6_CTIINTACK_ADDR A:0x6016010
y.create.l HWIO_QDSS_QDSS_CTI6_CTIAPPSET_ADDR A:0x6016014
y.create.l HWIO_QDSS_QDSS_CTI6_CTIAPPCLEAR_ADDR A:0x6016018
y.create.l HWIO_QDSS_QDSS_CTI6_CTIAPPPULSE_ADDR A:0x601601c
y.create.l HWIO_QDSS_QDSS_CTI6_CTIINEN0_ADDR A:0x6016020
y.create.l HWIO_QDSS_QDSS_CTI6_CTIINEN1_ADDR A:0x6016024
y.create.l HWIO_QDSS_QDSS_CTI6_CTIINEN2_ADDR A:0x6016028
y.create.l HWIO_QDSS_QDSS_CTI6_CTIINEN3_ADDR A:0x601602c
y.create.l HWIO_QDSS_QDSS_CTI6_CTIINEN4_ADDR A:0x6016030
y.create.l HWIO_QDSS_QDSS_CTI6_CTIINEN5_ADDR A:0x6016034
y.create.l HWIO_QDSS_QDSS_CTI6_CTIINEN6_ADDR A:0x6016038
y.create.l HWIO_QDSS_QDSS_CTI6_CTIINEN7_ADDR A:0x601603c
y.create.l HWIO_QDSS_QDSS_CTI6_CTIOUTEN0_ADDR A:0x60160a0
y.create.l HWIO_QDSS_QDSS_CTI6_CTIOUTEN1_ADDR A:0x60160a4
y.create.l HWIO_QDSS_QDSS_CTI6_CTIOUTEN2_ADDR A:0x60160a8
y.create.l HWIO_QDSS_QDSS_CTI6_CTIOUTEN3_ADDR A:0x60160ac
y.create.l HWIO_QDSS_QDSS_CTI6_CTIOUTEN4_ADDR A:0x60160b0
y.create.l HWIO_QDSS_QDSS_CTI6_CTIOUTEN5_ADDR A:0x60160b4
y.create.l HWIO_QDSS_QDSS_CTI6_CTIOUTEN6_ADDR A:0x60160b8
y.create.l HWIO_QDSS_QDSS_CTI6_CTIOUTEN7_ADDR A:0x60160bc
y.create.l HWIO_QDSS_QDSS_CTI6_CTITRIGINSTATUS_ADDR A:0x6016130
y.create.l HWIO_QDSS_QDSS_CTI6_CTITRIGOUTSTATUS_ADDR A:0x6016134
y.create.l HWIO_QDSS_QDSS_CTI6_CTICHINSTATUS_ADDR A:0x6016138
y.create.l HWIO_QDSS_QDSS_CTI6_CTICHOUTSTATUS_ADDR A:0x601613c
y.create.l HWIO_QDSS_QDSS_CTI6_CTIGATE_ADDR A:0x6016140
y.create.l HWIO_QDSS_QDSS_CTI6_ASICCTL_ADDR A:0x6016144
y.create.l HWIO_QDSS_QDSS_CTI6_ITCHINACK_ADDR A:0x6016edc
y.create.l HWIO_QDSS_QDSS_CTI6_ITTRIGINACK_ADDR A:0x6016ee0
y.create.l HWIO_QDSS_QDSS_CTI6_ITCHOUT_ADDR A:0x6016ee4
y.create.l HWIO_QDSS_QDSS_CTI6_ITTRIGOUT_ADDR A:0x6016ee8
y.create.l HWIO_QDSS_QDSS_CTI6_ITCHOUTACK_ADDR A:0x6016eec
y.create.l HWIO_QDSS_QDSS_CTI6_ITTRIGOUTACK_ADDR A:0x6016ef0
y.create.l HWIO_QDSS_QDSS_CTI6_ITCHIN_ADDR A:0x6016ef4
y.create.l HWIO_QDSS_QDSS_CTI6_ITTRIGIN_ADDR A:0x6016ef8
y.create.l HWIO_QDSS_QDSS_CTI6_ITCTRL_ADDR A:0x6016f00
y.create.l HWIO_QDSS_QDSS_CTI6_CLAIMSET_ADDR A:0x6016fa0
y.create.l HWIO_QDSS_QDSS_CTI6_CLAIMCLR_ADDR A:0x6016fa4
y.create.l HWIO_QDSS_QDSS_CTI6_LAR_ADDR A:0x6016fb0
y.create.l HWIO_QDSS_QDSS_CTI6_LSR_ADDR A:0x6016fb4
y.create.l HWIO_QDSS_QDSS_CTI6_AUTHSTATUS_ADDR A:0x6016fb8
y.create.l HWIO_QDSS_QDSS_CTI6_DEVID_ADDR A:0x6016fc8
y.create.l HWIO_QDSS_QDSS_CTI6_DEVTYPE_ADDR A:0x6016fcc
y.create.l HWIO_QDSS_QDSS_CTI6_PERIPHID0_ADDR A:0x6016fe0
y.create.l HWIO_QDSS_QDSS_CTI6_PERIPHID1_ADDR A:0x6016fe4
y.create.l HWIO_QDSS_QDSS_CTI6_PERIPHID2_ADDR A:0x6016fe8
y.create.l HWIO_QDSS_QDSS_CTI6_PERIPHID3_ADDR A:0x6016fec
y.create.l HWIO_QDSS_QDSS_CTI6_PERIPHID4_ADDR A:0x6016fd0
y.create.l HWIO_QDSS_QDSS_CTI6_PERIPHID5_ADDR A:0x6016fd4
y.create.l HWIO_QDSS_QDSS_CTI6_PERIPHID6_ADDR A:0x6016fd8
y.create.l HWIO_QDSS_QDSS_CTI6_PERIPHID7_ADDR A:0x6016fdc
y.create.l HWIO_QDSS_QDSS_CTI6_COMPID0_ADDR A:0x6016ff0
y.create.l HWIO_QDSS_QDSS_CTI6_COMPID1_ADDR A:0x6016ff4
y.create.l HWIO_QDSS_QDSS_CTI6_COMPID2_ADDR A:0x6016ff8
y.create.l HWIO_QDSS_QDSS_CTI6_COMPID3_ADDR A:0x6016ffc
y.create.l HWIO_QDSS_QDSS_CTI7_CTI7_CSCTI_REG_BASE_START_ADDR A:0x6017000
y.create.l HWIO_QDSS_QDSS_CTI7_CTI7_CSCTI_REG_BASE_LAST_ADDR A:0x6017ffc
y.create.l HWIO_QDSS_QDSS_CTI7_CTI7_CSCTI_REG_BASE_END_ADDR A:0x6018000
y.create.l HWIO_QDSS_QDSS_CTI7_CTICONTROL_ADDR A:0x6017000
y.create.l HWIO_QDSS_QDSS_CTI7_CTIINTACK_ADDR A:0x6017010
y.create.l HWIO_QDSS_QDSS_CTI7_CTIAPPSET_ADDR A:0x6017014
y.create.l HWIO_QDSS_QDSS_CTI7_CTIAPPCLEAR_ADDR A:0x6017018
y.create.l HWIO_QDSS_QDSS_CTI7_CTIAPPPULSE_ADDR A:0x601701c
y.create.l HWIO_QDSS_QDSS_CTI7_CTIINEN0_ADDR A:0x6017020
y.create.l HWIO_QDSS_QDSS_CTI7_CTIINEN1_ADDR A:0x6017024
y.create.l HWIO_QDSS_QDSS_CTI7_CTIINEN2_ADDR A:0x6017028
y.create.l HWIO_QDSS_QDSS_CTI7_CTIINEN3_ADDR A:0x601702c
y.create.l HWIO_QDSS_QDSS_CTI7_CTIINEN4_ADDR A:0x6017030
y.create.l HWIO_QDSS_QDSS_CTI7_CTIINEN5_ADDR A:0x6017034
y.create.l HWIO_QDSS_QDSS_CTI7_CTIINEN6_ADDR A:0x6017038
y.create.l HWIO_QDSS_QDSS_CTI7_CTIINEN7_ADDR A:0x601703c
y.create.l HWIO_QDSS_QDSS_CTI7_CTIOUTEN0_ADDR A:0x60170a0
y.create.l HWIO_QDSS_QDSS_CTI7_CTIOUTEN1_ADDR A:0x60170a4
y.create.l HWIO_QDSS_QDSS_CTI7_CTIOUTEN2_ADDR A:0x60170a8
y.create.l HWIO_QDSS_QDSS_CTI7_CTIOUTEN3_ADDR A:0x60170ac
y.create.l HWIO_QDSS_QDSS_CTI7_CTIOUTEN4_ADDR A:0x60170b0
y.create.l HWIO_QDSS_QDSS_CTI7_CTIOUTEN5_ADDR A:0x60170b4
y.create.l HWIO_QDSS_QDSS_CTI7_CTIOUTEN6_ADDR A:0x60170b8
y.create.l HWIO_QDSS_QDSS_CTI7_CTIOUTEN7_ADDR A:0x60170bc
y.create.l HWIO_QDSS_QDSS_CTI7_CTITRIGINSTATUS_ADDR A:0x6017130
y.create.l HWIO_QDSS_QDSS_CTI7_CTITRIGOUTSTATUS_ADDR A:0x6017134
y.create.l HWIO_QDSS_QDSS_CTI7_CTICHINSTATUS_ADDR A:0x6017138
y.create.l HWIO_QDSS_QDSS_CTI7_CTICHOUTSTATUS_ADDR A:0x601713c
y.create.l HWIO_QDSS_QDSS_CTI7_CTIGATE_ADDR A:0x6017140
y.create.l HWIO_QDSS_QDSS_CTI7_ASICCTL_ADDR A:0x6017144
y.create.l HWIO_QDSS_QDSS_CTI7_ITCHINACK_ADDR A:0x6017edc
y.create.l HWIO_QDSS_QDSS_CTI7_ITTRIGINACK_ADDR A:0x6017ee0
y.create.l HWIO_QDSS_QDSS_CTI7_ITCHOUT_ADDR A:0x6017ee4
y.create.l HWIO_QDSS_QDSS_CTI7_ITTRIGOUT_ADDR A:0x6017ee8
y.create.l HWIO_QDSS_QDSS_CTI7_ITCHOUTACK_ADDR A:0x6017eec
y.create.l HWIO_QDSS_QDSS_CTI7_ITTRIGOUTACK_ADDR A:0x6017ef0
y.create.l HWIO_QDSS_QDSS_CTI7_ITCHIN_ADDR A:0x6017ef4
y.create.l HWIO_QDSS_QDSS_CTI7_ITTRIGIN_ADDR A:0x6017ef8
y.create.l HWIO_QDSS_QDSS_CTI7_ITCTRL_ADDR A:0x6017f00
y.create.l HWIO_QDSS_QDSS_CTI7_CLAIMSET_ADDR A:0x6017fa0
y.create.l HWIO_QDSS_QDSS_CTI7_CLAIMCLR_ADDR A:0x6017fa4
y.create.l HWIO_QDSS_QDSS_CTI7_LAR_ADDR A:0x6017fb0
y.create.l HWIO_QDSS_QDSS_CTI7_LSR_ADDR A:0x6017fb4
y.create.l HWIO_QDSS_QDSS_CTI7_AUTHSTATUS_ADDR A:0x6017fb8
y.create.l HWIO_QDSS_QDSS_CTI7_DEVID_ADDR A:0x6017fc8
y.create.l HWIO_QDSS_QDSS_CTI7_DEVTYPE_ADDR A:0x6017fcc
y.create.l HWIO_QDSS_QDSS_CTI7_PERIPHID0_ADDR A:0x6017fe0
y.create.l HWIO_QDSS_QDSS_CTI7_PERIPHID1_ADDR A:0x6017fe4
y.create.l HWIO_QDSS_QDSS_CTI7_PERIPHID2_ADDR A:0x6017fe8
y.create.l HWIO_QDSS_QDSS_CTI7_PERIPHID3_ADDR A:0x6017fec
y.create.l HWIO_QDSS_QDSS_CTI7_PERIPHID4_ADDR A:0x6017fd0
y.create.l HWIO_QDSS_QDSS_CTI7_PERIPHID5_ADDR A:0x6017fd4
y.create.l HWIO_QDSS_QDSS_CTI7_PERIPHID6_ADDR A:0x6017fd8
y.create.l HWIO_QDSS_QDSS_CTI7_PERIPHID7_ADDR A:0x6017fdc
y.create.l HWIO_QDSS_QDSS_CTI7_COMPID0_ADDR A:0x6017ff0
y.create.l HWIO_QDSS_QDSS_CTI7_COMPID1_ADDR A:0x6017ff4
y.create.l HWIO_QDSS_QDSS_CTI7_COMPID2_ADDR A:0x6017ff8
y.create.l HWIO_QDSS_QDSS_CTI7_COMPID3_ADDR A:0x6017ffc
y.create.l HWIO_QDSS_QDSS_CTI8_CTI8_CSCTI_REG_BASE_START_ADDR A:0x6018000
y.create.l HWIO_QDSS_QDSS_CTI8_CTI8_CSCTI_REG_BASE_LAST_ADDR A:0x6018ffc
y.create.l HWIO_QDSS_QDSS_CTI8_CTI8_CSCTI_REG_BASE_END_ADDR A:0x6019000
y.create.l HWIO_QDSS_QDSS_CTI8_CTICONTROL_ADDR A:0x6018000
y.create.l HWIO_QDSS_QDSS_CTI8_CTIINTACK_ADDR A:0x6018010
y.create.l HWIO_QDSS_QDSS_CTI8_CTIAPPSET_ADDR A:0x6018014
y.create.l HWIO_QDSS_QDSS_CTI8_CTIAPPCLEAR_ADDR A:0x6018018
y.create.l HWIO_QDSS_QDSS_CTI8_CTIAPPPULSE_ADDR A:0x601801c
y.create.l HWIO_QDSS_QDSS_CTI8_CTIINEN0_ADDR A:0x6018020
y.create.l HWIO_QDSS_QDSS_CTI8_CTIINEN1_ADDR A:0x6018024
y.create.l HWIO_QDSS_QDSS_CTI8_CTIINEN2_ADDR A:0x6018028
y.create.l HWIO_QDSS_QDSS_CTI8_CTIINEN3_ADDR A:0x601802c
y.create.l HWIO_QDSS_QDSS_CTI8_CTIINEN4_ADDR A:0x6018030
y.create.l HWIO_QDSS_QDSS_CTI8_CTIINEN5_ADDR A:0x6018034
y.create.l HWIO_QDSS_QDSS_CTI8_CTIINEN6_ADDR A:0x6018038
y.create.l HWIO_QDSS_QDSS_CTI8_CTIINEN7_ADDR A:0x601803c
y.create.l HWIO_QDSS_QDSS_CTI8_CTIOUTEN0_ADDR A:0x60180a0
y.create.l HWIO_QDSS_QDSS_CTI8_CTIOUTEN1_ADDR A:0x60180a4
y.create.l HWIO_QDSS_QDSS_CTI8_CTIOUTEN2_ADDR A:0x60180a8
y.create.l HWIO_QDSS_QDSS_CTI8_CTIOUTEN3_ADDR A:0x60180ac
y.create.l HWIO_QDSS_QDSS_CTI8_CTIOUTEN4_ADDR A:0x60180b0
y.create.l HWIO_QDSS_QDSS_CTI8_CTIOUTEN5_ADDR A:0x60180b4
y.create.l HWIO_QDSS_QDSS_CTI8_CTIOUTEN6_ADDR A:0x60180b8
y.create.l HWIO_QDSS_QDSS_CTI8_CTIOUTEN7_ADDR A:0x60180bc
y.create.l HWIO_QDSS_QDSS_CTI8_CTITRIGINSTATUS_ADDR A:0x6018130
y.create.l HWIO_QDSS_QDSS_CTI8_CTITRIGOUTSTATUS_ADDR A:0x6018134
y.create.l HWIO_QDSS_QDSS_CTI8_CTICHINSTATUS_ADDR A:0x6018138
y.create.l HWIO_QDSS_QDSS_CTI8_CTICHOUTSTATUS_ADDR A:0x601813c
y.create.l HWIO_QDSS_QDSS_CTI8_CTIGATE_ADDR A:0x6018140
y.create.l HWIO_QDSS_QDSS_CTI8_ASICCTL_ADDR A:0x6018144
y.create.l HWIO_QDSS_QDSS_CTI8_ITCHINACK_ADDR A:0x6018edc
y.create.l HWIO_QDSS_QDSS_CTI8_ITTRIGINACK_ADDR A:0x6018ee0
y.create.l HWIO_QDSS_QDSS_CTI8_ITCHOUT_ADDR A:0x6018ee4
y.create.l HWIO_QDSS_QDSS_CTI8_ITTRIGOUT_ADDR A:0x6018ee8
y.create.l HWIO_QDSS_QDSS_CTI8_ITCHOUTACK_ADDR A:0x6018eec
y.create.l HWIO_QDSS_QDSS_CTI8_ITTRIGOUTACK_ADDR A:0x6018ef0
y.create.l HWIO_QDSS_QDSS_CTI8_ITCHIN_ADDR A:0x6018ef4
y.create.l HWIO_QDSS_QDSS_CTI8_ITTRIGIN_ADDR A:0x6018ef8
y.create.l HWIO_QDSS_QDSS_CTI8_ITCTRL_ADDR A:0x6018f00
y.create.l HWIO_QDSS_QDSS_CTI8_CLAIMSET_ADDR A:0x6018fa0
y.create.l HWIO_QDSS_QDSS_CTI8_CLAIMCLR_ADDR A:0x6018fa4
y.create.l HWIO_QDSS_QDSS_CTI8_LAR_ADDR A:0x6018fb0
y.create.l HWIO_QDSS_QDSS_CTI8_LSR_ADDR A:0x6018fb4
y.create.l HWIO_QDSS_QDSS_CTI8_AUTHSTATUS_ADDR A:0x6018fb8
y.create.l HWIO_QDSS_QDSS_CTI8_DEVID_ADDR A:0x6018fc8
y.create.l HWIO_QDSS_QDSS_CTI8_DEVTYPE_ADDR A:0x6018fcc
y.create.l HWIO_QDSS_QDSS_CTI8_PERIPHID0_ADDR A:0x6018fe0
y.create.l HWIO_QDSS_QDSS_CTI8_PERIPHID1_ADDR A:0x6018fe4
y.create.l HWIO_QDSS_QDSS_CTI8_PERIPHID2_ADDR A:0x6018fe8
y.create.l HWIO_QDSS_QDSS_CTI8_PERIPHID3_ADDR A:0x6018fec
y.create.l HWIO_QDSS_QDSS_CTI8_PERIPHID4_ADDR A:0x6018fd0
y.create.l HWIO_QDSS_QDSS_CTI8_PERIPHID5_ADDR A:0x6018fd4
y.create.l HWIO_QDSS_QDSS_CTI8_PERIPHID6_ADDR A:0x6018fd8
y.create.l HWIO_QDSS_QDSS_CTI8_PERIPHID7_ADDR A:0x6018fdc
y.create.l HWIO_QDSS_QDSS_CTI8_COMPID0_ADDR A:0x6018ff0
y.create.l HWIO_QDSS_QDSS_CTI8_COMPID1_ADDR A:0x6018ff4
y.create.l HWIO_QDSS_QDSS_CTI8_COMPID2_ADDR A:0x6018ff8
y.create.l HWIO_QDSS_QDSS_CTI8_COMPID3_ADDR A:0x6018ffc
y.create.l HWIO_QDSS_QDSS_CTI9_CTI9_CSCTI_REG_BASE_START_ADDR A:0x6019000
y.create.l HWIO_QDSS_QDSS_CTI9_CTI9_CSCTI_REG_BASE_LAST_ADDR A:0x6019ffc
y.create.l HWIO_QDSS_QDSS_CTI9_CTI9_CSCTI_REG_BASE_END_ADDR A:0x601a000
y.create.l HWIO_QDSS_QDSS_CTI9_CTICONTROL_ADDR A:0x6019000
y.create.l HWIO_QDSS_QDSS_CTI9_CTIINTACK_ADDR A:0x6019010
y.create.l HWIO_QDSS_QDSS_CTI9_CTIAPPSET_ADDR A:0x6019014
y.create.l HWIO_QDSS_QDSS_CTI9_CTIAPPCLEAR_ADDR A:0x6019018
y.create.l HWIO_QDSS_QDSS_CTI9_CTIAPPPULSE_ADDR A:0x601901c
y.create.l HWIO_QDSS_QDSS_CTI9_CTIINEN0_ADDR A:0x6019020
y.create.l HWIO_QDSS_QDSS_CTI9_CTIINEN1_ADDR A:0x6019024
y.create.l HWIO_QDSS_QDSS_CTI9_CTIINEN2_ADDR A:0x6019028
y.create.l HWIO_QDSS_QDSS_CTI9_CTIINEN3_ADDR A:0x601902c
y.create.l HWIO_QDSS_QDSS_CTI9_CTIINEN4_ADDR A:0x6019030
y.create.l HWIO_QDSS_QDSS_CTI9_CTIINEN5_ADDR A:0x6019034
y.create.l HWIO_QDSS_QDSS_CTI9_CTIINEN6_ADDR A:0x6019038
y.create.l HWIO_QDSS_QDSS_CTI9_CTIINEN7_ADDR A:0x601903c
y.create.l HWIO_QDSS_QDSS_CTI9_CTIOUTEN0_ADDR A:0x60190a0
y.create.l HWIO_QDSS_QDSS_CTI9_CTIOUTEN1_ADDR A:0x60190a4
y.create.l HWIO_QDSS_QDSS_CTI9_CTIOUTEN2_ADDR A:0x60190a8
y.create.l HWIO_QDSS_QDSS_CTI9_CTIOUTEN3_ADDR A:0x60190ac
y.create.l HWIO_QDSS_QDSS_CTI9_CTIOUTEN4_ADDR A:0x60190b0
y.create.l HWIO_QDSS_QDSS_CTI9_CTIOUTEN5_ADDR A:0x60190b4
y.create.l HWIO_QDSS_QDSS_CTI9_CTIOUTEN6_ADDR A:0x60190b8
y.create.l HWIO_QDSS_QDSS_CTI9_CTIOUTEN7_ADDR A:0x60190bc
y.create.l HWIO_QDSS_QDSS_CTI9_CTITRIGINSTATUS_ADDR A:0x6019130
y.create.l HWIO_QDSS_QDSS_CTI9_CTITRIGOUTSTATUS_ADDR A:0x6019134
y.create.l HWIO_QDSS_QDSS_CTI9_CTICHINSTATUS_ADDR A:0x6019138
y.create.l HWIO_QDSS_QDSS_CTI9_CTICHOUTSTATUS_ADDR A:0x601913c
y.create.l HWIO_QDSS_QDSS_CTI9_CTIGATE_ADDR A:0x6019140
y.create.l HWIO_QDSS_QDSS_CTI9_ASICCTL_ADDR A:0x6019144
y.create.l HWIO_QDSS_QDSS_CTI9_ITCHINACK_ADDR A:0x6019edc
y.create.l HWIO_QDSS_QDSS_CTI9_ITTRIGINACK_ADDR A:0x6019ee0
y.create.l HWIO_QDSS_QDSS_CTI9_ITCHOUT_ADDR A:0x6019ee4
y.create.l HWIO_QDSS_QDSS_CTI9_ITTRIGOUT_ADDR A:0x6019ee8
y.create.l HWIO_QDSS_QDSS_CTI9_ITCHOUTACK_ADDR A:0x6019eec
y.create.l HWIO_QDSS_QDSS_CTI9_ITTRIGOUTACK_ADDR A:0x6019ef0
y.create.l HWIO_QDSS_QDSS_CTI9_ITCHIN_ADDR A:0x6019ef4
y.create.l HWIO_QDSS_QDSS_CTI9_ITTRIGIN_ADDR A:0x6019ef8
y.create.l HWIO_QDSS_QDSS_CTI9_ITCTRL_ADDR A:0x6019f00
y.create.l HWIO_QDSS_QDSS_CTI9_CLAIMSET_ADDR A:0x6019fa0
y.create.l HWIO_QDSS_QDSS_CTI9_CLAIMCLR_ADDR A:0x6019fa4
y.create.l HWIO_QDSS_QDSS_CTI9_LAR_ADDR A:0x6019fb0
y.create.l HWIO_QDSS_QDSS_CTI9_LSR_ADDR A:0x6019fb4
y.create.l HWIO_QDSS_QDSS_CTI9_AUTHSTATUS_ADDR A:0x6019fb8
y.create.l HWIO_QDSS_QDSS_CTI9_DEVID_ADDR A:0x6019fc8
y.create.l HWIO_QDSS_QDSS_CTI9_DEVTYPE_ADDR A:0x6019fcc
y.create.l HWIO_QDSS_QDSS_CTI9_PERIPHID0_ADDR A:0x6019fe0
y.create.l HWIO_QDSS_QDSS_CTI9_PERIPHID1_ADDR A:0x6019fe4
y.create.l HWIO_QDSS_QDSS_CTI9_PERIPHID2_ADDR A:0x6019fe8
y.create.l HWIO_QDSS_QDSS_CTI9_PERIPHID3_ADDR A:0x6019fec
y.create.l HWIO_QDSS_QDSS_CTI9_PERIPHID4_ADDR A:0x6019fd0
y.create.l HWIO_QDSS_QDSS_CTI9_PERIPHID5_ADDR A:0x6019fd4
y.create.l HWIO_QDSS_QDSS_CTI9_PERIPHID6_ADDR A:0x6019fd8
y.create.l HWIO_QDSS_QDSS_CTI9_PERIPHID7_ADDR A:0x6019fdc
y.create.l HWIO_QDSS_QDSS_CTI9_COMPID0_ADDR A:0x6019ff0
y.create.l HWIO_QDSS_QDSS_CTI9_COMPID1_ADDR A:0x6019ff4
y.create.l HWIO_QDSS_QDSS_CTI9_COMPID2_ADDR A:0x6019ff8
y.create.l HWIO_QDSS_QDSS_CTI9_COMPID3_ADDR A:0x6019ffc
y.create.l HWIO_QDSS_QDSS_CTI10_CTI10_CSCTI_REG_BASE_START_ADDR A:0x601a000
y.create.l HWIO_QDSS_QDSS_CTI10_CTI10_CSCTI_REG_BASE_LAST_ADDR A:0x601affc
y.create.l HWIO_QDSS_QDSS_CTI10_CTI10_CSCTI_REG_BASE_END_ADDR A:0x601b000
y.create.l HWIO_QDSS_QDSS_CTI10_CTICONTROL_ADDR A:0x601a000
y.create.l HWIO_QDSS_QDSS_CTI10_CTIINTACK_ADDR A:0x601a010
y.create.l HWIO_QDSS_QDSS_CTI10_CTIAPPSET_ADDR A:0x601a014
y.create.l HWIO_QDSS_QDSS_CTI10_CTIAPPCLEAR_ADDR A:0x601a018
y.create.l HWIO_QDSS_QDSS_CTI10_CTIAPPPULSE_ADDR A:0x601a01c
y.create.l HWIO_QDSS_QDSS_CTI10_CTIINEN0_ADDR A:0x601a020
y.create.l HWIO_QDSS_QDSS_CTI10_CTIINEN1_ADDR A:0x601a024
y.create.l HWIO_QDSS_QDSS_CTI10_CTIINEN2_ADDR A:0x601a028
y.create.l HWIO_QDSS_QDSS_CTI10_CTIINEN3_ADDR A:0x601a02c
y.create.l HWIO_QDSS_QDSS_CTI10_CTIINEN4_ADDR A:0x601a030
y.create.l HWIO_QDSS_QDSS_CTI10_CTIINEN5_ADDR A:0x601a034
y.create.l HWIO_QDSS_QDSS_CTI10_CTIINEN6_ADDR A:0x601a038
y.create.l HWIO_QDSS_QDSS_CTI10_CTIINEN7_ADDR A:0x601a03c
y.create.l HWIO_QDSS_QDSS_CTI10_CTIOUTEN0_ADDR A:0x601a0a0
y.create.l HWIO_QDSS_QDSS_CTI10_CTIOUTEN1_ADDR A:0x601a0a4
y.create.l HWIO_QDSS_QDSS_CTI10_CTIOUTEN2_ADDR A:0x601a0a8
y.create.l HWIO_QDSS_QDSS_CTI10_CTIOUTEN3_ADDR A:0x601a0ac
y.create.l HWIO_QDSS_QDSS_CTI10_CTIOUTEN4_ADDR A:0x601a0b0
y.create.l HWIO_QDSS_QDSS_CTI10_CTIOUTEN5_ADDR A:0x601a0b4
y.create.l HWIO_QDSS_QDSS_CTI10_CTIOUTEN6_ADDR A:0x601a0b8
y.create.l HWIO_QDSS_QDSS_CTI10_CTIOUTEN7_ADDR A:0x601a0bc
y.create.l HWIO_QDSS_QDSS_CTI10_CTITRIGINSTATUS_ADDR A:0x601a130
y.create.l HWIO_QDSS_QDSS_CTI10_CTITRIGOUTSTATUS_ADDR A:0x601a134
y.create.l HWIO_QDSS_QDSS_CTI10_CTICHINSTATUS_ADDR A:0x601a138
y.create.l HWIO_QDSS_QDSS_CTI10_CTICHOUTSTATUS_ADDR A:0x601a13c
y.create.l HWIO_QDSS_QDSS_CTI10_CTIGATE_ADDR A:0x601a140
y.create.l HWIO_QDSS_QDSS_CTI10_ASICCTL_ADDR A:0x601a144
y.create.l HWIO_QDSS_QDSS_CTI10_ITCHINACK_ADDR A:0x601aedc
y.create.l HWIO_QDSS_QDSS_CTI10_ITTRIGINACK_ADDR A:0x601aee0
y.create.l HWIO_QDSS_QDSS_CTI10_ITCHOUT_ADDR A:0x601aee4
y.create.l HWIO_QDSS_QDSS_CTI10_ITTRIGOUT_ADDR A:0x601aee8
y.create.l HWIO_QDSS_QDSS_CTI10_ITCHOUTACK_ADDR A:0x601aeec
y.create.l HWIO_QDSS_QDSS_CTI10_ITTRIGOUTACK_ADDR A:0x601aef0
y.create.l HWIO_QDSS_QDSS_CTI10_ITCHIN_ADDR A:0x601aef4
y.create.l HWIO_QDSS_QDSS_CTI10_ITTRIGIN_ADDR A:0x601aef8
y.create.l HWIO_QDSS_QDSS_CTI10_ITCTRL_ADDR A:0x601af00
y.create.l HWIO_QDSS_QDSS_CTI10_CLAIMSET_ADDR A:0x601afa0
y.create.l HWIO_QDSS_QDSS_CTI10_CLAIMCLR_ADDR A:0x601afa4
y.create.l HWIO_QDSS_QDSS_CTI10_LAR_ADDR A:0x601afb0
y.create.l HWIO_QDSS_QDSS_CTI10_LSR_ADDR A:0x601afb4
y.create.l HWIO_QDSS_QDSS_CTI10_AUTHSTATUS_ADDR A:0x601afb8
y.create.l HWIO_QDSS_QDSS_CTI10_DEVID_ADDR A:0x601afc8
y.create.l HWIO_QDSS_QDSS_CTI10_DEVTYPE_ADDR A:0x601afcc
y.create.l HWIO_QDSS_QDSS_CTI10_PERIPHID0_ADDR A:0x601afe0
y.create.l HWIO_QDSS_QDSS_CTI10_PERIPHID1_ADDR A:0x601afe4
y.create.l HWIO_QDSS_QDSS_CTI10_PERIPHID2_ADDR A:0x601afe8
y.create.l HWIO_QDSS_QDSS_CTI10_PERIPHID3_ADDR A:0x601afec
y.create.l HWIO_QDSS_QDSS_CTI10_PERIPHID4_ADDR A:0x601afd0
y.create.l HWIO_QDSS_QDSS_CTI10_PERIPHID5_ADDR A:0x601afd4
y.create.l HWIO_QDSS_QDSS_CTI10_PERIPHID6_ADDR A:0x601afd8
y.create.l HWIO_QDSS_QDSS_CTI10_PERIPHID7_ADDR A:0x601afdc
y.create.l HWIO_QDSS_QDSS_CTI10_COMPID0_ADDR A:0x601aff0
y.create.l HWIO_QDSS_QDSS_CTI10_COMPID1_ADDR A:0x601aff4
y.create.l HWIO_QDSS_QDSS_CTI10_COMPID2_ADDR A:0x601aff8
y.create.l HWIO_QDSS_QDSS_CTI10_COMPID3_ADDR A:0x601affc
y.create.l HWIO_QDSS_QDSS_CTI11_CTI11_CSCTI_REG_BASE_START_ADDR A:0x601b000
y.create.l HWIO_QDSS_QDSS_CTI11_CTI11_CSCTI_REG_BASE_LAST_ADDR A:0x601bffc
y.create.l HWIO_QDSS_QDSS_CTI11_CTI11_CSCTI_REG_BASE_END_ADDR A:0x601c000
y.create.l HWIO_QDSS_QDSS_CTI11_CTICONTROL_ADDR A:0x601b000
y.create.l HWIO_QDSS_QDSS_CTI11_CTIINTACK_ADDR A:0x601b010
y.create.l HWIO_QDSS_QDSS_CTI11_CTIAPPSET_ADDR A:0x601b014
y.create.l HWIO_QDSS_QDSS_CTI11_CTIAPPCLEAR_ADDR A:0x601b018
y.create.l HWIO_QDSS_QDSS_CTI11_CTIAPPPULSE_ADDR A:0x601b01c
y.create.l HWIO_QDSS_QDSS_CTI11_CTIINEN0_ADDR A:0x601b020
y.create.l HWIO_QDSS_QDSS_CTI11_CTIINEN1_ADDR A:0x601b024
y.create.l HWIO_QDSS_QDSS_CTI11_CTIINEN2_ADDR A:0x601b028
y.create.l HWIO_QDSS_QDSS_CTI11_CTIINEN3_ADDR A:0x601b02c
y.create.l HWIO_QDSS_QDSS_CTI11_CTIINEN4_ADDR A:0x601b030
y.create.l HWIO_QDSS_QDSS_CTI11_CTIINEN5_ADDR A:0x601b034
y.create.l HWIO_QDSS_QDSS_CTI11_CTIINEN6_ADDR A:0x601b038
y.create.l HWIO_QDSS_QDSS_CTI11_CTIINEN7_ADDR A:0x601b03c
y.create.l HWIO_QDSS_QDSS_CTI11_CTIOUTEN0_ADDR A:0x601b0a0
y.create.l HWIO_QDSS_QDSS_CTI11_CTIOUTEN1_ADDR A:0x601b0a4
y.create.l HWIO_QDSS_QDSS_CTI11_CTIOUTEN2_ADDR A:0x601b0a8
y.create.l HWIO_QDSS_QDSS_CTI11_CTIOUTEN3_ADDR A:0x601b0ac
y.create.l HWIO_QDSS_QDSS_CTI11_CTIOUTEN4_ADDR A:0x601b0b0
y.create.l HWIO_QDSS_QDSS_CTI11_CTIOUTEN5_ADDR A:0x601b0b4
y.create.l HWIO_QDSS_QDSS_CTI11_CTIOUTEN6_ADDR A:0x601b0b8
y.create.l HWIO_QDSS_QDSS_CTI11_CTIOUTEN7_ADDR A:0x601b0bc
y.create.l HWIO_QDSS_QDSS_CTI11_CTITRIGINSTATUS_ADDR A:0x601b130
y.create.l HWIO_QDSS_QDSS_CTI11_CTITRIGOUTSTATUS_ADDR A:0x601b134
y.create.l HWIO_QDSS_QDSS_CTI11_CTICHINSTATUS_ADDR A:0x601b138
y.create.l HWIO_QDSS_QDSS_CTI11_CTICHOUTSTATUS_ADDR A:0x601b13c
y.create.l HWIO_QDSS_QDSS_CTI11_CTIGATE_ADDR A:0x601b140
y.create.l HWIO_QDSS_QDSS_CTI11_ASICCTL_ADDR A:0x601b144
y.create.l HWIO_QDSS_QDSS_CTI11_ITCHINACK_ADDR A:0x601bedc
y.create.l HWIO_QDSS_QDSS_CTI11_ITTRIGINACK_ADDR A:0x601bee0
y.create.l HWIO_QDSS_QDSS_CTI11_ITCHOUT_ADDR A:0x601bee4
y.create.l HWIO_QDSS_QDSS_CTI11_ITTRIGOUT_ADDR A:0x601bee8
y.create.l HWIO_QDSS_QDSS_CTI11_ITCHOUTACK_ADDR A:0x601beec
y.create.l HWIO_QDSS_QDSS_CTI11_ITTRIGOUTACK_ADDR A:0x601bef0
y.create.l HWIO_QDSS_QDSS_CTI11_ITCHIN_ADDR A:0x601bef4
y.create.l HWIO_QDSS_QDSS_CTI11_ITTRIGIN_ADDR A:0x601bef8
y.create.l HWIO_QDSS_QDSS_CTI11_ITCTRL_ADDR A:0x601bf00
y.create.l HWIO_QDSS_QDSS_CTI11_CLAIMSET_ADDR A:0x601bfa0
y.create.l HWIO_QDSS_QDSS_CTI11_CLAIMCLR_ADDR A:0x601bfa4
y.create.l HWIO_QDSS_QDSS_CTI11_LAR_ADDR A:0x601bfb0
y.create.l HWIO_QDSS_QDSS_CTI11_LSR_ADDR A:0x601bfb4
y.create.l HWIO_QDSS_QDSS_CTI11_AUTHSTATUS_ADDR A:0x601bfb8
y.create.l HWIO_QDSS_QDSS_CTI11_DEVID_ADDR A:0x601bfc8
y.create.l HWIO_QDSS_QDSS_CTI11_DEVTYPE_ADDR A:0x601bfcc
y.create.l HWIO_QDSS_QDSS_CTI11_PERIPHID0_ADDR A:0x601bfe0
y.create.l HWIO_QDSS_QDSS_CTI11_PERIPHID1_ADDR A:0x601bfe4
y.create.l HWIO_QDSS_QDSS_CTI11_PERIPHID2_ADDR A:0x601bfe8
y.create.l HWIO_QDSS_QDSS_CTI11_PERIPHID3_ADDR A:0x601bfec
y.create.l HWIO_QDSS_QDSS_CTI11_PERIPHID4_ADDR A:0x601bfd0
y.create.l HWIO_QDSS_QDSS_CTI11_PERIPHID5_ADDR A:0x601bfd4
y.create.l HWIO_QDSS_QDSS_CTI11_PERIPHID6_ADDR A:0x601bfd8
y.create.l HWIO_QDSS_QDSS_CTI11_PERIPHID7_ADDR A:0x601bfdc
y.create.l HWIO_QDSS_QDSS_CTI11_COMPID0_ADDR A:0x601bff0
y.create.l HWIO_QDSS_QDSS_CTI11_COMPID1_ADDR A:0x601bff4
y.create.l HWIO_QDSS_QDSS_CTI11_COMPID2_ADDR A:0x601bff8
y.create.l HWIO_QDSS_QDSS_CTI11_COMPID3_ADDR A:0x601bffc
y.create.l HWIO_QDSS_QDSS_CTI12_CTI12_CSCTI_REG_BASE_START_ADDR A:0x601c000
y.create.l HWIO_QDSS_QDSS_CTI12_CTI12_CSCTI_REG_BASE_LAST_ADDR A:0x601cffc
y.create.l HWIO_QDSS_QDSS_CTI12_CTI12_CSCTI_REG_BASE_END_ADDR A:0x601d000
y.create.l HWIO_QDSS_QDSS_CTI12_CTICONTROL_ADDR A:0x601c000
y.create.l HWIO_QDSS_QDSS_CTI12_CTIINTACK_ADDR A:0x601c010
y.create.l HWIO_QDSS_QDSS_CTI12_CTIAPPSET_ADDR A:0x601c014
y.create.l HWIO_QDSS_QDSS_CTI12_CTIAPPCLEAR_ADDR A:0x601c018
y.create.l HWIO_QDSS_QDSS_CTI12_CTIAPPPULSE_ADDR A:0x601c01c
y.create.l HWIO_QDSS_QDSS_CTI12_CTIINEN0_ADDR A:0x601c020
y.create.l HWIO_QDSS_QDSS_CTI12_CTIINEN1_ADDR A:0x601c024
y.create.l HWIO_QDSS_QDSS_CTI12_CTIINEN2_ADDR A:0x601c028
y.create.l HWIO_QDSS_QDSS_CTI12_CTIINEN3_ADDR A:0x601c02c
y.create.l HWIO_QDSS_QDSS_CTI12_CTIINEN4_ADDR A:0x601c030
y.create.l HWIO_QDSS_QDSS_CTI12_CTIINEN5_ADDR A:0x601c034
y.create.l HWIO_QDSS_QDSS_CTI12_CTIINEN6_ADDR A:0x601c038
y.create.l HWIO_QDSS_QDSS_CTI12_CTIINEN7_ADDR A:0x601c03c
y.create.l HWIO_QDSS_QDSS_CTI12_CTIOUTEN0_ADDR A:0x601c0a0
y.create.l HWIO_QDSS_QDSS_CTI12_CTIOUTEN1_ADDR A:0x601c0a4
y.create.l HWIO_QDSS_QDSS_CTI12_CTIOUTEN2_ADDR A:0x601c0a8
y.create.l HWIO_QDSS_QDSS_CTI12_CTIOUTEN3_ADDR A:0x601c0ac
y.create.l HWIO_QDSS_QDSS_CTI12_CTIOUTEN4_ADDR A:0x601c0b0
y.create.l HWIO_QDSS_QDSS_CTI12_CTIOUTEN5_ADDR A:0x601c0b4
y.create.l HWIO_QDSS_QDSS_CTI12_CTIOUTEN6_ADDR A:0x601c0b8
y.create.l HWIO_QDSS_QDSS_CTI12_CTIOUTEN7_ADDR A:0x601c0bc
y.create.l HWIO_QDSS_QDSS_CTI12_CTITRIGINSTATUS_ADDR A:0x601c130
y.create.l HWIO_QDSS_QDSS_CTI12_CTITRIGOUTSTATUS_ADDR A:0x601c134
y.create.l HWIO_QDSS_QDSS_CTI12_CTICHINSTATUS_ADDR A:0x601c138
y.create.l HWIO_QDSS_QDSS_CTI12_CTICHOUTSTATUS_ADDR A:0x601c13c
y.create.l HWIO_QDSS_QDSS_CTI12_CTIGATE_ADDR A:0x601c140
y.create.l HWIO_QDSS_QDSS_CTI12_ASICCTL_ADDR A:0x601c144
y.create.l HWIO_QDSS_QDSS_CTI12_ITCHINACK_ADDR A:0x601cedc
y.create.l HWIO_QDSS_QDSS_CTI12_ITTRIGINACK_ADDR A:0x601cee0
y.create.l HWIO_QDSS_QDSS_CTI12_ITCHOUT_ADDR A:0x601cee4
y.create.l HWIO_QDSS_QDSS_CTI12_ITTRIGOUT_ADDR A:0x601cee8
y.create.l HWIO_QDSS_QDSS_CTI12_ITCHOUTACK_ADDR A:0x601ceec
y.create.l HWIO_QDSS_QDSS_CTI12_ITTRIGOUTACK_ADDR A:0x601cef0
y.create.l HWIO_QDSS_QDSS_CTI12_ITCHIN_ADDR A:0x601cef4
y.create.l HWIO_QDSS_QDSS_CTI12_ITTRIGIN_ADDR A:0x601cef8
y.create.l HWIO_QDSS_QDSS_CTI12_ITCTRL_ADDR A:0x601cf00
y.create.l HWIO_QDSS_QDSS_CTI12_CLAIMSET_ADDR A:0x601cfa0
y.create.l HWIO_QDSS_QDSS_CTI12_CLAIMCLR_ADDR A:0x601cfa4
y.create.l HWIO_QDSS_QDSS_CTI12_LAR_ADDR A:0x601cfb0
y.create.l HWIO_QDSS_QDSS_CTI12_LSR_ADDR A:0x601cfb4
y.create.l HWIO_QDSS_QDSS_CTI12_AUTHSTATUS_ADDR A:0x601cfb8
y.create.l HWIO_QDSS_QDSS_CTI12_DEVID_ADDR A:0x601cfc8
y.create.l HWIO_QDSS_QDSS_CTI12_DEVTYPE_ADDR A:0x601cfcc
y.create.l HWIO_QDSS_QDSS_CTI12_PERIPHID0_ADDR A:0x601cfe0
y.create.l HWIO_QDSS_QDSS_CTI12_PERIPHID1_ADDR A:0x601cfe4
y.create.l HWIO_QDSS_QDSS_CTI12_PERIPHID2_ADDR A:0x601cfe8
y.create.l HWIO_QDSS_QDSS_CTI12_PERIPHID3_ADDR A:0x601cfec
y.create.l HWIO_QDSS_QDSS_CTI12_PERIPHID4_ADDR A:0x601cfd0
y.create.l HWIO_QDSS_QDSS_CTI12_PERIPHID5_ADDR A:0x601cfd4
y.create.l HWIO_QDSS_QDSS_CTI12_PERIPHID6_ADDR A:0x601cfd8
y.create.l HWIO_QDSS_QDSS_CTI12_PERIPHID7_ADDR A:0x601cfdc
y.create.l HWIO_QDSS_QDSS_CTI12_COMPID0_ADDR A:0x601cff0
y.create.l HWIO_QDSS_QDSS_CTI12_COMPID1_ADDR A:0x601cff4
y.create.l HWIO_QDSS_QDSS_CTI12_COMPID2_ADDR A:0x601cff8
y.create.l HWIO_QDSS_QDSS_CTI12_COMPID3_ADDR A:0x601cffc
y.create.l HWIO_QDSS_QDSS_CTI13_CTI13_CSCTI_REG_BASE_START_ADDR A:0x601d000
y.create.l HWIO_QDSS_QDSS_CTI13_CTI13_CSCTI_REG_BASE_LAST_ADDR A:0x601dffc
y.create.l HWIO_QDSS_QDSS_CTI13_CTI13_CSCTI_REG_BASE_END_ADDR A:0x601e000
y.create.l HWIO_QDSS_QDSS_CTI13_CTICONTROL_ADDR A:0x601d000
y.create.l HWIO_QDSS_QDSS_CTI13_CTIINTACK_ADDR A:0x601d010
y.create.l HWIO_QDSS_QDSS_CTI13_CTIAPPSET_ADDR A:0x601d014
y.create.l HWIO_QDSS_QDSS_CTI13_CTIAPPCLEAR_ADDR A:0x601d018
y.create.l HWIO_QDSS_QDSS_CTI13_CTIAPPPULSE_ADDR A:0x601d01c
y.create.l HWIO_QDSS_QDSS_CTI13_CTIINEN0_ADDR A:0x601d020
y.create.l HWIO_QDSS_QDSS_CTI13_CTIINEN1_ADDR A:0x601d024
y.create.l HWIO_QDSS_QDSS_CTI13_CTIINEN2_ADDR A:0x601d028
y.create.l HWIO_QDSS_QDSS_CTI13_CTIINEN3_ADDR A:0x601d02c
y.create.l HWIO_QDSS_QDSS_CTI13_CTIINEN4_ADDR A:0x601d030
y.create.l HWIO_QDSS_QDSS_CTI13_CTIINEN5_ADDR A:0x601d034
y.create.l HWIO_QDSS_QDSS_CTI13_CTIINEN6_ADDR A:0x601d038
y.create.l HWIO_QDSS_QDSS_CTI13_CTIINEN7_ADDR A:0x601d03c
y.create.l HWIO_QDSS_QDSS_CTI13_CTIOUTEN0_ADDR A:0x601d0a0
y.create.l HWIO_QDSS_QDSS_CTI13_CTIOUTEN1_ADDR A:0x601d0a4
y.create.l HWIO_QDSS_QDSS_CTI13_CTIOUTEN2_ADDR A:0x601d0a8
y.create.l HWIO_QDSS_QDSS_CTI13_CTIOUTEN3_ADDR A:0x601d0ac
y.create.l HWIO_QDSS_QDSS_CTI13_CTIOUTEN4_ADDR A:0x601d0b0
y.create.l HWIO_QDSS_QDSS_CTI13_CTIOUTEN5_ADDR A:0x601d0b4
y.create.l HWIO_QDSS_QDSS_CTI13_CTIOUTEN6_ADDR A:0x601d0b8
y.create.l HWIO_QDSS_QDSS_CTI13_CTIOUTEN7_ADDR A:0x601d0bc
y.create.l HWIO_QDSS_QDSS_CTI13_CTITRIGINSTATUS_ADDR A:0x601d130
y.create.l HWIO_QDSS_QDSS_CTI13_CTITRIGOUTSTATUS_ADDR A:0x601d134
y.create.l HWIO_QDSS_QDSS_CTI13_CTICHINSTATUS_ADDR A:0x601d138
y.create.l HWIO_QDSS_QDSS_CTI13_CTICHOUTSTATUS_ADDR A:0x601d13c
y.create.l HWIO_QDSS_QDSS_CTI13_CTIGATE_ADDR A:0x601d140
y.create.l HWIO_QDSS_QDSS_CTI13_ASICCTL_ADDR A:0x601d144
y.create.l HWIO_QDSS_QDSS_CTI13_ITCHINACK_ADDR A:0x601dedc
y.create.l HWIO_QDSS_QDSS_CTI13_ITTRIGINACK_ADDR A:0x601dee0
y.create.l HWIO_QDSS_QDSS_CTI13_ITCHOUT_ADDR A:0x601dee4
y.create.l HWIO_QDSS_QDSS_CTI13_ITTRIGOUT_ADDR A:0x601dee8
y.create.l HWIO_QDSS_QDSS_CTI13_ITCHOUTACK_ADDR A:0x601deec
y.create.l HWIO_QDSS_QDSS_CTI13_ITTRIGOUTACK_ADDR A:0x601def0
y.create.l HWIO_QDSS_QDSS_CTI13_ITCHIN_ADDR A:0x601def4
y.create.l HWIO_QDSS_QDSS_CTI13_ITTRIGIN_ADDR A:0x601def8
y.create.l HWIO_QDSS_QDSS_CTI13_ITCTRL_ADDR A:0x601df00
y.create.l HWIO_QDSS_QDSS_CTI13_CLAIMSET_ADDR A:0x601dfa0
y.create.l HWIO_QDSS_QDSS_CTI13_CLAIMCLR_ADDR A:0x601dfa4
y.create.l HWIO_QDSS_QDSS_CTI13_LAR_ADDR A:0x601dfb0
y.create.l HWIO_QDSS_QDSS_CTI13_LSR_ADDR A:0x601dfb4
y.create.l HWIO_QDSS_QDSS_CTI13_AUTHSTATUS_ADDR A:0x601dfb8
y.create.l HWIO_QDSS_QDSS_CTI13_DEVID_ADDR A:0x601dfc8
y.create.l HWIO_QDSS_QDSS_CTI13_DEVTYPE_ADDR A:0x601dfcc
y.create.l HWIO_QDSS_QDSS_CTI13_PERIPHID0_ADDR A:0x601dfe0
y.create.l HWIO_QDSS_QDSS_CTI13_PERIPHID1_ADDR A:0x601dfe4
y.create.l HWIO_QDSS_QDSS_CTI13_PERIPHID2_ADDR A:0x601dfe8
y.create.l HWIO_QDSS_QDSS_CTI13_PERIPHID3_ADDR A:0x601dfec
y.create.l HWIO_QDSS_QDSS_CTI13_PERIPHID4_ADDR A:0x601dfd0
y.create.l HWIO_QDSS_QDSS_CTI13_PERIPHID5_ADDR A:0x601dfd4
y.create.l HWIO_QDSS_QDSS_CTI13_PERIPHID6_ADDR A:0x601dfd8
y.create.l HWIO_QDSS_QDSS_CTI13_PERIPHID7_ADDR A:0x601dfdc
y.create.l HWIO_QDSS_QDSS_CTI13_COMPID0_ADDR A:0x601dff0
y.create.l HWIO_QDSS_QDSS_CTI13_COMPID1_ADDR A:0x601dff4
y.create.l HWIO_QDSS_QDSS_CTI13_COMPID2_ADDR A:0x601dff8
y.create.l HWIO_QDSS_QDSS_CTI13_COMPID3_ADDR A:0x601dffc
y.create.l HWIO_QDSS_QDSS_CTI14_CTI14_CSCTI_REG_BASE_START_ADDR A:0x601e000
y.create.l HWIO_QDSS_QDSS_CTI14_CTI14_CSCTI_REG_BASE_LAST_ADDR A:0x601effc
y.create.l HWIO_QDSS_QDSS_CTI14_CTI14_CSCTI_REG_BASE_END_ADDR A:0x601f000
y.create.l HWIO_QDSS_QDSS_CTI14_CTICONTROL_ADDR A:0x601e000
y.create.l HWIO_QDSS_QDSS_CTI14_CTIINTACK_ADDR A:0x601e010
y.create.l HWIO_QDSS_QDSS_CTI14_CTIAPPSET_ADDR A:0x601e014
y.create.l HWIO_QDSS_QDSS_CTI14_CTIAPPCLEAR_ADDR A:0x601e018
y.create.l HWIO_QDSS_QDSS_CTI14_CTIAPPPULSE_ADDR A:0x601e01c
y.create.l HWIO_QDSS_QDSS_CTI14_CTIINEN0_ADDR A:0x601e020
y.create.l HWIO_QDSS_QDSS_CTI14_CTIINEN1_ADDR A:0x601e024
y.create.l HWIO_QDSS_QDSS_CTI14_CTIINEN2_ADDR A:0x601e028
y.create.l HWIO_QDSS_QDSS_CTI14_CTIINEN3_ADDR A:0x601e02c
y.create.l HWIO_QDSS_QDSS_CTI14_CTIINEN4_ADDR A:0x601e030
y.create.l HWIO_QDSS_QDSS_CTI14_CTIINEN5_ADDR A:0x601e034
y.create.l HWIO_QDSS_QDSS_CTI14_CTIINEN6_ADDR A:0x601e038
y.create.l HWIO_QDSS_QDSS_CTI14_CTIINEN7_ADDR A:0x601e03c
y.create.l HWIO_QDSS_QDSS_CTI14_CTIOUTEN0_ADDR A:0x601e0a0
y.create.l HWIO_QDSS_QDSS_CTI14_CTIOUTEN1_ADDR A:0x601e0a4
y.create.l HWIO_QDSS_QDSS_CTI14_CTIOUTEN2_ADDR A:0x601e0a8
y.create.l HWIO_QDSS_QDSS_CTI14_CTIOUTEN3_ADDR A:0x601e0ac
y.create.l HWIO_QDSS_QDSS_CTI14_CTIOUTEN4_ADDR A:0x601e0b0
y.create.l HWIO_QDSS_QDSS_CTI14_CTIOUTEN5_ADDR A:0x601e0b4
y.create.l HWIO_QDSS_QDSS_CTI14_CTIOUTEN6_ADDR A:0x601e0b8
y.create.l HWIO_QDSS_QDSS_CTI14_CTIOUTEN7_ADDR A:0x601e0bc
y.create.l HWIO_QDSS_QDSS_CTI14_CTITRIGINSTATUS_ADDR A:0x601e130
y.create.l HWIO_QDSS_QDSS_CTI14_CTITRIGOUTSTATUS_ADDR A:0x601e134
y.create.l HWIO_QDSS_QDSS_CTI14_CTICHINSTATUS_ADDR A:0x601e138
y.create.l HWIO_QDSS_QDSS_CTI14_CTICHOUTSTATUS_ADDR A:0x601e13c
y.create.l HWIO_QDSS_QDSS_CTI14_CTIGATE_ADDR A:0x601e140
y.create.l HWIO_QDSS_QDSS_CTI14_ASICCTL_ADDR A:0x601e144
y.create.l HWIO_QDSS_QDSS_CTI14_ITCHINACK_ADDR A:0x601eedc
y.create.l HWIO_QDSS_QDSS_CTI14_ITTRIGINACK_ADDR A:0x601eee0
y.create.l HWIO_QDSS_QDSS_CTI14_ITCHOUT_ADDR A:0x601eee4
y.create.l HWIO_QDSS_QDSS_CTI14_ITTRIGOUT_ADDR A:0x601eee8
y.create.l HWIO_QDSS_QDSS_CTI14_ITCHOUTACK_ADDR A:0x601eeec
y.create.l HWIO_QDSS_QDSS_CTI14_ITTRIGOUTACK_ADDR A:0x601eef0
y.create.l HWIO_QDSS_QDSS_CTI14_ITCHIN_ADDR A:0x601eef4
y.create.l HWIO_QDSS_QDSS_CTI14_ITTRIGIN_ADDR A:0x601eef8
y.create.l HWIO_QDSS_QDSS_CTI14_ITCTRL_ADDR A:0x601ef00
y.create.l HWIO_QDSS_QDSS_CTI14_CLAIMSET_ADDR A:0x601efa0
y.create.l HWIO_QDSS_QDSS_CTI14_CLAIMCLR_ADDR A:0x601efa4
y.create.l HWIO_QDSS_QDSS_CTI14_LAR_ADDR A:0x601efb0
y.create.l HWIO_QDSS_QDSS_CTI14_LSR_ADDR A:0x601efb4
y.create.l HWIO_QDSS_QDSS_CTI14_AUTHSTATUS_ADDR A:0x601efb8
y.create.l HWIO_QDSS_QDSS_CTI14_DEVID_ADDR A:0x601efc8
y.create.l HWIO_QDSS_QDSS_CTI14_DEVTYPE_ADDR A:0x601efcc
y.create.l HWIO_QDSS_QDSS_CTI14_PERIPHID0_ADDR A:0x601efe0
y.create.l HWIO_QDSS_QDSS_CTI14_PERIPHID1_ADDR A:0x601efe4
y.create.l HWIO_QDSS_QDSS_CTI14_PERIPHID2_ADDR A:0x601efe8
y.create.l HWIO_QDSS_QDSS_CTI14_PERIPHID3_ADDR A:0x601efec
y.create.l HWIO_QDSS_QDSS_CTI14_PERIPHID4_ADDR A:0x601efd0
y.create.l HWIO_QDSS_QDSS_CTI14_PERIPHID5_ADDR A:0x601efd4
y.create.l HWIO_QDSS_QDSS_CTI14_PERIPHID6_ADDR A:0x601efd8
y.create.l HWIO_QDSS_QDSS_CTI14_PERIPHID7_ADDR A:0x601efdc
y.create.l HWIO_QDSS_QDSS_CTI14_COMPID0_ADDR A:0x601eff0
y.create.l HWIO_QDSS_QDSS_CTI14_COMPID1_ADDR A:0x601eff4
y.create.l HWIO_QDSS_QDSS_CTI14_COMPID2_ADDR A:0x601eff8
y.create.l HWIO_QDSS_QDSS_CTI14_COMPID3_ADDR A:0x601effc
y.create.l HWIO_QDSS_QDSS_CTI15_CTI15_CSCTI_REG_BASE_START_ADDR A:0x601f000
y.create.l HWIO_QDSS_QDSS_CTI15_CTI15_CSCTI_REG_BASE_LAST_ADDR A:0x601fffc
y.create.l HWIO_QDSS_QDSS_CTI15_CTI15_CSCTI_REG_BASE_END_ADDR A:0x6020000
y.create.l HWIO_QDSS_QDSS_CTI15_CTICONTROL_ADDR A:0x601f000
y.create.l HWIO_QDSS_QDSS_CTI15_CTIINTACK_ADDR A:0x601f010
y.create.l HWIO_QDSS_QDSS_CTI15_CTIAPPSET_ADDR A:0x601f014
y.create.l HWIO_QDSS_QDSS_CTI15_CTIAPPCLEAR_ADDR A:0x601f018
y.create.l HWIO_QDSS_QDSS_CTI15_CTIAPPPULSE_ADDR A:0x601f01c
y.create.l HWIO_QDSS_QDSS_CTI15_CTIINEN0_ADDR A:0x601f020
y.create.l HWIO_QDSS_QDSS_CTI15_CTIINEN1_ADDR A:0x601f024
y.create.l HWIO_QDSS_QDSS_CTI15_CTIINEN2_ADDR A:0x601f028
y.create.l HWIO_QDSS_QDSS_CTI15_CTIINEN3_ADDR A:0x601f02c
y.create.l HWIO_QDSS_QDSS_CTI15_CTIINEN4_ADDR A:0x601f030
y.create.l HWIO_QDSS_QDSS_CTI15_CTIINEN5_ADDR A:0x601f034
y.create.l HWIO_QDSS_QDSS_CTI15_CTIINEN6_ADDR A:0x601f038
y.create.l HWIO_QDSS_QDSS_CTI15_CTIINEN7_ADDR A:0x601f03c
y.create.l HWIO_QDSS_QDSS_CTI15_CTIOUTEN0_ADDR A:0x601f0a0
y.create.l HWIO_QDSS_QDSS_CTI15_CTIOUTEN1_ADDR A:0x601f0a4
y.create.l HWIO_QDSS_QDSS_CTI15_CTIOUTEN2_ADDR A:0x601f0a8
y.create.l HWIO_QDSS_QDSS_CTI15_CTIOUTEN3_ADDR A:0x601f0ac
y.create.l HWIO_QDSS_QDSS_CTI15_CTIOUTEN4_ADDR A:0x601f0b0
y.create.l HWIO_QDSS_QDSS_CTI15_CTIOUTEN5_ADDR A:0x601f0b4
y.create.l HWIO_QDSS_QDSS_CTI15_CTIOUTEN6_ADDR A:0x601f0b8
y.create.l HWIO_QDSS_QDSS_CTI15_CTIOUTEN7_ADDR A:0x601f0bc
y.create.l HWIO_QDSS_QDSS_CTI15_CTITRIGINSTATUS_ADDR A:0x601f130
y.create.l HWIO_QDSS_QDSS_CTI15_CTITRIGOUTSTATUS_ADDR A:0x601f134
y.create.l HWIO_QDSS_QDSS_CTI15_CTICHINSTATUS_ADDR A:0x601f138
y.create.l HWIO_QDSS_QDSS_CTI15_CTICHOUTSTATUS_ADDR A:0x601f13c
y.create.l HWIO_QDSS_QDSS_CTI15_CTIGATE_ADDR A:0x601f140
y.create.l HWIO_QDSS_QDSS_CTI15_ASICCTL_ADDR A:0x601f144
y.create.l HWIO_QDSS_QDSS_CTI15_ITCHINACK_ADDR A:0x601fedc
y.create.l HWIO_QDSS_QDSS_CTI15_ITTRIGINACK_ADDR A:0x601fee0
y.create.l HWIO_QDSS_QDSS_CTI15_ITCHOUT_ADDR A:0x601fee4
y.create.l HWIO_QDSS_QDSS_CTI15_ITTRIGOUT_ADDR A:0x601fee8
y.create.l HWIO_QDSS_QDSS_CTI15_ITCHOUTACK_ADDR A:0x601feec
y.create.l HWIO_QDSS_QDSS_CTI15_ITTRIGOUTACK_ADDR A:0x601fef0
y.create.l HWIO_QDSS_QDSS_CTI15_ITCHIN_ADDR A:0x601fef4
y.create.l HWIO_QDSS_QDSS_CTI15_ITTRIGIN_ADDR A:0x601fef8
y.create.l HWIO_QDSS_QDSS_CTI15_ITCTRL_ADDR A:0x601ff00
y.create.l HWIO_QDSS_QDSS_CTI15_CLAIMSET_ADDR A:0x601ffa0
y.create.l HWIO_QDSS_QDSS_CTI15_CLAIMCLR_ADDR A:0x601ffa4
y.create.l HWIO_QDSS_QDSS_CTI15_LAR_ADDR A:0x601ffb0
y.create.l HWIO_QDSS_QDSS_CTI15_LSR_ADDR A:0x601ffb4
y.create.l HWIO_QDSS_QDSS_CTI15_AUTHSTATUS_ADDR A:0x601ffb8
y.create.l HWIO_QDSS_QDSS_CTI15_DEVID_ADDR A:0x601ffc8
y.create.l HWIO_QDSS_QDSS_CTI15_DEVTYPE_ADDR A:0x601ffcc
y.create.l HWIO_QDSS_QDSS_CTI15_PERIPHID0_ADDR A:0x601ffe0
y.create.l HWIO_QDSS_QDSS_CTI15_PERIPHID1_ADDR A:0x601ffe4
y.create.l HWIO_QDSS_QDSS_CTI15_PERIPHID2_ADDR A:0x601ffe8
y.create.l HWIO_QDSS_QDSS_CTI15_PERIPHID3_ADDR A:0x601ffec
y.create.l HWIO_QDSS_QDSS_CTI15_PERIPHID4_ADDR A:0x601ffd0
y.create.l HWIO_QDSS_QDSS_CTI15_PERIPHID5_ADDR A:0x601ffd4
y.create.l HWIO_QDSS_QDSS_CTI15_PERIPHID6_ADDR A:0x601ffd8
y.create.l HWIO_QDSS_QDSS_CTI15_PERIPHID7_ADDR A:0x601ffdc
y.create.l HWIO_QDSS_QDSS_CTI15_COMPID0_ADDR A:0x601fff0
y.create.l HWIO_QDSS_QDSS_CTI15_COMPID1_ADDR A:0x601fff4
y.create.l HWIO_QDSS_QDSS_CTI15_COMPID2_ADDR A:0x601fff8
y.create.l HWIO_QDSS_QDSS_CTI15_COMPID3_ADDR A:0x601fffc
y.create.l HWIO_QDSS_QDSS_CSTPIU_CSTPIU_CSTPIU_REG_BASE_START_ADDR A:0x6040000
y.create.l HWIO_QDSS_QDSS_CSTPIU_CSTPIU_CSTPIU_REG_BASE_LAST_ADDR A:0x6040ffc
y.create.l HWIO_QDSS_QDSS_CSTPIU_CSTPIU_CSTPIU_REG_BASE_END_ADDR A:0x6041000
y.create.l HWIO_QDSS_QDSS_CSTPIU_SUPPORTED_PORT_SIZES_ADDR A:0x6040000
y.create.l HWIO_QDSS_QDSS_CSTPIU_CURRENT_PORT_SIZE_ADDR A:0x6040004
y.create.l HWIO_QDSS_QDSS_CSTPIU_SUPPORTED_TRIGGER_MODES_ADDR A:0x6040100
y.create.l HWIO_QDSS_QDSS_CSTPIU_TRIGGER_COUNTER_VALUE_ADDR A:0x6040104
y.create.l HWIO_QDSS_QDSS_CSTPIU_TRIGGER_MULTIPLIER_ADDR A:0x6040108
y.create.l HWIO_QDSS_QDSS_CSTPIU_SUPPORTED_TEST_PATTERN_MODES_ADDR A:0x6040200
y.create.l HWIO_QDSS_QDSS_CSTPIU_CURRENT_TEST_PATTERN_MODE_ADDR A:0x6040204
y.create.l HWIO_QDSS_QDSS_CSTPIU_TPRCR_ADDR A:0x6040208
y.create.l HWIO_QDSS_QDSS_CSTPIU_FFSR_ADDR A:0x6040300
y.create.l HWIO_QDSS_QDSS_CSTPIU_FFCR_ADDR A:0x6040304
y.create.l HWIO_QDSS_QDSS_CSTPIU_FSCR_ADDR A:0x6040308
y.create.l HWIO_QDSS_QDSS_CSTPIU_EXTCTL_IN_PORT_ADDR A:0x6040400
y.create.l HWIO_QDSS_QDSS_CSTPIU_EXTCTL_OUT_PORT_ADDR A:0x6040404
y.create.l HWIO_QDSS_QDSS_CSTPIU_ITTRFLINACK_ADDR A:0x6040ee4
y.create.l HWIO_QDSS_QDSS_CSTPIU_ITTRFLIN_ADDR A:0x6040ee8
y.create.l HWIO_QDSS_QDSS_CSTPIU_ITATBDATA0_ADDR A:0x6040eec
y.create.l HWIO_QDSS_QDSS_CSTPIU_ITATBCTR2_ADDR A:0x6040ef0
y.create.l HWIO_QDSS_QDSS_CSTPIU_ITATBCTR1_ADDR A:0x6040ef4
y.create.l HWIO_QDSS_QDSS_CSTPIU_ITATBCTR0_ADDR A:0x6040ef8
y.create.l HWIO_QDSS_QDSS_CSTPIU_ITCTRL_ADDR A:0x6040f00
y.create.l HWIO_QDSS_QDSS_CSTPIU_CLAIMSET_ADDR A:0x6040fa0
y.create.l HWIO_QDSS_QDSS_CSTPIU_CLAIMCLR_ADDR A:0x6040fa4
y.create.l HWIO_QDSS_QDSS_CSTPIU_LAR_ADDR A:0x6040fb0
y.create.l HWIO_QDSS_QDSS_CSTPIU_LSR_ADDR A:0x6040fb4
y.create.l HWIO_QDSS_QDSS_CSTPIU_AUTHSTATUS_ADDR A:0x6040fb8
y.create.l HWIO_QDSS_QDSS_CSTPIU_DEVID_ADDR A:0x6040fc8
y.create.l HWIO_QDSS_QDSS_CSTPIU_DEVTYPE_ADDR A:0x6040fcc
y.create.l HWIO_QDSS_QDSS_CSTPIU_PERIPHID0_ADDR A:0x6040fe0
y.create.l HWIO_QDSS_QDSS_CSTPIU_PERIPHID1_ADDR A:0x6040fe4
y.create.l HWIO_QDSS_QDSS_CSTPIU_PERIPHID2_ADDR A:0x6040fe8
y.create.l HWIO_QDSS_QDSS_CSTPIU_PERIPHID3_ADDR A:0x6040fec
y.create.l HWIO_QDSS_QDSS_CSTPIU_PERIPHID4_ADDR A:0x6040fd0
y.create.l HWIO_QDSS_QDSS_CSTPIU_PERIPHID5_ADDR A:0x6040fd4
y.create.l HWIO_QDSS_QDSS_CSTPIU_PERIPHID6_ADDR A:0x6040fd8
y.create.l HWIO_QDSS_QDSS_CSTPIU_PERIPHID7_ADDR A:0x6040fdc
y.create.l HWIO_QDSS_QDSS_CSTPIU_COMPID0_ADDR A:0x6040ff0
y.create.l HWIO_QDSS_QDSS_CSTPIU_COMPID1_ADDR A:0x6040ff4
y.create.l HWIO_QDSS_QDSS_CSTPIU_COMPID2_ADDR A:0x6040ff8
y.create.l HWIO_QDSS_QDSS_CSTPIU_COMPID3_ADDR A:0x6040ffc
y.create.l HWIO_QDSS_QDSS_IN_FUN0_IN_FUN0_CXATBFUNNEL_128W8SP_REG_BASE_START_ADDR A:0x6041000
y.create.l HWIO_QDSS_QDSS_IN_FUN0_IN_FUN0_CXATBFUNNEL_128W8SP_REG_BASE_LAST_ADDR A:0x6041ffc
y.create.l HWIO_QDSS_QDSS_IN_FUN0_IN_FUN0_CXATBFUNNEL_128W8SP_REG_BASE_END_ADDR A:0x6042000
y.create.l HWIO_QDSS_QDSS_IN_FUN0_CTRL_REG_ADDR A:0x6041000
y.create.l HWIO_QDSS_QDSS_IN_FUN0_PRIORITY_CTRL_REG_ADDR A:0x6041004
y.create.l HWIO_QDSS_QDSS_IN_FUN0_ITATBDATA0_ADDR A:0x6041eec
y.create.l HWIO_QDSS_QDSS_IN_FUN0_ITATBCTR2_ADDR A:0x6041ef0
y.create.l HWIO_QDSS_QDSS_IN_FUN0_ITATBCTR1_ADDR A:0x6041ef4
y.create.l HWIO_QDSS_QDSS_IN_FUN0_ITATBCTR0_ADDR A:0x6041ef8
y.create.l HWIO_QDSS_QDSS_IN_FUN0_ITCTRL_ADDR A:0x6041f00
y.create.l HWIO_QDSS_QDSS_IN_FUN0_CLAIMSET_ADDR A:0x6041fa0
y.create.l HWIO_QDSS_QDSS_IN_FUN0_CLAIMCLR_ADDR A:0x6041fa4
y.create.l HWIO_QDSS_QDSS_IN_FUN0_LOCKACCESS_ADDR A:0x6041fb0
y.create.l HWIO_QDSS_QDSS_IN_FUN0_LOCKSTATUS_ADDR A:0x6041fb4
y.create.l HWIO_QDSS_QDSS_IN_FUN0_AUTHSTATUS_ADDR A:0x6041fb8
y.create.l HWIO_QDSS_QDSS_IN_FUN0_DEVID_ADDR A:0x6041fc8
y.create.l HWIO_QDSS_QDSS_IN_FUN0_DEVTYPE_ADDR A:0x6041fcc
y.create.l HWIO_QDSS_QDSS_IN_FUN0_PIDR0_ADDR A:0x6041fe0
y.create.l HWIO_QDSS_QDSS_IN_FUN0_PIDR1_ADDR A:0x6041fe4
y.create.l HWIO_QDSS_QDSS_IN_FUN0_PIDR2_ADDR A:0x6041fe8
y.create.l HWIO_QDSS_QDSS_IN_FUN0_PIDR3_ADDR A:0x6041fec
y.create.l HWIO_QDSS_QDSS_IN_FUN0_PIDR4_ADDR A:0x6041fd0
y.create.l HWIO_QDSS_QDSS_IN_FUN0_PERIPHID5_ADDR A:0x6041fd4
y.create.l HWIO_QDSS_QDSS_IN_FUN0_PERIPHID6_ADDR A:0x6041fd8
y.create.l HWIO_QDSS_QDSS_IN_FUN0_PERIPHID7_ADDR A:0x6041fdc
y.create.l HWIO_QDSS_QDSS_IN_FUN0_CID0_ADDR A:0x6041ff0
y.create.l HWIO_QDSS_QDSS_IN_FUN0_CID1_ADDR A:0x6041ff4
y.create.l HWIO_QDSS_QDSS_IN_FUN0_CID2_ADDR A:0x6041ff8
y.create.l HWIO_QDSS_QDSS_IN_FUN0_CID3_ADDR A:0x6041ffc
y.create.l HWIO_QDSS_QDSS_REPL64_REPL64_CXATBREPLICATOR_64WP_REG_BASE_START_ADDR A:0x6046000
y.create.l HWIO_QDSS_QDSS_REPL64_REPL64_CXATBREPLICATOR_64WP_REG_BASE_LAST_ADDR A:0x6046ffc
y.create.l HWIO_QDSS_QDSS_REPL64_REPL64_CXATBREPLICATOR_64WP_REG_BASE_END_ADDR A:0x6047000
y.create.l HWIO_QDSS_QDSS_REPL64_IDFILTER0_ADDR A:0x6046000
y.create.l HWIO_QDSS_QDSS_REPL64_IDFILTER1_ADDR A:0x6046004
y.create.l HWIO_QDSS_QDSS_REPL64_ITATBCTR0_ADDR A:0x6046efc
y.create.l HWIO_QDSS_QDSS_REPL64_ITATBCTR1_ADDR A:0x6046ef8
y.create.l HWIO_QDSS_QDSS_REPL64_ITCTRL_ADDR A:0x6046f00
y.create.l HWIO_QDSS_QDSS_REPL64_CLAIMSET_ADDR A:0x6046fa0
y.create.l HWIO_QDSS_QDSS_REPL64_CLAIMCLR_ADDR A:0x6046fa4
y.create.l HWIO_QDSS_QDSS_REPL64_LAR_ADDR A:0x6046fb0
y.create.l HWIO_QDSS_QDSS_REPL64_LSR_ADDR A:0x6046fb4
y.create.l HWIO_QDSS_QDSS_REPL64_AUTHSTATUS_ADDR A:0x6046fb8
y.create.l HWIO_QDSS_QDSS_REPL64_DEVID_ADDR A:0x6046fc8
y.create.l HWIO_QDSS_QDSS_REPL64_DEVTYPE_ADDR A:0x6046fcc
y.create.l HWIO_QDSS_QDSS_REPL64_PIDR0_ADDR A:0x6046fe0
y.create.l HWIO_QDSS_QDSS_REPL64_PIDR1_ADDR A:0x6046fe4
y.create.l HWIO_QDSS_QDSS_REPL64_PIDR2_ADDR A:0x6046fe8
y.create.l HWIO_QDSS_QDSS_REPL64_PIDR3_ADDR A:0x6046fec
y.create.l HWIO_QDSS_QDSS_REPL64_PIDR4_ADDR A:0x6046fd0
y.create.l HWIO_QDSS_QDSS_REPL64_PIDR5_ADDR A:0x6046fd4
y.create.l HWIO_QDSS_QDSS_REPL64_PIDR6_ADDR A:0x6046fd8
y.create.l HWIO_QDSS_QDSS_REPL64_PIDR7_ADDR A:0x6046fdc
y.create.l HWIO_QDSS_QDSS_REPL64_CIDR0_ADDR A:0x6046ff0
y.create.l HWIO_QDSS_QDSS_REPL64_CIDR1_ADDR A:0x6046ff4
y.create.l HWIO_QDSS_QDSS_REPL64_CIDR2_ADDR A:0x6046ff8
y.create.l HWIO_QDSS_QDSS_REPL64_CIDR3_ADDR A:0x6046ffc
y.create.l HWIO_QDSS_QDSS_ETR_ETR_CXTMC_R64W32D_REG_BASE_START_ADDR A:0x6048000
y.create.l HWIO_QDSS_QDSS_ETR_ETR_CXTMC_R64W32D_REG_BASE_LAST_ADDR A:0x6048ffc
y.create.l HWIO_QDSS_QDSS_ETR_ETR_CXTMC_R64W32D_REG_BASE_END_ADDR A:0x6049000
y.create.l HWIO_QDSS_QDSS_ETR_RSZ_ADDR A:0x6048004
y.create.l HWIO_QDSS_QDSS_ETR_STS_ADDR A:0x604800c
y.create.l HWIO_QDSS_QDSS_ETR_RRD_ADDR A:0x6048010
y.create.l HWIO_QDSS_QDSS_ETR_RRP_ADDR A:0x6048014
y.create.l HWIO_QDSS_QDSS_ETR_RWP_ADDR A:0x6048018
y.create.l HWIO_QDSS_QDSS_ETR_TRG_ADDR A:0x604801c
y.create.l HWIO_QDSS_QDSS_ETR_CTL_ADDR A:0x6048020
y.create.l HWIO_QDSS_QDSS_ETR_RWD_ADDR A:0x6048024
y.create.l HWIO_QDSS_QDSS_ETR_MODE_ADDR A:0x6048028
y.create.l HWIO_QDSS_QDSS_ETR_LBUFLEVEL_ADDR A:0x604802c
y.create.l HWIO_QDSS_QDSS_ETR_CBUFLEVEL_ADDR A:0x6048030
y.create.l HWIO_QDSS_QDSS_ETR_BUFWM_ADDR A:0x6048034
y.create.l HWIO_QDSS_QDSS_ETR_RRPHI_ADDR A:0x6048038
y.create.l HWIO_QDSS_QDSS_ETR_RWPHI_ADDR A:0x604803c
y.create.l HWIO_QDSS_QDSS_ETR_AXICTL_ADDR A:0x6048110
y.create.l HWIO_QDSS_QDSS_ETR_DBALO_ADDR A:0x6048118
y.create.l HWIO_QDSS_QDSS_ETR_DBAHI_ADDR A:0x604811c
y.create.l HWIO_QDSS_QDSS_ETR_FFSR_ADDR A:0x6048300
y.create.l HWIO_QDSS_QDSS_ETR_FFCR_ADDR A:0x6048304
y.create.l HWIO_QDSS_QDSS_ETR_PSCR_ADDR A:0x6048308
y.create.l HWIO_QDSS_QDSS_ETR_ITMISCOP0_ADDR A:0x6048ee0
y.create.l HWIO_QDSS_QDSS_ETR_ITTRFLIN_ADDR A:0x6048ee8
y.create.l HWIO_QDSS_QDSS_ETR_ITATBDATA0_ADDR A:0x6048eec
y.create.l HWIO_QDSS_QDSS_ETR_ITATBCTR2_ADDR A:0x6048ef0
y.create.l HWIO_QDSS_QDSS_ETR_ITATBCTR1_ADDR A:0x6048ef4
y.create.l HWIO_QDSS_QDSS_ETR_ITATBCTR0_ADDR A:0x6048ef8
y.create.l HWIO_QDSS_QDSS_ETR_ITCTRL_ADDR A:0x6048f00
y.create.l HWIO_QDSS_QDSS_ETR_CLAIMSET_ADDR A:0x6048fa0
y.create.l HWIO_QDSS_QDSS_ETR_CLAIMCLR_ADDR A:0x6048fa4
y.create.l HWIO_QDSS_QDSS_ETR_LAR_ADDR A:0x6048fb0
y.create.l HWIO_QDSS_QDSS_ETR_LSR_ADDR A:0x6048fb4
y.create.l HWIO_QDSS_QDSS_ETR_AUTHSTATUS_ADDR A:0x6048fb8
y.create.l HWIO_QDSS_QDSS_ETR_DEVID_ADDR A:0x6048fc8
y.create.l HWIO_QDSS_QDSS_ETR_DEVTYPE_ADDR A:0x6048fcc
y.create.l HWIO_QDSS_QDSS_ETR_PERIPHID0_ADDR A:0x6048fe0
y.create.l HWIO_QDSS_QDSS_ETR_PERIPHID1_ADDR A:0x6048fe4
y.create.l HWIO_QDSS_QDSS_ETR_PERIPHID2_ADDR A:0x6048fe8
y.create.l HWIO_QDSS_QDSS_ETR_PERIPHID3_ADDR A:0x6048fec
y.create.l HWIO_QDSS_QDSS_ETR_PERIPHID4_ADDR A:0x6048fd0
y.create.l HWIO_QDSS_QDSS_ETR_PERIPHID5_ADDR A:0x6048fd4
y.create.l HWIO_QDSS_QDSS_ETR_PERIPHID6_ADDR A:0x6048fd8
y.create.l HWIO_QDSS_QDSS_ETR_PERIPHID7_ADDR A:0x6048fdc
y.create.l HWIO_QDSS_QDSS_ETR_COMPID0_ADDR A:0x6048ff0
y.create.l HWIO_QDSS_QDSS_ETR_COMPID1_ADDR A:0x6048ff4
y.create.l HWIO_QDSS_QDSS_ETR_COMPID2_ADDR A:0x6048ff8
y.create.l HWIO_QDSS_QDSS_ETR_COMPID3_ADDR A:0x6048ffc
y.create.l HWIO_QDSS_QDSS_IN_FUN1_IN_FUN1_CXATBFUNNEL_128W8SP_REG_BASE_START_ADDR A:0x6042000
y.create.l HWIO_QDSS_QDSS_IN_FUN1_IN_FUN1_CXATBFUNNEL_128W8SP_REG_BASE_LAST_ADDR A:0x6042ffc
y.create.l HWIO_QDSS_QDSS_IN_FUN1_IN_FUN1_CXATBFUNNEL_128W8SP_REG_BASE_END_ADDR A:0x6043000
y.create.l HWIO_QDSS_QDSS_IN_FUN1_CTRL_REG_ADDR A:0x6042000
y.create.l HWIO_QDSS_QDSS_IN_FUN1_PRIORITY_CTRL_REG_ADDR A:0x6042004
y.create.l HWIO_QDSS_QDSS_IN_FUN1_ITATBDATA0_ADDR A:0x6042eec
y.create.l HWIO_QDSS_QDSS_IN_FUN1_ITATBCTR2_ADDR A:0x6042ef0
y.create.l HWIO_QDSS_QDSS_IN_FUN1_ITATBCTR1_ADDR A:0x6042ef4
y.create.l HWIO_QDSS_QDSS_IN_FUN1_ITATBCTR0_ADDR A:0x6042ef8
y.create.l HWIO_QDSS_QDSS_IN_FUN1_ITCTRL_ADDR A:0x6042f00
y.create.l HWIO_QDSS_QDSS_IN_FUN1_CLAIMSET_ADDR A:0x6042fa0
y.create.l HWIO_QDSS_QDSS_IN_FUN1_CLAIMCLR_ADDR A:0x6042fa4
y.create.l HWIO_QDSS_QDSS_IN_FUN1_LOCKACCESS_ADDR A:0x6042fb0
y.create.l HWIO_QDSS_QDSS_IN_FUN1_LOCKSTATUS_ADDR A:0x6042fb4
y.create.l HWIO_QDSS_QDSS_IN_FUN1_AUTHSTATUS_ADDR A:0x6042fb8
y.create.l HWIO_QDSS_QDSS_IN_FUN1_DEVID_ADDR A:0x6042fc8
y.create.l HWIO_QDSS_QDSS_IN_FUN1_DEVTYPE_ADDR A:0x6042fcc
y.create.l HWIO_QDSS_QDSS_IN_FUN1_PIDR0_ADDR A:0x6042fe0
y.create.l HWIO_QDSS_QDSS_IN_FUN1_PIDR1_ADDR A:0x6042fe4
y.create.l HWIO_QDSS_QDSS_IN_FUN1_PIDR2_ADDR A:0x6042fe8
y.create.l HWIO_QDSS_QDSS_IN_FUN1_PIDR3_ADDR A:0x6042fec
y.create.l HWIO_QDSS_QDSS_IN_FUN1_PIDR4_ADDR A:0x6042fd0
y.create.l HWIO_QDSS_QDSS_IN_FUN1_PERIPHID5_ADDR A:0x6042fd4
y.create.l HWIO_QDSS_QDSS_IN_FUN1_PERIPHID6_ADDR A:0x6042fd8
y.create.l HWIO_QDSS_QDSS_IN_FUN1_PERIPHID7_ADDR A:0x6042fdc
y.create.l HWIO_QDSS_QDSS_IN_FUN1_CID0_ADDR A:0x6042ff0
y.create.l HWIO_QDSS_QDSS_IN_FUN1_CID1_ADDR A:0x6042ff4
y.create.l HWIO_QDSS_QDSS_IN_FUN1_CID2_ADDR A:0x6042ff8
y.create.l HWIO_QDSS_QDSS_IN_FUN1_CID3_ADDR A:0x6042ffc
y.create.l HWIO_QDSS_QDSS_MERG_FUN_MERG_FUN_CXATBFUNNEL_128W2SP_REG_BASE_START_ADDR A:0x6045000
y.create.l HWIO_QDSS_QDSS_MERG_FUN_MERG_FUN_CXATBFUNNEL_128W2SP_REG_BASE_LAST_ADDR A:0x6045ffc
y.create.l HWIO_QDSS_QDSS_MERG_FUN_MERG_FUN_CXATBFUNNEL_128W2SP_REG_BASE_END_ADDR A:0x6046000
y.create.l HWIO_QDSS_QDSS_MERG_FUN_CTRL_REG_ADDR A:0x6045000
y.create.l HWIO_QDSS_QDSS_MERG_FUN_PRIORITY_CTRL_REG_ADDR A:0x6045004
y.create.l HWIO_QDSS_QDSS_MERG_FUN_ITATBDATA0_ADDR A:0x6045eec
y.create.l HWIO_QDSS_QDSS_MERG_FUN_ITATBCTR2_ADDR A:0x6045ef0
y.create.l HWIO_QDSS_QDSS_MERG_FUN_ITATBCTR1_ADDR A:0x6045ef4
y.create.l HWIO_QDSS_QDSS_MERG_FUN_ITATBCTR0_ADDR A:0x6045ef8
y.create.l HWIO_QDSS_QDSS_MERG_FUN_ITCTRL_ADDR A:0x6045f00
y.create.l HWIO_QDSS_QDSS_MERG_FUN_CLAIMSET_ADDR A:0x6045fa0
y.create.l HWIO_QDSS_QDSS_MERG_FUN_CLAIMCLR_ADDR A:0x6045fa4
y.create.l HWIO_QDSS_QDSS_MERG_FUN_LOCKACCESS_ADDR A:0x6045fb0
y.create.l HWIO_QDSS_QDSS_MERG_FUN_LOCKSTATUS_ADDR A:0x6045fb4
y.create.l HWIO_QDSS_QDSS_MERG_FUN_AUTHSTATUS_ADDR A:0x6045fb8
y.create.l HWIO_QDSS_QDSS_MERG_FUN_DEVID_ADDR A:0x6045fc8
y.create.l HWIO_QDSS_QDSS_MERG_FUN_DEVTYPE_ADDR A:0x6045fcc
y.create.l HWIO_QDSS_QDSS_MERG_FUN_PIDR0_ADDR A:0x6045fe0
y.create.l HWIO_QDSS_QDSS_MERG_FUN_PIDR1_ADDR A:0x6045fe4
y.create.l HWIO_QDSS_QDSS_MERG_FUN_PIDR2_ADDR A:0x6045fe8
y.create.l HWIO_QDSS_QDSS_MERG_FUN_PIDR3_ADDR A:0x6045fec
y.create.l HWIO_QDSS_QDSS_MERG_FUN_PIDR4_ADDR A:0x6045fd0
y.create.l HWIO_QDSS_QDSS_MERG_FUN_PERIPHID5_ADDR A:0x6045fd4
y.create.l HWIO_QDSS_QDSS_MERG_FUN_PERIPHID6_ADDR A:0x6045fd8
y.create.l HWIO_QDSS_QDSS_MERG_FUN_PERIPHID7_ADDR A:0x6045fdc
y.create.l HWIO_QDSS_QDSS_MERG_FUN_CID0_ADDR A:0x6045ff0
y.create.l HWIO_QDSS_QDSS_MERG_FUN_CID1_ADDR A:0x6045ff4
y.create.l HWIO_QDSS_QDSS_MERG_FUN_CID2_ADDR A:0x6045ff8
y.create.l HWIO_QDSS_QDSS_MERG_FUN_CID3_ADDR A:0x6045ffc
y.create.l HWIO_QDSS_QDSS_ETFETB_ETFETB_CXTMC_F128W4K_REG_BASE_START_ADDR A:0x6047000
y.create.l HWIO_QDSS_QDSS_ETFETB_ETFETB_CXTMC_F128W4K_REG_BASE_LAST_ADDR A:0x6047ffc
y.create.l HWIO_QDSS_QDSS_ETFETB_ETFETB_CXTMC_F128W4K_REG_BASE_END_ADDR A:0x6048000
y.create.l HWIO_QDSS_QDSS_ETFETB_RSZ_ADDR A:0x6047004
y.create.l HWIO_QDSS_QDSS_ETFETB_STS_ADDR A:0x604700c
y.create.l HWIO_QDSS_QDSS_ETFETB_RRD_ADDR A:0x6047010
y.create.l HWIO_QDSS_QDSS_ETFETB_RRP_ADDR A:0x6047014
y.create.l HWIO_QDSS_QDSS_ETFETB_RWP_ADDR A:0x6047018
y.create.l HWIO_QDSS_QDSS_ETFETB_TRG_ADDR A:0x604701c
y.create.l HWIO_QDSS_QDSS_ETFETB_CTL_ADDR A:0x6047020
y.create.l HWIO_QDSS_QDSS_ETFETB_RWD_ADDR A:0x6047024
y.create.l HWIO_QDSS_QDSS_ETFETB_MODE_ADDR A:0x6047028
y.create.l HWIO_QDSS_QDSS_ETFETB_LBUFLEVEL_ADDR A:0x604702c
y.create.l HWIO_QDSS_QDSS_ETFETB_CBUFLEVEL_ADDR A:0x6047030
y.create.l HWIO_QDSS_QDSS_ETFETB_BUFWM_ADDR A:0x6047034
y.create.l HWIO_QDSS_QDSS_ETFETB_FFSR_ADDR A:0x6047300
y.create.l HWIO_QDSS_QDSS_ETFETB_FFCR_ADDR A:0x6047304
y.create.l HWIO_QDSS_QDSS_ETFETB_PSCR_ADDR A:0x6047308
y.create.l HWIO_QDSS_QDSS_ETFETB_ITATBMDATA0_ADDR A:0x6047ed0
y.create.l HWIO_QDSS_QDSS_ETFETB_ITATBMCTR2_ADDR A:0x6047ed4
y.create.l HWIO_QDSS_QDSS_ETFETB_ITATBMCTR1_ADDR A:0x6047ed8
y.create.l HWIO_QDSS_QDSS_ETFETB_ITATBMCTR0_ADDR A:0x6047edc
y.create.l HWIO_QDSS_QDSS_ETFETB_ITMISCOP0_ADDR A:0x6047ee0
y.create.l HWIO_QDSS_QDSS_ETFETB_ITTRFLIN_ADDR A:0x6047ee8
y.create.l HWIO_QDSS_QDSS_ETFETB_ITATBDATA0_ADDR A:0x6047eec
y.create.l HWIO_QDSS_QDSS_ETFETB_ITATBCTR2_ADDR A:0x6047ef0
y.create.l HWIO_QDSS_QDSS_ETFETB_ITATBCTR1_ADDR A:0x6047ef4
y.create.l HWIO_QDSS_QDSS_ETFETB_ITATBCTR0_ADDR A:0x6047ef8
y.create.l HWIO_QDSS_QDSS_ETFETB_ITCTRL_ADDR A:0x6047f00
y.create.l HWIO_QDSS_QDSS_ETFETB_CLAIMSET_ADDR A:0x6047fa0
y.create.l HWIO_QDSS_QDSS_ETFETB_CLAIMCLR_ADDR A:0x6047fa4
y.create.l HWIO_QDSS_QDSS_ETFETB_LAR_ADDR A:0x6047fb0
y.create.l HWIO_QDSS_QDSS_ETFETB_LSR_ADDR A:0x6047fb4
y.create.l HWIO_QDSS_QDSS_ETFETB_AUTHSTATUS_ADDR A:0x6047fb8
y.create.l HWIO_QDSS_QDSS_ETFETB_DEVID_ADDR A:0x6047fc8
y.create.l HWIO_QDSS_QDSS_ETFETB_DEVTYPE_ADDR A:0x6047fcc
y.create.l HWIO_QDSS_QDSS_ETFETB_PERIPHID0_ADDR A:0x6047fe0
y.create.l HWIO_QDSS_QDSS_ETFETB_PERIPHID1_ADDR A:0x6047fe4
y.create.l HWIO_QDSS_QDSS_ETFETB_PERIPHID2_ADDR A:0x6047fe8
y.create.l HWIO_QDSS_QDSS_ETFETB_PERIPHID3_ADDR A:0x6047fec
y.create.l HWIO_QDSS_QDSS_ETFETB_PERIPHID4_ADDR A:0x6047fd0
y.create.l HWIO_QDSS_QDSS_ETFETB_PERIPHID5_ADDR A:0x6047fd4
y.create.l HWIO_QDSS_QDSS_ETFETB_PERIPHID6_ADDR A:0x6047fd8
y.create.l HWIO_QDSS_QDSS_ETFETB_PERIPHID7_ADDR A:0x6047fdc
y.create.l HWIO_QDSS_QDSS_ETFETB_COMPID0_ADDR A:0x6047ff0
y.create.l HWIO_QDSS_QDSS_ETFETB_COMPID1_ADDR A:0x6047ff4
y.create.l HWIO_QDSS_QDSS_ETFETB_COMPID2_ADDR A:0x6047ff8
y.create.l HWIO_QDSS_QDSS_ETFETB_COMPID3_ADDR A:0x6047ffc
y.create.l HWIO_QDSS_QDSS_VMIDETR_VMIDETR_VMIDMT_IDX_2_SSD1_REG_BASE_START_ADDR A:0x6049000
y.create.l HWIO_QDSS_QDSS_VMIDETR_VMIDETR_VMIDMT_IDX_2_SSD1_REG_BASE_LAST_ADDR A:0x6049e04
y.create.l HWIO_QDSS_QDSS_VMIDETR_VMIDETR_VMIDMT_IDX_2_SSD1_REG_BASE_END_ADDR A:0x604a000
y.create.l HWIO_QDSS_QDSS_VMIDETR_VMIDMT_SCR0_ADDR A:0x6049000
y.create.l HWIO_QDSS_QDSS_VMIDETR_VMIDMT_SCR1_ADDR A:0x6049004
y.create.l HWIO_QDSS_QDSS_VMIDETR_VMIDMT_SCR2_ADDR A:0x6049008
y.create.l HWIO_QDSS_QDSS_VMIDETR_VMIDMT_SACR_ADDR A:0x6049010
y.create.l HWIO_QDSS_QDSS_VMIDETR_VMIDMT_SIDR0_ADDR A:0x6049020
y.create.l HWIO_QDSS_QDSS_VMIDETR_VMIDMT_SIDR1_ADDR A:0x6049024
y.create.l HWIO_QDSS_QDSS_VMIDETR_VMIDMT_SIDR2_ADDR A:0x6049028
y.create.l HWIO_QDSS_QDSS_VMIDETR_VMIDMT_SIDR4_ADDR A:0x6049030
y.create.l HWIO_QDSS_QDSS_VMIDETR_VMIDMT_SIDR5_ADDR A:0x6049034
y.create.l HWIO_QDSS_QDSS_VMIDETR_VMIDMT_SIDR7_ADDR A:0x604903c
y.create.l HWIO_QDSS_QDSS_VMIDETR_VMIDMT_SGFAR0_ADDR A:0x6049040
y.create.l HWIO_QDSS_QDSS_VMIDETR_VMIDMT_SGFSR_ADDR A:0x6049048
y.create.l HWIO_QDSS_QDSS_VMIDETR_VMIDMT_SGFSRRESTORE_ADDR A:0x604904c
y.create.l HWIO_QDSS_QDSS_VMIDETR_VMIDMT_SGFSYNDR0_ADDR A:0x6049050
y.create.l HWIO_QDSS_QDSS_VMIDETR_VMIDMT_SGFSYNDR1_ADDR A:0x6049054
y.create.l HWIO_QDSS_QDSS_VMIDETR_VMIDMT_SGFSYNDR2_ADDR A:0x6049058
y.create.l HWIO_QDSS_QDSS_VMIDETR_VMIDMT_VMIDMTSCR0_ADDR A:0x6049090
y.create.l HWIO_QDSS_QDSS_VMIDETR_VMIDMT_CR0_ADDR A:0x6049000
y.create.l HWIO_QDSS_QDSS_VMIDETR_VMIDMT_CR2_ADDR A:0x6049008
y.create.l HWIO_QDSS_QDSS_VMIDETR_VMIDMT_ACR_ADDR A:0x6049010
y.create.l HWIO_QDSS_QDSS_VMIDETR_VMIDMT_IDR0_ADDR A:0x6049020
y.create.l HWIO_QDSS_QDSS_VMIDETR_VMIDMT_IDR1_ADDR A:0x6049024
y.create.l HWIO_QDSS_QDSS_VMIDETR_VMIDMT_IDR2_ADDR A:0x6049028
y.create.l HWIO_QDSS_QDSS_VMIDETR_VMIDMT_IDR4_ADDR A:0x6049030
y.create.l HWIO_QDSS_QDSS_VMIDETR_VMIDMT_IDR5_ADDR A:0x6049034
y.create.l HWIO_QDSS_QDSS_VMIDETR_VMIDMT_IDR7_ADDR A:0x604903c
y.create.l HWIO_QDSS_QDSS_VMIDETR_VMIDMT_GFAR0_ADDR A:0x6049040
y.create.l HWIO_QDSS_QDSS_VMIDETR_VMIDMT_GFSR_ADDR A:0x6049048
y.create.l HWIO_QDSS_QDSS_VMIDETR_VMIDMT_GFSRRESTORE_ADDR A:0x604904c
y.create.l HWIO_QDSS_QDSS_VMIDETR_VMIDMT_GFSYNDR0_ADDR A:0x6049050
y.create.l HWIO_QDSS_QDSS_VMIDETR_VMIDMT_GFSYNDR1_ADDR A:0x6049054
y.create.l HWIO_QDSS_QDSS_VMIDETR_VMIDMT_GFSYNDR2_ADDR A:0x6049058
y.create.l HWIO_QDSS_QDSS_VMIDETR_VMIDMT_VMIDMTCR0_ADDR A:0x6049090
y.create.l HWIO_QDSS_QDSS_VMIDETR_VMIDMT_VMIDMTACR_ADDR A:0x604909c
y.create.l HWIO_QDSS_QDSS_VMIDETR_VMIDMT_NSCR0_ADDR A:0x6049400
y.create.l HWIO_QDSS_QDSS_VMIDETR_VMIDMT_NSCR2_ADDR A:0x6049408
y.create.l HWIO_QDSS_QDSS_VMIDETR_VMIDMT_NSACR_ADDR A:0x6049410
y.create.l HWIO_QDSS_QDSS_VMIDETR_VMIDMT_NSGFAR0_ADDR A:0x6049440
y.create.l HWIO_QDSS_QDSS_VMIDETR_VMIDMT_NSGFSR_ADDR A:0x6049448
y.create.l HWIO_QDSS_QDSS_VMIDETR_VMIDMT_NSGFSRRESTORE_ADDR A:0x604944c
y.create.l HWIO_QDSS_QDSS_VMIDETR_VMIDMT_NSGFSYNDR0_ADDR A:0x6049450
y.create.l HWIO_QDSS_QDSS_VMIDETR_VMIDMT_NSGFSYNDR1_ADDR A:0x6049454
y.create.l HWIO_QDSS_QDSS_VMIDETR_VMIDMT_NSGFSYNDR2_ADDR A:0x6049458
y.create.l HWIO_QDSS_QDSS_VMIDETR_VMIDMT_NSVMIDMTCR0_ADDR A:0x6049490
y.create.l HWIO_QDSS_QDSS_VMIDETR_VMIDMT_SSDR0_ADDR A:0x6049080
y.create.l HWIO_QDSS_QDSS_VMIDETR_VMIDMT_S2VR0_ADDR A:0x6049c00
y.create.l HWIO_QDSS_QDSS_VMIDETR_VMIDMT_S2VR1_ADDR A:0x6049c04
y.create.l HWIO_QDSS_QDSS_VMIDETR_VMIDMT_AS2VR0_ADDR A:0x6049e00
y.create.l HWIO_QDSS_QDSS_VMIDETR_VMIDMT_AS2VR1_ADDR A:0x6049e04
y.create.l HWIO_QDSS_QDSS_NDPBAM_BAM_REG_BASE_START_ADDR A:0x6064000
y.create.l HWIO_QDSS_QDSS_NDPBAM_BAM_REG_BASE_LAST_ADDR A:0x6078934
y.create.l HWIO_QDSS_QDSS_NDPBAM_BAM_REG_BASE_END_ADDR A:0x6079000
y.create.l HWIO_QDSS_QDSS_NDPBAM_BAM_CTRL_ADDR A:0x6064000
y.create.l HWIO_QDSS_QDSS_NDPBAM_BAM_TIMER_ADDR A:0x6064040
y.create.l HWIO_QDSS_QDSS_NDPBAM_BAM_TIMER_CTRL_ADDR A:0x6064044
y.create.l HWIO_QDSS_QDSS_NDPBAM_BAM_DESC_CNT_TRSHLD_ADDR A:0x6064008
y.create.l HWIO_QDSS_QDSS_NDPBAM_BAM_IRQ_STTS_ADDR A:0x6064014
y.create.l HWIO_QDSS_QDSS_NDPBAM_BAM_IRQ_CLR_ADDR A:0x6064018
y.create.l HWIO_QDSS_QDSS_NDPBAM_BAM_IRQ_EN_ADDR A:0x606401c
y.create.l HWIO_QDSS_QDSS_NDPBAM_BAM_CNFG_BITS_ADDR A:0x606407c
y.create.l HWIO_QDSS_QDSS_NDPBAM_BAM_CNFG_BITS_2_ADDR A:0x6064084
y.create.l HWIO_QDSS_QDSS_NDPBAM_BAM_REVISION_ADDR A:0x6065000
y.create.l HWIO_QDSS_QDSS_NDPBAM_BAM_SW_VERSION_ADDR A:0x6065004
y.create.l HWIO_QDSS_QDSS_NDPBAM_BAM_NUM_PIPES_ADDR A:0x6065008
y.create.l HWIO_QDSS_QDSS_NDPBAM_BAM_TEST_BUS_SEL_ADDR A:0x6065010
y.create.l HWIO_QDSS_QDSS_NDPBAM_BAM_TEST_BUS_REG_ADDR A:0x6065014
y.create.l HWIO_QDSS_QDSS_NDPBAM_BAM_AHB_MASTER_ERR_CTRLS_ADDR A:0x6065024
y.create.l HWIO_QDSS_QDSS_NDPBAM_BAM_AHB_MASTER_ERR_ADDR_ADDR A:0x6065028
y.create.l HWIO_QDSS_QDSS_NDPBAM_BAM_AHB_MASTER_ERR_DATA_ADDR A:0x606502c
y.create.l HWIO_QDSS_QDSS_NDPBAM_BAM_AHB_MASTER_ERR_ADDR_LSB_ADDR A:0x6065100
y.create.l HWIO_QDSS_QDSS_NDPBAM_BAM_AHB_MASTER_ERR_ADDR_MSB_ADDR A:0x6065104
y.create.l HWIO_QDSS_QDSS_NDPBAM_BAM_TRUST_REG_ADDR A:0x6066000
y.create.l HWIO_QDSS_QDSS_NDPBAM_BAM_P_TRUST_REG0_ADDR A:0x6066020
y.create.l HWIO_QDSS_QDSS_NDPBAM_BAM_P_TRUST_REG1_ADDR A:0x6066024
y.create.l HWIO_QDSS_QDSS_NDPBAM_BAM_IRQ_SRCS_EE0_ADDR A:0x6067000
y.create.l HWIO_QDSS_QDSS_NDPBAM_BAM_IRQ_SRCS_EE1_ADDR A:0x6068000
y.create.l HWIO_QDSS_QDSS_NDPBAM_BAM_IRQ_SRCS_EE2_ADDR A:0x6069000
y.create.l HWIO_QDSS_QDSS_NDPBAM_BAM_IRQ_SRCS_EE3_ADDR A:0x606a000
y.create.l HWIO_QDSS_QDSS_NDPBAM_BAM_IRQ_SRCS_MSK_EE0_ADDR A:0x6067004
y.create.l HWIO_QDSS_QDSS_NDPBAM_BAM_IRQ_SRCS_MSK_EE1_ADDR A:0x6068004
y.create.l HWIO_QDSS_QDSS_NDPBAM_BAM_IRQ_SRCS_MSK_EE2_ADDR A:0x6069004
y.create.l HWIO_QDSS_QDSS_NDPBAM_BAM_IRQ_SRCS_MSK_EE3_ADDR A:0x606a004
y.create.l HWIO_QDSS_QDSS_NDPBAM_BAM_IRQ_SRCS_UNMASKED_EE0_ADDR A:0x6067008
y.create.l HWIO_QDSS_QDSS_NDPBAM_BAM_IRQ_SRCS_UNMASKED_EE1_ADDR A:0x6068008
y.create.l HWIO_QDSS_QDSS_NDPBAM_BAM_IRQ_SRCS_UNMASKED_EE2_ADDR A:0x6069008
y.create.l HWIO_QDSS_QDSS_NDPBAM_BAM_IRQ_SRCS_UNMASKED_EE3_ADDR A:0x606a008
y.create.l HWIO_QDSS_QDSS_NDPBAM_BAM_PIPE_ATTR_EE0_ADDR A:0x606700c
y.create.l HWIO_QDSS_QDSS_NDPBAM_BAM_PIPE_ATTR_EE1_ADDR A:0x606800c
y.create.l HWIO_QDSS_QDSS_NDPBAM_BAM_PIPE_ATTR_EE2_ADDR A:0x606900c
y.create.l HWIO_QDSS_QDSS_NDPBAM_BAM_PIPE_ATTR_EE3_ADDR A:0x606a00c
y.create.l HWIO_QDSS_QDSS_NDPBAM_BAM_IRQ_SRCS_ADDR A:0x6067010
y.create.l HWIO_QDSS_QDSS_NDPBAM_BAM_IRQ_SRCS_MSK_ADDR A:0x6067014
y.create.l HWIO_QDSS_QDSS_NDPBAM_BAM_IRQ_SRCS_UNMASKED_ADDR A:0x6067018
y.create.l HWIO_QDSS_QDSS_NDPBAM_BAM_P_CTRL0_ADDR A:0x6077000
y.create.l HWIO_QDSS_QDSS_NDPBAM_BAM_P_CTRL1_ADDR A:0x6078000
y.create.l HWIO_QDSS_QDSS_NDPBAM_BAM_P_RST0_ADDR A:0x6077004
y.create.l HWIO_QDSS_QDSS_NDPBAM_BAM_P_RST1_ADDR A:0x6078004
y.create.l HWIO_QDSS_QDSS_NDPBAM_BAM_P_HALT0_ADDR A:0x6077008
y.create.l HWIO_QDSS_QDSS_NDPBAM_BAM_P_HALT1_ADDR A:0x6078008
y.create.l HWIO_QDSS_QDSS_NDPBAM_BAM_P_IRQ_STTS0_ADDR A:0x6077010
y.create.l HWIO_QDSS_QDSS_NDPBAM_BAM_P_IRQ_STTS1_ADDR A:0x6078010
y.create.l HWIO_QDSS_QDSS_NDPBAM_BAM_P_IRQ_CLR0_ADDR A:0x6077014
y.create.l HWIO_QDSS_QDSS_NDPBAM_BAM_P_IRQ_CLR1_ADDR A:0x6078014
y.create.l HWIO_QDSS_QDSS_NDPBAM_BAM_P_IRQ_EN0_ADDR A:0x6077018
y.create.l HWIO_QDSS_QDSS_NDPBAM_BAM_P_IRQ_EN1_ADDR A:0x6078018
y.create.l HWIO_QDSS_QDSS_NDPBAM_BAM_P_TIMER0_ADDR A:0x607701c
y.create.l HWIO_QDSS_QDSS_NDPBAM_BAM_P_TIMER1_ADDR A:0x607801c
y.create.l HWIO_QDSS_QDSS_NDPBAM_BAM_P_TIMER_CTRL0_ADDR A:0x6077020
y.create.l HWIO_QDSS_QDSS_NDPBAM_BAM_P_TIMER_CTRL1_ADDR A:0x6078020
y.create.l HWIO_QDSS_QDSS_NDPBAM_BAM_P_PRDCR_SDBND0_ADDR A:0x6077024
y.create.l HWIO_QDSS_QDSS_NDPBAM_BAM_P_PRDCR_SDBND1_ADDR A:0x6078024
y.create.l HWIO_QDSS_QDSS_NDPBAM_BAM_P_CNSMR_SDBND0_ADDR A:0x6077028
y.create.l HWIO_QDSS_QDSS_NDPBAM_BAM_P_CNSMR_SDBND1_ADDR A:0x6078028
y.create.l HWIO_QDSS_QDSS_NDPBAM_BAM_P_SW_OFSTS0_ADDR A:0x6077800
y.create.l HWIO_QDSS_QDSS_NDPBAM_BAM_P_SW_OFSTS1_ADDR A:0x6078800
y.create.l HWIO_QDSS_QDSS_NDPBAM_BAM_P_AU_PSM_CNTXT_1_0_ADDR A:0x6077804
y.create.l HWIO_QDSS_QDSS_NDPBAM_BAM_P_AU_PSM_CNTXT_1_1_ADDR A:0x6078804
y.create.l HWIO_QDSS_QDSS_NDPBAM_BAM_P_PSM_CNTXT_2_0_ADDR A:0x6077808
y.create.l HWIO_QDSS_QDSS_NDPBAM_BAM_P_PSM_CNTXT_2_1_ADDR A:0x6078808
y.create.l HWIO_QDSS_QDSS_NDPBAM_BAM_P_PSM_CNTXT_3_0_ADDR A:0x607780c
y.create.l HWIO_QDSS_QDSS_NDPBAM_BAM_P_PSM_CNTXT_3_1_ADDR A:0x607880c
y.create.l HWIO_QDSS_QDSS_NDPBAM_BAM_P_PSM_CNTXT_4_0_ADDR A:0x6077810
y.create.l HWIO_QDSS_QDSS_NDPBAM_BAM_P_PSM_CNTXT_4_1_ADDR A:0x6078810
y.create.l HWIO_QDSS_QDSS_NDPBAM_BAM_P_PSM_CNTXT_5_0_ADDR A:0x6077814
y.create.l HWIO_QDSS_QDSS_NDPBAM_BAM_P_PSM_CNTXT_5_1_ADDR A:0x6078814
y.create.l HWIO_QDSS_QDSS_NDPBAM_BAM_P_EVNT_REG0_ADDR A:0x6077818
y.create.l HWIO_QDSS_QDSS_NDPBAM_BAM_P_EVNT_REG1_ADDR A:0x6078818
y.create.l HWIO_QDSS_QDSS_NDPBAM_BAM_P_DESC_FIFO_ADDR0_ADDR A:0x607781c
y.create.l HWIO_QDSS_QDSS_NDPBAM_BAM_P_DESC_FIFO_ADDR1_ADDR A:0x607881c
y.create.l HWIO_QDSS_QDSS_NDPBAM_BAM_P_FIFO_SIZES0_ADDR A:0x6077820
y.create.l HWIO_QDSS_QDSS_NDPBAM_BAM_P_FIFO_SIZES1_ADDR A:0x6078820
y.create.l HWIO_QDSS_QDSS_NDPBAM_BAM_P_DATA_FIFO_ADDR0_ADDR A:0x6077824
y.create.l HWIO_QDSS_QDSS_NDPBAM_BAM_P_DATA_FIFO_ADDR1_ADDR A:0x6078824
y.create.l HWIO_QDSS_QDSS_NDPBAM_BAM_P_EVNT_GEN_TRSHLD0_ADDR A:0x6077828
y.create.l HWIO_QDSS_QDSS_NDPBAM_BAM_P_EVNT_GEN_TRSHLD1_ADDR A:0x6078828
y.create.l HWIO_QDSS_QDSS_NDPBAM_BAM_P_EVNT_DEST_ADDR0_ADDR A:0x607782c
y.create.l HWIO_QDSS_QDSS_NDPBAM_BAM_P_EVNT_DEST_ADDR1_ADDR A:0x607882c
y.create.l HWIO_QDSS_QDSS_NDPBAM_BAM_P_DF_CNTXT_0_ADDR A:0x6077830
y.create.l HWIO_QDSS_QDSS_NDPBAM_BAM_P_DF_CNTXT_1_ADDR A:0x6078830
y.create.l HWIO_QDSS_QDSS_NDPBAM_BAM_P_RETR_CNTXT_0_ADDR A:0x6077834
y.create.l HWIO_QDSS_QDSS_NDPBAM_BAM_P_RETR_CNTXT_1_ADDR A:0x6078834
y.create.l HWIO_QDSS_QDSS_NDPBAM_BAM_P_SI_CNTXT_0_ADDR A:0x6077838
y.create.l HWIO_QDSS_QDSS_NDPBAM_BAM_P_SI_CNTXT_1_ADDR A:0x6078838
y.create.l HWIO_QDSS_QDSS_NDPBAM_BAM_P_PSM_CNTXT_3_LSB0_ADDR A:0x6077900
y.create.l HWIO_QDSS_QDSS_NDPBAM_BAM_P_PSM_CNTXT_3_LSB1_ADDR A:0x6078900
y.create.l HWIO_QDSS_QDSS_NDPBAM_BAM_P_PSM_CNTXT_3_MSB0_ADDR A:0x6077904
y.create.l HWIO_QDSS_QDSS_NDPBAM_BAM_P_PSM_CNTXT_3_MSB1_ADDR A:0x6078904
y.create.l HWIO_QDSS_QDSS_NDPBAM_BAM_P_DESC_FIFO_ADDR_LSB0_ADDR A:0x6077910
y.create.l HWIO_QDSS_QDSS_NDPBAM_BAM_P_DESC_FIFO_ADDR_LSB1_ADDR A:0x6078910
y.create.l HWIO_QDSS_QDSS_NDPBAM_BAM_P_DESC_FIFO_ADDR_MSB0_ADDR A:0x6077914
y.create.l HWIO_QDSS_QDSS_NDPBAM_BAM_P_DESC_FIFO_ADDR_MSB1_ADDR A:0x6078914
y.create.l HWIO_QDSS_QDSS_NDPBAM_BAM_P_DATA_FIFO_ADDR_LSB0_ADDR A:0x6077920
y.create.l HWIO_QDSS_QDSS_NDPBAM_BAM_P_DATA_FIFO_ADDR_LSB1_ADDR A:0x6078920
y.create.l HWIO_QDSS_QDSS_NDPBAM_BAM_P_DATA_FIFO_ADDR_MSB0_ADDR A:0x6077924
y.create.l HWIO_QDSS_QDSS_NDPBAM_BAM_P_DATA_FIFO_ADDR_MSB1_ADDR A:0x6078924
y.create.l HWIO_QDSS_QDSS_NDPBAM_BAM_P_EVNT_DEST_ADDR_LSB0_ADDR A:0x6077930
y.create.l HWIO_QDSS_QDSS_NDPBAM_BAM_P_EVNT_DEST_ADDR_LSB1_ADDR A:0x6078930
y.create.l HWIO_QDSS_QDSS_NDPBAM_BAM_P_EVNT_DEST_ADDR_MSB0_ADDR A:0x6077934
y.create.l HWIO_QDSS_QDSS_NDPBAM_BAM_P_EVNT_DEST_ADDR_MSB1_ADDR A:0x6078934
y.create.l HWIO_QDSS_QDSS_VMIDDAP_VMIDDAP_VMIDMT_IDX_2_SSD1_REG_BASE_START_ADDR A:0x6088000
y.create.l HWIO_QDSS_QDSS_VMIDDAP_VMIDDAP_VMIDMT_IDX_2_SSD1_REG_BASE_LAST_ADDR A:0x6088e04
y.create.l HWIO_QDSS_QDSS_VMIDDAP_VMIDDAP_VMIDMT_IDX_2_SSD1_REG_BASE_END_ADDR A:0x6089000
y.create.l HWIO_QDSS_QDSS_VMIDDAP_VMIDMT_SCR0_ADDR A:0x6088000
y.create.l HWIO_QDSS_QDSS_VMIDDAP_VMIDMT_SCR1_ADDR A:0x6088004
y.create.l HWIO_QDSS_QDSS_VMIDDAP_VMIDMT_SCR2_ADDR A:0x6088008
y.create.l HWIO_QDSS_QDSS_VMIDDAP_VMIDMT_SACR_ADDR A:0x6088010
y.create.l HWIO_QDSS_QDSS_VMIDDAP_VMIDMT_SIDR0_ADDR A:0x6088020
y.create.l HWIO_QDSS_QDSS_VMIDDAP_VMIDMT_SIDR1_ADDR A:0x6088024
y.create.l HWIO_QDSS_QDSS_VMIDDAP_VMIDMT_SIDR2_ADDR A:0x6088028
y.create.l HWIO_QDSS_QDSS_VMIDDAP_VMIDMT_SIDR4_ADDR A:0x6088030
y.create.l HWIO_QDSS_QDSS_VMIDDAP_VMIDMT_SIDR5_ADDR A:0x6088034
y.create.l HWIO_QDSS_QDSS_VMIDDAP_VMIDMT_SIDR7_ADDR A:0x608803c
y.create.l HWIO_QDSS_QDSS_VMIDDAP_VMIDMT_SGFAR0_ADDR A:0x6088040
y.create.l HWIO_QDSS_QDSS_VMIDDAP_VMIDMT_SGFSR_ADDR A:0x6088048
y.create.l HWIO_QDSS_QDSS_VMIDDAP_VMIDMT_SGFSRRESTORE_ADDR A:0x608804c
y.create.l HWIO_QDSS_QDSS_VMIDDAP_VMIDMT_SGFSYNDR0_ADDR A:0x6088050
y.create.l HWIO_QDSS_QDSS_VMIDDAP_VMIDMT_SGFSYNDR1_ADDR A:0x6088054
y.create.l HWIO_QDSS_QDSS_VMIDDAP_VMIDMT_SGFSYNDR2_ADDR A:0x6088058
y.create.l HWIO_QDSS_QDSS_VMIDDAP_VMIDMT_VMIDMTSCR0_ADDR A:0x6088090
y.create.l HWIO_QDSS_QDSS_VMIDDAP_VMIDMT_CR0_ADDR A:0x6088000
y.create.l HWIO_QDSS_QDSS_VMIDDAP_VMIDMT_CR2_ADDR A:0x6088008
y.create.l HWIO_QDSS_QDSS_VMIDDAP_VMIDMT_ACR_ADDR A:0x6088010
y.create.l HWIO_QDSS_QDSS_VMIDDAP_VMIDMT_IDR0_ADDR A:0x6088020
y.create.l HWIO_QDSS_QDSS_VMIDDAP_VMIDMT_IDR1_ADDR A:0x6088024
y.create.l HWIO_QDSS_QDSS_VMIDDAP_VMIDMT_IDR2_ADDR A:0x6088028
y.create.l HWIO_QDSS_QDSS_VMIDDAP_VMIDMT_IDR4_ADDR A:0x6088030
y.create.l HWIO_QDSS_QDSS_VMIDDAP_VMIDMT_IDR5_ADDR A:0x6088034
y.create.l HWIO_QDSS_QDSS_VMIDDAP_VMIDMT_IDR7_ADDR A:0x608803c
y.create.l HWIO_QDSS_QDSS_VMIDDAP_VMIDMT_GFAR0_ADDR A:0x6088040
y.create.l HWIO_QDSS_QDSS_VMIDDAP_VMIDMT_GFSR_ADDR A:0x6088048
y.create.l HWIO_QDSS_QDSS_VMIDDAP_VMIDMT_GFSRRESTORE_ADDR A:0x608804c
y.create.l HWIO_QDSS_QDSS_VMIDDAP_VMIDMT_GFSYNDR0_ADDR A:0x6088050
y.create.l HWIO_QDSS_QDSS_VMIDDAP_VMIDMT_GFSYNDR1_ADDR A:0x6088054
y.create.l HWIO_QDSS_QDSS_VMIDDAP_VMIDMT_GFSYNDR2_ADDR A:0x6088058
y.create.l HWIO_QDSS_QDSS_VMIDDAP_VMIDMT_VMIDMTCR0_ADDR A:0x6088090
y.create.l HWIO_QDSS_QDSS_VMIDDAP_VMIDMT_VMIDMTACR_ADDR A:0x608809c
y.create.l HWIO_QDSS_QDSS_VMIDDAP_VMIDMT_NSCR0_ADDR A:0x6088400
y.create.l HWIO_QDSS_QDSS_VMIDDAP_VMIDMT_NSCR2_ADDR A:0x6088408
y.create.l HWIO_QDSS_QDSS_VMIDDAP_VMIDMT_NSACR_ADDR A:0x6088410
y.create.l HWIO_QDSS_QDSS_VMIDDAP_VMIDMT_NSGFAR0_ADDR A:0x6088440
y.create.l HWIO_QDSS_QDSS_VMIDDAP_VMIDMT_NSGFSR_ADDR A:0x6088448
y.create.l HWIO_QDSS_QDSS_VMIDDAP_VMIDMT_NSGFSRRESTORE_ADDR A:0x608844c
y.create.l HWIO_QDSS_QDSS_VMIDDAP_VMIDMT_NSGFSYNDR0_ADDR A:0x6088450
y.create.l HWIO_QDSS_QDSS_VMIDDAP_VMIDMT_NSGFSYNDR1_ADDR A:0x6088454
y.create.l HWIO_QDSS_QDSS_VMIDDAP_VMIDMT_NSGFSYNDR2_ADDR A:0x6088458
y.create.l HWIO_QDSS_QDSS_VMIDDAP_VMIDMT_NSVMIDMTCR0_ADDR A:0x6088490
y.create.l HWIO_QDSS_QDSS_VMIDDAP_VMIDMT_SSDR0_ADDR A:0x6088080
y.create.l HWIO_QDSS_QDSS_VMIDDAP_VMIDMT_S2VR0_ADDR A:0x6088c00
y.create.l HWIO_QDSS_QDSS_VMIDDAP_VMIDMT_S2VR1_ADDR A:0x6088c04
y.create.l HWIO_QDSS_QDSS_VMIDDAP_VMIDMT_AS2VR0_ADDR A:0x6088e00
y.create.l HWIO_QDSS_QDSS_VMIDDAP_VMIDMT_AS2VR1_ADDR A:0x6088e04
y.create.l HWIO_QDSS_QDSS_SPDM_SPDM_SPDM_SPDM_CREG_REG_BASE_START_ADDR A:0x6080000
y.create.l HWIO_QDSS_QDSS_SPDM_SPDM_SPDM_SPDM_CREG_REG_BASE_LAST_ADDR A:0x6080100
y.create.l HWIO_QDSS_QDSS_SPDM_SPDM_SPDM_SPDM_CREG_REG_BASE_END_ADDR A:0x6080120
y.create.l HWIO_QDSS_QDSS_SPDM_SPDM_CREG_CFG0_ADDR A:0x6080000
y.create.l HWIO_QDSS_QDSS_SPDM_SPDM_CREG_HW_INFO_ADDR A:0x6080004
y.create.l HWIO_QDSS_QDSS_SPDM_SPDM_CREG_HW_VERSION_ADDR A:0x6080008
y.create.l HWIO_QDSS_QDSS_SPDM_SPDM_CREG_MUTEX_0_ADDR A:0x6080100
y.create.l HWIO_QDSS_QDSS_SPDM_SPDM_SPDM_SPDM_OLEM_REG_BASE_START_ADDR A:0x6081000
y.create.l HWIO_QDSS_QDSS_SPDM_SPDM_SPDM_SPDM_OLEM_REG_BASE_LAST_ADDR A:0x608113c
y.create.l HWIO_QDSS_QDSS_SPDM_SPDM_SPDM_SPDM_OLEM_REG_BASE_END_ADDR A:0x608115c
y.create.l HWIO_QDSS_QDSS_SPDM_SPDM_OLEM_CFG0_ADDR A:0x6081000
y.create.l HWIO_QDSS_QDSS_SPDM_SPDM_OLEM_CFG1_ADDR A:0x6081004
y.create.l HWIO_QDSS_QDSS_SPDM_SPDM_OLEM_CFG2_ADDR A:0x6081008
y.create.l HWIO_QDSS_QDSS_SPDM_SPDM_OLEM_CFG3_ADDR A:0x608100c
y.create.l HWIO_QDSS_QDSS_SPDM_SPDM_OLEM_CFG4_ADDR A:0x6081010
y.create.l HWIO_QDSS_QDSS_SPDM_SPDM_OLEM_CFG5_ADDR A:0x6081014
y.create.l HWIO_QDSS_QDSS_SPDM_SPDM_OLEM_CFG6_ADDR A:0x6081018
y.create.l HWIO_QDSS_QDSS_SPDM_SPDM_OLEM_CYCLE_C0_OUT_ADDR A:0x6081020
y.create.l HWIO_QDSS_QDSS_SPDM_SPDM_OLEM_CYCLE_C1_OUT_ADDR A:0x6081024
y.create.l HWIO_QDSS_QDSS_SPDM_SPDM_OLEM_CYCLE_C2_OUT_ADDR A:0x6081028
y.create.l HWIO_QDSS_QDSS_SPDM_SPDM_OLEM_CYCLE_C3_OUT_ADDR A:0x608102c
y.create.l HWIO_QDSS_QDSS_SPDM_SPDM_OLEM_CYCLE_C4_OUT_ADDR A:0x6081030
y.create.l HWIO_QDSS_QDSS_SPDM_SPDM_OLEM_CYCLE_C5_OUT_ADDR A:0x6081034
y.create.l HWIO_QDSS_QDSS_SPDM_SPDM_OLEM_CYCLE_C6_OUT_ADDR A:0x6081038
y.create.l HWIO_QDSS_QDSS_SPDM_SPDM_OLEM_CYCLE_C7_OUT_ADDR A:0x608103c
y.create.l HWIO_QDSS_QDSS_SPDM_SPDM_OLEM_CYCLE_C8_OUT_ADDR A:0x6081040
y.create.l HWIO_QDSS_QDSS_SPDM_SPDM_OLEM_CYCLE_C9_OUT_ADDR A:0x6081044
y.create.l HWIO_QDSS_QDSS_SPDM_SPDM_OLEM_EVENT_C0_OUT_ADDR A:0x60810a0
y.create.l HWIO_QDSS_QDSS_SPDM_SPDM_OLEM_EVENT_C1_OUT_ADDR A:0x60810a4
y.create.l HWIO_QDSS_QDSS_SPDM_SPDM_OLEM_EVENT_C2_OUT_ADDR A:0x60810a8
y.create.l HWIO_QDSS_QDSS_SPDM_SPDM_OLEM_EVENT_C3_OUT_ADDR A:0x60810ac
y.create.l HWIO_QDSS_QDSS_SPDM_SPDM_OLEM_EVENT_C4_OUT_ADDR A:0x60810b0
y.create.l HWIO_QDSS_QDSS_SPDM_SPDM_OLEM_EVENT_C5_OUT_ADDR A:0x60810b4
y.create.l HWIO_QDSS_QDSS_SPDM_SPDM_OLEM_EVENT_C6_OUT_ADDR A:0x60810b8
y.create.l HWIO_QDSS_QDSS_SPDM_SPDM_OLEM_EVENT_C7_OUT_ADDR A:0x60810bc
y.create.l HWIO_QDSS_QDSS_SPDM_SPDM_OLEM_EVENT_C8_OUT_ADDR A:0x60810c0
y.create.l HWIO_QDSS_QDSS_SPDM_SPDM_OLEM_EVENT_C9_OUT_ADDR A:0x60810c4
y.create.l HWIO_QDSS_QDSS_SPDM_SPDM_OLEM_MULTIBIT_C0_OUT_ADDR A:0x6081120
y.create.l HWIO_QDSS_QDSS_SPDM_SPDM_OLEM_MULTIBIT_C1_OUT_ADDR A:0x6081124
y.create.l HWIO_QDSS_QDSS_SPDM_SPDM_OLEM_MULTIBIT_C2_OUT_ADDR A:0x6081128
y.create.l HWIO_QDSS_QDSS_SPDM_SPDM_OLEM_MULTIBIT_C3_OUT_ADDR A:0x608112c
y.create.l HWIO_QDSS_QDSS_SPDM_SPDM_OLEM_MULTIBIT_C4_OUT_ADDR A:0x6081130
y.create.l HWIO_QDSS_QDSS_SPDM_SPDM_OLEM_MULTIBIT_C5_OUT_ADDR A:0x6081134
y.create.l HWIO_QDSS_QDSS_SPDM_SPDM_OLEM_MULTIBIT_C6_OUT_ADDR A:0x6081138
y.create.l HWIO_QDSS_QDSS_SPDM_SPDM_OLEM_MULTIBIT_C7_OUT_ADDR A:0x608113c
y.create.l HWIO_QDSS_QDSS_SPDM_SPDM_SPDM_SPDM_RTEM_REG_BASE_START_ADDR A:0x6082000
y.create.l HWIO_QDSS_QDSS_SPDM_SPDM_SPDM_SPDM_RTEM_REG_BASE_LAST_ADDR A:0x60822f8
y.create.l HWIO_QDSS_QDSS_SPDM_SPDM_SPDM_SPDM_RTEM_REG_BASE_END_ADDR A:0x6082318
y.create.l HWIO_QDSS_QDSS_SPDM_SPDM_RT_LOW_THRESH_STATUS_ADDR A:0x6082000
y.create.l HWIO_QDSS_QDSS_SPDM_SPDM_RT_HIGH_THRESH_STATUS_ADDR A:0x6082004
y.create.l HWIO_QDSS_QDSS_SPDM_SPDM_RT_LOW_IRQ_EN_0_ADDR A:0x6082010
y.create.l HWIO_QDSS_QDSS_SPDM_SPDM_RT_LOW_IRQ_EN_1_ADDR A:0x6082014
y.create.l HWIO_QDSS_QDSS_SPDM_SPDM_RT_LOW_IRQ_EN_2_ADDR A:0x6082018
y.create.l HWIO_QDSS_QDSS_SPDM_SPDM_RT_LOW_IRQ_EN_3_ADDR A:0x608201c
y.create.l HWIO_QDSS_QDSS_SPDM_SPDM_RT_HIGH_IRQ_EN_0_ADDR A:0x6082020
y.create.l HWIO_QDSS_QDSS_SPDM_SPDM_RT_HIGH_IRQ_EN_1_ADDR A:0x6082024
y.create.l HWIO_QDSS_QDSS_SPDM_SPDM_RT_HIGH_IRQ_EN_2_ADDR A:0x6082028
y.create.l HWIO_QDSS_QDSS_SPDM_SPDM_RT_HIGH_IRQ_EN_3_ADDR A:0x608202c
y.create.l HWIO_QDSS_QDSS_SPDM_SPDM_RT_IRQ_TIMER_0_ADDR A:0x6082030
y.create.l HWIO_QDSS_QDSS_SPDM_SPDM_RT_IRQ_TIMER_1_ADDR A:0x6082034
y.create.l HWIO_QDSS_QDSS_SPDM_SPDM_RT_IRQ_TIMER_2_ADDR A:0x6082038
y.create.l HWIO_QDSS_QDSS_SPDM_SPDM_RT_IRQ_TIMER_3_ADDR A:0x608203c
y.create.l HWIO_QDSS_QDSS_SPDM_SPDM_RT_DIAG_MUX_SEL_ADDR A:0x6082040
y.create.l HWIO_QDSS_QDSS_SPDM_SPDM_RT_MON_EN_ADDR A:0x6082050
y.create.l HWIO_QDSS_QDSS_SPDM_SPDM_RT_MON_EN_SET_ADDR A:0x6082054
y.create.l HWIO_QDSS_QDSS_SPDM_SPDM_RT_MON_EN_CLEAR_ADDR A:0x6082058
y.create.l HWIO_QDSS_QDSS_SPDM_SPDM_RT_MON_RST_ADDR A:0x6082060
y.create.l HWIO_QDSS_QDSS_SPDM_SPDM_RT_MON_RST_SET_ADDR A:0x6082064
y.create.l HWIO_QDSS_QDSS_SPDM_SPDM_RT_MON_RST_CLEAR_ADDR A:0x6082068
y.create.l HWIO_QDSS_QDSS_SPDM_SPDM_RT_MON_CFG_0_ADDR A:0x6082100
y.create.l HWIO_QDSS_QDSS_SPDM_SPDM_RT_MON_CFG_1_ADDR A:0x6082110
y.create.l HWIO_QDSS_QDSS_SPDM_SPDM_RT_MON_CFG_2_ADDR A:0x6082120
y.create.l HWIO_QDSS_QDSS_SPDM_SPDM_RT_MON_CFG_3_ADDR A:0x6082130
y.create.l HWIO_QDSS_QDSS_SPDM_SPDM_RT_MON_CFG_4_ADDR A:0x6082140
y.create.l HWIO_QDSS_QDSS_SPDM_SPDM_RT_MON_CFG_5_ADDR A:0x6082150
y.create.l HWIO_QDSS_QDSS_SPDM_SPDM_RT_MON_CFG_6_ADDR A:0x6082160
y.create.l HWIO_QDSS_QDSS_SPDM_SPDM_RT_MON_CFG_7_ADDR A:0x6082170
y.create.l HWIO_QDSS_QDSS_SPDM_SPDM_RT_MON_CFG_8_ADDR A:0x6082180
y.create.l HWIO_QDSS_QDSS_SPDM_SPDM_RT_MON_CFG_9_ADDR A:0x6082190
y.create.l HWIO_QDSS_QDSS_SPDM_SPDM_RT_THRESH_CFG_0_ADDR A:0x6082104
y.create.l HWIO_QDSS_QDSS_SPDM_SPDM_RT_THRESH_CFG_1_ADDR A:0x6082114
y.create.l HWIO_QDSS_QDSS_SPDM_SPDM_RT_THRESH_CFG_2_ADDR A:0x6082124
y.create.l HWIO_QDSS_QDSS_SPDM_SPDM_RT_THRESH_CFG_3_ADDR A:0x6082134
y.create.l HWIO_QDSS_QDSS_SPDM_SPDM_RT_THRESH_CFG_4_ADDR A:0x6082144
y.create.l HWIO_QDSS_QDSS_SPDM_SPDM_RT_THRESH_CFG_5_ADDR A:0x6082154
y.create.l HWIO_QDSS_QDSS_SPDM_SPDM_RT_THRESH_CFG_6_ADDR A:0x6082164
y.create.l HWIO_QDSS_QDSS_SPDM_SPDM_RT_THRESH_CFG_7_ADDR A:0x6082174
y.create.l HWIO_QDSS_QDSS_SPDM_SPDM_RT_THRESH_CFG_8_ADDR A:0x6082184
y.create.l HWIO_QDSS_QDSS_SPDM_SPDM_RT_THRESH_CFG_9_ADDR A:0x6082194
y.create.l HWIO_QDSS_QDSS_SPDM_SPDM_RT_MON_STATUS_0_ADDR A:0x6082108
y.create.l HWIO_QDSS_QDSS_SPDM_SPDM_RT_MON_STATUS_1_ADDR A:0x6082118
y.create.l HWIO_QDSS_QDSS_SPDM_SPDM_RT_MON_STATUS_2_ADDR A:0x6082128
y.create.l HWIO_QDSS_QDSS_SPDM_SPDM_RT_MON_STATUS_3_ADDR A:0x6082138
y.create.l HWIO_QDSS_QDSS_SPDM_SPDM_RT_MON_STATUS_4_ADDR A:0x6082148
y.create.l HWIO_QDSS_QDSS_SPDM_SPDM_RT_MON_STATUS_5_ADDR A:0x6082158
y.create.l HWIO_QDSS_QDSS_SPDM_SPDM_RT_MON_STATUS_6_ADDR A:0x6082168
y.create.l HWIO_QDSS_QDSS_SPDM_SPDM_RT_MON_STATUS_7_ADDR A:0x6082178
y.create.l HWIO_QDSS_QDSS_SPDM_SPDM_RT_MON_STATUS_8_ADDR A:0x6082188
y.create.l HWIO_QDSS_QDSS_SPDM_SPDM_RT_MON_STATUS_9_ADDR A:0x6082198
y.create.l HWIO_QDSS_QDSS_SPDM_SPDM_SPDM_SPDM_SREG_REG_BASE_START_ADDR A:0x6084000
y.create.l HWIO_QDSS_QDSS_SPDM_SPDM_SPDM_SPDM_SREG_REG_BASE_LAST_ADDR A:0x6084100
y.create.l HWIO_QDSS_QDSS_SPDM_SPDM_SPDM_SPDM_SREG_REG_BASE_END_ADDR A:0x6084120
y.create.l HWIO_QDSS_QDSS_SPDM_SPDM_SREG_CFG0_ADDR A:0x6084000
y.create.l HWIO_QDSS_QDSS_SPDM_SPDM_SREG_CFG1_ADDR A:0x6084004
y.create.l HWIO_QDSS_QDSS_SPDM_SPDM_SREG_MUTEX_0_ADDR A:0x6084100
y.create.l HWIO_QDSS_QDSS_SPDM_SPDM_SPDM_APU0132_1_REG_BASE_START_ADDR A:0x6086000
y.create.l HWIO_QDSS_QDSS_SPDM_SPDM_SPDM_APU0132_1_REG_BASE_LAST_ADDR A:0x6086254
y.create.l HWIO_QDSS_QDSS_SPDM_SPDM_SPDM_APU0132_1_REG_BASE_END_ADDR A:0x6086280
y.create.l HWIO_QDSS_QDSS_SPDM_SPDM_XPU_SCR_ADDR A:0x6086000
y.create.l HWIO_QDSS_QDSS_SPDM_SPDM_XPU_SWDR_ADDR A:0x6086004
y.create.l HWIO_QDSS_QDSS_SPDM_SPDM_XPU_SEAR0_ADDR A:0x6086040
y.create.l HWIO_QDSS_QDSS_SPDM_SPDM_XPU_SESR_ADDR A:0x6086048
y.create.l HWIO_QDSS_QDSS_SPDM_SPDM_XPU_SESRRESTORE_ADDR A:0x608604c
y.create.l HWIO_QDSS_QDSS_SPDM_SPDM_XPU_SESYNR0_ADDR A:0x6086050
y.create.l HWIO_QDSS_QDSS_SPDM_SPDM_XPU_SESYNR1_ADDR A:0x6086054
y.create.l HWIO_QDSS_QDSS_SPDM_SPDM_XPU_SESYNR2_ADDR A:0x6086058
y.create.l HWIO_QDSS_QDSS_SPDM_SPDM_XPU_MCR_ADDR A:0x6086100
y.create.l HWIO_QDSS_QDSS_SPDM_SPDM_XPU_MEAR0_ADDR A:0x6086140
y.create.l HWIO_QDSS_QDSS_SPDM_SPDM_XPU_MESR_ADDR A:0x6086148
y.create.l HWIO_QDSS_QDSS_SPDM_SPDM_XPU_MESRRESTORE_ADDR A:0x608614c
y.create.l HWIO_QDSS_QDSS_SPDM_SPDM_XPU_MESYNR0_ADDR A:0x6086150
y.create.l HWIO_QDSS_QDSS_SPDM_SPDM_XPU_MESYNR1_ADDR A:0x6086154
y.create.l HWIO_QDSS_QDSS_SPDM_SPDM_XPU_MESYNR2_ADDR A:0x6086158
y.create.l HWIO_QDSS_QDSS_SPDM_SPDM_XPU_CR_ADDR A:0x6086080
y.create.l HWIO_QDSS_QDSS_SPDM_SPDM_XPU_RPU_ACR0_ADDR A:0x60860a0
y.create.l HWIO_QDSS_QDSS_SPDM_SPDM_XPU_EAR0_ADDR A:0x60860c0
y.create.l HWIO_QDSS_QDSS_SPDM_SPDM_XPU_ESR_ADDR A:0x60860c8
y.create.l HWIO_QDSS_QDSS_SPDM_SPDM_XPU_ESRRESTORE_ADDR A:0x60860cc
y.create.l HWIO_QDSS_QDSS_SPDM_SPDM_XPU_ESYNR0_ADDR A:0x60860d0
y.create.l HWIO_QDSS_QDSS_SPDM_SPDM_XPU_ESYNR1_ADDR A:0x60860d4
y.create.l HWIO_QDSS_QDSS_SPDM_SPDM_XPU_ESYNR2_ADDR A:0x60860d8
y.create.l HWIO_QDSS_QDSS_SPDM_SPDM_XPU_IDR0_ADDR A:0x6086074
y.create.l HWIO_QDSS_QDSS_SPDM_SPDM_XPU_IDR1_ADDR A:0x6086078
y.create.l HWIO_QDSS_QDSS_SPDM_SPDM_XPU_REV_ADDR A:0x608607c
y.create.l HWIO_QDSS_QDSS_SPDM_SPDM_XPU_RG0_RACR0_ADDR A:0x6086200
y.create.l HWIO_QDSS_QDSS_SPDM_SPDM_XPU_RG0_SCR_ADDR A:0x6086250
y.create.l HWIO_QDSS_QDSS_SPDM_SPDM_XPU_RG0_MCR_ADDR A:0x6086254
y.create.l HWIO_QPIC_QPIC_BAM_REG_BASE_START_ADDR A:0x7984000
y.create.l HWIO_QPIC_QPIC_BAM_REG_BASE_LAST_ADDR A:0x799f934
y.create.l HWIO_QPIC_QPIC_BAM_REG_BASE_END_ADDR A:0x79a0000
y.create.l HWIO_QPIC_QPIC_BAM_CTRL_ADDR A:0x7984000
y.create.l HWIO_QPIC_QPIC_BAM_TIMER_ADDR A:0x7984040
y.create.l HWIO_QPIC_QPIC_BAM_TIMER_CTRL_ADDR A:0x7984044
y.create.l HWIO_QPIC_QPIC_BAM_DESC_CNT_TRSHLD_ADDR A:0x7984008
y.create.l HWIO_QPIC_QPIC_BAM_IRQ_STTS_ADDR A:0x7984014
y.create.l HWIO_QPIC_QPIC_BAM_IRQ_CLR_ADDR A:0x7984018
y.create.l HWIO_QPIC_QPIC_BAM_IRQ_EN_ADDR A:0x798401c
y.create.l HWIO_QPIC_QPIC_BAM_CNFG_BITS_ADDR A:0x798407c
y.create.l HWIO_QPIC_QPIC_BAM_CNFG_BITS_2_ADDR A:0x7984084
y.create.l HWIO_QPIC_QPIC_BAM_REVISION_ADDR A:0x7985000
y.create.l HWIO_QPIC_QPIC_BAM_SW_VERSION_ADDR A:0x7985004
y.create.l HWIO_QPIC_QPIC_BAM_NUM_PIPES_ADDR A:0x7985008
y.create.l HWIO_QPIC_QPIC_BAM_TEST_BUS_SEL_ADDR A:0x7985010
y.create.l HWIO_QPIC_QPIC_BAM_TEST_BUS_REG_ADDR A:0x7985014
y.create.l HWIO_QPIC_QPIC_BAM_AHB_MASTER_ERR_CTRLS_ADDR A:0x7985024
y.create.l HWIO_QPIC_QPIC_BAM_AHB_MASTER_ERR_ADDR_ADDR A:0x7985028
y.create.l HWIO_QPIC_QPIC_BAM_AHB_MASTER_ERR_DATA_ADDR A:0x798502c
y.create.l HWIO_QPIC_QPIC_BAM_AHB_MASTER_ERR_ADDR_LSB_ADDR A:0x7985100
y.create.l HWIO_QPIC_QPIC_BAM_AHB_MASTER_ERR_ADDR_MSB_ADDR A:0x7985104
y.create.l HWIO_QPIC_QPIC_BAM_TRUST_REG_ADDR A:0x7986000
y.create.l HWIO_QPIC_QPIC_BAM_P_TRUST_REG0_ADDR A:0x7986020
y.create.l HWIO_QPIC_QPIC_BAM_P_TRUST_REG1_ADDR A:0x7986024
y.create.l HWIO_QPIC_QPIC_BAM_P_TRUST_REG2_ADDR A:0x7986028
y.create.l HWIO_QPIC_QPIC_BAM_P_TRUST_REG3_ADDR A:0x798602c
y.create.l HWIO_QPIC_QPIC_BAM_P_TRUST_REG4_ADDR A:0x7986030
y.create.l HWIO_QPIC_QPIC_BAM_P_TRUST_REG5_ADDR A:0x7986034
y.create.l HWIO_QPIC_QPIC_BAM_P_TRUST_REG6_ADDR A:0x7986038
y.create.l HWIO_QPIC_QPIC_BAM_P_TRUST_REG7_ADDR A:0x798603c
y.create.l HWIO_QPIC_QPIC_BAM_P_TRUST_REG8_ADDR A:0x7986040
y.create.l HWIO_QPIC_QPIC_BAM_IRQ_SRCS_EE0_ADDR A:0x7987000
y.create.l HWIO_QPIC_QPIC_BAM_IRQ_SRCS_EE1_ADDR A:0x7988000
y.create.l HWIO_QPIC_QPIC_BAM_IRQ_SRCS_EE2_ADDR A:0x7989000
y.create.l HWIO_QPIC_QPIC_BAM_IRQ_SRCS_EE3_ADDR A:0x798a000
y.create.l HWIO_QPIC_QPIC_BAM_IRQ_SRCS_MSK_EE0_ADDR A:0x7987004
y.create.l HWIO_QPIC_QPIC_BAM_IRQ_SRCS_MSK_EE1_ADDR A:0x7988004
y.create.l HWIO_QPIC_QPIC_BAM_IRQ_SRCS_MSK_EE2_ADDR A:0x7989004
y.create.l HWIO_QPIC_QPIC_BAM_IRQ_SRCS_MSK_EE3_ADDR A:0x798a004
y.create.l HWIO_QPIC_QPIC_BAM_IRQ_SRCS_UNMASKED_EE0_ADDR A:0x7987008
y.create.l HWIO_QPIC_QPIC_BAM_IRQ_SRCS_UNMASKED_EE1_ADDR A:0x7988008
y.create.l HWIO_QPIC_QPIC_BAM_IRQ_SRCS_UNMASKED_EE2_ADDR A:0x7989008
y.create.l HWIO_QPIC_QPIC_BAM_IRQ_SRCS_UNMASKED_EE3_ADDR A:0x798a008
y.create.l HWIO_QPIC_QPIC_BAM_PIPE_ATTR_EE0_ADDR A:0x798700c
y.create.l HWIO_QPIC_QPIC_BAM_PIPE_ATTR_EE1_ADDR A:0x798800c
y.create.l HWIO_QPIC_QPIC_BAM_PIPE_ATTR_EE2_ADDR A:0x798900c
y.create.l HWIO_QPIC_QPIC_BAM_PIPE_ATTR_EE3_ADDR A:0x798a00c
y.create.l HWIO_QPIC_QPIC_BAM_IRQ_SRCS_ADDR A:0x7987010
y.create.l HWIO_QPIC_QPIC_BAM_IRQ_SRCS_MSK_ADDR A:0x7987014
y.create.l HWIO_QPIC_QPIC_BAM_IRQ_SRCS_UNMASKED_ADDR A:0x7987018
y.create.l HWIO_QPIC_QPIC_BAM_P_CTRL0_ADDR A:0x7997000
y.create.l HWIO_QPIC_QPIC_BAM_P_CTRL1_ADDR A:0x7998000
y.create.l HWIO_QPIC_QPIC_BAM_P_CTRL2_ADDR A:0x7999000
y.create.l HWIO_QPIC_QPIC_BAM_P_CTRL3_ADDR A:0x799a000
y.create.l HWIO_QPIC_QPIC_BAM_P_CTRL4_ADDR A:0x799b000
y.create.l HWIO_QPIC_QPIC_BAM_P_CTRL5_ADDR A:0x799c000
y.create.l HWIO_QPIC_QPIC_BAM_P_CTRL6_ADDR A:0x799d000
y.create.l HWIO_QPIC_QPIC_BAM_P_CTRL7_ADDR A:0x799e000
y.create.l HWIO_QPIC_QPIC_BAM_P_CTRL8_ADDR A:0x799f000
y.create.l HWIO_QPIC_QPIC_BAM_P_RST0_ADDR A:0x7997004
y.create.l HWIO_QPIC_QPIC_BAM_P_RST1_ADDR A:0x7998004
y.create.l HWIO_QPIC_QPIC_BAM_P_RST2_ADDR A:0x7999004
y.create.l HWIO_QPIC_QPIC_BAM_P_RST3_ADDR A:0x799a004
y.create.l HWIO_QPIC_QPIC_BAM_P_RST4_ADDR A:0x799b004
y.create.l HWIO_QPIC_QPIC_BAM_P_RST5_ADDR A:0x799c004
y.create.l HWIO_QPIC_QPIC_BAM_P_RST6_ADDR A:0x799d004
y.create.l HWIO_QPIC_QPIC_BAM_P_RST7_ADDR A:0x799e004
y.create.l HWIO_QPIC_QPIC_BAM_P_RST8_ADDR A:0x799f004
y.create.l HWIO_QPIC_QPIC_BAM_P_HALT0_ADDR A:0x7997008
y.create.l HWIO_QPIC_QPIC_BAM_P_HALT1_ADDR A:0x7998008
y.create.l HWIO_QPIC_QPIC_BAM_P_HALT2_ADDR A:0x7999008
y.create.l HWIO_QPIC_QPIC_BAM_P_HALT3_ADDR A:0x799a008
y.create.l HWIO_QPIC_QPIC_BAM_P_HALT4_ADDR A:0x799b008
y.create.l HWIO_QPIC_QPIC_BAM_P_HALT5_ADDR A:0x799c008
y.create.l HWIO_QPIC_QPIC_BAM_P_HALT6_ADDR A:0x799d008
y.create.l HWIO_QPIC_QPIC_BAM_P_HALT7_ADDR A:0x799e008
y.create.l HWIO_QPIC_QPIC_BAM_P_HALT8_ADDR A:0x799f008
y.create.l HWIO_QPIC_QPIC_BAM_P_IRQ_STTS0_ADDR A:0x7997010
y.create.l HWIO_QPIC_QPIC_BAM_P_IRQ_STTS1_ADDR A:0x7998010
y.create.l HWIO_QPIC_QPIC_BAM_P_IRQ_STTS2_ADDR A:0x7999010
y.create.l HWIO_QPIC_QPIC_BAM_P_IRQ_STTS3_ADDR A:0x799a010
y.create.l HWIO_QPIC_QPIC_BAM_P_IRQ_STTS4_ADDR A:0x799b010
y.create.l HWIO_QPIC_QPIC_BAM_P_IRQ_STTS5_ADDR A:0x799c010
y.create.l HWIO_QPIC_QPIC_BAM_P_IRQ_STTS6_ADDR A:0x799d010
y.create.l HWIO_QPIC_QPIC_BAM_P_IRQ_STTS7_ADDR A:0x799e010
y.create.l HWIO_QPIC_QPIC_BAM_P_IRQ_STTS8_ADDR A:0x799f010
y.create.l HWIO_QPIC_QPIC_BAM_P_IRQ_CLR0_ADDR A:0x7997014
y.create.l HWIO_QPIC_QPIC_BAM_P_IRQ_CLR1_ADDR A:0x7998014
y.create.l HWIO_QPIC_QPIC_BAM_P_IRQ_CLR2_ADDR A:0x7999014
y.create.l HWIO_QPIC_QPIC_BAM_P_IRQ_CLR3_ADDR A:0x799a014
y.create.l HWIO_QPIC_QPIC_BAM_P_IRQ_CLR4_ADDR A:0x799b014
y.create.l HWIO_QPIC_QPIC_BAM_P_IRQ_CLR5_ADDR A:0x799c014
y.create.l HWIO_QPIC_QPIC_BAM_P_IRQ_CLR6_ADDR A:0x799d014
y.create.l HWIO_QPIC_QPIC_BAM_P_IRQ_CLR7_ADDR A:0x799e014
y.create.l HWIO_QPIC_QPIC_BAM_P_IRQ_CLR8_ADDR A:0x799f014
y.create.l HWIO_QPIC_QPIC_BAM_P_IRQ_EN0_ADDR A:0x7997018
y.create.l HWIO_QPIC_QPIC_BAM_P_IRQ_EN1_ADDR A:0x7998018
y.create.l HWIO_QPIC_QPIC_BAM_P_IRQ_EN2_ADDR A:0x7999018
y.create.l HWIO_QPIC_QPIC_BAM_P_IRQ_EN3_ADDR A:0x799a018
y.create.l HWIO_QPIC_QPIC_BAM_P_IRQ_EN4_ADDR A:0x799b018
y.create.l HWIO_QPIC_QPIC_BAM_P_IRQ_EN5_ADDR A:0x799c018
y.create.l HWIO_QPIC_QPIC_BAM_P_IRQ_EN6_ADDR A:0x799d018
y.create.l HWIO_QPIC_QPIC_BAM_P_IRQ_EN7_ADDR A:0x799e018
y.create.l HWIO_QPIC_QPIC_BAM_P_IRQ_EN8_ADDR A:0x799f018
y.create.l HWIO_QPIC_QPIC_BAM_P_TIMER0_ADDR A:0x799701c
y.create.l HWIO_QPIC_QPIC_BAM_P_TIMER1_ADDR A:0x799801c
y.create.l HWIO_QPIC_QPIC_BAM_P_TIMER2_ADDR A:0x799901c
y.create.l HWIO_QPIC_QPIC_BAM_P_TIMER3_ADDR A:0x799a01c
y.create.l HWIO_QPIC_QPIC_BAM_P_TIMER4_ADDR A:0x799b01c
y.create.l HWIO_QPIC_QPIC_BAM_P_TIMER5_ADDR A:0x799c01c
y.create.l HWIO_QPIC_QPIC_BAM_P_TIMER6_ADDR A:0x799d01c
y.create.l HWIO_QPIC_QPIC_BAM_P_TIMER7_ADDR A:0x799e01c
y.create.l HWIO_QPIC_QPIC_BAM_P_TIMER8_ADDR A:0x799f01c
y.create.l HWIO_QPIC_QPIC_BAM_P_TIMER_CTRL0_ADDR A:0x7997020
y.create.l HWIO_QPIC_QPIC_BAM_P_TIMER_CTRL1_ADDR A:0x7998020
y.create.l HWIO_QPIC_QPIC_BAM_P_TIMER_CTRL2_ADDR A:0x7999020
y.create.l HWIO_QPIC_QPIC_BAM_P_TIMER_CTRL3_ADDR A:0x799a020
y.create.l HWIO_QPIC_QPIC_BAM_P_TIMER_CTRL4_ADDR A:0x799b020
y.create.l HWIO_QPIC_QPIC_BAM_P_TIMER_CTRL5_ADDR A:0x799c020
y.create.l HWIO_QPIC_QPIC_BAM_P_TIMER_CTRL6_ADDR A:0x799d020
y.create.l HWIO_QPIC_QPIC_BAM_P_TIMER_CTRL7_ADDR A:0x799e020
y.create.l HWIO_QPIC_QPIC_BAM_P_TIMER_CTRL8_ADDR A:0x799f020
y.create.l HWIO_QPIC_QPIC_BAM_P_PRDCR_SDBND0_ADDR A:0x7997024
y.create.l HWIO_QPIC_QPIC_BAM_P_PRDCR_SDBND1_ADDR A:0x7998024
y.create.l HWIO_QPIC_QPIC_BAM_P_PRDCR_SDBND2_ADDR A:0x7999024
y.create.l HWIO_QPIC_QPIC_BAM_P_PRDCR_SDBND3_ADDR A:0x799a024
y.create.l HWIO_QPIC_QPIC_BAM_P_PRDCR_SDBND4_ADDR A:0x799b024
y.create.l HWIO_QPIC_QPIC_BAM_P_PRDCR_SDBND5_ADDR A:0x799c024
y.create.l HWIO_QPIC_QPIC_BAM_P_PRDCR_SDBND6_ADDR A:0x799d024
y.create.l HWIO_QPIC_QPIC_BAM_P_PRDCR_SDBND7_ADDR A:0x799e024
y.create.l HWIO_QPIC_QPIC_BAM_P_PRDCR_SDBND8_ADDR A:0x799f024
y.create.l HWIO_QPIC_QPIC_BAM_P_CNSMR_SDBND0_ADDR A:0x7997028
y.create.l HWIO_QPIC_QPIC_BAM_P_CNSMR_SDBND1_ADDR A:0x7998028
y.create.l HWIO_QPIC_QPIC_BAM_P_CNSMR_SDBND2_ADDR A:0x7999028
y.create.l HWIO_QPIC_QPIC_BAM_P_CNSMR_SDBND3_ADDR A:0x799a028
y.create.l HWIO_QPIC_QPIC_BAM_P_CNSMR_SDBND4_ADDR A:0x799b028
y.create.l HWIO_QPIC_QPIC_BAM_P_CNSMR_SDBND5_ADDR A:0x799c028
y.create.l HWIO_QPIC_QPIC_BAM_P_CNSMR_SDBND6_ADDR A:0x799d028
y.create.l HWIO_QPIC_QPIC_BAM_P_CNSMR_SDBND7_ADDR A:0x799e028
y.create.l HWIO_QPIC_QPIC_BAM_P_CNSMR_SDBND8_ADDR A:0x799f028
y.create.l HWIO_QPIC_QPIC_BAM_P_SW_OFSTS0_ADDR A:0x7997800
y.create.l HWIO_QPIC_QPIC_BAM_P_SW_OFSTS1_ADDR A:0x7998800
y.create.l HWIO_QPIC_QPIC_BAM_P_SW_OFSTS2_ADDR A:0x7999800
y.create.l HWIO_QPIC_QPIC_BAM_P_SW_OFSTS3_ADDR A:0x799a800
y.create.l HWIO_QPIC_QPIC_BAM_P_SW_OFSTS4_ADDR A:0x799b800
y.create.l HWIO_QPIC_QPIC_BAM_P_SW_OFSTS5_ADDR A:0x799c800
y.create.l HWIO_QPIC_QPIC_BAM_P_SW_OFSTS6_ADDR A:0x799d800
y.create.l HWIO_QPIC_QPIC_BAM_P_SW_OFSTS7_ADDR A:0x799e800
y.create.l HWIO_QPIC_QPIC_BAM_P_SW_OFSTS8_ADDR A:0x799f800
y.create.l HWIO_QPIC_QPIC_BAM_P_AU_PSM_CNTXT_1_0_ADDR A:0x7997804
y.create.l HWIO_QPIC_QPIC_BAM_P_AU_PSM_CNTXT_1_1_ADDR A:0x7998804
y.create.l HWIO_QPIC_QPIC_BAM_P_AU_PSM_CNTXT_1_2_ADDR A:0x7999804
y.create.l HWIO_QPIC_QPIC_BAM_P_AU_PSM_CNTXT_1_3_ADDR A:0x799a804
y.create.l HWIO_QPIC_QPIC_BAM_P_AU_PSM_CNTXT_1_4_ADDR A:0x799b804
y.create.l HWIO_QPIC_QPIC_BAM_P_AU_PSM_CNTXT_1_5_ADDR A:0x799c804
y.create.l HWIO_QPIC_QPIC_BAM_P_AU_PSM_CNTXT_1_6_ADDR A:0x799d804
y.create.l HWIO_QPIC_QPIC_BAM_P_AU_PSM_CNTXT_1_7_ADDR A:0x799e804
y.create.l HWIO_QPIC_QPIC_BAM_P_AU_PSM_CNTXT_1_8_ADDR A:0x799f804
y.create.l HWIO_QPIC_QPIC_BAM_P_PSM_CNTXT_2_0_ADDR A:0x7997808
y.create.l HWIO_QPIC_QPIC_BAM_P_PSM_CNTXT_2_1_ADDR A:0x7998808
y.create.l HWIO_QPIC_QPIC_BAM_P_PSM_CNTXT_2_2_ADDR A:0x7999808
y.create.l HWIO_QPIC_QPIC_BAM_P_PSM_CNTXT_2_3_ADDR A:0x799a808
y.create.l HWIO_QPIC_QPIC_BAM_P_PSM_CNTXT_2_4_ADDR A:0x799b808
y.create.l HWIO_QPIC_QPIC_BAM_P_PSM_CNTXT_2_5_ADDR A:0x799c808
y.create.l HWIO_QPIC_QPIC_BAM_P_PSM_CNTXT_2_6_ADDR A:0x799d808
y.create.l HWIO_QPIC_QPIC_BAM_P_PSM_CNTXT_2_7_ADDR A:0x799e808
y.create.l HWIO_QPIC_QPIC_BAM_P_PSM_CNTXT_2_8_ADDR A:0x799f808
y.create.l HWIO_QPIC_QPIC_BAM_P_PSM_CNTXT_3_0_ADDR A:0x799780c
y.create.l HWIO_QPIC_QPIC_BAM_P_PSM_CNTXT_3_1_ADDR A:0x799880c
y.create.l HWIO_QPIC_QPIC_BAM_P_PSM_CNTXT_3_2_ADDR A:0x799980c
y.create.l HWIO_QPIC_QPIC_BAM_P_PSM_CNTXT_3_3_ADDR A:0x799a80c
y.create.l HWIO_QPIC_QPIC_BAM_P_PSM_CNTXT_3_4_ADDR A:0x799b80c
y.create.l HWIO_QPIC_QPIC_BAM_P_PSM_CNTXT_3_5_ADDR A:0x799c80c
y.create.l HWIO_QPIC_QPIC_BAM_P_PSM_CNTXT_3_6_ADDR A:0x799d80c
y.create.l HWIO_QPIC_QPIC_BAM_P_PSM_CNTXT_3_7_ADDR A:0x799e80c
y.create.l HWIO_QPIC_QPIC_BAM_P_PSM_CNTXT_3_8_ADDR A:0x799f80c
y.create.l HWIO_QPIC_QPIC_BAM_P_PSM_CNTXT_4_0_ADDR A:0x7997810
y.create.l HWIO_QPIC_QPIC_BAM_P_PSM_CNTXT_4_1_ADDR A:0x7998810
y.create.l HWIO_QPIC_QPIC_BAM_P_PSM_CNTXT_4_2_ADDR A:0x7999810
y.create.l HWIO_QPIC_QPIC_BAM_P_PSM_CNTXT_4_3_ADDR A:0x799a810
y.create.l HWIO_QPIC_QPIC_BAM_P_PSM_CNTXT_4_4_ADDR A:0x799b810
y.create.l HWIO_QPIC_QPIC_BAM_P_PSM_CNTXT_4_5_ADDR A:0x799c810
y.create.l HWIO_QPIC_QPIC_BAM_P_PSM_CNTXT_4_6_ADDR A:0x799d810
y.create.l HWIO_QPIC_QPIC_BAM_P_PSM_CNTXT_4_7_ADDR A:0x799e810
y.create.l HWIO_QPIC_QPIC_BAM_P_PSM_CNTXT_4_8_ADDR A:0x799f810
y.create.l HWIO_QPIC_QPIC_BAM_P_PSM_CNTXT_5_0_ADDR A:0x7997814
y.create.l HWIO_QPIC_QPIC_BAM_P_PSM_CNTXT_5_1_ADDR A:0x7998814
y.create.l HWIO_QPIC_QPIC_BAM_P_PSM_CNTXT_5_2_ADDR A:0x7999814
y.create.l HWIO_QPIC_QPIC_BAM_P_PSM_CNTXT_5_3_ADDR A:0x799a814
y.create.l HWIO_QPIC_QPIC_BAM_P_PSM_CNTXT_5_4_ADDR A:0x799b814
y.create.l HWIO_QPIC_QPIC_BAM_P_PSM_CNTXT_5_5_ADDR A:0x799c814
y.create.l HWIO_QPIC_QPIC_BAM_P_PSM_CNTXT_5_6_ADDR A:0x799d814
y.create.l HWIO_QPIC_QPIC_BAM_P_PSM_CNTXT_5_7_ADDR A:0x799e814
y.create.l HWIO_QPIC_QPIC_BAM_P_PSM_CNTXT_5_8_ADDR A:0x799f814
y.create.l HWIO_QPIC_QPIC_BAM_P_EVNT_REG0_ADDR A:0x7997818
y.create.l HWIO_QPIC_QPIC_BAM_P_EVNT_REG1_ADDR A:0x7998818
y.create.l HWIO_QPIC_QPIC_BAM_P_EVNT_REG2_ADDR A:0x7999818
y.create.l HWIO_QPIC_QPIC_BAM_P_EVNT_REG3_ADDR A:0x799a818
y.create.l HWIO_QPIC_QPIC_BAM_P_EVNT_REG4_ADDR A:0x799b818
y.create.l HWIO_QPIC_QPIC_BAM_P_EVNT_REG5_ADDR A:0x799c818
y.create.l HWIO_QPIC_QPIC_BAM_P_EVNT_REG6_ADDR A:0x799d818
y.create.l HWIO_QPIC_QPIC_BAM_P_EVNT_REG7_ADDR A:0x799e818
y.create.l HWIO_QPIC_QPIC_BAM_P_EVNT_REG8_ADDR A:0x799f818
y.create.l HWIO_QPIC_QPIC_BAM_P_DESC_FIFO_ADDR0_ADDR A:0x799781c
y.create.l HWIO_QPIC_QPIC_BAM_P_DESC_FIFO_ADDR1_ADDR A:0x799881c
y.create.l HWIO_QPIC_QPIC_BAM_P_DESC_FIFO_ADDR2_ADDR A:0x799981c
y.create.l HWIO_QPIC_QPIC_BAM_P_DESC_FIFO_ADDR3_ADDR A:0x799a81c
y.create.l HWIO_QPIC_QPIC_BAM_P_DESC_FIFO_ADDR4_ADDR A:0x799b81c
y.create.l HWIO_QPIC_QPIC_BAM_P_DESC_FIFO_ADDR5_ADDR A:0x799c81c
y.create.l HWIO_QPIC_QPIC_BAM_P_DESC_FIFO_ADDR6_ADDR A:0x799d81c
y.create.l HWIO_QPIC_QPIC_BAM_P_DESC_FIFO_ADDR7_ADDR A:0x799e81c
y.create.l HWIO_QPIC_QPIC_BAM_P_DESC_FIFO_ADDR8_ADDR A:0x799f81c
y.create.l HWIO_QPIC_QPIC_BAM_P_FIFO_SIZES0_ADDR A:0x7997820
y.create.l HWIO_QPIC_QPIC_BAM_P_FIFO_SIZES1_ADDR A:0x7998820
y.create.l HWIO_QPIC_QPIC_BAM_P_FIFO_SIZES2_ADDR A:0x7999820
y.create.l HWIO_QPIC_QPIC_BAM_P_FIFO_SIZES3_ADDR A:0x799a820
y.create.l HWIO_QPIC_QPIC_BAM_P_FIFO_SIZES4_ADDR A:0x799b820
y.create.l HWIO_QPIC_QPIC_BAM_P_FIFO_SIZES5_ADDR A:0x799c820
y.create.l HWIO_QPIC_QPIC_BAM_P_FIFO_SIZES6_ADDR A:0x799d820
y.create.l HWIO_QPIC_QPIC_BAM_P_FIFO_SIZES7_ADDR A:0x799e820
y.create.l HWIO_QPIC_QPIC_BAM_P_FIFO_SIZES8_ADDR A:0x799f820
y.create.l HWIO_QPIC_QPIC_BAM_P_DATA_FIFO_ADDR0_ADDR A:0x7997824
y.create.l HWIO_QPIC_QPIC_BAM_P_DATA_FIFO_ADDR1_ADDR A:0x7998824
y.create.l HWIO_QPIC_QPIC_BAM_P_DATA_FIFO_ADDR2_ADDR A:0x7999824
y.create.l HWIO_QPIC_QPIC_BAM_P_DATA_FIFO_ADDR3_ADDR A:0x799a824
y.create.l HWIO_QPIC_QPIC_BAM_P_DATA_FIFO_ADDR4_ADDR A:0x799b824
y.create.l HWIO_QPIC_QPIC_BAM_P_DATA_FIFO_ADDR5_ADDR A:0x799c824
y.create.l HWIO_QPIC_QPIC_BAM_P_DATA_FIFO_ADDR6_ADDR A:0x799d824
y.create.l HWIO_QPIC_QPIC_BAM_P_DATA_FIFO_ADDR7_ADDR A:0x799e824
y.create.l HWIO_QPIC_QPIC_BAM_P_DATA_FIFO_ADDR8_ADDR A:0x799f824
y.create.l HWIO_QPIC_QPIC_BAM_P_EVNT_GEN_TRSHLD0_ADDR A:0x7997828
y.create.l HWIO_QPIC_QPIC_BAM_P_EVNT_GEN_TRSHLD1_ADDR A:0x7998828
y.create.l HWIO_QPIC_QPIC_BAM_P_EVNT_GEN_TRSHLD2_ADDR A:0x7999828
y.create.l HWIO_QPIC_QPIC_BAM_P_EVNT_GEN_TRSHLD3_ADDR A:0x799a828
y.create.l HWIO_QPIC_QPIC_BAM_P_EVNT_GEN_TRSHLD4_ADDR A:0x799b828
y.create.l HWIO_QPIC_QPIC_BAM_P_EVNT_GEN_TRSHLD5_ADDR A:0x799c828
y.create.l HWIO_QPIC_QPIC_BAM_P_EVNT_GEN_TRSHLD6_ADDR A:0x799d828
y.create.l HWIO_QPIC_QPIC_BAM_P_EVNT_GEN_TRSHLD7_ADDR A:0x799e828
y.create.l HWIO_QPIC_QPIC_BAM_P_EVNT_GEN_TRSHLD8_ADDR A:0x799f828
y.create.l HWIO_QPIC_QPIC_BAM_P_EVNT_DEST_ADDR0_ADDR A:0x799782c
y.create.l HWIO_QPIC_QPIC_BAM_P_EVNT_DEST_ADDR1_ADDR A:0x799882c
y.create.l HWIO_QPIC_QPIC_BAM_P_EVNT_DEST_ADDR2_ADDR A:0x799982c
y.create.l HWIO_QPIC_QPIC_BAM_P_EVNT_DEST_ADDR3_ADDR A:0x799a82c
y.create.l HWIO_QPIC_QPIC_BAM_P_EVNT_DEST_ADDR4_ADDR A:0x799b82c
y.create.l HWIO_QPIC_QPIC_BAM_P_EVNT_DEST_ADDR5_ADDR A:0x799c82c
y.create.l HWIO_QPIC_QPIC_BAM_P_EVNT_DEST_ADDR6_ADDR A:0x799d82c
y.create.l HWIO_QPIC_QPIC_BAM_P_EVNT_DEST_ADDR7_ADDR A:0x799e82c
y.create.l HWIO_QPIC_QPIC_BAM_P_EVNT_DEST_ADDR8_ADDR A:0x799f82c
y.create.l HWIO_QPIC_QPIC_BAM_P_DF_CNTXT_0_ADDR A:0x7997830
y.create.l HWIO_QPIC_QPIC_BAM_P_DF_CNTXT_1_ADDR A:0x7998830
y.create.l HWIO_QPIC_QPIC_BAM_P_DF_CNTXT_2_ADDR A:0x7999830
y.create.l HWIO_QPIC_QPIC_BAM_P_DF_CNTXT_3_ADDR A:0x799a830
y.create.l HWIO_QPIC_QPIC_BAM_P_DF_CNTXT_4_ADDR A:0x799b830
y.create.l HWIO_QPIC_QPIC_BAM_P_DF_CNTXT_5_ADDR A:0x799c830
y.create.l HWIO_QPIC_QPIC_BAM_P_DF_CNTXT_6_ADDR A:0x799d830
y.create.l HWIO_QPIC_QPIC_BAM_P_DF_CNTXT_7_ADDR A:0x799e830
y.create.l HWIO_QPIC_QPIC_BAM_P_DF_CNTXT_8_ADDR A:0x799f830
y.create.l HWIO_QPIC_QPIC_BAM_P_RETR_CNTXT_0_ADDR A:0x7997834
y.create.l HWIO_QPIC_QPIC_BAM_P_RETR_CNTXT_1_ADDR A:0x7998834
y.create.l HWIO_QPIC_QPIC_BAM_P_RETR_CNTXT_2_ADDR A:0x7999834
y.create.l HWIO_QPIC_QPIC_BAM_P_RETR_CNTXT_3_ADDR A:0x799a834
y.create.l HWIO_QPIC_QPIC_BAM_P_RETR_CNTXT_4_ADDR A:0x799b834
y.create.l HWIO_QPIC_QPIC_BAM_P_RETR_CNTXT_5_ADDR A:0x799c834
y.create.l HWIO_QPIC_QPIC_BAM_P_RETR_CNTXT_6_ADDR A:0x799d834
y.create.l HWIO_QPIC_QPIC_BAM_P_RETR_CNTXT_7_ADDR A:0x799e834
y.create.l HWIO_QPIC_QPIC_BAM_P_RETR_CNTXT_8_ADDR A:0x799f834
y.create.l HWIO_QPIC_QPIC_BAM_P_SI_CNTXT_0_ADDR A:0x7997838
y.create.l HWIO_QPIC_QPIC_BAM_P_SI_CNTXT_1_ADDR A:0x7998838
y.create.l HWIO_QPIC_QPIC_BAM_P_SI_CNTXT_2_ADDR A:0x7999838
y.create.l HWIO_QPIC_QPIC_BAM_P_SI_CNTXT_3_ADDR A:0x799a838
y.create.l HWIO_QPIC_QPIC_BAM_P_SI_CNTXT_4_ADDR A:0x799b838
y.create.l HWIO_QPIC_QPIC_BAM_P_SI_CNTXT_5_ADDR A:0x799c838
y.create.l HWIO_QPIC_QPIC_BAM_P_SI_CNTXT_6_ADDR A:0x799d838
y.create.l HWIO_QPIC_QPIC_BAM_P_SI_CNTXT_7_ADDR A:0x799e838
y.create.l HWIO_QPIC_QPIC_BAM_P_SI_CNTXT_8_ADDR A:0x799f838
y.create.l HWIO_QPIC_QPIC_BAM_P_PSM_CNTXT_3_LSB0_ADDR A:0x7997900
y.create.l HWIO_QPIC_QPIC_BAM_P_PSM_CNTXT_3_LSB1_ADDR A:0x7998900
y.create.l HWIO_QPIC_QPIC_BAM_P_PSM_CNTXT_3_LSB2_ADDR A:0x7999900
y.create.l HWIO_QPIC_QPIC_BAM_P_PSM_CNTXT_3_LSB3_ADDR A:0x799a900
y.create.l HWIO_QPIC_QPIC_BAM_P_PSM_CNTXT_3_LSB4_ADDR A:0x799b900
y.create.l HWIO_QPIC_QPIC_BAM_P_PSM_CNTXT_3_LSB5_ADDR A:0x799c900
y.create.l HWIO_QPIC_QPIC_BAM_P_PSM_CNTXT_3_LSB6_ADDR A:0x799d900
y.create.l HWIO_QPIC_QPIC_BAM_P_PSM_CNTXT_3_LSB7_ADDR A:0x799e900
y.create.l HWIO_QPIC_QPIC_BAM_P_PSM_CNTXT_3_LSB8_ADDR A:0x799f900
y.create.l HWIO_QPIC_QPIC_BAM_P_PSM_CNTXT_3_MSB0_ADDR A:0x7997904
y.create.l HWIO_QPIC_QPIC_BAM_P_PSM_CNTXT_3_MSB1_ADDR A:0x7998904
y.create.l HWIO_QPIC_QPIC_BAM_P_PSM_CNTXT_3_MSB2_ADDR A:0x7999904
y.create.l HWIO_QPIC_QPIC_BAM_P_PSM_CNTXT_3_MSB3_ADDR A:0x799a904
y.create.l HWIO_QPIC_QPIC_BAM_P_PSM_CNTXT_3_MSB4_ADDR A:0x799b904
y.create.l HWIO_QPIC_QPIC_BAM_P_PSM_CNTXT_3_MSB5_ADDR A:0x799c904
y.create.l HWIO_QPIC_QPIC_BAM_P_PSM_CNTXT_3_MSB6_ADDR A:0x799d904
y.create.l HWIO_QPIC_QPIC_BAM_P_PSM_CNTXT_3_MSB7_ADDR A:0x799e904
y.create.l HWIO_QPIC_QPIC_BAM_P_PSM_CNTXT_3_MSB8_ADDR A:0x799f904
y.create.l HWIO_QPIC_QPIC_BAM_P_DESC_FIFO_ADDR_LSB0_ADDR A:0x7997910
y.create.l HWIO_QPIC_QPIC_BAM_P_DESC_FIFO_ADDR_LSB1_ADDR A:0x7998910
y.create.l HWIO_QPIC_QPIC_BAM_P_DESC_FIFO_ADDR_LSB2_ADDR A:0x7999910
y.create.l HWIO_QPIC_QPIC_BAM_P_DESC_FIFO_ADDR_LSB3_ADDR A:0x799a910
y.create.l HWIO_QPIC_QPIC_BAM_P_DESC_FIFO_ADDR_LSB4_ADDR A:0x799b910
y.create.l HWIO_QPIC_QPIC_BAM_P_DESC_FIFO_ADDR_LSB5_ADDR A:0x799c910
y.create.l HWIO_QPIC_QPIC_BAM_P_DESC_FIFO_ADDR_LSB6_ADDR A:0x799d910
y.create.l HWIO_QPIC_QPIC_BAM_P_DESC_FIFO_ADDR_LSB7_ADDR A:0x799e910
y.create.l HWIO_QPIC_QPIC_BAM_P_DESC_FIFO_ADDR_LSB8_ADDR A:0x799f910
y.create.l HWIO_QPIC_QPIC_BAM_P_DESC_FIFO_ADDR_MSB0_ADDR A:0x7997914
y.create.l HWIO_QPIC_QPIC_BAM_P_DESC_FIFO_ADDR_MSB1_ADDR A:0x7998914
y.create.l HWIO_QPIC_QPIC_BAM_P_DESC_FIFO_ADDR_MSB2_ADDR A:0x7999914
y.create.l HWIO_QPIC_QPIC_BAM_P_DESC_FIFO_ADDR_MSB3_ADDR A:0x799a914
y.create.l HWIO_QPIC_QPIC_BAM_P_DESC_FIFO_ADDR_MSB4_ADDR A:0x799b914
y.create.l HWIO_QPIC_QPIC_BAM_P_DESC_FIFO_ADDR_MSB5_ADDR A:0x799c914
y.create.l HWIO_QPIC_QPIC_BAM_P_DESC_FIFO_ADDR_MSB6_ADDR A:0x799d914
y.create.l HWIO_QPIC_QPIC_BAM_P_DESC_FIFO_ADDR_MSB7_ADDR A:0x799e914
y.create.l HWIO_QPIC_QPIC_BAM_P_DESC_FIFO_ADDR_MSB8_ADDR A:0x799f914
y.create.l HWIO_QPIC_QPIC_BAM_P_DATA_FIFO_ADDR_LSB0_ADDR A:0x7997920
y.create.l HWIO_QPIC_QPIC_BAM_P_DATA_FIFO_ADDR_LSB1_ADDR A:0x7998920
y.create.l HWIO_QPIC_QPIC_BAM_P_DATA_FIFO_ADDR_LSB2_ADDR A:0x7999920
y.create.l HWIO_QPIC_QPIC_BAM_P_DATA_FIFO_ADDR_LSB3_ADDR A:0x799a920
y.create.l HWIO_QPIC_QPIC_BAM_P_DATA_FIFO_ADDR_LSB4_ADDR A:0x799b920
y.create.l HWIO_QPIC_QPIC_BAM_P_DATA_FIFO_ADDR_LSB5_ADDR A:0x799c920
y.create.l HWIO_QPIC_QPIC_BAM_P_DATA_FIFO_ADDR_LSB6_ADDR A:0x799d920
y.create.l HWIO_QPIC_QPIC_BAM_P_DATA_FIFO_ADDR_LSB7_ADDR A:0x799e920
y.create.l HWIO_QPIC_QPIC_BAM_P_DATA_FIFO_ADDR_LSB8_ADDR A:0x799f920
y.create.l HWIO_QPIC_QPIC_BAM_P_DATA_FIFO_ADDR_MSB0_ADDR A:0x7997924
y.create.l HWIO_QPIC_QPIC_BAM_P_DATA_FIFO_ADDR_MSB1_ADDR A:0x7998924
y.create.l HWIO_QPIC_QPIC_BAM_P_DATA_FIFO_ADDR_MSB2_ADDR A:0x7999924
y.create.l HWIO_QPIC_QPIC_BAM_P_DATA_FIFO_ADDR_MSB3_ADDR A:0x799a924
y.create.l HWIO_QPIC_QPIC_BAM_P_DATA_FIFO_ADDR_MSB4_ADDR A:0x799b924
y.create.l HWIO_QPIC_QPIC_BAM_P_DATA_FIFO_ADDR_MSB5_ADDR A:0x799c924
y.create.l HWIO_QPIC_QPIC_BAM_P_DATA_FIFO_ADDR_MSB6_ADDR A:0x799d924
y.create.l HWIO_QPIC_QPIC_BAM_P_DATA_FIFO_ADDR_MSB7_ADDR A:0x799e924
y.create.l HWIO_QPIC_QPIC_BAM_P_DATA_FIFO_ADDR_MSB8_ADDR A:0x799f924
y.create.l HWIO_QPIC_QPIC_BAM_P_EVNT_DEST_ADDR_LSB0_ADDR A:0x7997930
y.create.l HWIO_QPIC_QPIC_BAM_P_EVNT_DEST_ADDR_LSB1_ADDR A:0x7998930
y.create.l HWIO_QPIC_QPIC_BAM_P_EVNT_DEST_ADDR_LSB2_ADDR A:0x7999930
y.create.l HWIO_QPIC_QPIC_BAM_P_EVNT_DEST_ADDR_LSB3_ADDR A:0x799a930
y.create.l HWIO_QPIC_QPIC_BAM_P_EVNT_DEST_ADDR_LSB4_ADDR A:0x799b930
y.create.l HWIO_QPIC_QPIC_BAM_P_EVNT_DEST_ADDR_LSB5_ADDR A:0x799c930
y.create.l HWIO_QPIC_QPIC_BAM_P_EVNT_DEST_ADDR_LSB6_ADDR A:0x799d930
y.create.l HWIO_QPIC_QPIC_BAM_P_EVNT_DEST_ADDR_LSB7_ADDR A:0x799e930
y.create.l HWIO_QPIC_QPIC_BAM_P_EVNT_DEST_ADDR_LSB8_ADDR A:0x799f930
y.create.l HWIO_QPIC_QPIC_BAM_P_EVNT_DEST_ADDR_MSB0_ADDR A:0x7997934
y.create.l HWIO_QPIC_QPIC_BAM_P_EVNT_DEST_ADDR_MSB1_ADDR A:0x7998934
y.create.l HWIO_QPIC_QPIC_BAM_P_EVNT_DEST_ADDR_MSB2_ADDR A:0x7999934
y.create.l HWIO_QPIC_QPIC_BAM_P_EVNT_DEST_ADDR_MSB3_ADDR A:0x799a934
y.create.l HWIO_QPIC_QPIC_BAM_P_EVNT_DEST_ADDR_MSB4_ADDR A:0x799b934
y.create.l HWIO_QPIC_QPIC_BAM_P_EVNT_DEST_ADDR_MSB5_ADDR A:0x799c934
y.create.l HWIO_QPIC_QPIC_BAM_P_EVNT_DEST_ADDR_MSB6_ADDR A:0x799d934
y.create.l HWIO_QPIC_QPIC_BAM_P_EVNT_DEST_ADDR_MSB7_ADDR A:0x799e934
y.create.l HWIO_QPIC_QPIC_BAM_P_EVNT_DEST_ADDR_MSB8_ADDR A:0x799f934
y.create.l HWIO_QPIC_QPIC_XPU2_REG_BASE_START_ADDR A:0x7982000
y.create.l HWIO_QPIC_QPIC_XPU2_REG_BASE_LAST_ADDR A:0x7982d54
y.create.l HWIO_QPIC_QPIC_XPU2_REG_BASE_END_ADDR A:0x7984000
y.create.l HWIO_QPIC_QPIC_XPU_SCR_ADDR A:0x7982000
y.create.l HWIO_QPIC_QPIC_XPU_SWDR_ADDR A:0x7982004
y.create.l HWIO_QPIC_QPIC_XPU_SEAR0_ADDR A:0x7982040
y.create.l HWIO_QPIC_QPIC_XPU_SESR_ADDR A:0x7982048
y.create.l HWIO_QPIC_QPIC_XPU_SESRRESTORE_ADDR A:0x798204c
y.create.l HWIO_QPIC_QPIC_XPU_SESYNR0_ADDR A:0x7982050
y.create.l HWIO_QPIC_QPIC_XPU_SESYNR1_ADDR A:0x7982054
y.create.l HWIO_QPIC_QPIC_XPU_SESYNR2_ADDR A:0x7982058
y.create.l HWIO_QPIC_QPIC_XPU_MCR_ADDR A:0x7982100
y.create.l HWIO_QPIC_QPIC_XPU_MEAR0_ADDR A:0x7982140
y.create.l HWIO_QPIC_QPIC_XPU_MESR_ADDR A:0x7982148
y.create.l HWIO_QPIC_QPIC_XPU_MESRRESTORE_ADDR A:0x798214c
y.create.l HWIO_QPIC_QPIC_XPU_MESYNR0_ADDR A:0x7982150
y.create.l HWIO_QPIC_QPIC_XPU_MESYNR1_ADDR A:0x7982154
y.create.l HWIO_QPIC_QPIC_XPU_MESYNR2_ADDR A:0x7982158
y.create.l HWIO_QPIC_QPIC_XPU_CR_ADDR A:0x7982080
y.create.l HWIO_QPIC_QPIC_XPU_RPU_ACR0_ADDR A:0x79820a0
y.create.l HWIO_QPIC_QPIC_XPU_EAR0_ADDR A:0x79820c0
y.create.l HWIO_QPIC_QPIC_XPU_ESR_ADDR A:0x79820c8
y.create.l HWIO_QPIC_QPIC_XPU_ESRRESTORE_ADDR A:0x79820cc
y.create.l HWIO_QPIC_QPIC_XPU_ESYNR0_ADDR A:0x79820d0
y.create.l HWIO_QPIC_QPIC_XPU_ESYNR1_ADDR A:0x79820d4
y.create.l HWIO_QPIC_QPIC_XPU_ESYNR2_ADDR A:0x79820d8
y.create.l HWIO_QPIC_QPIC_XPU_IDR0_ADDR A:0x7982074
y.create.l HWIO_QPIC_QPIC_XPU_IDR1_ADDR A:0x7982078
y.create.l HWIO_QPIC_QPIC_XPU_REV_ADDR A:0x798207c
y.create.l HWIO_QPIC_QPIC_XPU_RG0_RACR0_ADDR A:0x7982200
y.create.l HWIO_QPIC_QPIC_XPU_RG1_RACR0_ADDR A:0x7982280
y.create.l HWIO_QPIC_QPIC_XPU_RG2_RACR0_ADDR A:0x7982300
y.create.l HWIO_QPIC_QPIC_XPU_RG3_RACR0_ADDR A:0x7982380
y.create.l HWIO_QPIC_QPIC_XPU_RG4_RACR0_ADDR A:0x7982400
y.create.l HWIO_QPIC_QPIC_XPU_RG5_RACR0_ADDR A:0x7982480
y.create.l HWIO_QPIC_QPIC_XPU_RG6_RACR0_ADDR A:0x7982500
y.create.l HWIO_QPIC_QPIC_XPU_RG7_RACR0_ADDR A:0x7982580
y.create.l HWIO_QPIC_QPIC_XPU_RG8_RACR0_ADDR A:0x7982600
y.create.l HWIO_QPIC_QPIC_XPU_RG9_RACR0_ADDR A:0x7982680
y.create.l HWIO_QPIC_QPIC_XPU_RG0_SCR_ADDR A:0x7982250
y.create.l HWIO_QPIC_QPIC_XPU_RG1_SCR_ADDR A:0x79822d0
y.create.l HWIO_QPIC_QPIC_XPU_RG2_SCR_ADDR A:0x7982350
y.create.l HWIO_QPIC_QPIC_XPU_RG3_SCR_ADDR A:0x79823d0
y.create.l HWIO_QPIC_QPIC_XPU_RG4_SCR_ADDR A:0x7982450
y.create.l HWIO_QPIC_QPIC_XPU_RG5_SCR_ADDR A:0x79824d0
y.create.l HWIO_QPIC_QPIC_XPU_RG6_SCR_ADDR A:0x7982550
y.create.l HWIO_QPIC_QPIC_XPU_RG7_SCR_ADDR A:0x79825d0
y.create.l HWIO_QPIC_QPIC_XPU_RG8_SCR_ADDR A:0x7982650
y.create.l HWIO_QPIC_QPIC_XPU_RG9_SCR_ADDR A:0x79826d0
y.create.l HWIO_QPIC_QPIC_XPU_RG0_MCR_ADDR A:0x7982254
y.create.l HWIO_QPIC_QPIC_XPU_RG1_MCR_ADDR A:0x79822d4
y.create.l HWIO_QPIC_QPIC_XPU_RG2_MCR_ADDR A:0x7982354
y.create.l HWIO_QPIC_QPIC_XPU_RG3_MCR_ADDR A:0x79823d4
y.create.l HWIO_QPIC_QPIC_XPU_RG4_MCR_ADDR A:0x7982454
y.create.l HWIO_QPIC_QPIC_XPU_RG5_MCR_ADDR A:0x79824d4
y.create.l HWIO_QPIC_QPIC_XPU_RG6_MCR_ADDR A:0x7982554
y.create.l HWIO_QPIC_QPIC_XPU_RG7_MCR_ADDR A:0x79825d4
y.create.l HWIO_QPIC_QPIC_XPU_RG8_MCR_ADDR A:0x7982654
y.create.l HWIO_QPIC_QPIC_XPU_RG9_MCR_ADDR A:0x79826d4
y.create.l HWIO_QPIC_QPIC_VMIDMT_REG_BASE_START_ADDR A:0x7980000
y.create.l HWIO_QPIC_QPIC_VMIDMT_REG_BASE_LAST_ADDR A:0x7980e24
y.create.l HWIO_QPIC_QPIC_VMIDMT_REG_BASE_END_ADDR A:0x7981000
y.create.l HWIO_QPIC_QPIC_VMIDMT_SCR0_ADDR A:0x7980000
y.create.l HWIO_QPIC_QPIC_VMIDMT_SCR1_ADDR A:0x7980004
y.create.l HWIO_QPIC_QPIC_VMIDMT_SCR2_ADDR A:0x7980008
y.create.l HWIO_QPIC_QPIC_VMIDMT_SACR_ADDR A:0x7980010
y.create.l HWIO_QPIC_QPIC_VMIDMT_SIDR0_ADDR A:0x7980020
y.create.l HWIO_QPIC_QPIC_VMIDMT_SIDR1_ADDR A:0x7980024
y.create.l HWIO_QPIC_QPIC_VMIDMT_SIDR2_ADDR A:0x7980028
y.create.l HWIO_QPIC_QPIC_VMIDMT_SIDR4_ADDR A:0x7980030
y.create.l HWIO_QPIC_QPIC_VMIDMT_SIDR5_ADDR A:0x7980034
y.create.l HWIO_QPIC_QPIC_VMIDMT_SIDR7_ADDR A:0x798003c
y.create.l HWIO_QPIC_QPIC_VMIDMT_SGFAR0_ADDR A:0x7980040
y.create.l HWIO_QPIC_QPIC_VMIDMT_SGFSR_ADDR A:0x7980048
y.create.l HWIO_QPIC_QPIC_VMIDMT_SGFSRRESTORE_ADDR A:0x798004c
y.create.l HWIO_QPIC_QPIC_VMIDMT_SGFSYNDR0_ADDR A:0x7980050
y.create.l HWIO_QPIC_QPIC_VMIDMT_SGFSYNDR1_ADDR A:0x7980054
y.create.l HWIO_QPIC_QPIC_VMIDMT_SGFSYNDR2_ADDR A:0x7980058
y.create.l HWIO_QPIC_QPIC_VMIDMT_VMIDMTSCR0_ADDR A:0x7980090
y.create.l HWIO_QPIC_QPIC_VMIDMT_CR0_ADDR A:0x7980000
y.create.l HWIO_QPIC_QPIC_VMIDMT_CR2_ADDR A:0x7980008
y.create.l HWIO_QPIC_QPIC_VMIDMT_ACR_ADDR A:0x7980010
y.create.l HWIO_QPIC_QPIC_VMIDMT_IDR0_ADDR A:0x7980020
y.create.l HWIO_QPIC_QPIC_VMIDMT_IDR1_ADDR A:0x7980024
y.create.l HWIO_QPIC_QPIC_VMIDMT_IDR2_ADDR A:0x7980028
y.create.l HWIO_QPIC_QPIC_VMIDMT_IDR4_ADDR A:0x7980030
y.create.l HWIO_QPIC_QPIC_VMIDMT_IDR5_ADDR A:0x7980034
y.create.l HWIO_QPIC_QPIC_VMIDMT_IDR7_ADDR A:0x798003c
y.create.l HWIO_QPIC_QPIC_VMIDMT_GFAR0_ADDR A:0x7980040
y.create.l HWIO_QPIC_QPIC_VMIDMT_GFSR_ADDR A:0x7980048
y.create.l HWIO_QPIC_QPIC_VMIDMT_GFSRRESTORE_ADDR A:0x798004c
y.create.l HWIO_QPIC_QPIC_VMIDMT_GFSYNDR0_ADDR A:0x7980050
y.create.l HWIO_QPIC_QPIC_VMIDMT_GFSYNDR1_ADDR A:0x7980054
y.create.l HWIO_QPIC_QPIC_VMIDMT_GFSYNDR2_ADDR A:0x7980058
y.create.l HWIO_QPIC_QPIC_VMIDMT_VMIDMTCR0_ADDR A:0x7980090
y.create.l HWIO_QPIC_QPIC_VMIDMT_VMIDMTACR_ADDR A:0x798009c
y.create.l HWIO_QPIC_QPIC_VMIDMT_NSCR0_ADDR A:0x7980400
y.create.l HWIO_QPIC_QPIC_VMIDMT_NSCR2_ADDR A:0x7980408
y.create.l HWIO_QPIC_QPIC_VMIDMT_NSACR_ADDR A:0x7980410
y.create.l HWIO_QPIC_QPIC_VMIDMT_NSGFAR0_ADDR A:0x7980440
y.create.l HWIO_QPIC_QPIC_VMIDMT_NSGFSR_ADDR A:0x7980448
y.create.l HWIO_QPIC_QPIC_VMIDMT_NSGFSRRESTORE_ADDR A:0x798044c
y.create.l HWIO_QPIC_QPIC_VMIDMT_NSGFSYNDR0_ADDR A:0x7980450
y.create.l HWIO_QPIC_QPIC_VMIDMT_NSGFSYNDR1_ADDR A:0x7980454
y.create.l HWIO_QPIC_QPIC_VMIDMT_NSGFSYNDR2_ADDR A:0x7980458
y.create.l HWIO_QPIC_QPIC_VMIDMT_NSVMIDMTCR0_ADDR A:0x7980490
y.create.l HWIO_QPIC_QPIC_VMIDMT_SSDR0_ADDR A:0x7980080
y.create.l HWIO_QPIC_QPIC_VMIDMT_MSDR0_ADDR A:0x7980480
y.create.l HWIO_QPIC_QPIC_VMIDMT_MCR_ADDR A:0x7980494
y.create.l HWIO_QPIC_QPIC_VMIDMT_S2VR0_ADDR A:0x7980c00
y.create.l HWIO_QPIC_QPIC_VMIDMT_S2VR1_ADDR A:0x7980c04
y.create.l HWIO_QPIC_QPIC_VMIDMT_S2VR2_ADDR A:0x7980c08
y.create.l HWIO_QPIC_QPIC_VMIDMT_S2VR3_ADDR A:0x7980c0c
y.create.l HWIO_QPIC_QPIC_VMIDMT_S2VR4_ADDR A:0x7980c10
y.create.l HWIO_QPIC_QPIC_VMIDMT_S2VR5_ADDR A:0x7980c14
y.create.l HWIO_QPIC_QPIC_VMIDMT_S2VR6_ADDR A:0x7980c18
y.create.l HWIO_QPIC_QPIC_VMIDMT_S2VR7_ADDR A:0x7980c1c
y.create.l HWIO_QPIC_QPIC_VMIDMT_S2VR8_ADDR A:0x7980c20
y.create.l HWIO_QPIC_QPIC_VMIDMT_S2VR9_ADDR A:0x7980c24
y.create.l HWIO_QPIC_QPIC_VMIDMT_AS2VR0_ADDR A:0x7980e00
y.create.l HWIO_QPIC_QPIC_VMIDMT_AS2VR1_ADDR A:0x7980e04
y.create.l HWIO_QPIC_QPIC_VMIDMT_AS2VR2_ADDR A:0x7980e08
y.create.l HWIO_QPIC_QPIC_VMIDMT_AS2VR3_ADDR A:0x7980e0c
y.create.l HWIO_QPIC_QPIC_VMIDMT_AS2VR4_ADDR A:0x7980e10
y.create.l HWIO_QPIC_QPIC_VMIDMT_AS2VR5_ADDR A:0x7980e14
y.create.l HWIO_QPIC_QPIC_VMIDMT_AS2VR6_ADDR A:0x7980e18
y.create.l HWIO_QPIC_QPIC_VMIDMT_AS2VR7_ADDR A:0x7980e1c
y.create.l HWIO_QPIC_QPIC_VMIDMT_AS2VR8_ADDR A:0x7980e20
y.create.l HWIO_QPIC_QPIC_VMIDMT_AS2VR9_ADDR A:0x7980e24
y.create.l HWIO_QPIC_QPIC_VMIDMT_SMR0_ADDR A:0x7980800
y.create.l HWIO_QPIC_QPIC_VMIDMT_SMR1_ADDR A:0x7980804
y.create.l HWIO_QPIC_QPIC_VMIDMT_SMR2_ADDR A:0x7980808
y.create.l HWIO_QPIC_QPIC_VMIDMT_SMR3_ADDR A:0x798080c
y.create.l HWIO_QPIC_QPIC_VMIDMT_SMR4_ADDR A:0x7980810
y.create.l HWIO_QPIC_QPIC_VMIDMT_SMR5_ADDR A:0x7980814
y.create.l HWIO_QPIC_QPIC_VMIDMT_SMR6_ADDR A:0x7980818
y.create.l HWIO_QPIC_QPIC_VMIDMT_SMR7_ADDR A:0x798081c
y.create.l HWIO_QPIC_QPIC_VMIDMT_SMR8_ADDR A:0x7980820
y.create.l HWIO_QPIC_QPIC_VMIDMT_SMR9_ADDR A:0x7980824
y.create.l HWIO_QPIC_EBI2CR_REG_BASE_START_ADDR A:0x79a0000
y.create.l HWIO_QPIC_EBI2CR_REG_BASE_LAST_ADDR A:0x79a7104
y.create.l HWIO_QPIC_EBI2CR_REG_BASE_END_ADDR A:0x79a8000
y.create.l HWIO_QPIC_EBI2_CHIP_SELECT_CFG0_ADDR A:0x79a6000
y.create.l HWIO_QPIC_EBI2_CFG_ADDR A:0x79a7004
y.create.l HWIO_QPIC_EBI2_ARBITER_CFG_ADDR A:0x79a7030
y.create.l HWIO_QPIC_EBI2_DEBUG_REG_LSB_ADDR A:0x79a4048
y.create.l HWIO_QPIC_EBI2_DEBUG_REG_MSB_ADDR A:0x79a404c
y.create.l HWIO_QPIC_EBI2_DEBUG_SEL_ADDR A:0x79a4050
y.create.l HWIO_QPIC_EBI2_CRC_CFG_ADDR A:0x79a6054
y.create.l HWIO_QPIC_EBI2_CRC_REMINDER_CFG_ADDR A:0x79a6058
y.create.l HWIO_QPIC_EBI2_NAND_ADM_MUX_ADDR A:0x79a605c
y.create.l HWIO_QPIC_EBI2_CLKON_CFG_ADDR A:0x79a7068
y.create.l HWIO_QPIC_EBI2_CORE_CLKON_CFG_ADDR A:0x79a706c
y.create.l HWIO_QPIC_QPIC_LCDC_CTRL_ADDR A:0x79a2000
y.create.l HWIO_QPIC_LCDC_VERSION_ADDR A:0x79a2004
y.create.l HWIO_QPIC_QPIC_LCDC_IRQ_EN_ADDR A:0x79a2008
y.create.l HWIO_QPIC_QPIC_LCDC_IRQ_STTS_ADDR A:0x79a200c
y.create.l HWIO_QPIC_QPIC_LCDC_IRQ_CLR_ADDR A:0x79a2010
y.create.l HWIO_QPIC_QPIC_LCDC_STTS_ADDR A:0x79a2014
y.create.l HWIO_QPIC_QPIC_LCDC_CMD_DATA_CYCLE_CNT_ADDR A:0x79a2018
y.create.l HWIO_QPIC_QPIC_LCDC_CFG0_ADDR A:0x79a2020
y.create.l HWIO_QPIC_QPIC_LCDC_CFG1_ADDR A:0x79a2024
y.create.l HWIO_QPIC_QPIC_LCDC_CFG2_ADDR A:0x79a2028
y.create.l HWIO_QPIC_QPIC_LCDC_RESET_ADDR A:0x79a202c
y.create.l HWIO_QPIC_QPIC_LCD_DEVICE_RESET_ADDR A:0x79a2030
y.create.l HWIO_QPIC_QPIC_LCDC_FIFO_SOF_ADDR A:0x79a2100
y.create.l HWIO_QPIC_QPIC_LCDC_FIFO_DATA_PORT0_ADDR A:0x79a2140
y.create.l HWIO_QPIC_QPIC_LCDC_FIFO_DATA_PORT1_ADDR A:0x79a2144
y.create.l HWIO_QPIC_QPIC_LCDC_FIFO_DATA_PORT2_ADDR A:0x79a2148
y.create.l HWIO_QPIC_QPIC_LCDC_FIFO_DATA_PORT3_ADDR A:0x79a214c
y.create.l HWIO_QPIC_QPIC_LCDC_FIFO_DATA_PORT4_ADDR A:0x79a2150
y.create.l HWIO_QPIC_QPIC_LCDC_FIFO_DATA_PORT5_ADDR A:0x79a2154
y.create.l HWIO_QPIC_QPIC_LCDC_FIFO_DATA_PORT6_ADDR A:0x79a2158
y.create.l HWIO_QPIC_QPIC_LCDC_FIFO_DATA_PORT7_ADDR A:0x79a215c
y.create.l HWIO_QPIC_QPIC_LCDC_FIFO_DATA_PORT8_ADDR A:0x79a2160
y.create.l HWIO_QPIC_QPIC_LCDC_FIFO_DATA_PORT9_ADDR A:0x79a2164
y.create.l HWIO_QPIC_QPIC_LCDC_FIFO_EOF_ADDR A:0x79a2180
y.create.l HWIO_QPIC_LCD_DEVICE_CMD0_ADDR A:0x79a3000
y.create.l HWIO_QPIC_LCD_DEVICE_CMD1_ADDR A:0x79a3004
y.create.l HWIO_QPIC_LCD_DEVICE_CMD2_ADDR A:0x79a3008
y.create.l HWIO_QPIC_LCD_DEVICE_CMD3_ADDR A:0x79a300c
y.create.l HWIO_QPIC_LCD_DEVICE_CMD4_ADDR A:0x79a3010
y.create.l HWIO_QPIC_LCD_DEVICE_CMD5_ADDR A:0x79a3014
y.create.l HWIO_QPIC_LCD_DEVICE_CMD6_ADDR A:0x79a3018
y.create.l HWIO_QPIC_LCD_DEVICE_CMD7_ADDR A:0x79a301c
y.create.l HWIO_QPIC_LCD_DEVICE_CMD8_ADDR A:0x79a3020
y.create.l HWIO_QPIC_LCD_DEVICE_CMD9_ADDR A:0x79a3024
y.create.l HWIO_QPIC_QPIC_VERSION_ADDR A:0x79a4100
y.create.l HWIO_QPIC_QPIC_CTRL_ADDR A:0x79a7104
y.create.l HWIO_QPIC_QPIC_HW_INFO_ADDR A:0x79a4108
y.create.l HWIO_QPIC_QPIC_REG_PERMISSION_ADDR A:0x79a510c
y.create.l HWIO_QPIC_QPIC_DEBUG_ADDR A:0x79a5110
y.create.l HWIO_QPIC_QPIC_HW_GENERICS_ADDR A:0x79a4114
y.create.l HWIO_QPIC_ILAM_DEBUG_CONFIG_ADDR A:0x79a4200
y.create.l HWIO_QPIC_ILAM_DEBUG_MASK_ADDR A:0x79a4204
y.create.l HWIO_QPIC_QPIC_RAM_DEBUG_ACC_SW_CTL_ADDR A:0x79a4208
y.create.l HWIO_QPIC_QPIC_RAM_DEBUG_ACC_DATA_ADDR A:0x79a420c
y.create.l HWIO_QPIC_ILAM_DEBUG_MATCH_ADDR A:0x79a4210
y.create.l HWIO_QPIC_QPIC_PERF_MON_CFG_ADDR A:0x79a4214
y.create.l HWIO_QPIC_QPIC_PERF_MON_INDEX_ADDR A:0x79a4218
y.create.l HWIO_QPIC_QPIC_PERF_MON_STATISTIC_ADDR A:0x79a421c
y.create.l HWIO_QPIC_QPIC_PERF_MON_COUNT_ADDR A:0x79a4220
y.create.l HWIO_QPIC_QPIC_PERF_MON_STATUS_ADDR A:0x79a4224
y.create.l HWIO_QPIC_QPIC_IRQ_EN_ADDR A:0x79a4228
y.create.l HWIO_QPIC_QPIC_IRQ_STTS_ADDR A:0x79a422c
y.create.l HWIO_QPIC_QPIC_IRQ_CLR_ADDR A:0x79a4230
y.create.l HWIO_QPIC_EBI2ND_REG_BASE_START_ADDR A:0x79b0000
y.create.l HWIO_QPIC_EBI2ND_REG_BASE_LAST_ADDR A:0x79b7f94
y.create.l HWIO_QPIC_EBI2ND_REG_BASE_END_ADDR A:0x79c0000
y.create.l HWIO_QPIC_NAND_FLASH_CMD_ADDR A:0x79b0000
y.create.l HWIO_QPIC_NAND_ADDR0_ADDR A:0x79b0004
y.create.l HWIO_QPIC_NAND_ADDR1_ADDR A:0x79b0008
y.create.l HWIO_QPIC_NAND_FLASH_CHIP_SELECT_ADDR A:0x79b000c
y.create.l HWIO_QPIC_NANDC_EXEC_CMD_ADDR A:0x79b0010
y.create.l HWIO_QPIC_NAND_FLASH_STATUS_ADDR A:0x79b0014
y.create.l HWIO_QPIC_NANDC_BUFFER_STATUS_ADDR A:0x79b0018
y.create.l HWIO_QPIC_NAND_DEV0_CFG0_ADDR A:0x79b0020
y.create.l HWIO_QPIC_NAND_DEV1_CFG0_ADDR A:0x79b0030
y.create.l HWIO_QPIC_NAND_DEV0_CFG1_ADDR A:0x79b0024
y.create.l HWIO_QPIC_NAND_DEV1_CFG1_ADDR A:0x79b0034
y.create.l HWIO_QPIC_NAND_DEV0_ECC_CFG_ADDR A:0x79b0028
y.create.l HWIO_QPIC_NAND_AUTO_STATUS_EN_ADDR A:0x79b002c
y.create.l HWIO_QPIC_NAND_DEV1_ECC_CFG_ADDR A:0x79b602c
y.create.l HWIO_QPIC_NAND_FLASH_READ_ID_ADDR A:0x79b0040
y.create.l HWIO_QPIC_NAND_FLASH_READ_ID2_ADDR A:0x79b0048
y.create.l HWIO_QPIC_NAND_FLASH_READ_STATUS_ADDR A:0x79b0044
y.create.l HWIO_QPIC_NAND_FLASH_CONFIG_DATA_ADDR A:0x79b6050
y.create.l HWIO_QPIC_NAND_FLASH_CONFIG_ADDR A:0x79b6054
y.create.l HWIO_QPIC_NAND_FLASH_CONFIG_MODE_ADDR A:0x79b6058
y.create.l HWIO_QPIC_NAND_FLASH_CONFIG_STATUS_ADDR A:0x79b6060
y.create.l HWIO_QPIC_FLASH_MACRO1_REG_ADDR A:0x79b6064
y.create.l HWIO_QPIC_HSDDR_NAND_CFG_ADDR A:0x79b6068
y.create.l HWIO_QPIC_FLASH_XFR_STEP1_ADDR A:0x79b7070
y.create.l HWIO_QPIC_FLASH_XFR_STEP2_ADDR A:0x79b7074
y.create.l HWIO_QPIC_FLASH_XFR_STEP3_ADDR A:0x79b7078
y.create.l HWIO_QPIC_FLASH_XFR_STEP4_ADDR A:0x79b707c
y.create.l HWIO_QPIC_FLASH_XFR_STEP5_ADDR A:0x79b7080
y.create.l HWIO_QPIC_FLASH_XFR_STEP6_ADDR A:0x79b7084
y.create.l HWIO_QPIC_FLASH_XFR_STEP7_ADDR A:0x79b7088
y.create.l HWIO_QPIC_NAND_GENP_REG0_ADDR A:0x79b6090
y.create.l HWIO_QPIC_NAND_GENP_REG1_ADDR A:0x79b6094
y.create.l HWIO_QPIC_NAND_GENP_REG2_ADDR A:0x79b6098
y.create.l HWIO_QPIC_NAND_GENP_REG3_ADDR A:0x79b609c
y.create.l HWIO_QPIC_FLASH_DEV_CMD0_ADDR A:0x79b70a0
y.create.l HWIO_QPIC_FLASH_DEV_CMD1_ADDR A:0x79b70a4
y.create.l HWIO_QPIC_FLASH_DEV_CMD2_ADDR A:0x79b70a8
y.create.l HWIO_QPIC_FLASH_DEV_CMD_VLD_ADDR A:0x79b70ac
y.create.l HWIO_QPIC_FLASH_DEV_CMD7_ADDR A:0x79b70b0
y.create.l HWIO_QPIC_FLASH_DEV_CMD8_ADDR A:0x79b70b4
y.create.l HWIO_QPIC_FLASH_DEV_CMD9_ADDR A:0x79b70b8
y.create.l HWIO_QPIC_NAND_FLASH_FEATURES_ADDR A:0x79b0f64
y.create.l HWIO_QPIC_NAND_FLASH_SPI_CFG_ADDR A:0x79b70c0
y.create.l HWIO_QPIC_SPI_NUM_ADDR_CYCLES_ADDR A:0x79b70c4
y.create.l HWIO_QPIC_SPI_BUSY_CHECK_WAIT_CNT_ADDR A:0x79b70c8
y.create.l HWIO_QPIC_NAND_MULTI_PAGE_CMD_ADDR A:0x79b0f60
y.create.l HWIO_QPIC_NAND_ADDR2_ADDR A:0x79b60c0
y.create.l HWIO_QPIC_NAND_ADDR3_ADDR A:0x79b60c4
y.create.l HWIO_QPIC_NAND_ADDR4_ADDR A:0x79b60c8
y.create.l HWIO_QPIC_NAND_ADDR5_ADDR A:0x79b60cc
y.create.l HWIO_QPIC_FLASH_DEV_CMD3_ADDR A:0x79b70d0
y.create.l HWIO_QPIC_FLASH_DEV_CMD4_ADDR A:0x79b70d4
y.create.l HWIO_QPIC_FLASH_DEV_CMD5_ADDR A:0x79b70d8
y.create.l HWIO_QPIC_FLASH_DEV_CMD6_ADDR A:0x79b70dc
y.create.l HWIO_QPIC_NAND_ADDR6_ADDR A:0x79b60e4
y.create.l HWIO_QPIC_NAND_ERASED_CW_DETECT_CFG_ADDR A:0x79b00e8
y.create.l HWIO_QPIC_NAND_ERASED_CW_DETECT_STATUS_ADDR A:0x79b00ec
y.create.l HWIO_QPIC_EBI2_ECC_BUF_CFG_ADDR A:0x79b00f0
y.create.l HWIO_QPIC_NANDC_DBG_CFG_ADDR A:0x79b40f4
y.create.l HWIO_QPIC_NANDC_HW_PROFILE_CFG_ADDR A:0x79b40f8
y.create.l HWIO_QPIC_FLASH_BUFF0_ACC_ADDR A:0x79b0100
y.create.l HWIO_QPIC_FLASH_BUFF1_ACC_ADDR A:0x79b0104
y.create.l HWIO_QPIC_FLASH_BUFF2_ACC_ADDR A:0x79b0108
y.create.l HWIO_QPIC_FLASH_BUFF3_ACC_ADDR A:0x79b010c
y.create.l HWIO_QPIC_FLASH_BUFF4_ACC_ADDR A:0x79b0110
y.create.l HWIO_QPIC_FLASH_BUFF5_ACC_ADDR A:0x79b0114
y.create.l HWIO_QPIC_FLASH_BUFF6_ACC_ADDR A:0x79b0118
y.create.l HWIO_QPIC_FLASH_BUFF7_ACC_ADDR A:0x79b011c
y.create.l HWIO_QPIC_FLASH_BUFF8_ACC_ADDR A:0x79b0120
y.create.l HWIO_QPIC_FLASH_BUFF9_ACC_ADDR A:0x79b0124
y.create.l HWIO_QPIC_NAND_CTRL_ADDR A:0x79b0f00
y.create.l HWIO_QPIC_NAND_STATUS_ADDR A:0x79b4f04
y.create.l HWIO_QPIC_NAND_VERSION_ADDR A:0x79b4f08
y.create.l HWIO_QPIC_NAND_MPU_BYPASS_ADDR A:0x79b5f44
y.create.l HWIO_QPIC_NAND_DEBUG_ADDR A:0x79b5f0c
y.create.l HWIO_QPIC_NAND_IRQ_STTS_ADDR A:0x79b0f10
y.create.l HWIO_QPIC_NAND_IRQ_CLR_ADDR A:0x79b0f14
y.create.l HWIO_QPIC_NAND_IRQ_EN_ADDR A:0x79b0f18
y.create.l HWIO_QPIC_NAND_MUTEX_ADDR A:0x79b0f1c
y.create.l HWIO_QPIC_NAND_CONFIG_BITS_ADDR A:0x79b7f40
y.create.l HWIO_QPIC_NAND_READ_LOCATION_0_ADDR A:0x79b0f20
y.create.l HWIO_QPIC_NAND_READ_LOCATION_1_ADDR A:0x79b0f24
y.create.l HWIO_QPIC_NAND_READ_LOCATION_2_ADDR A:0x79b0f28
y.create.l HWIO_QPIC_NAND_READ_LOCATION_3_ADDR A:0x79b0f2c
y.create.l HWIO_QPIC_NAND_READ_LOCATION_4_ADDR A:0x79b0f30
y.create.l HWIO_QPIC_NAND_READ_LOCATION_LAST_CW_0_ADDR A:0x79b0f40
y.create.l HWIO_QPIC_NAND_READ_LOCATION_LAST_CW_1_ADDR A:0x79b0f44
y.create.l HWIO_QPIC_NAND_READ_LOCATION_LAST_CW_2_ADDR A:0x79b0f48
y.create.l HWIO_QPIC_NAND_READ_LOCATION_LAST_CW_3_ADDR A:0x79b0f4c
y.create.l HWIO_QPIC_NAND_READ_LOCATION_LAST_CW_4_ADDR A:0x79b0f50
y.create.l HWIO_QPIC_NAND_TEST_BUS_LSB_ADDR A:0x79b4f48
y.create.l HWIO_QPIC_NAND_TEST_BUS_MSB_ADDR A:0x79b4f4c
y.create.l HWIO_QPIC_NAND_OP_DONE_CNT_ADDR A:0x79b5f50
y.create.l HWIO_QPIC_NAND_ERR_RESP_TIME_OUT_ADDR A:0x79b7f54
y.create.l HWIO_QPIC_QSPI_MSTR_CONFIG_ADDR A:0x79b7f60
y.create.l HWIO_QPIC_QSPI_CHAR_CFG_ADDR A:0x79b7f64
y.create.l HWIO_QPIC_QSPI_CHAR_DATA_MISO0_ADDR A:0x79b7f70
y.create.l HWIO_QPIC_QSPI_CHAR_DATA_MISO1_ADDR A:0x79b7f74
y.create.l HWIO_QPIC_QSPI_CHAR_DATA_MISO2_ADDR A:0x79b7f78
y.create.l HWIO_QPIC_QSPI_CHAR_DATA_MISO3_ADDR A:0x79b7f7c
y.create.l HWIO_QPIC_QSPI_CHAR_DATA_MOSI0_ADDR A:0x79b7f80
y.create.l HWIO_QPIC_QSPI_CHAR_DATA_MOSI1_ADDR A:0x79b7f84
y.create.l HWIO_QPIC_QSPI_CHAR_DATA_MOSI2_ADDR A:0x79b7f88
y.create.l HWIO_QPIC_QSPI_CHAR_DATA_MOSI3_ADDR A:0x79b7f8c
y.create.l HWIO_QPIC_QSPI_CHAR_CS_N0_ADDR A:0x79b7f90
y.create.l HWIO_QPIC_QSPI_CHAR_CS_N1_ADDR A:0x79b7f94
y.create.l HWIO_QPIC_NAND_ILAM_MATCH_0_ADDR A:0x79b4f50
y.create.l HWIO_QPIC_NAND_ILAM_MATCH_1_ADDR A:0x79b4f54
y.create.l HWIO_QPIC_NAND_ILAM_MATCH_2_ADDR A:0x79b4f5c
y.create.l HWIO_QPIC_NAND_ILAM_MATCH_3_ADDR A:0x79b4f60
y.create.l HWIO_QPIC_NAND_ILAM_MATCH_4_ADDR A:0x79b4f64
y.create.l HWIO_QPIC_NAND_ILAM_MATCH_5_ADDR A:0x79b4f68
y.create.l HWIO_QPIC_NAND_ILAM_MASK_0_ADDR A:0x79b4f6c
y.create.l HWIO_QPIC_NAND_ILAM_MASK_1_ADDR A:0x79b4f70
y.create.l HWIO_QPIC_NAND_ILAM_MASK_2_ADDR A:0x79b4f74
y.create.l HWIO_QPIC_NAND_ILAM_MASK_3_ADDR A:0x79b4f78
y.create.l HWIO_QPIC_NAND_ILAM_MASK_4_ADDR A:0x79b4f7c
y.create.l HWIO_QPIC_NAND_ILAM_MASK_5_ADDR A:0x79b4f80
y.create.l HWIO_QPIC_QPIC_MPU_MPU1132_8_M39L16_AHB_40_REG_BASE_START_ADDR A:0x79b1000
y.create.l HWIO_QPIC_QPIC_MPU_MPU1132_8_M39L16_AHB_40_REG_BASE_LAST_ADDR A:0x79b15dc
y.create.l HWIO_QPIC_QPIC_MPU_MPU1132_8_M39L16_AHB_40_REG_BASE_END_ADDR A:0x79b1600
y.create.l HWIO_QPIC_QPIC_MPU_XPU_SCR_ADDR A:0x79b1000
y.create.l HWIO_QPIC_QPIC_MPU_XPU_SWDR_ADDR A:0x79b1004
y.create.l HWIO_QPIC_QPIC_MPU_XPU_PRTN_RACR_SSHADOW_ADDR A:0x79b1008
y.create.l HWIO_QPIC_QPIC_MPU_XPU_PRTN_WACR_SSHADOW_ADDR A:0x79b100c
y.create.l HWIO_QPIC_QPIC_MPU_XPU_PRTN_START_SSHADOW0_ADDR A:0x79b1010
y.create.l HWIO_QPIC_QPIC_MPU_XPU_PRTN_START_SSHADOW1_ADDR A:0x79b1014
y.create.l HWIO_QPIC_QPIC_MPU_XPU_PRTN_END_SSHADOW0_ADDR A:0x79b1018
y.create.l HWIO_QPIC_QPIC_MPU_XPU_PRTN_END_SSHADOW1_ADDR A:0x79b101c
y.create.l HWIO_QPIC_QPIC_MPU_XPU_SEAR0_ADDR A:0x79b1040
y.create.l HWIO_QPIC_QPIC_MPU_XPU_SEAR1_ADDR A:0x79b1044
y.create.l HWIO_QPIC_QPIC_MPU_XPU_SESR_ADDR A:0x79b1048
y.create.l HWIO_QPIC_QPIC_MPU_XPU_SESRRESTORE_ADDR A:0x79b104c
y.create.l HWIO_QPIC_QPIC_MPU_XPU_SESYNR0_ADDR A:0x79b1050
y.create.l HWIO_QPIC_QPIC_MPU_XPU_SESYNR1_ADDR A:0x79b1054
y.create.l HWIO_QPIC_QPIC_MPU_XPU_SESYNR2_ADDR A:0x79b1058
y.create.l HWIO_QPIC_QPIC_MPU_XPU_MCR_ADDR A:0x79b1100
y.create.l HWIO_QPIC_QPIC_MPU_XPU_MEAR0_ADDR A:0x79b1140
y.create.l HWIO_QPIC_QPIC_MPU_XPU_MEAR1_ADDR A:0x79b1144
y.create.l HWIO_QPIC_QPIC_MPU_XPU_MESR_ADDR A:0x79b1148
y.create.l HWIO_QPIC_QPIC_MPU_XPU_MESRRESTORE_ADDR A:0x79b114c
y.create.l HWIO_QPIC_QPIC_MPU_XPU_MESYNR0_ADDR A:0x79b1150
y.create.l HWIO_QPIC_QPIC_MPU_XPU_MESYNR1_ADDR A:0x79b1154
y.create.l HWIO_QPIC_QPIC_MPU_XPU_MESYNR2_ADDR A:0x79b1158
y.create.l HWIO_QPIC_QPIC_MPU_XPU_CR_ADDR A:0x79b1080
y.create.l HWIO_QPIC_QPIC_MPU_XPU_PRTN_RACR_SHADOW_ADDR A:0x79b1088
y.create.l HWIO_QPIC_QPIC_MPU_XPU_PRTN_WACR_SHADOW_ADDR A:0x79b108c
y.create.l HWIO_QPIC_QPIC_MPU_XPU_PRTN_START_SHADOW0_ADDR A:0x79b1090
y.create.l HWIO_QPIC_QPIC_MPU_XPU_PRTN_START_SHADOW1_ADDR A:0x79b1094
y.create.l HWIO_QPIC_QPIC_MPU_XPU_PRTN_END_SHADOW0_ADDR A:0x79b1098
y.create.l HWIO_QPIC_QPIC_MPU_XPU_PRTN_END_SHADOW1_ADDR A:0x79b109c
y.create.l HWIO_QPIC_QPIC_MPU_XPU_RPU_ACR0_ADDR A:0x79b10a0
y.create.l HWIO_QPIC_QPIC_MPU_XPU_EAR0_ADDR A:0x79b10c0
y.create.l HWIO_QPIC_QPIC_MPU_XPU_EAR1_ADDR A:0x79b10c4
y.create.l HWIO_QPIC_QPIC_MPU_XPU_ESR_ADDR A:0x79b10c8
y.create.l HWIO_QPIC_QPIC_MPU_XPU_ESRRESTORE_ADDR A:0x79b10cc
y.create.l HWIO_QPIC_QPIC_MPU_XPU_ESYNR0_ADDR A:0x79b10d0
y.create.l HWIO_QPIC_QPIC_MPU_XPU_ESYNR1_ADDR A:0x79b10d4
y.create.l HWIO_QPIC_QPIC_MPU_XPU_ESYNR2_ADDR A:0x79b10d8
y.create.l HWIO_QPIC_QPIC_MPU_XPU_UMR_RACR_ADDR A:0x79b10e0
y.create.l HWIO_QPIC_QPIC_MPU_XPU_UMR_WACR_ADDR A:0x79b10e4
y.create.l HWIO_QPIC_QPIC_MPU_XPU_UMR_CNTL_ADDR A:0x79b10f0
y.create.l HWIO_QPIC_QPIC_MPU_XPU_IDR0_ADDR A:0x79b1074
y.create.l HWIO_QPIC_QPIC_MPU_XPU_IDR1_ADDR A:0x79b1078
y.create.l HWIO_QPIC_QPIC_MPU_XPU_REV_ADDR A:0x79b107c
y.create.l HWIO_QPIC_QPIC_MPU_XPU_PRT0_RACR0_ADDR A:0x79b1200
y.create.l HWIO_QPIC_QPIC_MPU_XPU_PRT1_RACR0_ADDR A:0x79b1280
y.create.l HWIO_QPIC_QPIC_MPU_XPU_PRT2_RACR0_ADDR A:0x79b1300
y.create.l HWIO_QPIC_QPIC_MPU_XPU_PRT3_RACR0_ADDR A:0x79b1380
y.create.l HWIO_QPIC_QPIC_MPU_XPU_PRT4_RACR0_ADDR A:0x79b1400
y.create.l HWIO_QPIC_QPIC_MPU_XPU_PRT5_RACR0_ADDR A:0x79b1480
y.create.l HWIO_QPIC_QPIC_MPU_XPU_PRT6_RACR0_ADDR A:0x79b1500
y.create.l HWIO_QPIC_QPIC_MPU_XPU_PRT7_RACR0_ADDR A:0x79b1580
y.create.l HWIO_QPIC_QPIC_MPU_XPU_PRT0_WACR0_ADDR A:0x79b1220
y.create.l HWIO_QPIC_QPIC_MPU_XPU_PRT1_WACR0_ADDR A:0x79b12a0
y.create.l HWIO_QPIC_QPIC_MPU_XPU_PRT2_WACR0_ADDR A:0x79b1320
y.create.l HWIO_QPIC_QPIC_MPU_XPU_PRT3_WACR0_ADDR A:0x79b13a0
y.create.l HWIO_QPIC_QPIC_MPU_XPU_PRT4_WACR0_ADDR A:0x79b1420
y.create.l HWIO_QPIC_QPIC_MPU_XPU_PRT5_WACR0_ADDR A:0x79b14a0
y.create.l HWIO_QPIC_QPIC_MPU_XPU_PRT6_WACR0_ADDR A:0x79b1520
y.create.l HWIO_QPIC_QPIC_MPU_XPU_PRT7_WACR0_ADDR A:0x79b15a0
y.create.l HWIO_QPIC_QPIC_MPU_XPU_PRT0_START0_ADDR A:0x79b1240
y.create.l HWIO_QPIC_QPIC_MPU_XPU_PRT1_START0_ADDR A:0x79b12c0
y.create.l HWIO_QPIC_QPIC_MPU_XPU_PRT2_START0_ADDR A:0x79b1340
y.create.l HWIO_QPIC_QPIC_MPU_XPU_PRT3_START0_ADDR A:0x79b13c0
y.create.l HWIO_QPIC_QPIC_MPU_XPU_PRT4_START0_ADDR A:0x79b1440
y.create.l HWIO_QPIC_QPIC_MPU_XPU_PRT5_START0_ADDR A:0x79b14c0
y.create.l HWIO_QPIC_QPIC_MPU_XPU_PRT6_START0_ADDR A:0x79b1540
y.create.l HWIO_QPIC_QPIC_MPU_XPU_PRT7_START0_ADDR A:0x79b15c0
y.create.l HWIO_QPIC_QPIC_MPU_XPU_PRT0_START1_ADDR A:0x79b1244
y.create.l HWIO_QPIC_QPIC_MPU_XPU_PRT1_START1_ADDR A:0x79b12c4
y.create.l HWIO_QPIC_QPIC_MPU_XPU_PRT2_START1_ADDR A:0x79b1344
y.create.l HWIO_QPIC_QPIC_MPU_XPU_PRT3_START1_ADDR A:0x79b13c4
y.create.l HWIO_QPIC_QPIC_MPU_XPU_PRT4_START1_ADDR A:0x79b1444
y.create.l HWIO_QPIC_QPIC_MPU_XPU_PRT5_START1_ADDR A:0x79b14c4
y.create.l HWIO_QPIC_QPIC_MPU_XPU_PRT6_START1_ADDR A:0x79b1544
y.create.l HWIO_QPIC_QPIC_MPU_XPU_PRT7_START1_ADDR A:0x79b15c4
y.create.l HWIO_QPIC_QPIC_MPU_XPU_PRT0_END0_ADDR A:0x79b1248
y.create.l HWIO_QPIC_QPIC_MPU_XPU_PRT1_END0_ADDR A:0x79b12c8
y.create.l HWIO_QPIC_QPIC_MPU_XPU_PRT2_END0_ADDR A:0x79b1348
y.create.l HWIO_QPIC_QPIC_MPU_XPU_PRT3_END0_ADDR A:0x79b13c8
y.create.l HWIO_QPIC_QPIC_MPU_XPU_PRT4_END0_ADDR A:0x79b1448
y.create.l HWIO_QPIC_QPIC_MPU_XPU_PRT5_END0_ADDR A:0x79b14c8
y.create.l HWIO_QPIC_QPIC_MPU_XPU_PRT6_END0_ADDR A:0x79b1548
y.create.l HWIO_QPIC_QPIC_MPU_XPU_PRT7_END0_ADDR A:0x79b15c8
y.create.l HWIO_QPIC_QPIC_MPU_XPU_PRT0_END1_ADDR A:0x79b124c
y.create.l HWIO_QPIC_QPIC_MPU_XPU_PRT1_END1_ADDR A:0x79b12cc
y.create.l HWIO_QPIC_QPIC_MPU_XPU_PRT2_END1_ADDR A:0x79b134c
y.create.l HWIO_QPIC_QPIC_MPU_XPU_PRT3_END1_ADDR A:0x79b13cc
y.create.l HWIO_QPIC_QPIC_MPU_XPU_PRT4_END1_ADDR A:0x79b144c
y.create.l HWIO_QPIC_QPIC_MPU_XPU_PRT5_END1_ADDR A:0x79b14cc
y.create.l HWIO_QPIC_QPIC_MPU_XPU_PRT6_END1_ADDR A:0x79b154c
y.create.l HWIO_QPIC_QPIC_MPU_XPU_PRT7_END1_ADDR A:0x79b15cc
y.create.l HWIO_QPIC_QPIC_MPU_XPU_PRT0_SCR_ADDR A:0x79b1250
y.create.l HWIO_QPIC_QPIC_MPU_XPU_PRT1_SCR_ADDR A:0x79b12d0
y.create.l HWIO_QPIC_QPIC_MPU_XPU_PRT2_SCR_ADDR A:0x79b1350
y.create.l HWIO_QPIC_QPIC_MPU_XPU_PRT3_SCR_ADDR A:0x79b13d0
y.create.l HWIO_QPIC_QPIC_MPU_XPU_PRT4_SCR_ADDR A:0x79b1450
y.create.l HWIO_QPIC_QPIC_MPU_XPU_PRT5_SCR_ADDR A:0x79b14d0
y.create.l HWIO_QPIC_QPIC_MPU_XPU_PRT6_SCR_ADDR A:0x79b1550
y.create.l HWIO_QPIC_QPIC_MPU_XPU_PRT7_SCR_ADDR A:0x79b15d0
y.create.l HWIO_QPIC_QPIC_MPU_XPU_PRT0_MCR_ADDR A:0x79b1254
y.create.l HWIO_QPIC_QPIC_MPU_XPU_PRT1_MCR_ADDR A:0x79b12d4
y.create.l HWIO_QPIC_QPIC_MPU_XPU_PRT2_MCR_ADDR A:0x79b1354
y.create.l HWIO_QPIC_QPIC_MPU_XPU_PRT3_MCR_ADDR A:0x79b13d4
y.create.l HWIO_QPIC_QPIC_MPU_XPU_PRT4_MCR_ADDR A:0x79b1454
y.create.l HWIO_QPIC_QPIC_MPU_XPU_PRT5_MCR_ADDR A:0x79b14d4
y.create.l HWIO_QPIC_QPIC_MPU_XPU_PRT6_MCR_ADDR A:0x79b1554
y.create.l HWIO_QPIC_QPIC_MPU_XPU_PRT7_MCR_ADDR A:0x79b15d4
y.create.l HWIO_QPIC_QPIC_MPU_XPU_PRT0_CNTL0_ADDR A:0x79b1258
y.create.l HWIO_QPIC_QPIC_MPU_XPU_PRT1_CNTL0_ADDR A:0x79b12d8
y.create.l HWIO_QPIC_QPIC_MPU_XPU_PRT2_CNTL0_ADDR A:0x79b1358
y.create.l HWIO_QPIC_QPIC_MPU_XPU_PRT3_CNTL0_ADDR A:0x79b13d8
y.create.l HWIO_QPIC_QPIC_MPU_XPU_PRT4_CNTL0_ADDR A:0x79b1458
y.create.l HWIO_QPIC_QPIC_MPU_XPU_PRT5_CNTL0_ADDR A:0x79b14d8
y.create.l HWIO_QPIC_QPIC_MPU_XPU_PRT6_CNTL0_ADDR A:0x79b1558
y.create.l HWIO_QPIC_QPIC_MPU_XPU_PRT7_CNTL0_ADDR A:0x79b15d8
y.create.l HWIO_QPIC_QPIC_MPU_XPU_PRT0_CNTL1_ADDR A:0x79b125c
y.create.l HWIO_QPIC_QPIC_MPU_XPU_PRT1_CNTL1_ADDR A:0x79b12dc
y.create.l HWIO_QPIC_QPIC_MPU_XPU_PRT2_CNTL1_ADDR A:0x79b135c
y.create.l HWIO_QPIC_QPIC_MPU_XPU_PRT3_CNTL1_ADDR A:0x79b13dc
y.create.l HWIO_QPIC_QPIC_MPU_XPU_PRT4_CNTL1_ADDR A:0x79b145c
y.create.l HWIO_QPIC_QPIC_MPU_XPU_PRT5_CNTL1_ADDR A:0x79b14dc
y.create.l HWIO_QPIC_QPIC_MPU_XPU_PRT6_CNTL1_ADDR A:0x79b155c
y.create.l HWIO_QPIC_QPIC_MPU_XPU_PRT7_CNTL1_ADDR A:0x79b15dc
y.create.l HWIO_RBCPR_WRAPPER_REG_BASE_START_ADDR A:0x48000
y.create.l HWIO_RBCPR_WRAPPER_REG_BASE_LAST_ADDR A:0x48174
y.create.l HWIO_RBCPR_WRAPPER_REG_BASE_END_ADDR A:0x49000
y.create.l HWIO_RBCPR_VERSION_ADDR A:0x48000
y.create.l HWIO_RBCPR_SENSOR_MASK0_ADDR A:0x48020
y.create.l HWIO_RBCPR_SENSOR_MASK1_ADDR A:0x48024
y.create.l HWIO_RBCPR_SENSOR_MASK2_ADDR A:0x48028
y.create.l HWIO_RBCPR_SENSOR_MASK3_ADDR A:0x4802c
y.create.l HWIO_RBCPR_SENSOR_BYPASS0_ADDR A:0x48030
y.create.l HWIO_RBCPR_SENSOR_BYPASS1_ADDR A:0x48034
y.create.l HWIO_RBCPR_SENSOR_BYPASS2_ADDR A:0x48038
y.create.l HWIO_RBCPR_SENSOR_BYPASS3_ADDR A:0x4803c
y.create.l HWIO_RBIF_PMIC_ADDR_ADDR A:0x48040
y.create.l HWIO_RBCPR_TIMER_INTERVAL_ADDR A:0x48044
y.create.l HWIO_RBIF_LIMIT_ADDR A:0x48048
y.create.l HWIO_RBIF_TIMER_ADJUST_ADDR A:0x4804c
y.create.l HWIO_RBCPR_GCNT_TARGET0_ADDR A:0x48060
y.create.l HWIO_RBCPR_GCNT_TARGET1_ADDR A:0x48064
y.create.l HWIO_RBCPR_GCNT_TARGET2_ADDR A:0x48068
y.create.l HWIO_RBCPR_GCNT_TARGET3_ADDR A:0x4806c
y.create.l HWIO_RBCPR_GCNT_TARGET4_ADDR A:0x48070
y.create.l HWIO_RBCPR_GCNT_TARGET5_ADDR A:0x48074
y.create.l HWIO_RBCPR_GCNT_TARGET6_ADDR A:0x48078
y.create.l HWIO_RBCPR_GCNT_TARGET7_ADDR A:0x4807c
y.create.l HWIO_RBCPR_STEP_QUOT_ADDR A:0x48080
y.create.l HWIO_RBCPR_CTL_ADDR A:0x48090
y.create.l HWIO_RBIF_SW_VLEVEL_ADDR A:0x48094
y.create.l HWIO_RBIF_CONT_ACK_CMD_ADDR A:0x48098
y.create.l HWIO_RBIF_CONT_NACK_CMD_ADDR A:0x4809c
y.create.l HWIO_RBCPR_RESULT_0_ADDR A:0x480a0
y.create.l HWIO_RBCPR_RESULT_1_ADDR A:0x480a4
y.create.l HWIO_RBIF_IRQ_EN_0_ADDR A:0x48100
y.create.l HWIO_RBIF_IRQ_EN_1_ADDR A:0x48104
y.create.l HWIO_RBIF_IRQ_EN_2_ADDR A:0x48108
y.create.l HWIO_RBIF_IRQ_CLEAR_ADDR A:0x48110
y.create.l HWIO_RBIF_IRQ_STATUS_ADDR A:0x48114
y.create.l HWIO_RBCPR_QUOT_AVG_ADDR A:0x48118
y.create.l HWIO_RBCPR_DEBUG0_ADDR A:0x4811c
y.create.l HWIO_RBCPR_DEBUG1_ADDR A:0x48120
y.create.l HWIO_RBCPR_DEBUG2_ADDR A:0x48124
y.create.l HWIO_RBCPR_BIST_MINMAX_ADDR A:0x48128
y.create.l HWIO_RBCPR_BIST_RESULT_ADDR A:0x4812c
y.create.l HWIO_RBCPR_BIST_FAIL_MAP0_ADDR A:0x48130
y.create.l HWIO_RBCPR_BIST_FAIL_MAP1_ADDR A:0x48134
y.create.l HWIO_RBCPR_BIST_FAIL_MAP2_ADDR A:0x48138
y.create.l HWIO_RBCPR_BIST_FAIL_MAP3_ADDR A:0x4813c
y.create.l HWIO_RBCPR_LOG_0_ADDR A:0x48140
y.create.l HWIO_RBCPR_LOG_1_ADDR A:0x48144
y.create.l HWIO_RBCPR_LOG_2_ADDR A:0x48148
y.create.l HWIO_RBCPR_LOG_3_ADDR A:0x4814c
y.create.l HWIO_RBCPR_LOG_4_ADDR A:0x48150
y.create.l HWIO_RBCPR_LOG_5_ADDR A:0x48154
y.create.l HWIO_RBCPR_LOG_6_ADDR A:0x48158
y.create.l HWIO_RBCPR_LOG_7_ADDR A:0x4815c
y.create.l HWIO_RBCPR_HTOL_AGE_ADDR A:0x48160
y.create.l HWIO_RBCPR_HW_STARVATION_THRESHOLD_ADDR A:0x48164
y.create.l HWIO_RBCPR_SENSOR_MASK_BYPASS_READ0_ADDR A:0x48168
y.create.l HWIO_RBCPR_SENSOR_MASK_BYPASS_READ1_ADDR A:0x4816c
y.create.l HWIO_RBCPR_SENSOR_MASK_BYPASS_READ2_ADDR A:0x48170
y.create.l HWIO_RBCPR_SENSOR_MASK_BYPASS_READ3_ADDR A:0x48174
y.create.l HWIO_RPM_DEC_REG_BASE_START_ADDR A:0x280000
y.create.l HWIO_RPM_DEC_REG_BASE_LAST_ADDR A:0x280070
y.create.l HWIO_RPM_DEC_REG_BASE_END_ADDR A:0x282000
y.create.l HWIO_RPM_HW_VERSION_ADDR A:0x280000
y.create.l HWIO_RPM_WFI_CONFIG_ADDR A:0x280004
y.create.l HWIO_RPM_TIMERS_CLK_OFF_CTL_ADDR A:0x280008
y.create.l HWIO_RPM_IPC_ADDR A:0x28000c
y.create.l HWIO_RPM_GPO_WDATA_ADDR A:0x280010
y.create.l HWIO_RPM_GPO_WDSET_ADDR A:0x280014
y.create.l HWIO_RPM_GPO_WDCLR_ADDR A:0x280018
y.create.l HWIO_RPM_SLAVES_CLK_GATING_ADDR A:0x28001c
y.create.l HWIO_RPM_INTR_POLARITY_0_ADDR A:0x280030
y.create.l HWIO_RPM_INTR_POLARITY_1_ADDR A:0x280034
y.create.l HWIO_RPM_INTR_EDG_LVL_0_ADDR A:0x280038
y.create.l HWIO_RPM_INTR_EDG_LVL_1_ADDR A:0x28003c
y.create.l HWIO_RPM_WDOG_RESET_ADDR A:0x280040
y.create.l HWIO_RPM_WDOG_CTRL_ADDR A:0x280044
y.create.l HWIO_RPM_WDOG_STATUS_ADDR A:0x280048
y.create.l HWIO_RPM_WDOG_BARK_TIME_ADDR A:0x28004c
y.create.l HWIO_RPM_WDOG_BITE_TIME_ADDR A:0x280050
y.create.l HWIO_RPM_WDOG_TEST_LOAD_ADDR A:0x280054
y.create.l HWIO_RPM_WDOG_TEST_ADDR A:0x280058
y.create.l HWIO_RPM_TEST_BUS_SEL_ADDR A:0x28005c
y.create.l HWIO_RPM_SPARE_REG0_ADDR A:0x280060
y.create.l HWIO_RPM_SPARE_REG1_ADDR A:0x280064
y.create.l HWIO_RPM_SPARE_REG2_ADDR A:0x280068
y.create.l HWIO_RPM_SPARE_REG3_ADDR A:0x28006c
y.create.l HWIO_RPM_PAGE_SELECT_ADDR A:0x280070
y.create.l HWIO_RPM_QTMR_AC_REG_BASE_START_ADDR A:0x282000
y.create.l HWIO_RPM_QTMR_AC_REG_BASE_LAST_ADDR A:0x282fd0
y.create.l HWIO_RPM_QTMR_AC_REG_BASE_END_ADDR A:0x283000
y.create.l HWIO_RPM_QTMR_AC_CNTFRQ_ADDR A:0x282000
y.create.l HWIO_RPM_QTMR_AC_CNTSR_ADDR A:0x282004
y.create.l HWIO_RPM_QTMR_AC_CNTTID_ADDR A:0x282008
y.create.l HWIO_RPM_QTMR_AC_CNTACR_0_ADDR A:0x282040
y.create.l HWIO_RPM_QTMR_AC_CNTACR_1_ADDR A:0x282044
y.create.l HWIO_RPM_QTMR_AC_CNTVOFF_LO_0_ADDR A:0x282080
y.create.l HWIO_RPM_QTMR_AC_CNTVOFF_LO_1_ADDR A:0x282088
y.create.l HWIO_RPM_QTMR_AC_CNTVOFF_HI_0_ADDR A:0x282084
y.create.l HWIO_RPM_QTMR_AC_CNTVOFF_HI_1_ADDR A:0x28208c
y.create.l HWIO_RPM_QTMR_AC_CFG_ADDR A:0x282fc0
y.create.l HWIO_RPM_QTMR_AC_VERSION_ADDR A:0x282fd0
y.create.l HWIO_RPM_F0_QTMR_V1_F0_REG_BASE_START_ADDR A:0x283000
y.create.l HWIO_RPM_F0_QTMR_V1_F0_REG_BASE_LAST_ADDR A:0x283fd0
y.create.l HWIO_RPM_F0_QTMR_V1_F0_REG_BASE_END_ADDR A:0x284000
y.create.l HWIO_RPM_F0_QTMR_V1_CNTPCT_LO_ADDR A:0x283000
y.create.l HWIO_RPM_F0_QTMR_V1_CNTPCT_HI_ADDR A:0x283004
y.create.l HWIO_RPM_F0_QTMR_V1_CNTVCT_LO_ADDR A:0x283008
y.create.l HWIO_RPM_F0_QTMR_V1_CNTVCT_HI_ADDR A:0x28300c
y.create.l HWIO_RPM_F0_QTMR_V1_CNTFRQ_ADDR A:0x283010
y.create.l HWIO_RPM_F0_QTMR_V1_CNTPL0ACR_ADDR A:0x283014
y.create.l HWIO_RPM_F0_QTMR_V1_CNTVOFF_LO_ADDR A:0x283018
y.create.l HWIO_RPM_F0_QTMR_V1_CNTVOFF_HI_ADDR A:0x28301c
y.create.l HWIO_RPM_F0_QTMR_V1_CNTP_CVAL_LO_ADDR A:0x283020
y.create.l HWIO_RPM_F0_QTMR_V1_CNTP_CVAL_HI_ADDR A:0x283024
y.create.l HWIO_RPM_F0_QTMR_V1_CNTP_TVAL_ADDR A:0x283028
y.create.l HWIO_RPM_F0_QTMR_V1_CNTP_CTL_ADDR A:0x28302c
y.create.l HWIO_RPM_F0_QTMR_V1_CNTV_CVAL_LO_ADDR A:0x283030
y.create.l HWIO_RPM_F0_QTMR_V1_CNTV_CVAL_HI_ADDR A:0x283034
y.create.l HWIO_RPM_F0_QTMR_V1_CNTV_TVAL_ADDR A:0x283038
y.create.l HWIO_RPM_F0_QTMR_V1_CNTV_CTL_ADDR A:0x28303c
y.create.l HWIO_RPM_F0_QTMR_V1_VERSION_ADDR A:0x283fd0
y.create.l HWIO_RPM_F1_QTMR_V1_F1_REG_BASE_START_ADDR A:0x284000
y.create.l HWIO_RPM_F1_QTMR_V1_F1_REG_BASE_LAST_ADDR A:0x284fd0
y.create.l HWIO_RPM_F1_QTMR_V1_F1_REG_BASE_END_ADDR A:0x285000
y.create.l HWIO_RPM_F1_QTMR_V1_CNTPCT_LO_ADDR A:0x284000
y.create.l HWIO_RPM_F1_QTMR_V1_CNTPCT_HI_ADDR A:0x284004
y.create.l HWIO_RPM_F1_QTMR_V1_CNTVCT_LO_ADDR A:0x284008
y.create.l HWIO_RPM_F1_QTMR_V1_CNTVCT_HI_ADDR A:0x28400c
y.create.l HWIO_RPM_F1_QTMR_V1_CNTFRQ_ADDR A:0x284010
y.create.l HWIO_RPM_F1_QTMR_V1_CNTPL0ACR_ADDR A:0x284014
y.create.l HWIO_RPM_F1_QTMR_V1_CNTVOFF_LO_ADDR A:0x284018
y.create.l HWIO_RPM_F1_QTMR_V1_CNTVOFF_HI_ADDR A:0x28401c
y.create.l HWIO_RPM_F1_QTMR_V1_CNTP_CVAL_LO_ADDR A:0x284020
y.create.l HWIO_RPM_F1_QTMR_V1_CNTP_CVAL_HI_ADDR A:0x284024
y.create.l HWIO_RPM_F1_QTMR_V1_CNTP_TVAL_ADDR A:0x284028
y.create.l HWIO_RPM_F1_QTMR_V1_CNTP_CTL_ADDR A:0x28402c
y.create.l HWIO_RPM_F1_QTMR_V1_CNTV_CVAL_LO_ADDR A:0x284030
y.create.l HWIO_RPM_F1_QTMR_V1_CNTV_CVAL_HI_ADDR A:0x284034
y.create.l HWIO_RPM_F1_QTMR_V1_CNTV_TVAL_ADDR A:0x284038
y.create.l HWIO_RPM_F1_QTMR_V1_CNTV_CTL_ADDR A:0x28403c
y.create.l HWIO_RPM_F1_QTMR_V1_VERSION_ADDR A:0x284fd0
y.create.l HWIO_RPM_APU_REG_BASE_START_ADDR A:0x287000
y.create.l HWIO_RPM_APU_REG_BASE_LAST_ADDR A:0x2872d4
y.create.l HWIO_RPM_APU_REG_BASE_END_ADDR A:0x287300
y.create.l HWIO_RPM_APU_XPU_SCR_ADDR A:0x287000
y.create.l HWIO_RPM_APU_XPU_SWDR_ADDR A:0x287004
y.create.l HWIO_RPM_APU_XPU_SEAR0_ADDR A:0x287040
y.create.l HWIO_RPM_APU_XPU_SESR_ADDR A:0x287048
y.create.l HWIO_RPM_APU_XPU_SESRRESTORE_ADDR A:0x28704c
y.create.l HWIO_RPM_APU_XPU_SESYNR0_ADDR A:0x287050
y.create.l HWIO_RPM_APU_XPU_SESYNR1_ADDR A:0x287054
y.create.l HWIO_RPM_APU_XPU_SESYNR2_ADDR A:0x287058
y.create.l HWIO_RPM_APU_XPU_MCR_ADDR A:0x287100
y.create.l HWIO_RPM_APU_XPU_MEAR0_ADDR A:0x287140
y.create.l HWIO_RPM_APU_XPU_MESR_ADDR A:0x287148
y.create.l HWIO_RPM_APU_XPU_MESRRESTORE_ADDR A:0x28714c
y.create.l HWIO_RPM_APU_XPU_MESYNR0_ADDR A:0x287150
y.create.l HWIO_RPM_APU_XPU_MESYNR1_ADDR A:0x287154
y.create.l HWIO_RPM_APU_XPU_MESYNR2_ADDR A:0x287158
y.create.l HWIO_RPM_APU_XPU_CR_ADDR A:0x287080
y.create.l HWIO_RPM_APU_XPU_RPU_ACR0_ADDR A:0x2870a0
y.create.l HWIO_RPM_APU_XPU_EAR0_ADDR A:0x2870c0
y.create.l HWIO_RPM_APU_XPU_ESR_ADDR A:0x2870c8
y.create.l HWIO_RPM_APU_XPU_ESRRESTORE_ADDR A:0x2870cc
y.create.l HWIO_RPM_APU_XPU_ESYNR0_ADDR A:0x2870d0
y.create.l HWIO_RPM_APU_XPU_ESYNR1_ADDR A:0x2870d4
y.create.l HWIO_RPM_APU_XPU_ESYNR2_ADDR A:0x2870d8
y.create.l HWIO_RPM_APU_XPU_IDR0_ADDR A:0x287074
y.create.l HWIO_RPM_APU_XPU_IDR1_ADDR A:0x287078
y.create.l HWIO_RPM_APU_XPU_REV_ADDR A:0x28707c
y.create.l HWIO_RPM_APU_XPU_RG0_RACR0_ADDR A:0x287200
y.create.l HWIO_RPM_APU_XPU_RG1_RACR0_ADDR A:0x287280
y.create.l HWIO_RPM_APU_XPU_RG0_WACR0_ADDR A:0x287220
y.create.l HWIO_RPM_APU_XPU_RG1_WACR0_ADDR A:0x2872a0
y.create.l HWIO_RPM_APU_XPU_RG0_SCR_ADDR A:0x287250
y.create.l HWIO_RPM_APU_XPU_RG1_SCR_ADDR A:0x2872d0
y.create.l HWIO_RPM_APU_XPU_RG0_MCR_ADDR A:0x287254
y.create.l HWIO_RPM_APU_XPU_RG1_MCR_ADDR A:0x2872d4
y.create.l HWIO_RPM_VMIDMT_REG_BASE_START_ADDR A:0x288000
y.create.l HWIO_RPM_VMIDMT_REG_BASE_LAST_ADDR A:0x288e00
y.create.l HWIO_RPM_VMIDMT_REG_BASE_END_ADDR A:0x289000
y.create.l HWIO_RPM_VMIDMT_SCR0_ADDR A:0x288000
y.create.l HWIO_RPM_VMIDMT_SCR1_ADDR A:0x288004
y.create.l HWIO_RPM_VMIDMT_SCR2_ADDR A:0x288008
y.create.l HWIO_RPM_VMIDMT_SACR_ADDR A:0x288010
y.create.l HWIO_RPM_VMIDMT_SIDR0_ADDR A:0x288020
y.create.l HWIO_RPM_VMIDMT_SIDR1_ADDR A:0x288024
y.create.l HWIO_RPM_VMIDMT_SIDR2_ADDR A:0x288028
y.create.l HWIO_RPM_VMIDMT_SIDR4_ADDR A:0x288030
y.create.l HWIO_RPM_VMIDMT_SIDR5_ADDR A:0x288034
y.create.l HWIO_RPM_VMIDMT_SIDR7_ADDR A:0x28803c
y.create.l HWIO_RPM_VMIDMT_SGFAR0_ADDR A:0x288040
y.create.l HWIO_RPM_VMIDMT_SGFSR_ADDR A:0x288048
y.create.l HWIO_RPM_VMIDMT_SGFSRRESTORE_ADDR A:0x28804c
y.create.l HWIO_RPM_VMIDMT_SGFSYNDR0_ADDR A:0x288050
y.create.l HWIO_RPM_VMIDMT_SGFSYNDR1_ADDR A:0x288054
y.create.l HWIO_RPM_VMIDMT_SGFSYNDR2_ADDR A:0x288058
y.create.l HWIO_RPM_VMIDMT_VMIDMTSCR0_ADDR A:0x288090
y.create.l HWIO_RPM_VMIDMT_CR0_ADDR A:0x288000
y.create.l HWIO_RPM_VMIDMT_CR2_ADDR A:0x288008
y.create.l HWIO_RPM_VMIDMT_ACR_ADDR A:0x288010
y.create.l HWIO_RPM_VMIDMT_IDR0_ADDR A:0x288020
y.create.l HWIO_RPM_VMIDMT_IDR1_ADDR A:0x288024
y.create.l HWIO_RPM_VMIDMT_IDR2_ADDR A:0x288028
y.create.l HWIO_RPM_VMIDMT_IDR4_ADDR A:0x288030
y.create.l HWIO_RPM_VMIDMT_IDR5_ADDR A:0x288034
y.create.l HWIO_RPM_VMIDMT_IDR7_ADDR A:0x28803c
y.create.l HWIO_RPM_VMIDMT_GFAR0_ADDR A:0x288040
y.create.l HWIO_RPM_VMIDMT_GFSR_ADDR A:0x288048
y.create.l HWIO_RPM_VMIDMT_GFSRRESTORE_ADDR A:0x28804c
y.create.l HWIO_RPM_VMIDMT_GFSYNDR0_ADDR A:0x288050
y.create.l HWIO_RPM_VMIDMT_GFSYNDR1_ADDR A:0x288054
y.create.l HWIO_RPM_VMIDMT_GFSYNDR2_ADDR A:0x288058
y.create.l HWIO_RPM_VMIDMT_VMIDMTCR0_ADDR A:0x288090
y.create.l HWIO_RPM_VMIDMT_VMIDMTACR_ADDR A:0x28809c
y.create.l HWIO_RPM_VMIDMT_NSCR0_ADDR A:0x288400
y.create.l HWIO_RPM_VMIDMT_NSCR2_ADDR A:0x288408
y.create.l HWIO_RPM_VMIDMT_NSACR_ADDR A:0x288410
y.create.l HWIO_RPM_VMIDMT_NSGFAR0_ADDR A:0x288440
y.create.l HWIO_RPM_VMIDMT_NSGFSR_ADDR A:0x288448
y.create.l HWIO_RPM_VMIDMT_NSGFSRRESTORE_ADDR A:0x28844c
y.create.l HWIO_RPM_VMIDMT_NSGFSYNDR0_ADDR A:0x288450
y.create.l HWIO_RPM_VMIDMT_NSGFSYNDR1_ADDR A:0x288454
y.create.l HWIO_RPM_VMIDMT_NSGFSYNDR2_ADDR A:0x288458
y.create.l HWIO_RPM_VMIDMT_NSVMIDMTCR0_ADDR A:0x288490
y.create.l HWIO_RPM_VMIDMT_SSDR0_ADDR A:0x288080
y.create.l HWIO_RPM_VMIDMT_MSDR0_ADDR A:0x288480
y.create.l HWIO_RPM_VMIDMT_MCR_ADDR A:0x288494
y.create.l HWIO_RPM_VMIDMT_S2VR0_ADDR A:0x288c00
y.create.l HWIO_RPM_VMIDMT_AS2VR0_ADDR A:0x288e00
y.create.l HWIO_SECURITY_CONTROL_CORE_REG_BASE_START_ADDR A:0xa0000
y.create.l HWIO_SECURITY_CONTROL_CORE_REG_BASE_LAST_ADDR A:0xa6400
y.create.l HWIO_SECURITY_CONTROL_CORE_REG_BASE_END_ADDR A:0xa7000
y.create.l HWIO_QFPROM_RAW_CRI_CM_PRIVATE0_ADDR A:0xa0000
y.create.l HWIO_QFPROM_RAW_CRI_CM_PRIVATE1_ADDR A:0xa0004
y.create.l HWIO_QFPROM_RAW_CRI_CM_PRIVATE2_ADDR A:0xa0008
y.create.l HWIO_QFPROM_RAW_CRI_CM_PRIVATE3_ADDR A:0xa000c
y.create.l HWIO_QFPROM_RAW_CRI_CM_PRIVATE4_ADDR A:0xa0010
y.create.l HWIO_QFPROM_RAW_CRI_CM_PRIVATE5_ADDR A:0xa0014
y.create.l HWIO_QFPROM_RAW_CRI_CM_PRIVATE6_ADDR A:0xa0018
y.create.l HWIO_QFPROM_RAW_CRI_CM_PRIVATE7_ADDR A:0xa001c
y.create.l HWIO_QFPROM_RAW_CRI_CM_PRIVATE8_ADDR A:0xa0020
y.create.l HWIO_QFPROM_RAW_CRI_CM_PRIVATE9_ADDR A:0xa0024
y.create.l HWIO_QFPROM_RAW_LCM_ROW_LSB_ADDR A:0xa0120
y.create.l HWIO_QFPROM_RAW_LCM_ROW_MSB_ADDR A:0xa0124
y.create.l HWIO_QFPROM_RAW_PRI_KEY_DERIVATION_KEY_ROW0_LSB_ADDR A:0xa0128
y.create.l HWIO_QFPROM_RAW_PRI_KEY_DERIVATION_KEY_ROW1_LSB_ADDR A:0xa0130
y.create.l HWIO_QFPROM_RAW_PRI_KEY_DERIVATION_KEY_ROW2_LSB_ADDR A:0xa0138
y.create.l HWIO_QFPROM_RAW_PRI_KEY_DERIVATION_KEY_ROW3_LSB_ADDR A:0xa0140
y.create.l HWIO_QFPROM_RAW_PRI_KEY_DERIVATION_KEY_ROW4_LSB_ADDR A:0xa0148
y.create.l HWIO_QFPROM_RAW_PRI_KEY_DERIVATION_KEY_ROW0_MSB_ADDR A:0xa012c
y.create.l HWIO_QFPROM_RAW_PRI_KEY_DERIVATION_KEY_ROW1_MSB_ADDR A:0xa0134
y.create.l HWIO_QFPROM_RAW_PRI_KEY_DERIVATION_KEY_ROW2_MSB_ADDR A:0xa013c
y.create.l HWIO_QFPROM_RAW_PRI_KEY_DERIVATION_KEY_ROW3_MSB_ADDR A:0xa0144
y.create.l HWIO_QFPROM_RAW_PRI_KEY_DERIVATION_KEY_ROW4_MSB_ADDR A:0xa014c
y.create.l HWIO_QFPROM_RAW_CM_FEAT_CONFIG_ROW0_LSB_ADDR A:0xa0150
y.create.l HWIO_QFPROM_RAW_CM_FEAT_CONFIG_ROW0_MSB_ADDR A:0xa0154
y.create.l HWIO_QFPROM_RAW_CM_FEAT_CONFIG_ROW1_LSB_ADDR A:0xa0158
y.create.l HWIO_QFPROM_RAW_CM_FEAT_CONFIG_ROW1_MSB_ADDR A:0xa015c
y.create.l HWIO_QFPROM_RAW_CM_FEAT_CONFIG_ROW2_LSB_ADDR A:0xa0160
y.create.l HWIO_QFPROM_RAW_CM_FEAT_CONFIG_ROW2_MSB_ADDR A:0xa0164
y.create.l HWIO_QFPROM_RAW_MRC_2_0_ROW0_LSB_ADDR A:0xa0168
y.create.l HWIO_QFPROM_RAW_MRC_2_0_ROW0_MSB_ADDR A:0xa016c
y.create.l HWIO_QFPROM_RAW_MRC_2_0_ROW1_LSB_ADDR A:0xa0170
y.create.l HWIO_QFPROM_RAW_MRC_2_0_ROW1_MSB_ADDR A:0xa0174
y.create.l HWIO_QFPROM_RAW_PTE_ROW0_LSB_ADDR A:0xa0178
y.create.l HWIO_QFPROM_RAW_PTE_ROW0_MSB_ADDR A:0xa017c
y.create.l HWIO_QFPROM_RAW_PTE_ROW1_LSB_ADDR A:0xa0180
y.create.l HWIO_QFPROM_RAW_PTE_ROW1_MSB_ADDR A:0xa0184
y.create.l HWIO_QFPROM_RAW_PTE_ROW2_LSB_ADDR A:0xa0188
y.create.l HWIO_QFPROM_RAW_PTE_ROW2_MSB_ADDR A:0xa018c
y.create.l HWIO_QFPROM_RAW_PTE_ROW3_LSB_ADDR A:0xa0190
y.create.l HWIO_QFPROM_RAW_PTE_ROW3_MSB_ADDR A:0xa0194
y.create.l HWIO_QFPROM_RAW_RD_PERM_LSB_ADDR A:0xa0198
y.create.l HWIO_QFPROM_RAW_RD_PERM_MSB_ADDR A:0xa019c
y.create.l HWIO_QFPROM_RAW_WR_PERM_LSB_ADDR A:0xa01a0
y.create.l HWIO_QFPROM_RAW_WR_PERM_MSB_ADDR A:0xa01a4
y.create.l HWIO_QFPROM_RAW_FEC_EN_LSB_ADDR A:0xa01a8
y.create.l HWIO_QFPROM_RAW_FEC_EN_MSB_ADDR A:0xa01ac
y.create.l HWIO_QFPROM_RAW_OEM_CONFIG_ROW0_LSB_ADDR A:0xa01b0
y.create.l HWIO_QFPROM_RAW_OEM_CONFIG_ROW0_MSB_ADDR A:0xa01b4
y.create.l HWIO_QFPROM_RAW_OEM_CONFIG_ROW1_LSB_ADDR A:0xa01b8
y.create.l HWIO_QFPROM_RAW_OEM_CONFIG_ROW1_MSB_ADDR A:0xa01bc
y.create.l HWIO_QFPROM_RAW_OEM_CONFIG_ROW2_LSB_ADDR A:0xa01c0
y.create.l HWIO_QFPROM_RAW_OEM_CONFIG_ROW2_MSB_ADDR A:0xa01c4
y.create.l HWIO_QFPROM_RAW_FEAT_CONFIG_ROW0_LSB_ADDR A:0xa01c8
y.create.l HWIO_QFPROM_RAW_FEAT_CONFIG_ROW0_MSB_ADDR A:0xa01cc
y.create.l HWIO_QFPROM_RAW_FEAT_CONFIG_ROW1_LSB_ADDR A:0xa01d0
y.create.l HWIO_QFPROM_RAW_FEAT_CONFIG_ROW1_MSB_ADDR A:0xa01d4
y.create.l HWIO_QFPROM_RAW_FEAT_CONFIG_ROW2_LSB_ADDR A:0xa01d8
y.create.l HWIO_QFPROM_RAW_FEAT_CONFIG_ROW2_MSB_ADDR A:0xa01dc
y.create.l HWIO_QFPROM_RAW_ANTI_ROLLBACK_1_LSB_ADDR A:0xa01e0
y.create.l HWIO_QFPROM_RAW_ANTI_ROLLBACK_1_MSB_ADDR A:0xa01e4
y.create.l HWIO_QFPROM_RAW_ANTI_ROLLBACK_2_LSB_ADDR A:0xa01e8
y.create.l HWIO_QFPROM_RAW_ANTI_ROLLBACK_2_MSB_ADDR A:0xa01ec
y.create.l HWIO_QFPROM_RAW_ANTI_ROLLBACK_3_LSB_ADDR A:0xa01f0
y.create.l HWIO_QFPROM_RAW_ANTI_ROLLBACK_3_MSB_ADDR A:0xa01f4
y.create.l HWIO_QFPROM_RAW_ANTI_ROLLBACK_4_LSB_ADDR A:0xa01f8
y.create.l HWIO_QFPROM_RAW_ANTI_ROLLBACK_4_MSB_ADDR A:0xa01fc
y.create.l HWIO_QFPROM_RAW_PK_HASH0_ROW0_LSB_ADDR A:0xa0200
y.create.l HWIO_QFPROM_RAW_PK_HASH0_ROW1_LSB_ADDR A:0xa0208
y.create.l HWIO_QFPROM_RAW_PK_HASH0_ROW2_LSB_ADDR A:0xa0210
y.create.l HWIO_QFPROM_RAW_PK_HASH0_ROW3_LSB_ADDR A:0xa0218
y.create.l HWIO_QFPROM_RAW_PK_HASH0_ROW4_LSB_ADDR A:0xa0220
y.create.l HWIO_QFPROM_RAW_PK_HASH0_ROW5_LSB_ADDR A:0xa0228
y.create.l HWIO_QFPROM_RAW_PK_HASH0_ROW6_LSB_ADDR A:0xa0230
y.create.l HWIO_QFPROM_RAW_PK_HASH0_ROW0_MSB_ADDR A:0xa0204
y.create.l HWIO_QFPROM_RAW_PK_HASH0_ROW1_MSB_ADDR A:0xa020c
y.create.l HWIO_QFPROM_RAW_PK_HASH0_ROW2_MSB_ADDR A:0xa0214
y.create.l HWIO_QFPROM_RAW_PK_HASH0_ROW3_MSB_ADDR A:0xa021c
y.create.l HWIO_QFPROM_RAW_PK_HASH0_ROW4_MSB_ADDR A:0xa0224
y.create.l HWIO_QFPROM_RAW_PK_HASH0_ROW5_MSB_ADDR A:0xa022c
y.create.l HWIO_QFPROM_RAW_PK_HASH0_ROW6_MSB_ADDR A:0xa0234
y.create.l HWIO_QFPROM_RAW_CALIB_ROW0_LSB_ADDR A:0xa0238
y.create.l HWIO_QFPROM_RAW_CALIB_ROW0_MSB_ADDR A:0xa023c
y.create.l HWIO_QFPROM_RAW_CALIB_ROW1_LSB_ADDR A:0xa0240
y.create.l HWIO_QFPROM_RAW_CALIB_ROW1_MSB_ADDR A:0xa0244
y.create.l HWIO_QFPROM_RAW_CALIB_ROW2_LSB_ADDR A:0xa0248
y.create.l HWIO_QFPROM_RAW_CALIB_ROW2_MSB_ADDR A:0xa024c
y.create.l HWIO_QFPROM_RAW_CALIB_ROW3_LSB_ADDR A:0xa0250
y.create.l HWIO_QFPROM_RAW_CALIB_ROW3_MSB_ADDR A:0xa0254
y.create.l HWIO_QFPROM_RAW_CALIB_ROW4_LSB_ADDR A:0xa0258
y.create.l HWIO_QFPROM_RAW_CALIB_ROW4_MSB_ADDR A:0xa025c
y.create.l HWIO_QFPROM_RAW_CALIB_ROW5_LSB_ADDR A:0xa0260
y.create.l HWIO_QFPROM_RAW_CALIB_ROW5_MSB_ADDR A:0xa0264
y.create.l HWIO_QFPROM_RAW_CALIB_ROW6_LSB_ADDR A:0xa0268
y.create.l HWIO_QFPROM_RAW_CALIB_ROW6_MSB_ADDR A:0xa026c
y.create.l HWIO_QFPROM_RAW_CALIB_ROW7_LSB_ADDR A:0xa0270
y.create.l HWIO_QFPROM_RAW_CALIB_ROW7_MSB_ADDR A:0xa0274
y.create.l HWIO_QFPROM_RAW_CALIB_ROW8_LSB_ADDR A:0xa0278
y.create.l HWIO_QFPROM_RAW_CALIB_ROW8_MSB_ADDR A:0xa027c
y.create.l HWIO_QFPROM_RAW_CALIB_ROW9_LSB_ADDR A:0xa0280
y.create.l HWIO_QFPROM_RAW_CALIB_ROW9_MSB_ADDR A:0xa0284
y.create.l HWIO_QFPROM_RAW_CALIB_ROW10_LSB_ADDR A:0xa0288
y.create.l HWIO_QFPROM_RAW_CALIB_ROW10_MSB_ADDR A:0xa028c
y.create.l HWIO_QFPROM_RAW_CALIB_ROW11_LSB_ADDR A:0xa0290
y.create.l HWIO_QFPROM_RAW_CALIB_ROW11_MSB_ADDR A:0xa0294
y.create.l HWIO_QFPROM_RAW_MEM_CONFIG_ROW0_LSB_ADDR A:0xa0298
y.create.l HWIO_QFPROM_RAW_MEM_CONFIG_ROW1_LSB_ADDR A:0xa02a0
y.create.l HWIO_QFPROM_RAW_MEM_CONFIG_ROW2_LSB_ADDR A:0xa02a8
y.create.l HWIO_QFPROM_RAW_MEM_CONFIG_ROW3_LSB_ADDR A:0xa02b0
y.create.l HWIO_QFPROM_RAW_MEM_CONFIG_ROW4_LSB_ADDR A:0xa02b8
y.create.l HWIO_QFPROM_RAW_MEM_CONFIG_ROW5_LSB_ADDR A:0xa02c0
y.create.l HWIO_QFPROM_RAW_MEM_CONFIG_ROW6_LSB_ADDR A:0xa02c8
y.create.l HWIO_QFPROM_RAW_MEM_CONFIG_ROW7_LSB_ADDR A:0xa02d0
y.create.l HWIO_QFPROM_RAW_MEM_CONFIG_ROW8_LSB_ADDR A:0xa02d8
y.create.l HWIO_QFPROM_RAW_MEM_CONFIG_ROW9_LSB_ADDR A:0xa02e0
y.create.l HWIO_QFPROM_RAW_MEM_CONFIG_ROW0_MSB_ADDR A:0xa029c
y.create.l HWIO_QFPROM_RAW_MEM_CONFIG_ROW1_MSB_ADDR A:0xa02a4
y.create.l HWIO_QFPROM_RAW_MEM_CONFIG_ROW2_MSB_ADDR A:0xa02ac
y.create.l HWIO_QFPROM_RAW_MEM_CONFIG_ROW3_MSB_ADDR A:0xa02b4
y.create.l HWIO_QFPROM_RAW_MEM_CONFIG_ROW4_MSB_ADDR A:0xa02bc
y.create.l HWIO_QFPROM_RAW_MEM_CONFIG_ROW5_MSB_ADDR A:0xa02c4
y.create.l HWIO_QFPROM_RAW_MEM_CONFIG_ROW6_MSB_ADDR A:0xa02cc
y.create.l HWIO_QFPROM_RAW_MEM_CONFIG_ROW7_MSB_ADDR A:0xa02d4
y.create.l HWIO_QFPROM_RAW_MEM_CONFIG_ROW8_MSB_ADDR A:0xa02dc
y.create.l HWIO_QFPROM_RAW_MEM_CONFIG_ROW9_MSB_ADDR A:0xa02e4
y.create.l HWIO_QFPROM_RAW_QC_SPARE_REG18_LSB_ADDR A:0xa02f8
y.create.l HWIO_QFPROM_RAW_QC_SPARE_REG19_LSB_ADDR A:0xa0300
y.create.l HWIO_QFPROM_RAW_QC_SPARE_REG18_MSB_ADDR A:0xa02fc
y.create.l HWIO_QFPROM_RAW_QC_SPARE_REG19_MSB_ADDR A:0xa0304
y.create.l HWIO_QFPROM_RAW_OEM_IMAGE_ENCR_KEY_ROW0_LSB_ADDR A:0xa0308
y.create.l HWIO_QFPROM_RAW_OEM_IMAGE_ENCR_KEY_ROW1_LSB_ADDR A:0xa0310
y.create.l HWIO_QFPROM_RAW_OEM_IMAGE_ENCR_KEY_ROW0_MSB_ADDR A:0xa030c
y.create.l HWIO_QFPROM_RAW_OEM_IMAGE_ENCR_KEY_ROW1_MSB_ADDR A:0xa0314
y.create.l HWIO_QFPROM_RAW_OEM_IMAGE_ENCR_KEY_ROW2_LSB_ADDR A:0xa0318
y.create.l HWIO_QFPROM_RAW_OEM_IMAGE_ENCR_KEY_ROW2_MSB_ADDR A:0xa031c
y.create.l HWIO_QFPROM_RAW_OEM_SEC_BOOT_ROW0_LSB_ADDR A:0xa0320
y.create.l HWIO_QFPROM_RAW_OEM_SEC_BOOT_ROW1_LSB_ADDR A:0xa0328
y.create.l HWIO_QFPROM_RAW_OEM_SEC_BOOT_ROW0_MSB_ADDR A:0xa0324
y.create.l HWIO_QFPROM_RAW_OEM_SEC_BOOT_ROW1_MSB_ADDR A:0xa032c
y.create.l HWIO_QFPROM_RAW_SEC_KEY_DERIVATION_KEY_ROW0_LSB_ADDR A:0xa0330
y.create.l HWIO_QFPROM_RAW_SEC_KEY_DERIVATION_KEY_ROW1_LSB_ADDR A:0xa0338
y.create.l HWIO_QFPROM_RAW_SEC_KEY_DERIVATION_KEY_ROW2_LSB_ADDR A:0xa0340
y.create.l HWIO_QFPROM_RAW_SEC_KEY_DERIVATION_KEY_ROW3_LSB_ADDR A:0xa0348
y.create.l HWIO_QFPROM_RAW_SEC_KEY_DERIVATION_KEY_ROW0_MSB_ADDR A:0xa0334
y.create.l HWIO_QFPROM_RAW_SEC_KEY_DERIVATION_KEY_ROW1_MSB_ADDR A:0xa033c
y.create.l HWIO_QFPROM_RAW_SEC_KEY_DERIVATION_KEY_ROW2_MSB_ADDR A:0xa0344
y.create.l HWIO_QFPROM_RAW_SEC_KEY_DERIVATION_KEY_ROW3_MSB_ADDR A:0xa034c
y.create.l HWIO_QFPROM_RAW_SEC_KEY_DERIVATION_KEY_ROW4_LSB_ADDR A:0xa0350
y.create.l HWIO_QFPROM_RAW_SEC_KEY_DERIVATION_KEY_ROW4_MSB_ADDR A:0xa0354
y.create.l HWIO_QFPROM_RAW_ROM_PATCH_ROW0_LSB_ADDR A:0xa0358
y.create.l HWIO_QFPROM_RAW_ROM_PATCH_ROW1_LSB_ADDR A:0xa0360
y.create.l HWIO_QFPROM_RAW_ROM_PATCH_ROW2_LSB_ADDR A:0xa0368
y.create.l HWIO_QFPROM_RAW_ROM_PATCH_ROW3_LSB_ADDR A:0xa0370
y.create.l HWIO_QFPROM_RAW_ROM_PATCH_ROW4_LSB_ADDR A:0xa0378
y.create.l HWIO_QFPROM_RAW_ROM_PATCH_ROW5_LSB_ADDR A:0xa0380
y.create.l HWIO_QFPROM_RAW_ROM_PATCH_ROW6_LSB_ADDR A:0xa0388
y.create.l HWIO_QFPROM_RAW_ROM_PATCH_ROW7_LSB_ADDR A:0xa0390
y.create.l HWIO_QFPROM_RAW_ROM_PATCH_ROW8_LSB_ADDR A:0xa0398
y.create.l HWIO_QFPROM_RAW_ROM_PATCH_ROW9_LSB_ADDR A:0xa03a0
y.create.l HWIO_QFPROM_RAW_ROM_PATCH_ROW0_MSB_ADDR A:0xa035c
y.create.l HWIO_QFPROM_RAW_ROM_PATCH_ROW1_MSB_ADDR A:0xa0364
y.create.l HWIO_QFPROM_RAW_ROM_PATCH_ROW2_MSB_ADDR A:0xa036c
y.create.l HWIO_QFPROM_RAW_ROM_PATCH_ROW3_MSB_ADDR A:0xa0374
y.create.l HWIO_QFPROM_RAW_ROM_PATCH_ROW4_MSB_ADDR A:0xa037c
y.create.l HWIO_QFPROM_RAW_ROM_PATCH_ROW5_MSB_ADDR A:0xa0384
y.create.l HWIO_QFPROM_RAW_ROM_PATCH_ROW6_MSB_ADDR A:0xa038c
y.create.l HWIO_QFPROM_RAW_ROM_PATCH_ROW7_MSB_ADDR A:0xa0394
y.create.l HWIO_QFPROM_RAW_ROM_PATCH_ROW8_MSB_ADDR A:0xa039c
y.create.l HWIO_QFPROM_RAW_ROM_PATCH_ROW9_MSB_ADDR A:0xa03a4
y.create.l HWIO_QFPROM_RAW_IMAGE_ENCR_KEY1_ROW0_LSB_ADDR A:0xa0478
y.create.l HWIO_QFPROM_RAW_IMAGE_ENCR_KEY1_ROW1_LSB_ADDR A:0xa0480
y.create.l HWIO_QFPROM_RAW_IMAGE_ENCR_KEY1_ROW0_MSB_ADDR A:0xa047c
y.create.l HWIO_QFPROM_RAW_IMAGE_ENCR_KEY1_ROW1_MSB_ADDR A:0xa0484
y.create.l HWIO_QFPROM_RAW_IMAGE_ENCR_KEY1_ROW2_LSB_ADDR A:0xa0488
y.create.l HWIO_QFPROM_RAW_IMAGE_ENCR_KEY1_ROW2_MSB_ADDR A:0xa048c
y.create.l HWIO_QFPROM_RAW_USER_DATA_KEY_ROW0_LSB_ADDR A:0xa0490
y.create.l HWIO_QFPROM_RAW_USER_DATA_KEY_ROW1_LSB_ADDR A:0xa0498
y.create.l HWIO_QFPROM_RAW_USER_DATA_KEY_ROW2_LSB_ADDR A:0xa04a0
y.create.l HWIO_QFPROM_RAW_USER_DATA_KEY_ROW3_LSB_ADDR A:0xa04a8
y.create.l HWIO_QFPROM_RAW_USER_DATA_KEY_ROW0_MSB_ADDR A:0xa0494
y.create.l HWIO_QFPROM_RAW_USER_DATA_KEY_ROW1_MSB_ADDR A:0xa049c
y.create.l HWIO_QFPROM_RAW_USER_DATA_KEY_ROW2_MSB_ADDR A:0xa04a4
y.create.l HWIO_QFPROM_RAW_USER_DATA_KEY_ROW3_MSB_ADDR A:0xa04ac
y.create.l HWIO_QFPROM_RAW_USER_DATA_KEY_ROW4_LSB_ADDR A:0xa04b0
y.create.l HWIO_QFPROM_RAW_USER_DATA_KEY_ROW4_MSB_ADDR A:0xa04b4
y.create.l HWIO_QFPROM_RAW_OEM_SPARE_REG26_ROW0_LSB_ADDR A:0xa04b8
y.create.l HWIO_QFPROM_RAW_OEM_SPARE_REG27_ROW0_LSB_ADDR A:0xa04c8
y.create.l HWIO_QFPROM_RAW_OEM_SPARE_REG28_ROW0_LSB_ADDR A:0xa04d8
y.create.l HWIO_QFPROM_RAW_OEM_SPARE_REG29_ROW0_LSB_ADDR A:0xa04e8
y.create.l HWIO_QFPROM_RAW_OEM_SPARE_REG26_ROW0_MSB_ADDR A:0xa04bc
y.create.l HWIO_QFPROM_RAW_OEM_SPARE_REG27_ROW0_MSB_ADDR A:0xa04cc
y.create.l HWIO_QFPROM_RAW_OEM_SPARE_REG28_ROW0_MSB_ADDR A:0xa04dc
y.create.l HWIO_QFPROM_RAW_OEM_SPARE_REG29_ROW0_MSB_ADDR A:0xa04ec
y.create.l HWIO_QFPROM_RAW_OEM_SPARE_REG26_ROW1_LSB_ADDR A:0xa04c0
y.create.l HWIO_QFPROM_RAW_OEM_SPARE_REG27_ROW1_LSB_ADDR A:0xa04d0
y.create.l HWIO_QFPROM_RAW_OEM_SPARE_REG28_ROW1_LSB_ADDR A:0xa04e0
y.create.l HWIO_QFPROM_RAW_OEM_SPARE_REG29_ROW1_LSB_ADDR A:0xa04f0
y.create.l HWIO_QFPROM_RAW_OEM_SPARE_REG26_ROW1_MSB_ADDR A:0xa04c4
y.create.l HWIO_QFPROM_RAW_OEM_SPARE_REG27_ROW1_MSB_ADDR A:0xa04d4
y.create.l HWIO_QFPROM_RAW_OEM_SPARE_REG28_ROW1_MSB_ADDR A:0xa04e4
y.create.l HWIO_QFPROM_RAW_OEM_SPARE_REG29_ROW1_MSB_ADDR A:0xa04f4
y.create.l HWIO_QFPROM_RAW_OEM_SPARE_REG30_ROW_LSB_ADDR A:0xa04f8
y.create.l HWIO_QFPROM_RAW_OEM_SPARE_REG30_ROW_MSB_ADDR A:0xa04fc
y.create.l HWIO_QFPROM_BLOW_TIMER_ADDR A:0xa203c
y.create.l HWIO_QFPROM_TEST_CTRL_ADDR A:0xa2040
y.create.l HWIO_QFPROM_ACCEL_ADDR A:0xa2044
y.create.l HWIO_QFPROM_BLOW_STATUS_ADDR A:0xa2048
y.create.l HWIO_QFPROM_ROM_ERROR_ADDR A:0xa204c
y.create.l HWIO_QFPROM0_MATCH_STATUS_ADDR A:0xa2050
y.create.l HWIO_QFPROM1_MATCH_STATUS_ADDR A:0xa2054
y.create.l HWIO_FEC_ESR_ADDR A:0xa2058
y.create.l HWIO_FEC_EAR_ADDR A:0xa205c
y.create.l HWIO_QFPROM_BIST_CTRL_ADDR A:0xa2060
y.create.l HWIO_QFPROM_BIST_ERROR0_ADDR A:0xa2064
y.create.l HWIO_QFPROM_BIST_ERROR1_ADDR A:0xa2068
y.create.l HWIO_QFPROM_HASH_SIGNATURE0_ADDR A:0xa206c
y.create.l HWIO_QFPROM_HASH_SIGNATURE1_ADDR A:0xa2070
y.create.l HWIO_QFPROM_HASH_SIGNATURE2_ADDR A:0xa2074
y.create.l HWIO_QFPROM_HASH_SIGNATURE3_ADDR A:0xa2078
y.create.l HWIO_QFPROM_HASH_SIGNATURE4_ADDR A:0xa207c
y.create.l HWIO_QFPROM_HASH_SIGNATURE5_ADDR A:0xa2080
y.create.l HWIO_QFPROM_HASH_SIGNATURE6_ADDR A:0xa2084
y.create.l HWIO_QFPROM_HASH_SIGNATURE7_ADDR A:0xa2088
y.create.l HWIO_HW_KEY_STATUS_ADDR A:0xa208c
y.create.l HWIO_RESET_JDR_STATUS_ADDR A:0xa2090
y.create.l HWIO_ATPG_JDR_STATUS_ADDR A:0xa2094
y.create.l HWIO_FEAT_PROV_OUT0_ADDR A:0xa2098
y.create.l HWIO_FEAT_PROV_OUT1_ADDR A:0xa209c
y.create.l HWIO_FEAT_PROV_OUT2_ADDR A:0xa20a0
y.create.l HWIO_FEAT_PROV_OUT3_ADDR A:0xa20a4
y.create.l HWIO_SEC_CTRL_MISC_CONFIG_STATUS0_ADDR A:0xa20a8
y.create.l HWIO_SEC_CTRL_MISC_CONFIG_STATUS1_ADDR A:0xa20ac
y.create.l HWIO_SEC_CTRL_MISC_CONFIG_STATUS2_ADDR A:0xa20b0
y.create.l HWIO_SEC_CTRL_MISC_CONFIG_STATUS3_ADDR A:0xa20b4
y.create.l HWIO_DEBUG_FUSE_STATUS_ADDR A:0xa20f0
y.create.l HWIO_HW_ATTESTATION_CTRL0_ADDR A:0xa2100
y.create.l HWIO_HW_ATTESTATION_CTRL1_ADDR A:0xa2104
y.create.l HWIO_HW_ATTESTATION_CMD_ADDR A:0xa2108
y.create.l HWIO_HW_ATTESTATION_STATUS_ADDR A:0xa210c
y.create.l HWIO_HW_ATTESTATION_ERROR_ADDR A:0xa2110
y.create.l HWIO_HW_ATTESTATION_RESULT0_ADDR A:0xa2120
y.create.l HWIO_HW_ATTESTATION_RESULT1_ADDR A:0xa2124
y.create.l HWIO_HW_ATTESTATION_RESULT2_ADDR A:0xa2128
y.create.l HWIO_HW_ATTESTATION_RESULT3_ADDR A:0xa212c
y.create.l HWIO_HW_ATTESTATION_RESULT4_ADDR A:0xa2130
y.create.l HWIO_HW_ATTESTATION_RESULT5_ADDR A:0xa2134
y.create.l HWIO_HW_ATTESTATION_RESULT6_ADDR A:0xa2138
y.create.l HWIO_HW_ATTESTATION_RESULT7_ADDR A:0xa213c
y.create.l HWIO_QFPROM_CORR_CRI_CM_PRIVATE0_ADDR A:0xa4000
y.create.l HWIO_QFPROM_CORR_CRI_CM_PRIVATE1_ADDR A:0xa4004
y.create.l HWIO_QFPROM_CORR_CRI_CM_PRIVATE2_ADDR A:0xa4008
y.create.l HWIO_QFPROM_CORR_CRI_CM_PRIVATE3_ADDR A:0xa400c
y.create.l HWIO_QFPROM_CORR_CRI_CM_PRIVATE4_ADDR A:0xa4010
y.create.l HWIO_QFPROM_CORR_CRI_CM_PRIVATE5_ADDR A:0xa4014
y.create.l HWIO_QFPROM_CORR_CRI_CM_PRIVATE6_ADDR A:0xa4018
y.create.l HWIO_QFPROM_CORR_CRI_CM_PRIVATE7_ADDR A:0xa401c
y.create.l HWIO_QFPROM_CORR_CRI_CM_PRIVATE8_ADDR A:0xa4020
y.create.l HWIO_QFPROM_CORR_CRI_CM_PRIVATE9_ADDR A:0xa4024
y.create.l HWIO_QFPROM_CORR_LCM_ROW_LSB_ADDR A:0xa4120
y.create.l HWIO_QFPROM_CORR_LCM_ROW_MSB_ADDR A:0xa4124
y.create.l HWIO_QFPROM_CORR_PRI_KEY_DERIVATION_KEY_ROW0_LSB_ADDR A:0xa4128
y.create.l HWIO_QFPROM_CORR_PRI_KEY_DERIVATION_KEY_ROW1_LSB_ADDR A:0xa4130
y.create.l HWIO_QFPROM_CORR_PRI_KEY_DERIVATION_KEY_ROW2_LSB_ADDR A:0xa4138
y.create.l HWIO_QFPROM_CORR_PRI_KEY_DERIVATION_KEY_ROW3_LSB_ADDR A:0xa4140
y.create.l HWIO_QFPROM_CORR_PRI_KEY_DERIVATION_KEY_ROW4_LSB_ADDR A:0xa4148
y.create.l HWIO_QFPROM_CORR_PRI_KEY_DERIVATION_KEY_ROW0_MSB_ADDR A:0xa412c
y.create.l HWIO_QFPROM_CORR_PRI_KEY_DERIVATION_KEY_ROW1_MSB_ADDR A:0xa4134
y.create.l HWIO_QFPROM_CORR_PRI_KEY_DERIVATION_KEY_ROW2_MSB_ADDR A:0xa413c
y.create.l HWIO_QFPROM_CORR_PRI_KEY_DERIVATION_KEY_ROW3_MSB_ADDR A:0xa4144
y.create.l HWIO_QFPROM_CORR_PRI_KEY_DERIVATION_KEY_ROW4_MSB_ADDR A:0xa414c
y.create.l HWIO_QFPROM_CORR_CM_FEAT_CONFIG_ROW0_LSB_ADDR A:0xa4150
y.create.l HWIO_QFPROM_CORR_CM_FEAT_CONFIG_ROW0_MSB_ADDR A:0xa4154
y.create.l HWIO_QFPROM_CORR_CM_FEAT_CONFIG_ROW1_LSB_ADDR A:0xa4158
y.create.l HWIO_QFPROM_CORR_CM_FEAT_CONFIG_ROW1_MSB_ADDR A:0xa415c
y.create.l HWIO_QFPROM_CORR_CM_FEAT_CONFIG_ROW2_LSB_ADDR A:0xa4160
y.create.l HWIO_QFPROM_CORR_CM_FEAT_CONFIG_ROW2_MSB_ADDR A:0xa4164
y.create.l HWIO_QFPROM_CORR_MRC_2_0_ROW0_LSB_ADDR A:0xa4168
y.create.l HWIO_QFPROM_CORR_MRC_2_0_ROW0_MSB_ADDR A:0xa416c
y.create.l HWIO_QFPROM_CORR_MRC_2_0_ROW1_LSB_ADDR A:0xa4170
y.create.l HWIO_QFPROM_CORR_MRC_2_0_ROW1_MSB_ADDR A:0xa4174
y.create.l HWIO_QFPROM_CORR_PTE_ROW0_LSB_ADDR A:0xa4178
y.create.l HWIO_QFPROM_CORR_PTE_ROW0_MSB_ADDR A:0xa417c
y.create.l HWIO_QFPROM_CORR_PTE_ROW1_LSB_ADDR A:0xa4180
y.create.l HWIO_QFPROM_CORR_PTE_ROW1_MSB_ADDR A:0xa4184
y.create.l HWIO_QFPROM_CORR_PTE_ROW2_LSB_ADDR A:0xa4188
y.create.l HWIO_QFPROM_CORR_PTE_ROW2_MSB_ADDR A:0xa418c
y.create.l HWIO_QFPROM_CORR_PTE_ROW3_LSB_ADDR A:0xa4190
y.create.l HWIO_QFPROM_CORR_PTE_ROW3_MSB_ADDR A:0xa4194
y.create.l HWIO_QFPROM_CORR_RD_PERM_LSB_ADDR A:0xa4198
y.create.l HWIO_QFPROM_CORR_RD_PERM_MSB_ADDR A:0xa419c
y.create.l HWIO_QFPROM_CORR_WR_PERM_LSB_ADDR A:0xa41a0
y.create.l HWIO_QFPROM_CORR_WR_PERM_MSB_ADDR A:0xa41a4
y.create.l HWIO_QFPROM_CORR_FEC_EN_LSB_ADDR A:0xa41a8
y.create.l HWIO_QFPROM_CORR_FEC_EN_MSB_ADDR A:0xa41ac
y.create.l HWIO_QFPROM_CORR_OEM_CONFIG_ROW0_LSB_ADDR A:0xa41b0
y.create.l HWIO_QFPROM_CORR_OEM_CONFIG_ROW0_MSB_ADDR A:0xa41b4
y.create.l HWIO_QFPROM_CORR_OEM_CONFIG_ROW1_LSB_ADDR A:0xa41b8
y.create.l HWIO_QFPROM_CORR_OEM_CONFIG_ROW1_MSB_ADDR A:0xa41bc
y.create.l HWIO_QFPROM_CORR_OEM_CONFIG_ROW2_LSB_ADDR A:0xa41c0
y.create.l HWIO_QFPROM_CORR_OEM_CONFIG_ROW2_MSB_ADDR A:0xa41c4
y.create.l HWIO_QFPROM_CORR_FEAT_CONFIG_ROW0_LSB_ADDR A:0xa41c8
y.create.l HWIO_QFPROM_CORR_FEAT_CONFIG_ROW0_MSB_ADDR A:0xa41cc
y.create.l HWIO_QFPROM_CORR_FEAT_CONFIG_ROW1_LSB_ADDR A:0xa41d0
y.create.l HWIO_QFPROM_CORR_FEAT_CONFIG_ROW1_MSB_ADDR A:0xa41d4
y.create.l HWIO_QFPROM_CORR_FEAT_CONFIG_ROW2_LSB_ADDR A:0xa41d8
y.create.l HWIO_QFPROM_CORR_FEAT_CONFIG_ROW2_MSB_ADDR A:0xa41dc
y.create.l HWIO_QFPROM_CORR_ANTI_ROLLBACK_1_LSB_ADDR A:0xa41e0
y.create.l HWIO_QFPROM_CORR_ANTI_ROLLBACK_1_MSB_ADDR A:0xa41e4
y.create.l HWIO_QFPROM_CORR_ANTI_ROLLBACK_2_LSB_ADDR A:0xa41e8
y.create.l HWIO_QFPROM_CORR_ANTI_ROLLBACK_2_MSB_ADDR A:0xa41ec
y.create.l HWIO_QFPROM_CORR_ANTI_ROLLBACK_3_LSB_ADDR A:0xa41f0
y.create.l HWIO_QFPROM_CORR_ANTI_ROLLBACK_3_MSB_ADDR A:0xa41f4
y.create.l HWIO_QFPROM_CORR_ANTI_ROLLBACK_4_LSB_ADDR A:0xa41f8
y.create.l HWIO_QFPROM_CORR_ANTI_ROLLBACK_4_MSB_ADDR A:0xa41fc
y.create.l HWIO_QFPROM_CORR_PK_HASH0_ROW0_LSB_ADDR A:0xa4200
y.create.l HWIO_QFPROM_CORR_PK_HASH0_ROW1_LSB_ADDR A:0xa4208
y.create.l HWIO_QFPROM_CORR_PK_HASH0_ROW2_LSB_ADDR A:0xa4210
y.create.l HWIO_QFPROM_CORR_PK_HASH0_ROW3_LSB_ADDR A:0xa4218
y.create.l HWIO_QFPROM_CORR_PK_HASH0_ROW4_LSB_ADDR A:0xa4220
y.create.l HWIO_QFPROM_CORR_PK_HASH0_ROW5_LSB_ADDR A:0xa4228
y.create.l HWIO_QFPROM_CORR_PK_HASH0_ROW6_LSB_ADDR A:0xa4230
y.create.l HWIO_QFPROM_CORR_PK_HASH0_ROW0_MSB_ADDR A:0xa4204
y.create.l HWIO_QFPROM_CORR_PK_HASH0_ROW1_MSB_ADDR A:0xa420c
y.create.l HWIO_QFPROM_CORR_PK_HASH0_ROW2_MSB_ADDR A:0xa4214
y.create.l HWIO_QFPROM_CORR_PK_HASH0_ROW3_MSB_ADDR A:0xa421c
y.create.l HWIO_QFPROM_CORR_PK_HASH0_ROW4_MSB_ADDR A:0xa4224
y.create.l HWIO_QFPROM_CORR_PK_HASH0_ROW5_MSB_ADDR A:0xa422c
y.create.l HWIO_QFPROM_CORR_PK_HASH0_ROW6_MSB_ADDR A:0xa4234
y.create.l HWIO_QFPROM_CORR_CALIB_ROW0_LSB_ADDR A:0xa4238
y.create.l HWIO_QFPROM_CORR_CALIB_ROW0_MSB_ADDR A:0xa423c
y.create.l HWIO_QFPROM_CORR_CALIB_ROW1_LSB_ADDR A:0xa4240
y.create.l HWIO_QFPROM_CORR_CALIB_ROW1_MSB_ADDR A:0xa4244
y.create.l HWIO_QFPROM_CORR_CALIB_ROW2_LSB_ADDR A:0xa4248
y.create.l HWIO_QFPROM_CORR_CALIB_ROW2_MSB_ADDR A:0xa424c
y.create.l HWIO_QFPROM_CORR_CALIB_ROW3_LSB_ADDR A:0xa4250
y.create.l HWIO_QFPROM_CORR_CALIB_ROW3_MSB_ADDR A:0xa4254
y.create.l HWIO_QFPROM_CORR_CALIB_ROW4_LSB_ADDR A:0xa4258
y.create.l HWIO_QFPROM_CORR_CALIB_ROW4_MSB_ADDR A:0xa425c
y.create.l HWIO_QFPROM_CORR_CALIB_ROW5_LSB_ADDR A:0xa4260
y.create.l HWIO_QFPROM_CORR_CALIB_ROW5_MSB_ADDR A:0xa4264
y.create.l HWIO_QFPROM_CORR_CALIB_ROW6_LSB_ADDR A:0xa4268
y.create.l HWIO_QFPROM_CORR_CALIB_ROW6_MSB_ADDR A:0xa426c
y.create.l HWIO_QFPROM_CORR_CALIB_ROW7_LSB_ADDR A:0xa4270
y.create.l HWIO_QFPROM_CORR_CALIB_ROW7_MSB_ADDR A:0xa4274
y.create.l HWIO_QFPROM_CORR_CALIB_ROW8_LSB_ADDR A:0xa4278
y.create.l HWIO_QFPROM_CORR_CALIB_ROW8_MSB_ADDR A:0xa427c
y.create.l HWIO_QFPROM_CORR_CALIB_ROW9_LSB_ADDR A:0xa4280
y.create.l HWIO_QFPROM_CORR_CALIB_ROW9_MSB_ADDR A:0xa4284
y.create.l HWIO_QFPROM_CORR_CALIB_ROW10_LSB_ADDR A:0xa4288
y.create.l HWIO_QFPROM_CORR_CALIB_ROW10_MSB_ADDR A:0xa428c
y.create.l HWIO_QFPROM_CORR_CALIB_ROW11_LSB_ADDR A:0xa4290
y.create.l HWIO_QFPROM_CORR_CALIB_ROW11_MSB_ADDR A:0xa4294
y.create.l HWIO_QFPROM_CORR_MEM_CONFIG_ROW0_LSB_ADDR A:0xa4298
y.create.l HWIO_QFPROM_CORR_MEM_CONFIG_ROW1_LSB_ADDR A:0xa42a0
y.create.l HWIO_QFPROM_CORR_MEM_CONFIG_ROW2_LSB_ADDR A:0xa42a8
y.create.l HWIO_QFPROM_CORR_MEM_CONFIG_ROW3_LSB_ADDR A:0xa42b0
y.create.l HWIO_QFPROM_CORR_MEM_CONFIG_ROW4_LSB_ADDR A:0xa42b8
y.create.l HWIO_QFPROM_CORR_MEM_CONFIG_ROW5_LSB_ADDR A:0xa42c0
y.create.l HWIO_QFPROM_CORR_MEM_CONFIG_ROW6_LSB_ADDR A:0xa42c8
y.create.l HWIO_QFPROM_CORR_MEM_CONFIG_ROW7_LSB_ADDR A:0xa42d0
y.create.l HWIO_QFPROM_CORR_MEM_CONFIG_ROW8_LSB_ADDR A:0xa42d8
y.create.l HWIO_QFPROM_CORR_MEM_CONFIG_ROW9_LSB_ADDR A:0xa42e0
y.create.l HWIO_QFPROM_CORR_MEM_CONFIG_ROW0_MSB_ADDR A:0xa429c
y.create.l HWIO_QFPROM_CORR_MEM_CONFIG_ROW1_MSB_ADDR A:0xa42a4
y.create.l HWIO_QFPROM_CORR_MEM_CONFIG_ROW2_MSB_ADDR A:0xa42ac
y.create.l HWIO_QFPROM_CORR_MEM_CONFIG_ROW3_MSB_ADDR A:0xa42b4
y.create.l HWIO_QFPROM_CORR_MEM_CONFIG_ROW4_MSB_ADDR A:0xa42bc
y.create.l HWIO_QFPROM_CORR_MEM_CONFIG_ROW5_MSB_ADDR A:0xa42c4
y.create.l HWIO_QFPROM_CORR_MEM_CONFIG_ROW6_MSB_ADDR A:0xa42cc
y.create.l HWIO_QFPROM_CORR_MEM_CONFIG_ROW7_MSB_ADDR A:0xa42d4
y.create.l HWIO_QFPROM_CORR_MEM_CONFIG_ROW8_MSB_ADDR A:0xa42dc
y.create.l HWIO_QFPROM_CORR_MEM_CONFIG_ROW9_MSB_ADDR A:0xa42e4
y.create.l HWIO_QFPROM_CORR_QC_SPARE_REG18_LSB_ADDR A:0xa42f8
y.create.l HWIO_QFPROM_CORR_QC_SPARE_REG19_LSB_ADDR A:0xa4300
y.create.l HWIO_QFPROM_CORR_QC_SPARE_REG18_MSB_ADDR A:0xa42fc
y.create.l HWIO_QFPROM_CORR_QC_SPARE_REG19_MSB_ADDR A:0xa4304
y.create.l HWIO_QFPROM_CORR_OEM_IMAGE_ENCR_KEY_ROW0_LSB_ADDR A:0xa4308
y.create.l HWIO_QFPROM_CORR_OEM_IMAGE_ENCR_KEY_ROW1_LSB_ADDR A:0xa4310
y.create.l HWIO_QFPROM_CORR_OEM_IMAGE_ENCR_KEY_ROW0_MSB_ADDR A:0xa430c
y.create.l HWIO_QFPROM_CORR_OEM_IMAGE_ENCR_KEY_ROW1_MSB_ADDR A:0xa4314
y.create.l HWIO_QFPROM_CORR_OEM_IMAGE_ENCR_KEY_ROW2_LSB_ADDR A:0xa4318
y.create.l HWIO_QFPROM_CORR_OEM_IMAGE_ENCR_KEY_ROW2_MSB_ADDR A:0xa431c
y.create.l HWIO_QFPROM_CORR_OEM_SEC_BOOT_ROW0_LSB_ADDR A:0xa4320
y.create.l HWIO_QFPROM_CORR_OEM_SEC_BOOT_ROW1_LSB_ADDR A:0xa4328
y.create.l HWIO_QFPROM_CORR_OEM_SEC_BOOT_ROW0_MSB_ADDR A:0xa4324
y.create.l HWIO_QFPROM_CORR_OEM_SEC_BOOT_ROW1_MSB_ADDR A:0xa432c
y.create.l HWIO_QFPROM_CORR_SEC_KEY_DERIVATION_KEY_ROW0_LSB_ADDR A:0xa4330
y.create.l HWIO_QFPROM_CORR_SEC_KEY_DERIVATION_KEY_ROW1_LSB_ADDR A:0xa4338
y.create.l HWIO_QFPROM_CORR_SEC_KEY_DERIVATION_KEY_ROW2_LSB_ADDR A:0xa4340
y.create.l HWIO_QFPROM_CORR_SEC_KEY_DERIVATION_KEY_ROW3_LSB_ADDR A:0xa4348
y.create.l HWIO_QFPROM_CORR_SEC_KEY_DERIVATION_KEY_ROW0_MSB_ADDR A:0xa4334
y.create.l HWIO_QFPROM_CORR_SEC_KEY_DERIVATION_KEY_ROW1_MSB_ADDR A:0xa433c
y.create.l HWIO_QFPROM_CORR_SEC_KEY_DERIVATION_KEY_ROW2_MSB_ADDR A:0xa4344
y.create.l HWIO_QFPROM_CORR_SEC_KEY_DERIVATION_KEY_ROW3_MSB_ADDR A:0xa434c
y.create.l HWIO_QFPROM_CORR_SEC_KEY_DERIVATION_KEY_ROW4_LSB_ADDR A:0xa4350
y.create.l HWIO_QFPROM_CORR_SEC_KEY_DERIVATION_KEY_ROW4_MSB_ADDR A:0xa4354
y.create.l HWIO_QFPROM_CORR_ROM_PATCH_ROW0_LSB_ADDR A:0xa4358
y.create.l HWIO_QFPROM_CORR_ROM_PATCH_ROW1_LSB_ADDR A:0xa4360
y.create.l HWIO_QFPROM_CORR_ROM_PATCH_ROW2_LSB_ADDR A:0xa4368
y.create.l HWIO_QFPROM_CORR_ROM_PATCH_ROW3_LSB_ADDR A:0xa4370
y.create.l HWIO_QFPROM_CORR_ROM_PATCH_ROW4_LSB_ADDR A:0xa4378
y.create.l HWIO_QFPROM_CORR_ROM_PATCH_ROW5_LSB_ADDR A:0xa4380
y.create.l HWIO_QFPROM_CORR_ROM_PATCH_ROW6_LSB_ADDR A:0xa4388
y.create.l HWIO_QFPROM_CORR_ROM_PATCH_ROW7_LSB_ADDR A:0xa4390
y.create.l HWIO_QFPROM_CORR_ROM_PATCH_ROW8_LSB_ADDR A:0xa4398
y.create.l HWIO_QFPROM_CORR_ROM_PATCH_ROW9_LSB_ADDR A:0xa43a0
y.create.l HWIO_QFPROM_CORR_ROM_PATCH_ROW0_MSB_ADDR A:0xa435c
y.create.l HWIO_QFPROM_CORR_ROM_PATCH_ROW1_MSB_ADDR A:0xa4364
y.create.l HWIO_QFPROM_CORR_ROM_PATCH_ROW2_MSB_ADDR A:0xa436c
y.create.l HWIO_QFPROM_CORR_ROM_PATCH_ROW3_MSB_ADDR A:0xa4374
y.create.l HWIO_QFPROM_CORR_ROM_PATCH_ROW4_MSB_ADDR A:0xa437c
y.create.l HWIO_QFPROM_CORR_ROM_PATCH_ROW5_MSB_ADDR A:0xa4384
y.create.l HWIO_QFPROM_CORR_ROM_PATCH_ROW6_MSB_ADDR A:0xa438c
y.create.l HWIO_QFPROM_CORR_ROM_PATCH_ROW7_MSB_ADDR A:0xa4394
y.create.l HWIO_QFPROM_CORR_ROM_PATCH_ROW8_MSB_ADDR A:0xa439c
y.create.l HWIO_QFPROM_CORR_ROM_PATCH_ROW9_MSB_ADDR A:0xa43a4
y.create.l HWIO_QFPROM_CORR_IMAGE_ENCR_KEY1_ROW0_LSB_ADDR A:0xa4478
y.create.l HWIO_QFPROM_CORR_IMAGE_ENCR_KEY1_ROW1_LSB_ADDR A:0xa4480
y.create.l HWIO_QFPROM_CORR_IMAGE_ENCR_KEY1_ROW0_MSB_ADDR A:0xa447c
y.create.l HWIO_QFPROM_CORR_IMAGE_ENCR_KEY1_ROW1_MSB_ADDR A:0xa4484
y.create.l HWIO_QFPROM_CORR_IMAGE_ENCR_KEY1_ROW2_LSB_ADDR A:0xa4488
y.create.l HWIO_QFPROM_CORR_IMAGE_ENCR_KEY1_ROW2_MSB_ADDR A:0xa448c
y.create.l HWIO_QFPROM_CORR_USER_DATA_KEY_ROW0_LSB_ADDR A:0xa4490
y.create.l HWIO_QFPROM_CORR_USER_DATA_KEY_ROW1_LSB_ADDR A:0xa4498
y.create.l HWIO_QFPROM_CORR_USER_DATA_KEY_ROW2_LSB_ADDR A:0xa44a0
y.create.l HWIO_QFPROM_CORR_USER_DATA_KEY_ROW3_LSB_ADDR A:0xa44a8
y.create.l HWIO_QFPROM_CORR_USER_DATA_KEY_ROW0_MSB_ADDR A:0xa4494
y.create.l HWIO_QFPROM_CORR_USER_DATA_KEY_ROW1_MSB_ADDR A:0xa449c
y.create.l HWIO_QFPROM_CORR_USER_DATA_KEY_ROW2_MSB_ADDR A:0xa44a4
y.create.l HWIO_QFPROM_CORR_USER_DATA_KEY_ROW3_MSB_ADDR A:0xa44ac
y.create.l HWIO_QFPROM_CORR_USER_DATA_KEY_ROW4_LSB_ADDR A:0xa44b0
y.create.l HWIO_QFPROM_CORR_USER_DATA_KEY_ROW4_MSB_ADDR A:0xa44b4
y.create.l HWIO_QFPROM_CORR_OEM_SPARE_REG26_ROW0_LSB_ADDR A:0xa44b8
y.create.l HWIO_QFPROM_CORR_OEM_SPARE_REG27_ROW0_LSB_ADDR A:0xa44c8
y.create.l HWIO_QFPROM_CORR_OEM_SPARE_REG28_ROW0_LSB_ADDR A:0xa44d8
y.create.l HWIO_QFPROM_CORR_OEM_SPARE_REG29_ROW0_LSB_ADDR A:0xa44e8
y.create.l HWIO_QFPROM_CORR_OEM_SPARE_REG26_ROW0_MSB_ADDR A:0xa44bc
y.create.l HWIO_QFPROM_CORR_OEM_SPARE_REG27_ROW0_MSB_ADDR A:0xa44cc
y.create.l HWIO_QFPROM_CORR_OEM_SPARE_REG28_ROW0_MSB_ADDR A:0xa44dc
y.create.l HWIO_QFPROM_CORR_OEM_SPARE_REG29_ROW0_MSB_ADDR A:0xa44ec
y.create.l HWIO_QFPROM_CORR_OEM_SPARE_REG26_ROW1_LSB_ADDR A:0xa44c0
y.create.l HWIO_QFPROM_CORR_OEM_SPARE_REG27_ROW1_LSB_ADDR A:0xa44d0
y.create.l HWIO_QFPROM_CORR_OEM_SPARE_REG28_ROW1_LSB_ADDR A:0xa44e0
y.create.l HWIO_QFPROM_CORR_OEM_SPARE_REG29_ROW1_LSB_ADDR A:0xa44f0
y.create.l HWIO_QFPROM_CORR_OEM_SPARE_REG26_ROW1_MSB_ADDR A:0xa44c4
y.create.l HWIO_QFPROM_CORR_OEM_SPARE_REG27_ROW1_MSB_ADDR A:0xa44d4
y.create.l HWIO_QFPROM_CORR_OEM_SPARE_REG28_ROW1_MSB_ADDR A:0xa44e4
y.create.l HWIO_QFPROM_CORR_OEM_SPARE_REG29_ROW1_MSB_ADDR A:0xa44f4
y.create.l HWIO_QFPROM_CORR_OEM_SPARE_REG30_ROW_LSB_ADDR A:0xa44f8
y.create.l HWIO_QFPROM_CORR_OEM_SPARE_REG30_ROW_MSB_ADDR A:0xa44fc
y.create.l HWIO_SEC_CTRL_HW_VERSION_ADDR A:0xa6000
y.create.l HWIO_FEATURE_CONFIG0_ADDR A:0xa6004
y.create.l HWIO_FEATURE_CONFIG1_ADDR A:0xa6008
y.create.l HWIO_FEATURE_CONFIG2_ADDR A:0xa600c
y.create.l HWIO_FEATURE_CONFIG3_ADDR A:0xa6010
y.create.l HWIO_FEATURE_CONFIG4_ADDR A:0xa6014
y.create.l HWIO_FEATURE_CONFIG5_ADDR A:0xa6018
y.create.l HWIO_FEATURE_CONFIG6_ADDR A:0xa601c
y.create.l HWIO_FEATURE_CONFIG7_ADDR A:0xa6020
y.create.l HWIO_FEATURE_CONFIG8_ADDR A:0xa6024
y.create.l HWIO_FEATURE_CONFIG9_ADDR A:0xa6028
y.create.l HWIO_FEATURE_CONFIG10_ADDR A:0xa602c
y.create.l HWIO_FEATURE_CONFIG11_ADDR A:0xa6030
y.create.l HWIO_FEATURE_CONFIG12_ADDR A:0xa6034
y.create.l HWIO_FEATURE_CONFIG13_ADDR A:0xa6038
y.create.l HWIO_OEM_CONFIG0_ADDR A:0xa6040
y.create.l HWIO_OEM_CONFIG1_ADDR A:0xa6044
y.create.l HWIO_OEM_CONFIG2_ADDR A:0xa6048
y.create.l HWIO_OEM_CONFIG3_ADDR A:0xa604c
y.create.l HWIO_OEM_CONFIG4_ADDR A:0xa6050
y.create.l HWIO_OEM_CONFIG5_ADDR A:0xa6054
y.create.l HWIO_BOOT_CONFIG_ADDR A:0xa6070
y.create.l HWIO_SECURE_BOOT1_ADDR A:0xa607c
y.create.l HWIO_SECURE_BOOT2_ADDR A:0xa6080
y.create.l HWIO_SECURE_BOOT3_ADDR A:0xa6084
y.create.l HWIO_SECURE_BOOT4_ADDR A:0xa6088
y.create.l HWIO_SECURE_BOOT5_ADDR A:0xa608c
y.create.l HWIO_SECURE_BOOT6_ADDR A:0xa6090
y.create.l HWIO_SECURE_BOOT7_ADDR A:0xa6094
y.create.l HWIO_SECURE_BOOT8_ADDR A:0xa6098
y.create.l HWIO_SECURE_BOOT9_ADDR A:0xa609c
y.create.l HWIO_SECURE_BOOT10_ADDR A:0xa60a0
y.create.l HWIO_QSEE_INV_OVERRIDE_ADDR A:0xa60c0
y.create.l HWIO_QSEE_NI_OVERRIDE_ADDR A:0xa60c4
y.create.l HWIO_MSS_INV_OVERRIDE_ADDR A:0xa60c8
y.create.l HWIO_MSS_NI_OVERRIDE_ADDR A:0xa60cc
y.create.l HWIO_CP_INV_OVERRIDE_ADDR A:0xa60d0
y.create.l HWIO_CP_NI_OVERRIDE_ADDR A:0xa60d4
y.create.l HWIO_NS_INV_OVERRIDE_ADDR A:0xa60d8
y.create.l HWIO_NS_NI_OVERRIDE_ADDR A:0xa60dc
y.create.l HWIO_MISC_DEBUG_OVERRIDE_ADDR A:0xa60e0
y.create.l HWIO_CAPT_SEC_GPIO_ADDR A:0xa6100
y.create.l HWIO_APP_PROC_CFG_ADDR A:0xa6110
y.create.l HWIO_MSS_PROC_CFG_ADDR A:0xa6114
y.create.l HWIO_QFPROM_CLK_CTL_ADDR A:0xa6118
y.create.l HWIO_JTAG_ID_ADDR A:0xa6130
y.create.l HWIO_SERIAL_NUM_ADDR A:0xa6134
y.create.l HWIO_OEM_ID_ADDR A:0xa6138
y.create.l HWIO_TEST_BUS_SEL_ADDR A:0xa613c
y.create.l HWIO_SPDM_DYN_SECURE_MODE_ADDR A:0xa6140
y.create.l HWIO_CHIP_ID_ADDR A:0xa6144
y.create.l HWIO_OEM_IMAGE_ENCR_KEY0_ADDR A:0xa6150
y.create.l HWIO_OEM_IMAGE_ENCR_KEY1_ADDR A:0xa6154
y.create.l HWIO_OEM_IMAGE_ENCR_KEY2_ADDR A:0xa6158
y.create.l HWIO_OEM_IMAGE_ENCR_KEY3_ADDR A:0xa615c
y.create.l HWIO_IMAGE_ENCR_KEY1_0_ADDR A:0xa6160
y.create.l HWIO_IMAGE_ENCR_KEY1_1_ADDR A:0xa6164
y.create.l HWIO_IMAGE_ENCR_KEY1_2_ADDR A:0xa6168
y.create.l HWIO_IMAGE_ENCR_KEY1_3_ADDR A:0xa616c
y.create.l HWIO_PK_HASH0_0_ADDR A:0xa6190
y.create.l HWIO_PK_HASH0_1_ADDR A:0xa6194
y.create.l HWIO_PK_HASH0_2_ADDR A:0xa6198
y.create.l HWIO_PK_HASH0_3_ADDR A:0xa619c
y.create.l HWIO_PK_HASH0_4_ADDR A:0xa61a0
y.create.l HWIO_PK_HASH0_5_ADDR A:0xa61a4
y.create.l HWIO_PK_HASH0_6_ADDR A:0xa61a8
y.create.l HWIO_PK_HASH0_7_ADDR A:0xa61ac
y.create.l HWIO_PK_HASH0_8_ADDR A:0xa61b0
y.create.l HWIO_PK_HASH0_9_ADDR A:0xa61b4
y.create.l HWIO_PK_HASH0_10_ADDR A:0xa61b8
y.create.l HWIO_PK_HASH0_11_ADDR A:0xa61bc
y.create.l HWIO_QFPROM_WRITE_DISABLE_STICKY_BIT0_ADDR A:0xa61f0
y.create.l HWIO_QFPROM_WRITE_DISABLE_STICKY_BIT1_ADDR A:0xa61f4
y.create.l HWIO_ANTI_ROLLBACK_1_0_ADDR A:0xa6200
y.create.l HWIO_ANTI_ROLLBACK_1_1_ADDR A:0xa6204
y.create.l HWIO_ANTI_ROLLBACK_2_0_ADDR A:0xa6208
y.create.l HWIO_ANTI_ROLLBACK_2_1_ADDR A:0xa620c
y.create.l HWIO_ANTI_ROLLBACK_3_0_ADDR A:0xa6210
y.create.l HWIO_ANTI_ROLLBACK_3_1_ADDR A:0xa6214
y.create.l HWIO_ANTI_ROLLBACK_4_0_ADDR A:0xa6218
y.create.l HWIO_ANTI_ROLLBACK_4_1_ADDR A:0xa621c
y.create.l HWIO_ANTI_ROLLBACK_5_0_ADDR A:0xa6220
y.create.l HWIO_ANTI_ROLLBACK_5_1_ADDR A:0xa6224
y.create.l HWIO_MRC_2_0_0_ADDR A:0xa6250
y.create.l HWIO_MRC_2_0_1_ADDR A:0xa6254
y.create.l HWIO_MRC_2_0_2_ADDR A:0xa6258
y.create.l HWIO_MRC_2_0_3_ADDR A:0xa625c
y.create.l HWIO_CRYPTO_LIB_VERSION_ADDR A:0xa6300
y.create.l HWIO_LCM_0_ADDR A:0xa6304
y.create.l HWIO_LCM_1_ADDR A:0xa6308
y.create.l HWIO_VIRTUAL_SEC_CTRL_BASE_ADDR_ADDR A:0xa6400
y.create.l HWIO_SECURE_CHANNEL_REG_BASE_START_ADDR A:0xa8000
y.create.l HWIO_SECURE_CHANNEL_REG_BASE_LAST_ADDR A:0xaac24
y.create.l HWIO_SECURE_CHANNEL_REG_BASE_END_ADDR A:0xab000
y.create.l HWIO_KEY_CTRL_EE0_VERSION_ADDR A:0xa8000
y.create.l HWIO_KEY_CTRL_EE1_VERSION_ADDR A:0xa9000
y.create.l HWIO_KEY_CTRL_EE2_VERSION_ADDR A:0xaa000
y.create.l HWIO_KEY_CTRL_EE0_HW_PARAMS_ADDR A:0xa8004
y.create.l HWIO_KEY_CTRL_EE1_HW_PARAMS_ADDR A:0xa9004
y.create.l HWIO_KEY_CTRL_EE2_HW_PARAMS_ADDR A:0xaa004
y.create.l HWIO_KEY_CTRL_EE0_HW_PARAMS2_ADDR A:0xa8008
y.create.l HWIO_KEY_CTRL_EE1_HW_PARAMS2_ADDR A:0xa9008
y.create.l HWIO_KEY_CTRL_EE2_HW_PARAMS2_ADDR A:0xaa008
y.create.l HWIO_KEY_CTRL_EE0_COMMAND_INFO_IDX0_ADDR A:0xa8010
y.create.l HWIO_KEY_CTRL_EE1_COMMAND_INFO_IDX0_ADDR A:0xa9010
y.create.l HWIO_KEY_CTRL_EE2_COMMAND_INFO_IDX0_ADDR A:0xaa010
y.create.l HWIO_KEY_CTRL_EE0_USAGE_RULES_ADDR A:0xa8018
y.create.l HWIO_KEY_CTRL_EE1_USAGE_RULES_ADDR A:0xa9018
y.create.l HWIO_KEY_CTRL_EE2_USAGE_RULES_ADDR A:0xaa018
y.create.l HWIO_KEY_CTRL_EE0_IRQ_MASK_ADDR A:0xa801c
y.create.l HWIO_KEY_CTRL_EE1_IRQ_MASK_ADDR A:0xa901c
y.create.l HWIO_KEY_CTRL_EE2_IRQ_MASK_ADDR A:0xaa01c
y.create.l HWIO_KEY_CTRL_EE0_KDF_CNTXT0_ADDR A:0xa8020
y.create.l HWIO_KEY_CTRL_EE0_KDF_CNTXT1_ADDR A:0xa8024
y.create.l HWIO_KEY_CTRL_EE0_KDF_CNTXT2_ADDR A:0xa8028
y.create.l HWIO_KEY_CTRL_EE0_KDF_CNTXT3_ADDR A:0xa802c
y.create.l HWIO_KEY_CTRL_EE1_KDF_CNTXT0_ADDR A:0xa9020
y.create.l HWIO_KEY_CTRL_EE1_KDF_CNTXT1_ADDR A:0xa9024
y.create.l HWIO_KEY_CTRL_EE1_KDF_CNTXT2_ADDR A:0xa9028
y.create.l HWIO_KEY_CTRL_EE1_KDF_CNTXT3_ADDR A:0xa902c
y.create.l HWIO_KEY_CTRL_EE2_KDF_CNTXT0_ADDR A:0xaa020
y.create.l HWIO_KEY_CTRL_EE2_KDF_CNTXT1_ADDR A:0xaa024
y.create.l HWIO_KEY_CTRL_EE2_KDF_CNTXT2_ADDR A:0xaa028
y.create.l HWIO_KEY_CTRL_EE2_KDF_CNTXT3_ADDR A:0xaa02c
y.create.l HWIO_KEY_CTRL_EE0_CACHE0INFO_IDX0_ADDR A:0xa8040
y.create.l HWIO_KEY_CTRL_EE0_CACHE1INFO_IDX0_ADDR A:0xa8050
y.create.l HWIO_KEY_CTRL_EE0_CACHE2INFO_IDX0_ADDR A:0xa8060
y.create.l HWIO_KEY_CTRL_EE0_CACHE3INFO_IDX0_ADDR A:0xa8070
y.create.l HWIO_KEY_CTRL_EE1_CACHE0INFO_IDX0_ADDR A:0xa9040
y.create.l HWIO_KEY_CTRL_EE1_CACHE1INFO_IDX0_ADDR A:0xa9050
y.create.l HWIO_KEY_CTRL_EE1_CACHE2INFO_IDX0_ADDR A:0xa9060
y.create.l HWIO_KEY_CTRL_EE1_CACHE3INFO_IDX0_ADDR A:0xa9070
y.create.l HWIO_KEY_CTRL_EE2_CACHE0INFO_IDX0_ADDR A:0xaa040
y.create.l HWIO_KEY_CTRL_EE2_CACHE1INFO_IDX0_ADDR A:0xaa050
y.create.l HWIO_KEY_CTRL_EE2_CACHE2INFO_IDX0_ADDR A:0xaa060
y.create.l HWIO_KEY_CTRL_EE2_CACHE3INFO_IDX0_ADDR A:0xaa070
y.create.l HWIO_KEY_CTRL_EE0_CACHE0INFO_IDX1_ADDR A:0xa8044
y.create.l HWIO_KEY_CTRL_EE0_CACHE1INFO_IDX1_ADDR A:0xa8054
y.create.l HWIO_KEY_CTRL_EE0_CACHE2INFO_IDX1_ADDR A:0xa8064
y.create.l HWIO_KEY_CTRL_EE0_CACHE3INFO_IDX1_ADDR A:0xa8074
y.create.l HWIO_KEY_CTRL_EE1_CACHE0INFO_IDX1_ADDR A:0xa9044
y.create.l HWIO_KEY_CTRL_EE1_CACHE1INFO_IDX1_ADDR A:0xa9054
y.create.l HWIO_KEY_CTRL_EE1_CACHE2INFO_IDX1_ADDR A:0xa9064
y.create.l HWIO_KEY_CTRL_EE1_CACHE3INFO_IDX1_ADDR A:0xa9074
y.create.l HWIO_KEY_CTRL_EE2_CACHE0INFO_IDX1_ADDR A:0xaa044
y.create.l HWIO_KEY_CTRL_EE2_CACHE1INFO_IDX1_ADDR A:0xaa054
y.create.l HWIO_KEY_CTRL_EE2_CACHE2INFO_IDX1_ADDR A:0xaa064
y.create.l HWIO_KEY_CTRL_EE2_CACHE3INFO_IDX1_ADDR A:0xaa074
y.create.l HWIO_KEY_CTRL_EE0_CACHE0INFO_IDX2_ADDR A:0xa8048
y.create.l HWIO_KEY_CTRL_EE0_CACHE1INFO_IDX2_ADDR A:0xa8058
y.create.l HWIO_KEY_CTRL_EE0_CACHE2INFO_IDX2_ADDR A:0xa8068
y.create.l HWIO_KEY_CTRL_EE0_CACHE3INFO_IDX2_ADDR A:0xa8078
y.create.l HWIO_KEY_CTRL_EE1_CACHE0INFO_IDX2_ADDR A:0xa9048
y.create.l HWIO_KEY_CTRL_EE1_CACHE1INFO_IDX2_ADDR A:0xa9058
y.create.l HWIO_KEY_CTRL_EE1_CACHE2INFO_IDX2_ADDR A:0xa9068
y.create.l HWIO_KEY_CTRL_EE1_CACHE3INFO_IDX2_ADDR A:0xa9078
y.create.l HWIO_KEY_CTRL_EE2_CACHE0INFO_IDX2_ADDR A:0xaa048
y.create.l HWIO_KEY_CTRL_EE2_CACHE1INFO_IDX2_ADDR A:0xaa058
y.create.l HWIO_KEY_CTRL_EE2_CACHE2INFO_IDX2_ADDR A:0xaa068
y.create.l HWIO_KEY_CTRL_EE2_CACHE3INFO_IDX2_ADDR A:0xaa078
y.create.l HWIO_KEY_CTRL_EE0_DEBUG_ENABLE_ADDR A:0xa8100
y.create.l HWIO_KEY_CTRL_EE1_DEBUG_ENABLE_ADDR A:0xa9100
y.create.l HWIO_KEY_CTRL_EE2_DEBUG_ENABLE_ADDR A:0xaa100
y.create.l HWIO_KEY_CTRL_EE0_DEBUG_BUS_ADDR A:0xa8104
y.create.l HWIO_KEY_CTRL_EE1_DEBUG_BUS_ADDR A:0xa9104
y.create.l HWIO_KEY_CTRL_EE2_DEBUG_BUS_ADDR A:0xaa104
y.create.l HWIO_KEY_CTRL_EE0_STATUS_ADDR A:0xa8400
y.create.l HWIO_KEY_CTRL_EE1_STATUS_ADDR A:0xa9400
y.create.l HWIO_KEY_CTRL_EE2_STATUS_ADDR A:0xaa400
y.create.l HWIO_KEY_CTRL_EE0_LOCK_ADDR A:0xa8404
y.create.l HWIO_KEY_CTRL_EE1_LOCK_ADDR A:0xa9404
y.create.l HWIO_KEY_CTRL_EE2_LOCK_ADDR A:0xaa404
y.create.l HWIO_KEY_CTRL_EE0_COMMAND_ADDR A:0xa8408
y.create.l HWIO_KEY_CTRL_EE1_COMMAND_ADDR A:0xa9408
y.create.l HWIO_KEY_CTRL_EE2_COMMAND_ADDR A:0xaa408
y.create.l HWIO_KEY_CTRL_EE0_KEY_INFO_ADDR A:0xa840c
y.create.l HWIO_KEY_CTRL_EE1_KEY_INFO_ADDR A:0xa940c
y.create.l HWIO_KEY_CTRL_EE2_KEY_INFO_ADDR A:0xaa40c
y.create.l HWIO_KEY_CTRL_EE0_KEY_IDX0_ADDR A:0xa8410
y.create.l HWIO_KEY_CTRL_EE0_KEY_IDX1_ADDR A:0xa8414
y.create.l HWIO_KEY_CTRL_EE0_KEY_IDX2_ADDR A:0xa8418
y.create.l HWIO_KEY_CTRL_EE0_KEY_IDX3_ADDR A:0xa841c
y.create.l HWIO_KEY_CTRL_EE1_KEY_IDX0_ADDR A:0xa9410
y.create.l HWIO_KEY_CTRL_EE1_KEY_IDX1_ADDR A:0xa9414
y.create.l HWIO_KEY_CTRL_EE1_KEY_IDX2_ADDR A:0xa9418
y.create.l HWIO_KEY_CTRL_EE1_KEY_IDX3_ADDR A:0xa941c
y.create.l HWIO_KEY_CTRL_EE2_KEY_IDX0_ADDR A:0xaa410
y.create.l HWIO_KEY_CTRL_EE2_KEY_IDX1_ADDR A:0xaa414
y.create.l HWIO_KEY_CTRL_EE2_KEY_IDX2_ADDR A:0xaa418
y.create.l HWIO_KEY_CTRL_EE2_KEY_IDX3_ADDR A:0xaa41c
y.create.l HWIO_CRI_CM_EE0_CHIP_SERIES_ADDR A:0xa8800
y.create.l HWIO_CRI_CM_EE1_CHIP_SERIES_ADDR A:0xa9800
y.create.l HWIO_CRI_CM_EE2_CHIP_SERIES_ADDR A:0xaa800
y.create.l HWIO_CRI_CM_EE0_VERSION_ADDR A:0xa8804
y.create.l HWIO_CRI_CM_EE1_VERSION_ADDR A:0xa9804
y.create.l HWIO_CRI_CM_EE2_VERSION_ADDR A:0xaa804
y.create.l HWIO_CRI_CM_EE0_DEVICE_ID_0_ADDR A:0xa88f0
y.create.l HWIO_CRI_CM_EE1_DEVICE_ID_0_ADDR A:0xa98f0
y.create.l HWIO_CRI_CM_EE2_DEVICE_ID_0_ADDR A:0xaa8f0
y.create.l HWIO_CRI_CM_EE0_DEVICE_ID_1_ADDR A:0xa88f4
y.create.l HWIO_CRI_CM_EE1_DEVICE_ID_1_ADDR A:0xa98f4
y.create.l HWIO_CRI_CM_EE2_DEVICE_ID_1_ADDR A:0xaa8f4
y.create.l HWIO_CRI_CM_EE0_PADAK_ID_0_ADDR A:0xa88f8
y.create.l HWIO_CRI_CM_EE1_PADAK_ID_0_ADDR A:0xa98f8
y.create.l HWIO_CRI_CM_EE2_PADAK_ID_0_ADDR A:0xaa8f8
y.create.l HWIO_CRI_CM_EE0_PADAK_ID_1_ADDR A:0xa88fc
y.create.l HWIO_CRI_CM_EE1_PADAK_ID_1_ADDR A:0xa98fc
y.create.l HWIO_CRI_CM_EE2_PADAK_ID_1_ADDR A:0xaa8fc
y.create.l HWIO_CRI_CM_EE0_CONFIG_0_ADDR A:0xa88e0
y.create.l HWIO_CRI_CM_EE1_CONFIG_0_ADDR A:0xa98e0
y.create.l HWIO_CRI_CM_EE2_CONFIG_0_ADDR A:0xaa8e0
y.create.l HWIO_CRI_CM_EE0_CONFIG_1_ADDR A:0xa88e4
y.create.l HWIO_CRI_CM_EE1_CONFIG_1_ADDR A:0xa98e4
y.create.l HWIO_CRI_CM_EE2_CONFIG_1_ADDR A:0xaa8e4
y.create.l HWIO_CRI_CM_EE0_CONFIG_2_ADDR A:0xa88e8
y.create.l HWIO_CRI_CM_EE1_CONFIG_2_ADDR A:0xa98e8
y.create.l HWIO_CRI_CM_EE2_CONFIG_2_ADDR A:0xaa8e8
y.create.l HWIO_CRI_CM_EE0_CONFIG_3_ADDR A:0xa88ec
y.create.l HWIO_CRI_CM_EE1_CONFIG_3_ADDR A:0xa98ec
y.create.l HWIO_CRI_CM_EE2_CONFIG_3_ADDR A:0xaa8ec
y.create.l HWIO_CRI_CM_EE0_STATUS_SUMMARY_ADDR A:0xa8808
y.create.l HWIO_CRI_CM_EE1_STATUS_SUMMARY_ADDR A:0xa9808
y.create.l HWIO_CRI_CM_EE2_STATUS_SUMMARY_ADDR A:0xaa808
y.create.l HWIO_CRI_CM_EE0_STATUS_FLAGS_ADDR A:0xa880c
y.create.l HWIO_CRI_CM_EE1_STATUS_FLAGS_ADDR A:0xa980c
y.create.l HWIO_CRI_CM_EE2_STATUS_FLAGS_ADDR A:0xaa80c
y.create.l HWIO_CRI_CM_EE0_STATUS_REGWRITE_COUNT_ADDR A:0xa8810
y.create.l HWIO_CRI_CM_EE1_STATUS_REGWRITE_COUNT_ADDR A:0xa9810
y.create.l HWIO_CRI_CM_EE2_STATUS_REGWRITE_COUNT_ADDR A:0xaa810
y.create.l HWIO_CRI_CM_EE0_STATUS_KEYS_ADDR A:0xa8814
y.create.l HWIO_CRI_CM_EE1_STATUS_KEYS_ADDR A:0xa9814
y.create.l HWIO_CRI_CM_EE2_STATUS_KEYS_ADDR A:0xaa814
y.create.l HWIO_CRI_CM_EE0_STATUS_KEYS_2_ADDR A:0xa8838
y.create.l HWIO_CRI_CM_EE1_STATUS_KEYS_2_ADDR A:0xa9838
y.create.l HWIO_CRI_CM_EE2_STATUS_KEYS_2_ADDR A:0xaa838
y.create.l HWIO_CRI_CM_EE0_ERROR_SEQ_ADDR A:0xa8834
y.create.l HWIO_CRI_CM_EE1_ERROR_SEQ_ADDR A:0xa9834
y.create.l HWIO_CRI_CM_EE2_ERROR_SEQ_ADDR A:0xaa834
y.create.l HWIO_CRI_CM_EE0_ERROR_INFO_ADDR A:0xa8818
y.create.l HWIO_CRI_CM_EE1_ERROR_INFO_ADDR A:0xa9818
y.create.l HWIO_CRI_CM_EE2_ERROR_INFO_ADDR A:0xaa818
y.create.l HWIO_CRI_CM_EE0_ERROR_OTP_ADDR A:0xa881c
y.create.l HWIO_CRI_CM_EE1_ERROR_OTP_ADDR A:0xa981c
y.create.l HWIO_CRI_CM_EE2_ERROR_OTP_ADDR A:0xaa81c
y.create.l HWIO_CRI_CM_EE0_INIT_ERROR_ADDR_ADDR A:0xa8860
y.create.l HWIO_CRI_CM_EE1_INIT_ERROR_ADDR_ADDR A:0xa9860
y.create.l HWIO_CRI_CM_EE2_INIT_ERROR_ADDR_ADDR A:0xaa860
y.create.l HWIO_CRI_CM_EE0_INIT_ERROR_INFO_ADDR A:0xa8864
y.create.l HWIO_CRI_CM_EE1_INIT_ERROR_INFO_ADDR A:0xa9864
y.create.l HWIO_CRI_CM_EE2_INIT_ERROR_INFO_ADDR A:0xaa864
y.create.l HWIO_CRI_CM_EE0_INIT_ERROR_OTP_ADDR A:0xa8868
y.create.l HWIO_CRI_CM_EE1_INIT_ERROR_OTP_ADDR A:0xa9868
y.create.l HWIO_CRI_CM_EE2_INIT_ERROR_OTP_ADDR A:0xaa868
y.create.l HWIO_CRI_CM_EE0_OTPCMD_ERROR_ADDR_ADDR A:0xa8870
y.create.l HWIO_CRI_CM_EE1_OTPCMD_ERROR_ADDR_ADDR A:0xa9870
y.create.l HWIO_CRI_CM_EE2_OTPCMD_ERROR_ADDR_ADDR A:0xaa870
y.create.l HWIO_CRI_CM_EE0_OTPCMD_ERROR_INFO_ADDR A:0xa8874
y.create.l HWIO_CRI_CM_EE1_OTPCMD_ERROR_INFO_ADDR A:0xa9874
y.create.l HWIO_CRI_CM_EE2_OTPCMD_ERROR_INFO_ADDR A:0xaa874
y.create.l HWIO_CRI_CM_EE0_OTPCMD_ERROR_OTP_ADDR A:0xa8878
y.create.l HWIO_CRI_CM_EE1_OTPCMD_ERROR_OTP_ADDR A:0xa9878
y.create.l HWIO_CRI_CM_EE2_OTPCMD_ERROR_OTP_ADDR A:0xaa878
y.create.l HWIO_CRI_CM_EE0_TRNG_ERROR_ADDR A:0xa883c
y.create.l HWIO_CRI_CM_EE1_TRNG_ERROR_ADDR A:0xa983c
y.create.l HWIO_CRI_CM_EE2_TRNG_ERROR_ADDR A:0xaa83c
y.create.l HWIO_CRI_CM_EE0_TRNG_CTRL_1_ADDR A:0xa88d0
y.create.l HWIO_CRI_CM_EE1_TRNG_CTRL_1_ADDR A:0xa98d0
y.create.l HWIO_CRI_CM_EE2_TRNG_CTRL_1_ADDR A:0xaa8d0
y.create.l HWIO_CRI_CM_EE0_TRNG_CTRL_2_ADDR A:0xa88d4
y.create.l HWIO_CRI_CM_EE1_TRNG_CTRL_2_ADDR A:0xa98d4
y.create.l HWIO_CRI_CM_EE2_TRNG_CTRL_2_ADDR A:0xaa8d4
y.create.l HWIO_CRI_CM_EE0_IRQ_CONTROL_ADDR A:0xa8820
y.create.l HWIO_CRI_CM_EE1_IRQ_CONTROL_ADDR A:0xa9820
y.create.l HWIO_CRI_CM_EE2_IRQ_CONTROL_ADDR A:0xaa820
y.create.l HWIO_CRI_CM_EE0_IRQ_STATUS_ADDR A:0xa8824
y.create.l HWIO_CRI_CM_EE1_IRQ_STATUS_ADDR A:0xa9824
y.create.l HWIO_CRI_CM_EE2_IRQ_STATUS_ADDR A:0xaa824
y.create.l HWIO_CRI_CM_EE0_CONTROL_ADDR A:0xa8828
y.create.l HWIO_CRI_CM_EE1_CONTROL_ADDR A:0xa9828
y.create.l HWIO_CRI_CM_EE2_CONTROL_ADDR A:0xaa828
y.create.l HWIO_CRI_CM_EE0_SEQUENCE_INPUT_ADDR A:0xa882c
y.create.l HWIO_CRI_CM_EE1_SEQUENCE_INPUT_ADDR A:0xa982c
y.create.l HWIO_CRI_CM_EE2_SEQUENCE_INPUT_ADDR A:0xaa82c
y.create.l HWIO_CRI_CM_EE0_SEQUENCE_OUTPUT_ADDR A:0xa8830
y.create.l HWIO_CRI_CM_EE1_SEQUENCE_OUTPUT_ADDR A:0xa9830
y.create.l HWIO_CRI_CM_EE2_SEQUENCE_OUTPUT_ADDR A:0xaa830
y.create.l HWIO_CRI_CM_EE0_SW_BUFFER_0_ADDR A:0xa8880
y.create.l HWIO_CRI_CM_EE0_SW_BUFFER_1_ADDR A:0xa8884
y.create.l HWIO_CRI_CM_EE0_SW_BUFFER_2_ADDR A:0xa8888
y.create.l HWIO_CRI_CM_EE0_SW_BUFFER_3_ADDR A:0xa888c
y.create.l HWIO_CRI_CM_EE1_SW_BUFFER_0_ADDR A:0xa9880
y.create.l HWIO_CRI_CM_EE1_SW_BUFFER_1_ADDR A:0xa9884
y.create.l HWIO_CRI_CM_EE1_SW_BUFFER_2_ADDR A:0xa9888
y.create.l HWIO_CRI_CM_EE1_SW_BUFFER_3_ADDR A:0xa988c
y.create.l HWIO_CRI_CM_EE2_SW_BUFFER_0_ADDR A:0xaa880
y.create.l HWIO_CRI_CM_EE2_SW_BUFFER_1_ADDR A:0xaa884
y.create.l HWIO_CRI_CM_EE2_SW_BUFFER_2_ADDR A:0xaa888
y.create.l HWIO_CRI_CM_EE2_SW_BUFFER_3_ADDR A:0xaa88c
y.create.l HWIO_CRI_CM_EE0_DIRECTREAD_FEATURE_REQ_ADDR A:0xa8840
y.create.l HWIO_CRI_CM_EE1_DIRECTREAD_FEATURE_REQ_ADDR A:0xa9840
y.create.l HWIO_CRI_CM_EE2_DIRECTREAD_FEATURE_REQ_ADDR A:0xaa840
y.create.l HWIO_CRI_CM_EE0_DIRECTREAD_FEATURE_STATUS_ADDR A:0xa8844
y.create.l HWIO_CRI_CM_EE1_DIRECTREAD_FEATURE_STATUS_ADDR A:0xa9844
y.create.l HWIO_CRI_CM_EE2_DIRECTREAD_FEATURE_STATUS_ADDR A:0xaa844
y.create.l HWIO_CRI_CM_EE0_DIRECTREAD_FEATURE_DATA_ADDR A:0xa8848
y.create.l HWIO_CRI_CM_EE1_DIRECTREAD_FEATURE_DATA_ADDR A:0xa9848
y.create.l HWIO_CRI_CM_EE2_DIRECTREAD_FEATURE_DATA_ADDR A:0xaa848
y.create.l HWIO_CRI_CM_EE0_DIRECTREAD_OTP_REQ_ADDR A:0xa8850
y.create.l HWIO_CRI_CM_EE1_DIRECTREAD_OTP_REQ_ADDR A:0xa9850
y.create.l HWIO_CRI_CM_EE2_DIRECTREAD_OTP_REQ_ADDR A:0xaa850
y.create.l HWIO_CRI_CM_EE0_DIRECTREAD_OTP_STATUS_ADDR A:0xa8854
y.create.l HWIO_CRI_CM_EE1_DIRECTREAD_OTP_STATUS_ADDR A:0xa9854
y.create.l HWIO_CRI_CM_EE2_DIRECTREAD_OTP_STATUS_ADDR A:0xaa854
y.create.l HWIO_CRI_CM_EE0_DIRECTREAD_OTP_DATA_ADDR A:0xa8858
y.create.l HWIO_CRI_CM_EE1_DIRECTREAD_OTP_DATA_ADDR A:0xa9858
y.create.l HWIO_CRI_CM_EE2_DIRECTREAD_OTP_DATA_ADDR A:0xaa858
y.create.l HWIO_CRI_CM_EE0_DEVICE_ID_STATUS_ADDR A:0xa8c00
y.create.l HWIO_CRI_CM_EE1_DEVICE_ID_STATUS_ADDR A:0xa9c00
y.create.l HWIO_CRI_CM_EE2_DEVICE_ID_STATUS_ADDR A:0xaac00
y.create.l HWIO_CRI_CM_EE0_CHIP_ID_ADDR A:0xa8c0c
y.create.l HWIO_CRI_CM_EE1_CHIP_ID_ADDR A:0xa9c0c
y.create.l HWIO_CRI_CM_EE2_CHIP_ID_ADDR A:0xaac0c
y.create.l HWIO_CRI_CM_EE0_CHIP_SERIAL_NUM_ADDR A:0xa8c10
y.create.l HWIO_CRI_CM_EE1_CHIP_SERIAL_NUM_ADDR A:0xa9c10
y.create.l HWIO_CRI_CM_EE2_CHIP_SERIAL_NUM_ADDR A:0xaac10
y.create.l HWIO_CRI_CM_EE0_OEM_ID_ADDR A:0xa8c14
y.create.l HWIO_CRI_CM_EE1_OEM_ID_ADDR A:0xa9c14
y.create.l HWIO_CRI_CM_EE2_OEM_ID_ADDR A:0xaac14
y.create.l HWIO_CRI_CM_EE0_BIST_CTRL_0_ADDR A:0xa8c20
y.create.l HWIO_CRI_CM_EE1_BIST_CTRL_0_ADDR A:0xa9c20
y.create.l HWIO_CRI_CM_EE2_BIST_CTRL_0_ADDR A:0xaac20
y.create.l HWIO_CRI_CM_EE0_TRNG_CTRL_0_ADDR A:0xa8c24
y.create.l HWIO_CRI_CM_EE1_TRNG_CTRL_0_ADDR A:0xa9c24
y.create.l HWIO_CRI_CM_EE2_TRNG_CTRL_0_ADDR A:0xaac24
y.create.l HWIO_SEC_CTRL_APU_APU1132_19_REG_BASE_START_ADDR A:0xae000
y.create.l HWIO_SEC_CTRL_APU_APU1132_19_REG_BASE_LAST_ADDR A:0xaeb54
y.create.l HWIO_SEC_CTRL_APU_APU1132_19_REG_BASE_END_ADDR A:0xaeb80
y.create.l HWIO_SEC_CTRL_APU_XPU_SCR_ADDR A:0xae000
y.create.l HWIO_SEC_CTRL_APU_XPU_SWDR_ADDR A:0xae004
y.create.l HWIO_SEC_CTRL_APU_XPU_SEAR0_ADDR A:0xae040
y.create.l HWIO_SEC_CTRL_APU_XPU_SESR_ADDR A:0xae048
y.create.l HWIO_SEC_CTRL_APU_XPU_SESRRESTORE_ADDR A:0xae04c
y.create.l HWIO_SEC_CTRL_APU_XPU_SESYNR0_ADDR A:0xae050
y.create.l HWIO_SEC_CTRL_APU_XPU_SESYNR1_ADDR A:0xae054
y.create.l HWIO_SEC_CTRL_APU_XPU_SESYNR2_ADDR A:0xae058
y.create.l HWIO_SEC_CTRL_APU_XPU_MCR_ADDR A:0xae100
y.create.l HWIO_SEC_CTRL_APU_XPU_MEAR0_ADDR A:0xae140
y.create.l HWIO_SEC_CTRL_APU_XPU_MESR_ADDR A:0xae148
y.create.l HWIO_SEC_CTRL_APU_XPU_MESRRESTORE_ADDR A:0xae14c
y.create.l HWIO_SEC_CTRL_APU_XPU_MESYNR0_ADDR A:0xae150
y.create.l HWIO_SEC_CTRL_APU_XPU_MESYNR1_ADDR A:0xae154
y.create.l HWIO_SEC_CTRL_APU_XPU_MESYNR2_ADDR A:0xae158
y.create.l HWIO_SEC_CTRL_APU_XPU_CR_ADDR A:0xae080
y.create.l HWIO_SEC_CTRL_APU_XPU_RPU_ACR0_ADDR A:0xae0a0
y.create.l HWIO_SEC_CTRL_APU_XPU_EAR0_ADDR A:0xae0c0
y.create.l HWIO_SEC_CTRL_APU_XPU_ESR_ADDR A:0xae0c8
y.create.l HWIO_SEC_CTRL_APU_XPU_ESRRESTORE_ADDR A:0xae0cc
y.create.l HWIO_SEC_CTRL_APU_XPU_ESYNR0_ADDR A:0xae0d0
y.create.l HWIO_SEC_CTRL_APU_XPU_ESYNR1_ADDR A:0xae0d4
y.create.l HWIO_SEC_CTRL_APU_XPU_ESYNR2_ADDR A:0xae0d8
y.create.l HWIO_SEC_CTRL_APU_XPU_IDR0_ADDR A:0xae074
y.create.l HWIO_SEC_CTRL_APU_XPU_IDR1_ADDR A:0xae078
y.create.l HWIO_SEC_CTRL_APU_XPU_REV_ADDR A:0xae07c
y.create.l HWIO_SEC_CTRL_APU_XPU_RG0_RACR0_ADDR A:0xae200
y.create.l HWIO_SEC_CTRL_APU_XPU_RG1_RACR0_ADDR A:0xae280
y.create.l HWIO_SEC_CTRL_APU_XPU_RG2_RACR0_ADDR A:0xae300
y.create.l HWIO_SEC_CTRL_APU_XPU_RG3_RACR0_ADDR A:0xae380
y.create.l HWIO_SEC_CTRL_APU_XPU_RG4_RACR0_ADDR A:0xae400
y.create.l HWIO_SEC_CTRL_APU_XPU_RG5_RACR0_ADDR A:0xae480
y.create.l HWIO_SEC_CTRL_APU_XPU_RG6_RACR0_ADDR A:0xae500
y.create.l HWIO_SEC_CTRL_APU_XPU_RG7_RACR0_ADDR A:0xae580
y.create.l HWIO_SEC_CTRL_APU_XPU_RG8_RACR0_ADDR A:0xae600
y.create.l HWIO_SEC_CTRL_APU_XPU_RG9_RACR0_ADDR A:0xae680
y.create.l HWIO_SEC_CTRL_APU_XPU_RG0_WACR0_ADDR A:0xae220
y.create.l HWIO_SEC_CTRL_APU_XPU_RG1_WACR0_ADDR A:0xae2a0
y.create.l HWIO_SEC_CTRL_APU_XPU_RG2_WACR0_ADDR A:0xae320
y.create.l HWIO_SEC_CTRL_APU_XPU_RG3_WACR0_ADDR A:0xae3a0
y.create.l HWIO_SEC_CTRL_APU_XPU_RG4_WACR0_ADDR A:0xae420
y.create.l HWIO_SEC_CTRL_APU_XPU_RG5_WACR0_ADDR A:0xae4a0
y.create.l HWIO_SEC_CTRL_APU_XPU_RG6_WACR0_ADDR A:0xae520
y.create.l HWIO_SEC_CTRL_APU_XPU_RG7_WACR0_ADDR A:0xae5a0
y.create.l HWIO_SEC_CTRL_APU_XPU_RG8_WACR0_ADDR A:0xae620
y.create.l HWIO_SEC_CTRL_APU_XPU_RG9_WACR0_ADDR A:0xae6a0
y.create.l HWIO_SEC_CTRL_APU_XPU_RG0_SCR_ADDR A:0xae250
y.create.l HWIO_SEC_CTRL_APU_XPU_RG1_SCR_ADDR A:0xae2d0
y.create.l HWIO_SEC_CTRL_APU_XPU_RG2_SCR_ADDR A:0xae350
y.create.l HWIO_SEC_CTRL_APU_XPU_RG3_SCR_ADDR A:0xae3d0
y.create.l HWIO_SEC_CTRL_APU_XPU_RG4_SCR_ADDR A:0xae450
y.create.l HWIO_SEC_CTRL_APU_XPU_RG5_SCR_ADDR A:0xae4d0
y.create.l HWIO_SEC_CTRL_APU_XPU_RG6_SCR_ADDR A:0xae550
y.create.l HWIO_SEC_CTRL_APU_XPU_RG7_SCR_ADDR A:0xae5d0
y.create.l HWIO_SEC_CTRL_APU_XPU_RG8_SCR_ADDR A:0xae650
y.create.l HWIO_SEC_CTRL_APU_XPU_RG9_SCR_ADDR A:0xae6d0
y.create.l HWIO_SEC_CTRL_APU_XPU_RG0_MCR_ADDR A:0xae254
y.create.l HWIO_SEC_CTRL_APU_XPU_RG1_MCR_ADDR A:0xae2d4
y.create.l HWIO_SEC_CTRL_APU_XPU_RG2_MCR_ADDR A:0xae354
y.create.l HWIO_SEC_CTRL_APU_XPU_RG3_MCR_ADDR A:0xae3d4
y.create.l HWIO_SEC_CTRL_APU_XPU_RG4_MCR_ADDR A:0xae454
y.create.l HWIO_SEC_CTRL_APU_XPU_RG5_MCR_ADDR A:0xae4d4
y.create.l HWIO_SEC_CTRL_APU_XPU_RG6_MCR_ADDR A:0xae554
y.create.l HWIO_SEC_CTRL_APU_XPU_RG7_MCR_ADDR A:0xae5d4
y.create.l HWIO_SEC_CTRL_APU_XPU_RG8_MCR_ADDR A:0xae654
y.create.l HWIO_SEC_CTRL_APU_XPU_RG9_MCR_ADDR A:0xae6d4
y.create.l HWIO_TLMM_MPU1132_16_M22L12_AHB_REG_BASE_START_ADDR A:0x1300000
y.create.l HWIO_TLMM_MPU1132_16_M22L12_AHB_REG_BASE_LAST_ADDR A:0x13009dc
y.create.l HWIO_TLMM_MPU1132_16_M22L12_AHB_REG_BASE_END_ADDR A:0x1300a00
y.create.l HWIO_TLMM_XPU_SCR_ADDR A:0x1300000
y.create.l HWIO_TLMM_XPU_SWDR_ADDR A:0x1300004
y.create.l HWIO_TLMM_XPU_PRTN_RACR_SSHADOW_ADDR A:0x1300008
y.create.l HWIO_TLMM_XPU_PRTN_WACR_SSHADOW_ADDR A:0x130000c
y.create.l HWIO_TLMM_XPU_PRTN_START_SSHADOW0_ADDR A:0x1300010
y.create.l HWIO_TLMM_XPU_PRTN_END_SSHADOW0_ADDR A:0x1300018
y.create.l HWIO_TLMM_XPU_SEAR0_ADDR A:0x1300040
y.create.l HWIO_TLMM_XPU_SESR_ADDR A:0x1300048
y.create.l HWIO_TLMM_XPU_SESRRESTORE_ADDR A:0x130004c
y.create.l HWIO_TLMM_XPU_SESYNR0_ADDR A:0x1300050
y.create.l HWIO_TLMM_XPU_SESYNR1_ADDR A:0x1300054
y.create.l HWIO_TLMM_XPU_SESYNR2_ADDR A:0x1300058
y.create.l HWIO_TLMM_XPU_MCR_ADDR A:0x1300100
y.create.l HWIO_TLMM_XPU_MEAR0_ADDR A:0x1300140
y.create.l HWIO_TLMM_XPU_MESR_ADDR A:0x1300148
y.create.l HWIO_TLMM_XPU_MESRRESTORE_ADDR A:0x130014c
y.create.l HWIO_TLMM_XPU_MESYNR0_ADDR A:0x1300150
y.create.l HWIO_TLMM_XPU_MESYNR1_ADDR A:0x1300154
y.create.l HWIO_TLMM_XPU_MESYNR2_ADDR A:0x1300158
y.create.l HWIO_TLMM_XPU_CR_ADDR A:0x1300080
y.create.l HWIO_TLMM_XPU_PRTN_RACR_SHADOW_ADDR A:0x1300088
y.create.l HWIO_TLMM_XPU_PRTN_WACR_SHADOW_ADDR A:0x130008c
y.create.l HWIO_TLMM_XPU_PRTN_START_SHADOW0_ADDR A:0x1300090
y.create.l HWIO_TLMM_XPU_PRTN_END_SHADOW0_ADDR A:0x1300098
y.create.l HWIO_TLMM_XPU_RPU_ACR0_ADDR A:0x13000a0
y.create.l HWIO_TLMM_XPU_EAR0_ADDR A:0x13000c0
y.create.l HWIO_TLMM_XPU_ESR_ADDR A:0x13000c8
y.create.l HWIO_TLMM_XPU_ESRRESTORE_ADDR A:0x13000cc
y.create.l HWIO_TLMM_XPU_ESYNR0_ADDR A:0x13000d0
y.create.l HWIO_TLMM_XPU_ESYNR1_ADDR A:0x13000d4
y.create.l HWIO_TLMM_XPU_ESYNR2_ADDR A:0x13000d8
y.create.l HWIO_TLMM_XPU_UMR_RACR_ADDR A:0x13000e0
y.create.l HWIO_TLMM_XPU_UMR_WACR_ADDR A:0x13000e4
y.create.l HWIO_TLMM_XPU_UMR_CNTL_ADDR A:0x13000f0
y.create.l HWIO_TLMM_XPU_IDR0_ADDR A:0x1300074
y.create.l HWIO_TLMM_XPU_IDR1_ADDR A:0x1300078
y.create.l HWIO_TLMM_XPU_REV_ADDR A:0x130007c
y.create.l HWIO_TLMM_XPU_PRT0_RACR0_ADDR A:0x1300200
y.create.l HWIO_TLMM_XPU_PRT1_RACR0_ADDR A:0x1300280
y.create.l HWIO_TLMM_XPU_PRT2_RACR0_ADDR A:0x1300300
y.create.l HWIO_TLMM_XPU_PRT3_RACR0_ADDR A:0x1300380
y.create.l HWIO_TLMM_XPU_PRT4_RACR0_ADDR A:0x1300400
y.create.l HWIO_TLMM_XPU_PRT5_RACR0_ADDR A:0x1300480
y.create.l HWIO_TLMM_XPU_PRT6_RACR0_ADDR A:0x1300500
y.create.l HWIO_TLMM_XPU_PRT7_RACR0_ADDR A:0x1300580
y.create.l HWIO_TLMM_XPU_PRT8_RACR0_ADDR A:0x1300600
y.create.l HWIO_TLMM_XPU_PRT9_RACR0_ADDR A:0x1300680
y.create.l HWIO_TLMM_XPU_PRT0_WACR0_ADDR A:0x1300220
y.create.l HWIO_TLMM_XPU_PRT1_WACR0_ADDR A:0x13002a0
y.create.l HWIO_TLMM_XPU_PRT2_WACR0_ADDR A:0x1300320
y.create.l HWIO_TLMM_XPU_PRT3_WACR0_ADDR A:0x13003a0
y.create.l HWIO_TLMM_XPU_PRT4_WACR0_ADDR A:0x1300420
y.create.l HWIO_TLMM_XPU_PRT5_WACR0_ADDR A:0x13004a0
y.create.l HWIO_TLMM_XPU_PRT6_WACR0_ADDR A:0x1300520
y.create.l HWIO_TLMM_XPU_PRT7_WACR0_ADDR A:0x13005a0
y.create.l HWIO_TLMM_XPU_PRT8_WACR0_ADDR A:0x1300620
y.create.l HWIO_TLMM_XPU_PRT9_WACR0_ADDR A:0x13006a0
y.create.l HWIO_TLMM_XPU_PRT0_START0_ADDR A:0x1300240
y.create.l HWIO_TLMM_XPU_PRT1_START0_ADDR A:0x13002c0
y.create.l HWIO_TLMM_XPU_PRT2_START0_ADDR A:0x1300340
y.create.l HWIO_TLMM_XPU_PRT3_START0_ADDR A:0x13003c0
y.create.l HWIO_TLMM_XPU_PRT4_START0_ADDR A:0x1300440
y.create.l HWIO_TLMM_XPU_PRT5_START0_ADDR A:0x13004c0
y.create.l HWIO_TLMM_XPU_PRT6_START0_ADDR A:0x1300540
y.create.l HWIO_TLMM_XPU_PRT7_START0_ADDR A:0x13005c0
y.create.l HWIO_TLMM_XPU_PRT8_START0_ADDR A:0x1300640
y.create.l HWIO_TLMM_XPU_PRT9_START0_ADDR A:0x13006c0
y.create.l HWIO_TLMM_XPU_PRT0_END0_ADDR A:0x1300248
y.create.l HWIO_TLMM_XPU_PRT1_END0_ADDR A:0x13002c8
y.create.l HWIO_TLMM_XPU_PRT2_END0_ADDR A:0x1300348
y.create.l HWIO_TLMM_XPU_PRT3_END0_ADDR A:0x13003c8
y.create.l HWIO_TLMM_XPU_PRT4_END0_ADDR A:0x1300448
y.create.l HWIO_TLMM_XPU_PRT5_END0_ADDR A:0x13004c8
y.create.l HWIO_TLMM_XPU_PRT6_END0_ADDR A:0x1300548
y.create.l HWIO_TLMM_XPU_PRT7_END0_ADDR A:0x13005c8
y.create.l HWIO_TLMM_XPU_PRT8_END0_ADDR A:0x1300648
y.create.l HWIO_TLMM_XPU_PRT9_END0_ADDR A:0x13006c8
y.create.l HWIO_TLMM_XPU_PRT0_SCR_ADDR A:0x1300250
y.create.l HWIO_TLMM_XPU_PRT1_SCR_ADDR A:0x13002d0
y.create.l HWIO_TLMM_XPU_PRT2_SCR_ADDR A:0x1300350
y.create.l HWIO_TLMM_XPU_PRT3_SCR_ADDR A:0x13003d0
y.create.l HWIO_TLMM_XPU_PRT4_SCR_ADDR A:0x1300450
y.create.l HWIO_TLMM_XPU_PRT5_SCR_ADDR A:0x13004d0
y.create.l HWIO_TLMM_XPU_PRT6_SCR_ADDR A:0x1300550
y.create.l HWIO_TLMM_XPU_PRT7_SCR_ADDR A:0x13005d0
y.create.l HWIO_TLMM_XPU_PRT8_SCR_ADDR A:0x1300650
y.create.l HWIO_TLMM_XPU_PRT9_SCR_ADDR A:0x13006d0
y.create.l HWIO_TLMM_XPU_PRT0_MCR_ADDR A:0x1300254
y.create.l HWIO_TLMM_XPU_PRT1_MCR_ADDR A:0x13002d4
y.create.l HWIO_TLMM_XPU_PRT2_MCR_ADDR A:0x1300354
y.create.l HWIO_TLMM_XPU_PRT3_MCR_ADDR A:0x13003d4
y.create.l HWIO_TLMM_XPU_PRT4_MCR_ADDR A:0x1300454
y.create.l HWIO_TLMM_XPU_PRT5_MCR_ADDR A:0x13004d4
y.create.l HWIO_TLMM_XPU_PRT6_MCR_ADDR A:0x1300554
y.create.l HWIO_TLMM_XPU_PRT7_MCR_ADDR A:0x13005d4
y.create.l HWIO_TLMM_XPU_PRT8_MCR_ADDR A:0x1300654
y.create.l HWIO_TLMM_XPU_PRT9_MCR_ADDR A:0x13006d4
y.create.l HWIO_TLMM_XPU_PRT0_CNTL0_ADDR A:0x1300258
y.create.l HWIO_TLMM_XPU_PRT1_CNTL0_ADDR A:0x13002d8
y.create.l HWIO_TLMM_XPU_PRT2_CNTL0_ADDR A:0x1300358
y.create.l HWIO_TLMM_XPU_PRT3_CNTL0_ADDR A:0x13003d8
y.create.l HWIO_TLMM_XPU_PRT4_CNTL0_ADDR A:0x1300458
y.create.l HWIO_TLMM_XPU_PRT5_CNTL0_ADDR A:0x13004d8
y.create.l HWIO_TLMM_XPU_PRT6_CNTL0_ADDR A:0x1300558
y.create.l HWIO_TLMM_XPU_PRT7_CNTL0_ADDR A:0x13005d8
y.create.l HWIO_TLMM_XPU_PRT8_CNTL0_ADDR A:0x1300658
y.create.l HWIO_TLMM_XPU_PRT9_CNTL0_ADDR A:0x13006d8
y.create.l HWIO_TLMM_XPU_PRT0_CNTL1_ADDR A:0x130025c
y.create.l HWIO_TLMM_XPU_PRT1_CNTL1_ADDR A:0x13002dc
y.create.l HWIO_TLMM_XPU_PRT2_CNTL1_ADDR A:0x130035c
y.create.l HWIO_TLMM_XPU_PRT3_CNTL1_ADDR A:0x13003dc
y.create.l HWIO_TLMM_XPU_PRT4_CNTL1_ADDR A:0x130045c
y.create.l HWIO_TLMM_XPU_PRT5_CNTL1_ADDR A:0x13004dc
y.create.l HWIO_TLMM_XPU_PRT6_CNTL1_ADDR A:0x130055c
y.create.l HWIO_TLMM_XPU_PRT7_CNTL1_ADDR A:0x13005dc
y.create.l HWIO_TLMM_XPU_PRT8_CNTL1_ADDR A:0x130065c
y.create.l HWIO_TLMM_XPU_PRT9_CNTL1_ADDR A:0x13006dc
y.create.l HWIO_TLMM_CSR_REG_BASE_START_ADDR A:0x1000000
y.create.l HWIO_TLMM_CSR_REG_BASE_LAST_ADDR A:0x12000c4
y.create.l HWIO_TLMM_CSR_REG_BASE_END_ADDR A:0x1300000
y.create.l HWIO_TLMM_GPIO_CFG0_ADDR A:0x1000000
y.create.l HWIO_TLMM_GPIO_CFG1_ADDR A:0x1001000
y.create.l HWIO_TLMM_GPIO_CFG2_ADDR A:0x1002000
y.create.l HWIO_TLMM_GPIO_CFG3_ADDR A:0x1003000
y.create.l HWIO_TLMM_GPIO_CFG4_ADDR A:0x1004000
y.create.l HWIO_TLMM_GPIO_CFG5_ADDR A:0x1005000
y.create.l HWIO_TLMM_GPIO_CFG6_ADDR A:0x1006000
y.create.l HWIO_TLMM_GPIO_CFG7_ADDR A:0x1007000
y.create.l HWIO_TLMM_GPIO_CFG8_ADDR A:0x1008000
y.create.l HWIO_TLMM_GPIO_CFG9_ADDR A:0x1009000
y.create.l HWIO_TLMM_GPIO_CFG43_ADDR A:0x102b000
y.create.l HWIO_TLMM_GPIO_CFG44_ADDR A:0x102c000
y.create.l HWIO_TLMM_GPIO_CFG45_ADDR A:0x102d000
y.create.l HWIO_TLMM_GPIO_CFG46_ADDR A:0x102e000
y.create.l HWIO_TLMM_GPIO_CFG47_ADDR A:0x102f000
y.create.l HWIO_TLMM_GPIO_CFG48_ADDR A:0x1030000
y.create.l HWIO_TLMM_GPIO_CFG49_ADDR A:0x1031000
y.create.l HWIO_TLMM_GPIO_CFG50_ADDR A:0x1032000
y.create.l HWIO_TLMM_GPIO_CFG51_ADDR A:0x1033000
y.create.l HWIO_TLMM_GPIO_CFG52_ADDR A:0x1034000
y.create.l HWIO_TLMM_GPIO_CFG53_ADDR A:0x1035000
y.create.l HWIO_TLMM_GPIO_CFG54_ADDR A:0x1036000
y.create.l HWIO_TLMM_GPIO_CFG55_ADDR A:0x1037000
y.create.l HWIO_TLMM_GPIO_IN_OUT0_ADDR A:0x1000004
y.create.l HWIO_TLMM_GPIO_IN_OUT1_ADDR A:0x1001004
y.create.l HWIO_TLMM_GPIO_IN_OUT2_ADDR A:0x1002004
y.create.l HWIO_TLMM_GPIO_IN_OUT3_ADDR A:0x1003004
y.create.l HWIO_TLMM_GPIO_IN_OUT4_ADDR A:0x1004004
y.create.l HWIO_TLMM_GPIO_IN_OUT5_ADDR A:0x1005004
y.create.l HWIO_TLMM_GPIO_IN_OUT6_ADDR A:0x1006004
y.create.l HWIO_TLMM_GPIO_IN_OUT7_ADDR A:0x1007004
y.create.l HWIO_TLMM_GPIO_IN_OUT8_ADDR A:0x1008004
y.create.l HWIO_TLMM_GPIO_IN_OUT9_ADDR A:0x1009004
y.create.l HWIO_TLMM_GPIO_INTR_CFG0_ADDR A:0x1000008
y.create.l HWIO_TLMM_GPIO_INTR_CFG1_ADDR A:0x1001008
y.create.l HWIO_TLMM_GPIO_INTR_CFG2_ADDR A:0x1002008
y.create.l HWIO_TLMM_GPIO_INTR_CFG3_ADDR A:0x1003008
y.create.l HWIO_TLMM_GPIO_INTR_CFG4_ADDR A:0x1004008
y.create.l HWIO_TLMM_GPIO_INTR_CFG5_ADDR A:0x1005008
y.create.l HWIO_TLMM_GPIO_INTR_CFG6_ADDR A:0x1006008
y.create.l HWIO_TLMM_GPIO_INTR_CFG7_ADDR A:0x1007008
y.create.l HWIO_TLMM_GPIO_INTR_CFG8_ADDR A:0x1008008
y.create.l HWIO_TLMM_GPIO_INTR_CFG9_ADDR A:0x1009008
y.create.l HWIO_TLMM_GPIO_INTR_STATUS0_ADDR A:0x100000c
y.create.l HWIO_TLMM_GPIO_INTR_STATUS1_ADDR A:0x100100c
y.create.l HWIO_TLMM_GPIO_INTR_STATUS2_ADDR A:0x100200c
y.create.l HWIO_TLMM_GPIO_INTR_STATUS3_ADDR A:0x100300c
y.create.l HWIO_TLMM_GPIO_INTR_STATUS4_ADDR A:0x100400c
y.create.l HWIO_TLMM_GPIO_INTR_STATUS5_ADDR A:0x100500c
y.create.l HWIO_TLMM_GPIO_INTR_STATUS6_ADDR A:0x100600c
y.create.l HWIO_TLMM_GPIO_INTR_STATUS7_ADDR A:0x100700c
y.create.l HWIO_TLMM_GPIO_INTR_STATUS8_ADDR A:0x100800c
y.create.l HWIO_TLMM_GPIO_INTR_STATUS9_ADDR A:0x100900c
y.create.l HWIO_TLMM_CLK_GATE_EN_ADDR A:0x1100000
y.create.l HWIO_TLMM_IE_CTRL_DISABLE_ADDR A:0x1100004
y.create.l HWIO_TLMM_MPM_WAKEUP_INT_EN_0_ADDR A:0x1100008
y.create.l HWIO_TLMM_INT_JTAG_CTL_ADDR A:0x1110000
y.create.l HWIO_TLMM_ETM_MODE_ADDR A:0x1110004
y.create.l HWIO_TLMM_DBG_BUS_OUT_SEL_ADDR A:0x1110008
y.create.l HWIO_TLMM_CHIP_MODE_ADDR A:0x111000c
y.create.l HWIO_TLMM_SPARE_ADDR A:0x110e000
y.create.l HWIO_SPARE1_ADDR A:0x111001c
y.create.l HWIO_SPARE2_ADDR A:0x1110020
y.create.l HWIO_TLMM_HW_REVISION_NUMBER_ADDR A:0x1110010
y.create.l HWIO_TLMM_PERIPH_CHAR_TEST_MODE_ADDR A:0x1110014
y.create.l HWIO_TLMM_EBI2_EMMC_GPIO_CFG_ADDR A:0x1111000
y.create.l HWIO_TLMM_PBL_DEBUG_ADDR A:0x1110018
y.create.l HWIO_TLMM_RFFE_CTL_ADDR A:0x1108000
y.create.l HWIO_TLMM_RESOUT_HDRV_CTL_ADDR A:0x110d000
y.create.l HWIO_TLMM_JTAG_HDRV_CTL_ADDR A:0x110c000
y.create.l HWIO_TLMM_PMIC_HDRV_PULL_CTL_ADDR A:0x110b000
y.create.l HWIO_TLMM_EBI2_HDRV_PULL_CTL_ADDR A:0x110a000
y.create.l HWIO_TLMM_MODE_PULL_CTL_ADDR A:0x1107000
y.create.l HWIO_TLMM_GPIO_HS_I2C_CTL_ADDR A:0x110f000
y.create.l HWIO_TLMM_DIR_CONN_INTR0_CFG_WCSS_ADDR A:0x1106000
y.create.l HWIO_TLMM_DIR_CONN_INTR1_CFG_WCSS_ADDR A:0x1106004
y.create.l HWIO_TLMM_DIR_CONN_INTR0_CFG_SENSORS_ADDR A:0x1105000
y.create.l HWIO_TLMM_DIR_CONN_INTR1_CFG_SENSORS_ADDR A:0x1105004
y.create.l HWIO_TLMM_DIR_CONN_INTR2_CFG_SENSORS_ADDR A:0x1105008
y.create.l HWIO_TLMM_DIR_CONN_INTR3_CFG_SENSORS_ADDR A:0x110500c
y.create.l HWIO_TLMM_DIR_CONN_INTR4_CFG_SENSORS_ADDR A:0x1105010
y.create.l HWIO_TLMM_DIR_CONN_INTR5_CFG_SENSORS_ADDR A:0x1105014
y.create.l HWIO_TLMM_DIR_CONN_INTR6_CFG_SENSORS_ADDR A:0x1105018
y.create.l HWIO_TLMM_DIR_CONN_INTR7_CFG_SENSORS_ADDR A:0x110501c
y.create.l HWIO_TLMM_DIR_CONN_INTR8_CFG_SENSORS_ADDR A:0x1105020
y.create.l HWIO_TLMM_DIR_CONN_INTR9_CFG_SENSORS_ADDR A:0x1105024
y.create.l HWIO_TLMM_DIR_CONN_INTR0_CFG_LPA_DSP_ADDR A:0x1104000
y.create.l HWIO_TLMM_DIR_CONN_INTR1_CFG_LPA_DSP_ADDR A:0x1104004
y.create.l HWIO_TLMM_DIR_CONN_INTR2_CFG_LPA_DSP_ADDR A:0x1104008
y.create.l HWIO_TLMM_DIR_CONN_INTR3_CFG_LPA_DSP_ADDR A:0x110400c
y.create.l HWIO_TLMM_DIR_CONN_INTR4_CFG_LPA_DSP_ADDR A:0x1104010
y.create.l HWIO_TLMM_DIR_CONN_INTR5_CFG_LPA_DSP_ADDR A:0x1104014
y.create.l HWIO_TLMM_DIR_CONN_INTR0_CFG_RPM_ADDR A:0x1103000
y.create.l HWIO_TLMM_DIR_CONN_INTR0_CFG_APSS_ADDR A:0x1102000
y.create.l HWIO_TLMM_DIR_CONN_INTR1_CFG_APSS_ADDR A:0x1102004
y.create.l HWIO_TLMM_DIR_CONN_INTR2_CFG_APSS_ADDR A:0x1102008
y.create.l HWIO_TLMM_DIR_CONN_INTR3_CFG_APSS_ADDR A:0x110200c
y.create.l HWIO_TLMM_DIR_CONN_INTR4_CFG_APSS_ADDR A:0x1102010
y.create.l HWIO_TLMM_DIR_CONN_INTR5_CFG_APSS_ADDR A:0x1102014
y.create.l HWIO_TLMM_DIR_CONN_INTR6_CFG_APSS_ADDR A:0x1102018
y.create.l HWIO_TLMM_DIR_CONN_INTR7_CFG_APSS_ADDR A:0x110201c
y.create.l HWIO_TLMM_DIR_CONN_INTR0_CFG_MSS_ADDR A:0x1101000
y.create.l HWIO_TLMM_DIR_CONN_INTR1_CFG_MSS_ADDR A:0x1101004
y.create.l HWIO_TLMM_GPIO_OUT_0_ADDR A:0x1200000
y.create.l HWIO_TLMM_GPIO_OUT_1_ADDR A:0x1200004
y.create.l HWIO_TLMM_GPIO_OUT_CLR_0_ADDR A:0x1200020
y.create.l HWIO_TLMM_GPIO_OUT_CLR_1_ADDR A:0x1200024
y.create.l HWIO_TLMM_GPIO_OUT_SET_0_ADDR A:0x1200040
y.create.l HWIO_TLMM_GPIO_OUT_SET_1_ADDR A:0x1200044
y.create.l HWIO_TLMM_GPIO_IN_0_ADDR A:0x1200060
y.create.l HWIO_TLMM_GPIO_IN_1_ADDR A:0x1200064
y.create.l HWIO_TLMM_GPIO_OE_0_ADDR A:0x1200080
y.create.l HWIO_TLMM_GPIO_OE_1_ADDR A:0x1200084
y.create.l HWIO_TLMM_GPIO_OE_CLR_0_ADDR A:0x12000a0
y.create.l HWIO_TLMM_GPIO_OE_CLR_1_ADDR A:0x12000a4
y.create.l HWIO_TLMM_GPIO_OE_SET_0_ADDR A:0x12000c0
y.create.l HWIO_TLMM_GPIO_OE_SET_1_ADDR A:0x12000c4
y.create.l HWIO_ULTAUDIO_LPASS_TCSR_REG_BASE_START_ADDR A:0x7700000
y.create.l HWIO_ULTAUDIO_LPASS_TCSR_REG_BASE_LAST_ADDR A:0x7700004
y.create.l HWIO_ULTAUDIO_LPASS_TCSR_REG_BASE_END_ADDR A:0x7700100
y.create.l HWIO_ULTAUDIO_HW_VERSION_ADDR A:0x7700000
y.create.l HWIO_ULTAUDIO_TCSR_DEBUG_CTL_ADDR A:0x7700004
y.create.l HWIO_LPASS_LPASS_CSR_REG_BASE_START_ADDR A:0x7700100
y.create.l HWIO_LPASS_LPASS_CSR_REG_BASE_LAST_ADDR A:0x77001b0
y.create.l HWIO_LPASS_LPASS_CSR_REG_BASE_END_ADDR A:0x7701000
y.create.l HWIO_LPASS_CSR_GP_CTL_ADDR A:0x7700100
y.create.l HWIO_LPASS_CSR_MEMTYPE_CTL_ADDR A:0x7700104
y.create.l HWIO_LPASS_CSR_DEBUG_BUS_ADDR A:0x7700114
y.create.l HWIO_LPASS_AHBI_CFG_ADDR A:0x7700124
y.create.l HWIO_LPASS_AHBI_LOCK_CTL_ADDR A:0x7700128
y.create.l HWIO_LPASS_AHBI_CFG_EXT_ADDR A:0x770012c
y.create.l HWIO_LPASS_AHBX_CFG_ADDR A:0x7700140
y.create.l HWIO_LPASS_AHBX_LOCK_CTL_ADDR A:0x7700144
y.create.l HWIO_LPASS_AHBIX_SSR_CTL_ADDR A:0x7700148
y.create.l HWIO_LPASS_AHBIX_STATUS_ADDR A:0x7700150
y.create.l HWIO_LPASS_AHBIX_ACK_ADDR A:0x7700154
y.create.l HWIO_LPASS_AHBIX_EN_ADDR A:0x7700158
y.create.l HWIO_LPASS_AUDIO_CORE_LPM_CGCR_ADDR A:0x770015c
y.create.l HWIO_LPASS_AUDIO_CORE_AUDSYNC_CGCR_ADDR A:0x7700160
y.create.l HWIO_LPASS_AUDIO_CORE_AVSYNC_CGCR_ADDR A:0x7700164
y.create.l HWIO_LPASS_AUDIO_CORE_AHB2AHB_CODEC_CGCR_ADDR A:0x770016c
y.create.l HWIO_LPASS_AUDIO_CORE_LPAIF_CTL_CGCR_ADDR A:0x7700170
y.create.l HWIO_LPASS_AUDIO_CORE_VFR_CGCR_ADDR A:0x7700174
y.create.l HWIO_LPASS_AUDIO_CORE_AHB2AHB_PCNOC_SLV_CGCR_ADDR A:0x7700178
y.create.l HWIO_LPASS_AUDIO_CORE_AHB2AHB_PCNOC_MST_CGCR_ADDR A:0x770017c
y.create.l HWIO_LPASS_AUDIO_CORE_AVTIMER_XO_FM_CGCR_ADDR A:0x7700180
y.create.l HWIO_LPASS_AUDIO_CORE_AVTIMER_XO_BT_CGCR_ADDR A:0x7700184
y.create.l HWIO_LPASS_AUDIO_CORE_SLIMBUS_SLV_CGCR_ADDR A:0x7700188
y.create.l HWIO_LPASS_AUDIO_CORE_SLIMBUS_MST_CGCR_ADDR A:0x770018c
y.create.l HWIO_LPASS_LPASS_CSR_ADDR_VALID_STATUS_ADDR A:0x7700190
y.create.l HWIO_LPASS_LPASS_CSR_ADDR_VALID_ACK_ADDR A:0x7700194
y.create.l HWIO_LPASS_LPASS_CSR_ADDR_VALID_EN_ADDR A:0x7700198
y.create.l HWIO_LPASS_LPM_CTL_ADDR A:0x770019c
y.create.l HWIO_LPASS_LPAIF_CTL_ADDR A:0x77001b0
y.create.l HWIO_LPASS_LPASS_CSR_VFR_REG_BASE_START_ADDR A:0x7701000
y.create.l HWIO_LPASS_LPASS_CSR_VFR_REG_BASE_LAST_ADDR A:0x770104c
y.create.l HWIO_LPASS_LPASS_CSR_VFR_REG_BASE_END_ADDR A:0x7702000
y.create.l HWIO_LPASS_VFR_IRQ_MUX_CTL_ADDR A:0x7701000
y.create.l HWIO_LPASS_VFR_STC_MSB_ADDR A:0x7701004
y.create.l HWIO_LPASS_VFR_STC_LSB_ADDR A:0x7701008
y.create.l HWIO_LPASS_VFR_IRQ_MUX_CTL_1_ADDR A:0x7701010
y.create.l HWIO_LPASS_VFR_STC_MSB_1_ADDR A:0x7701014
y.create.l HWIO_LPASS_VFR_STC_LSB_1_ADDR A:0x7701018
y.create.l HWIO_LPASS_GP_IRQ_TS_MUX_CTL_0_ADDR A:0x7701020
y.create.l HWIO_LPASS_GP_IRQ_STC_MSB_0_ADDR A:0x7701024
y.create.l HWIO_LPASS_GP_IRQ_STC_LSB_0_ADDR A:0x7701028
y.create.l HWIO_LPASS_GP_IRQ_TS_MUX_CTL_1_ADDR A:0x7701030
y.create.l HWIO_LPASS_GP_IRQ_STC_MSB_1_ADDR A:0x7701034
y.create.l HWIO_LPASS_GP_IRQ_STC_LSB_1_ADDR A:0x7701038
y.create.l HWIO_LPASS_LPAIF_VFR_IRQ_CTL_ADDR A:0x7701040
y.create.l HWIO_LPASS_WCN_VFR_IRQ_CTL_ADDR A:0x7701044
y.create.l HWIO_LPASS_AVT_VFR_IRQ_CTL_ADDR A:0x7701048
y.create.l HWIO_LPASS_SLIMBUS_VFR_IRQ_CTL_ADDR A:0x770104c
y.create.l HWIO_LPASS_LPASS_CSR_IO_REG_BASE_START_ADDR A:0x7702000
y.create.l HWIO_LPASS_LPASS_CSR_IO_REG_BASE_LAST_ADDR A:0x7702014
y.create.l HWIO_LPASS_LPASS_CSR_IO_REG_BASE_END_ADDR A:0x7703000
y.create.l HWIO_LPASS_CSR_GP_IO_MUX_MIC_CTL_ADDR A:0x7702000
y.create.l HWIO_LPASS_CSR_GP_IO_MUX_SPKR_CTL_ADDR A:0x7702004
y.create.l HWIO_LPASS_CSR_GP_LPAIF_PRI_PCM_PRI_MODE_MUXSEL_ADDR A:0x7702008
y.create.l HWIO_LPASS_CSR_GP_LPAIF_SEC_PCM_SEC_MODE_MUXSEL_ADDR A:0x770200c
y.create.l HWIO_LPASS_CSR_GP_LPAIF_TER_PCM_TER_MODE_MUXSEL_ADDR A:0x7702010
y.create.l HWIO_LPASS_CSR_GP_IO_MUX_TER_CTL_ADDR A:0x7702014
y.create.l HWIO_LPASS_AHBI_TIME_REG_BASE_START_ADDR A:0x7705000
y.create.l HWIO_LPASS_AHBI_TIME_REG_BASE_LAST_ADDR A:0x7705034
y.create.l HWIO_LPASS_AHBI_TIME_REG_BASE_END_ADDR A:0x7706000
y.create.l HWIO_LPASS_AHBI_ABT_HW_VERSION_ADDR A:0x7705000
y.create.l HWIO_LPASS_AHBI_ABT_INST_ID_ADDR A:0x7705004
y.create.l HWIO_LPASS_AHBI_ABT_NUM_SLAVES_ADDR A:0x7705008
y.create.l HWIO_LPASS_AHBI_ABT_TIMER_LOADVAL_ADDR A:0x770500c
y.create.l HWIO_LPASS_AHBI_ABT_TIMER_MODE_ADDR A:0x7705010
y.create.l HWIO_LPASS_AHBI_ABT_INTR_STATUS_ADDR A:0x7705014
y.create.l HWIO_LPASS_AHBI_ABT_INTR_CLEAR_ADDR A:0x7705018
y.create.l HWIO_LPASS_AHBI_ABT_INTR_ENABLE_ADDR A:0x770501c
y.create.l HWIO_LPASS_AHBI_ABT_SYND_VALID_ADDR A:0x7705020
y.create.l HWIO_LPASS_AHBI_ABT_SYND_CLEAR_ADDR A:0x7705024
y.create.l HWIO_LPASS_AHBI_ABT_SYND_ID_ADDR A:0x7705028
y.create.l HWIO_LPASS_AHBI_ABT_SYND_ADDR0_ADDR A:0x770502c
y.create.l HWIO_LPASS_AHBI_ABT_SYND_ADDR1_ADDR A:0x7705030
y.create.l HWIO_LPASS_AHBI_ABT_SYND_HREADY_ADDR A:0x7705034
y.create.l HWIO_LPASS_AVTIMER_REG_BASE_START_ADDR A:0x7706000
y.create.l HWIO_LPASS_AVTIMER_REG_BASE_LAST_ADDR A:0x7706090
y.create.l HWIO_LPASS_AVTIMER_REG_BASE_END_ADDR A:0x7706100
y.create.l HWIO_LPASS_AVTIMER_HW_VERSION_ADDR A:0x7706000
y.create.l HWIO_LPASS_AVTIMER_CTL_ADDR A:0x7706004
y.create.l HWIO_LPASS_AVTIMER_RESMOD_ADDR A:0x7706008
y.create.l HWIO_LPASS_AVTIMER_TIMER_LSB_ADDR A:0x770600c
y.create.l HWIO_LPASS_AVTIMER_TIMER_MSB_ADDR A:0x7706010
y.create.l HWIO_LPASS_AVTIMER_INT0_LSB_ADDR A:0x7706014
y.create.l HWIO_LPASS_AVTIMER_INT0_MSB_ADDR A:0x7706018
y.create.l HWIO_LPASS_AVTIMER_INT1_LSB_ADDR A:0x770601c
y.create.l HWIO_LPASS_AVTIMER_INT1_MSB_ADDR A:0x7706020
y.create.l HWIO_LPASS_AVTIMER_TIMEOUT_VAL_ADDR A:0x7706024
y.create.l HWIO_LPASS_AVTIMER_L0_VAL_NEXT_ADDR A:0x7706028
y.create.l HWIO_LPASS_AVTIMER_M0_VAL_NEXT_ADDR A:0x770602c
y.create.l HWIO_LPASS_AVTIMER_N0_VAL_NEXT_ADDR A:0x7706030
y.create.l HWIO_LPASS_AVTIMER_L0_VAL_CURR_ADDR A:0x7706034
y.create.l HWIO_LPASS_AVTIMER_M0_VAL_CURR_ADDR A:0x7706038
y.create.l HWIO_LPASS_AVTIMER_N0_VAL_CURR_ADDR A:0x770603c
y.create.l HWIO_LPASS_AVTIMER_MODE_CTL_ADDR A:0x7706040
y.create.l HWIO_LPASS_AVTIMER_LMN_DWT_ADDR A:0x7706044
y.create.l HWIO_LPASS_AVTIMER_LTIME_LSB_ADDR A:0x7706048
y.create.l HWIO_LPASS_AVTIMER_LTIME_MSB_ADDR A:0x770604c
y.create.l HWIO_LPASS_AVTIMER_EXT_STC_LSB_ADDR A:0x7706050
y.create.l HWIO_LPASS_AVTIMER_EXT_STC_MSB_ADDR A:0x7706054
y.create.l HWIO_LPASS_AVTIMER_RTIME_LSB_ADDR A:0x7706058
y.create.l HWIO_LPASS_AVTIMER_RTIME_MSB_ADDR A:0x770605c
y.create.l HWIO_LPASS_AVTIMER_RTIME_CTL_ADDR A:0x7706060
y.create.l HWIO_LPASS_AVTIMER_TIME_CTL_ADDR A:0x7706064
y.create.l HWIO_LPASS_AVTIMER_TIMER_LOAD_LSB_NEXT_ADDR A:0x7706068
y.create.l HWIO_LPASS_AVTIMER_TIMER_LOAD_MSB_NEXT_ADDR A:0x770606c
y.create.l HWIO_LPASS_AVTIMER_TIMER_LOAD_LSB_CURR_ADDR A:0x7706070
y.create.l HWIO_LPASS_AVTIMER_TIMER_LOAD_MSB_CURR_ADDR A:0x7706074
y.create.l HWIO_LPASS_AVTIMER_TIMER_LOAD_DWT_ADDR A:0x7706078
y.create.l HWIO_LPASS_AVTIMER_INT1_ST_ADDR A:0x770607c
y.create.l HWIO_LPASS_AVTIMER_INT0_ST_ADDR A:0x7706080
y.create.l HWIO_LPASS_AVTIMER_INT1_CTL_ADDR A:0x7706084
y.create.l HWIO_LPASS_AVTIMER_INT0_CTL_ADDR A:0x7706088
y.create.l HWIO_LPASS_AVTIMER_INT_ON_ADDR A:0x770608c
y.create.l HWIO_LPASS_AVTIMER_TICK_DIV_ADDR A:0x7706090
y.create.l HWIO_LPASS_LPA_IF_ULTAUDIO_REG_BASE_START_ADDR A:0x7708000
y.create.l HWIO_LPASS_LPA_IF_ULTAUDIO_REG_BASE_LAST_ADDR A:0x771503c
y.create.l HWIO_LPASS_LPA_IF_ULTAUDIO_REG_BASE_END_ADDR A:0x7718000
y.create.l HWIO_LPASS_LPAIF_VERSION_ADDR A:0x7708000
y.create.l HWIO_LPASS_LPAIF_HW_CONFIG_ADDR A:0x7708004
y.create.l HWIO_LPASS_LPAIF_HW_CONFIG2_ADDR A:0x7708008
y.create.l HWIO_LPASS_LPAIF_DMIC_CTL_ADDR A:0x7708080
y.create.l HWIO_LPASS_LPAIF_DMIC_VOL_CTL0_ADDR A:0x7708084
y.create.l HWIO_LPASS_LPAIF_DMIC_VOL_CTL1_ADDR A:0x7708088
y.create.l HWIO_LPASS_LPAIF_WRDMA_LPBK_MIX_ADDR A:0x7708100
y.create.l HWIO_LPASS_LPAIF_MIXER_CTL_ADDR A:0x7708180
y.create.l HWIO_LPASS_LPAIF_EXT_VFR_ADDR A:0x7708200
y.create.l HWIO_LPASS_LPAIF_DEBUG_CTL_ADDR A:0x7708280
y.create.l HWIO_LPASS_LPAIF_PRI_RATE_DET_CONFIG_ADDR A:0x7708300
y.create.l HWIO_LPASS_LPAIF_PRI_RATE_DET_TARGET1_CONFIG_ADDR A:0x7708304
y.create.l HWIO_LPASS_LPAIF_PRI_RATE_DET_TARGET2_CONFIG_ADDR A:0x7708308
y.create.l HWIO_LPASS_LPAIF_PRI_RATE_BIN_ADDR A:0x770830c
y.create.l HWIO_LPASS_LPAIF_PRI_STC_DIFF_ADDR A:0x7708310
y.create.l HWIO_LPASS_LPAIF_SEC_RATE_DET_CONFIG_ADDR A:0x7708380
y.create.l HWIO_LPASS_LPAIF_SEC_RATE_DET_TARGET1_CONFIG_ADDR A:0x7708384
y.create.l HWIO_LPASS_LPAIF_SEC_RATE_DET_TARGET2_CONFIG_ADDR A:0x7708388
y.create.l HWIO_LPASS_LPAIF_SEC_RATE_BIN_ADDR A:0x770838c
y.create.l HWIO_LPASS_LPAIF_SEC_STC_DIFF_ADDR A:0x7708390
y.create.l HWIO_LPASS_LPAIF_SPARE_ADDR A:0x7708400
y.create.l HWIO_LPASS_LPAIF_I2S_CTL0_ADDR A:0x7709000
y.create.l HWIO_LPASS_LPAIF_I2S_CTL1_ADDR A:0x770a000
y.create.l HWIO_LPASS_LPAIF_I2S_CTL2_ADDR A:0x770b000
y.create.l HWIO_LPASS_LPAIF_PCM_CTL0_ADDR A:0x7709040
y.create.l HWIO_LPASS_LPAIF_PCM_CTL1_ADDR A:0x770a040
y.create.l HWIO_LPASS_LPAIF_PCM_CTL2_ADDR A:0x770b040
y.create.l HWIO_LPASS_LPAIF_PCM_SLOT_CTL0_ADDR A:0x7709044
y.create.l HWIO_LPASS_LPAIF_PCM_SLOT_CTL1_ADDR A:0x770a044
y.create.l HWIO_LPASS_LPAIF_PCM_SLOT_CTL2_ADDR A:0x770b044
y.create.l HWIO_LPASS_LPAIF_PCM_SLOT_CTL2_0_ADDR A:0x7709048
y.create.l HWIO_LPASS_LPAIF_PCM_SLOT_CTL2_1_ADDR A:0x770a048
y.create.l HWIO_LPASS_LPAIF_PCM_SLOT_CTL2_2_ADDR A:0x770b048
y.create.l HWIO_LPASS_LPAIF_PCM_SLOT_CTL3_0_ADDR A:0x770904c
y.create.l HWIO_LPASS_LPAIF_PCM_SLOT_CTL3_1_ADDR A:0x770a04c
y.create.l HWIO_LPASS_LPAIF_PCM_SLOT_CTL3_2_ADDR A:0x770b04c
y.create.l HWIO_LPASS_LPAIF_PCM_TDM_CTL_0_ADDR A:0x7709050
y.create.l HWIO_LPASS_LPAIF_PCM_TDM_CTL_1_ADDR A:0x770a050
y.create.l HWIO_LPASS_LPAIF_PCM_TDM_CTL_2_ADDR A:0x770b050
y.create.l HWIO_LPASS_LPAIF_PCM_TDM_SAMPLE_WIDTH_0_ADDR A:0x7709054
y.create.l HWIO_LPASS_LPAIF_PCM_TDM_SAMPLE_WIDTH_1_ADDR A:0x770a054
y.create.l HWIO_LPASS_LPAIF_PCM_TDM_SAMPLE_WIDTH_2_ADDR A:0x770b054
y.create.l HWIO_LPASS_LPAIF_IRQ_EN0_ADDR A:0x770e000
y.create.l HWIO_LPASS_LPAIF_IRQ_EN1_ADDR A:0x770f000
y.create.l HWIO_LPASS_LPAIF_IRQ_EN2_ADDR A:0x7710000
y.create.l HWIO_LPASS_LPAIF_IRQ_STAT0_ADDR A:0x770e004
y.create.l HWIO_LPASS_LPAIF_IRQ_STAT1_ADDR A:0x770f004
y.create.l HWIO_LPASS_LPAIF_IRQ_STAT2_ADDR A:0x7710004
y.create.l HWIO_LPASS_LPAIF_IRQ_RAW_STAT0_ADDR A:0x770e008
y.create.l HWIO_LPASS_LPAIF_IRQ_RAW_STAT1_ADDR A:0x770f008
y.create.l HWIO_LPASS_LPAIF_IRQ_RAW_STAT2_ADDR A:0x7710008
y.create.l HWIO_LPASS_LPAIF_IRQ_CLEAR0_ADDR A:0x770e00c
y.create.l HWIO_LPASS_LPAIF_IRQ_CLEAR1_ADDR A:0x770f00c
y.create.l HWIO_LPASS_LPAIF_IRQ_CLEAR2_ADDR A:0x771000c
y.create.l HWIO_LPASS_LPAIF_IRQ_FORCE0_ADDR A:0x770e010
y.create.l HWIO_LPASS_LPAIF_IRQ_FORCE1_ADDR A:0x770f010
y.create.l HWIO_LPASS_LPAIF_IRQ_FORCE2_ADDR A:0x7710010
y.create.l HWIO_LPASS_LPAIF_IRQ2_EN0_ADDR A:0x770e040
y.create.l HWIO_LPASS_LPAIF_IRQ2_EN1_ADDR A:0x770f040
y.create.l HWIO_LPASS_LPAIF_IRQ2_EN2_ADDR A:0x7710040
y.create.l HWIO_LPASS_LPAIF_IRQ2_STAT0_ADDR A:0x770e044
y.create.l HWIO_LPASS_LPAIF_IRQ2_STAT1_ADDR A:0x770f044
y.create.l HWIO_LPASS_LPAIF_IRQ2_STAT2_ADDR A:0x7710044
y.create.l HWIO_LPASS_LPAIF_IRQ2_RAW_STAT0_ADDR A:0x770e048
y.create.l HWIO_LPASS_LPAIF_IRQ2_RAW_STAT1_ADDR A:0x770f048
y.create.l HWIO_LPASS_LPAIF_IRQ2_RAW_STAT2_ADDR A:0x7710048
y.create.l HWIO_LPASS_LPAIF_IRQ2_CLEAR0_ADDR A:0x770e04c
y.create.l HWIO_LPASS_LPAIF_IRQ2_CLEAR1_ADDR A:0x770f04c
y.create.l HWIO_LPASS_LPAIF_IRQ2_CLEAR2_ADDR A:0x771004c
y.create.l HWIO_LPASS_LPAIF_IRQ2_FORCE0_ADDR A:0x770e050
y.create.l HWIO_LPASS_LPAIF_IRQ2_FORCE1_ADDR A:0x770f050
y.create.l HWIO_LPASS_LPAIF_IRQ2_FORCE2_ADDR A:0x7710050
y.create.l HWIO_LPASS_LPAIF_RDDMA_CTL0_ADDR A:0x7710400
y.create.l HWIO_LPASS_LPAIF_RDDMA_CTL1_ADDR A:0x7711400
y.create.l HWIO_LPASS_LPAIF_RDDMA_CTL2_ADDR A:0x7712400
y.create.l HWIO_LPASS_LPAIF_RDDMA_BASE0_ADDR A:0x7710404
y.create.l HWIO_LPASS_LPAIF_RDDMA_BASE1_ADDR A:0x7711404
y.create.l HWIO_LPASS_LPAIF_RDDMA_BASE2_ADDR A:0x7712404
y.create.l HWIO_LPASS_LPAIF_RDDMA_BUFF_LEN0_ADDR A:0x7710408
y.create.l HWIO_LPASS_LPAIF_RDDMA_BUFF_LEN1_ADDR A:0x7711408
y.create.l HWIO_LPASS_LPAIF_RDDMA_BUFF_LEN2_ADDR A:0x7712408
y.create.l HWIO_LPASS_LPAIF_RDDMA_CURR_ADDR0_ADDR A:0x771040c
y.create.l HWIO_LPASS_LPAIF_RDDMA_CURR_ADDR1_ADDR A:0x771140c
y.create.l HWIO_LPASS_LPAIF_RDDMA_CURR_ADDR2_ADDR A:0x771240c
y.create.l HWIO_LPASS_LPAIF_RDDMA_PER_LEN0_ADDR A:0x7710410
y.create.l HWIO_LPASS_LPAIF_RDDMA_PER_LEN1_ADDR A:0x7711410
y.create.l HWIO_LPASS_LPAIF_RDDMA_PER_LEN2_ADDR A:0x7712410
y.create.l HWIO_LPASS_LPAIF_RDDMA_PER_CNT0_ADDR A:0x7710414
y.create.l HWIO_LPASS_LPAIF_RDDMA_PER_CNT1_ADDR A:0x7711414
y.create.l HWIO_LPASS_LPAIF_RDDMA_PER_CNT2_ADDR A:0x7712414
y.create.l HWIO_LPASS_LPAIF_RDDMA_FRM0_ADDR A:0x7710418
y.create.l HWIO_LPASS_LPAIF_RDDMA_FRM1_ADDR A:0x7711418
y.create.l HWIO_LPASS_LPAIF_RDDMA_FRM2_ADDR A:0x7712418
y.create.l HWIO_LPASS_LPAIF_RDDMA_FRMCLR0_ADDR A:0x771041c
y.create.l HWIO_LPASS_LPAIF_RDDMA_FRMCLR1_ADDR A:0x771141c
y.create.l HWIO_LPASS_LPAIF_RDDMA_FRMCLR2_ADDR A:0x771241c
y.create.l HWIO_LPASS_LPAIF_RDDMA_SET_BUFF_CNT0_ADDR A:0x7710420
y.create.l HWIO_LPASS_LPAIF_RDDMA_SET_BUFF_CNT1_ADDR A:0x7711420
y.create.l HWIO_LPASS_LPAIF_RDDMA_SET_BUFF_CNT2_ADDR A:0x7712420
y.create.l HWIO_LPASS_LPAIF_RDDMA_SET_PER_CNT0_ADDR A:0x7710424
y.create.l HWIO_LPASS_LPAIF_RDDMA_SET_PER_CNT1_ADDR A:0x7711424
y.create.l HWIO_LPASS_LPAIF_RDDMA_SET_PER_CNT2_ADDR A:0x7712424
y.create.l HWIO_LPASS_LPAIF_RDDMA_STC_LSB0_ADDR A:0x7710428
y.create.l HWIO_LPASS_LPAIF_RDDMA_STC_LSB1_ADDR A:0x7711428
y.create.l HWIO_LPASS_LPAIF_RDDMA_STC_LSB2_ADDR A:0x7712428
y.create.l HWIO_LPASS_LPAIF_RDDMA_STC_MSB0_ADDR A:0x771042c
y.create.l HWIO_LPASS_LPAIF_RDDMA_STC_MSB1_ADDR A:0x771142c
y.create.l HWIO_LPASS_LPAIF_RDDMA_STC_MSB2_ADDR A:0x771242c
y.create.l HWIO_LPASS_LPAIF_RDDMA_PER0_ADDR A:0x7710430
y.create.l HWIO_LPASS_LPAIF_RDDMA_PER1_ADDR A:0x7711430
y.create.l HWIO_LPASS_LPAIF_RDDMA_PER2_ADDR A:0x7712430
y.create.l HWIO_LPASS_LPAIF_RDDMA_PERCLR0_ADDR A:0x7710434
y.create.l HWIO_LPASS_LPAIF_RDDMA_PERCLR1_ADDR A:0x7711434
y.create.l HWIO_LPASS_LPAIF_RDDMA_PERCLR2_ADDR A:0x7712434
y.create.l HWIO_LPASS_LPAIF_RDDMA_BASE_EXT0_ADDR A:0x7710438
y.create.l HWIO_LPASS_LPAIF_RDDMA_BASE_EXT1_ADDR A:0x7711438
y.create.l HWIO_LPASS_LPAIF_RDDMA_BASE_EXT2_ADDR A:0x7712438
y.create.l HWIO_LPASS_LPAIF_RDDMA_CURR_ADDR_EXT0_ADDR A:0x771043c
y.create.l HWIO_LPASS_LPAIF_RDDMA_CURR_ADDR_EXT1_ADDR A:0x771143c
y.create.l HWIO_LPASS_LPAIF_RDDMA_CURR_ADDR_EXT2_ADDR A:0x771243c
y.create.l HWIO_LPASS_LPAIF_WRDMA_CTL0_ADDR A:0x7713000
y.create.l HWIO_LPASS_LPAIF_WRDMA_CTL1_ADDR A:0x7714000
y.create.l HWIO_LPASS_LPAIF_WRDMA_CTL2_ADDR A:0x7715000
y.create.l HWIO_LPASS_LPAIF_WRDMA_BASE0_ADDR A:0x7713004
y.create.l HWIO_LPASS_LPAIF_WRDMA_BASE1_ADDR A:0x7714004
y.create.l HWIO_LPASS_LPAIF_WRDMA_BASE2_ADDR A:0x7715004
y.create.l HWIO_LPASS_LPAIF_WRDMA_BUFF_LEN0_ADDR A:0x7713008
y.create.l HWIO_LPASS_LPAIF_WRDMA_BUFF_LEN1_ADDR A:0x7714008
y.create.l HWIO_LPASS_LPAIF_WRDMA_BUFF_LEN2_ADDR A:0x7715008
y.create.l HWIO_LPASS_LPAIF_WRDMA_CURR_ADDR0_ADDR A:0x771300c
y.create.l HWIO_LPASS_LPAIF_WRDMA_CURR_ADDR1_ADDR A:0x771400c
y.create.l HWIO_LPASS_LPAIF_WRDMA_CURR_ADDR2_ADDR A:0x771500c
y.create.l HWIO_LPASS_LPAIF_WRDMA_PER_LEN0_ADDR A:0x7713010
y.create.l HWIO_LPASS_LPAIF_WRDMA_PER_LEN1_ADDR A:0x7714010
y.create.l HWIO_LPASS_LPAIF_WRDMA_PER_LEN2_ADDR A:0x7715010
y.create.l HWIO_LPASS_LPAIF_WRDMA_PER_CNT0_ADDR A:0x7713014
y.create.l HWIO_LPASS_LPAIF_WRDMA_PER_CNT1_ADDR A:0x7714014
y.create.l HWIO_LPASS_LPAIF_WRDMA_PER_CNT2_ADDR A:0x7715014
y.create.l HWIO_LPASS_LPAIF_WRDMA_FRM0_ADDR A:0x7713018
y.create.l HWIO_LPASS_LPAIF_WRDMA_FRM1_ADDR A:0x7714018
y.create.l HWIO_LPASS_LPAIF_WRDMA_FRM2_ADDR A:0x7715018
y.create.l HWIO_LPASS_LPAIF_WRDMA_FRMCLR0_ADDR A:0x771301c
y.create.l HWIO_LPASS_LPAIF_WRDMA_FRMCLR1_ADDR A:0x771401c
y.create.l HWIO_LPASS_LPAIF_WRDMA_FRMCLR2_ADDR A:0x771501c
y.create.l HWIO_LPASS_LPAIF_WRDMA_SET_BUFF_CNT0_ADDR A:0x7713020
y.create.l HWIO_LPASS_LPAIF_WRDMA_SET_BUFF_CNT1_ADDR A:0x7714020
y.create.l HWIO_LPASS_LPAIF_WRDMA_SET_BUFF_CNT2_ADDR A:0x7715020
y.create.l HWIO_LPASS_LPAIF_WRDMA_SET_PER_CNT0_ADDR A:0x7713024
y.create.l HWIO_LPASS_LPAIF_WRDMA_SET_PER_CNT1_ADDR A:0x7714024
y.create.l HWIO_LPASS_LPAIF_WRDMA_SET_PER_CNT2_ADDR A:0x7715024
y.create.l HWIO_LPASS_LPAIF_WRDMA_STC_LSB0_ADDR A:0x7713028
y.create.l HWIO_LPASS_LPAIF_WRDMA_STC_LSB1_ADDR A:0x7714028
y.create.l HWIO_LPASS_LPAIF_WRDMA_STC_LSB2_ADDR A:0x7715028
y.create.l HWIO_LPASS_LPAIF_WRDMA_STC_MSB0_ADDR A:0x771302c
y.create.l HWIO_LPASS_LPAIF_WRDMA_STC_MSB1_ADDR A:0x771402c
y.create.l HWIO_LPASS_LPAIF_WRDMA_STC_MSB2_ADDR A:0x771502c
y.create.l HWIO_LPASS_LPAIF_WRDMA_PER0_ADDR A:0x7713030
y.create.l HWIO_LPASS_LPAIF_WRDMA_PER1_ADDR A:0x7714030
y.create.l HWIO_LPASS_LPAIF_WRDMA_PER2_ADDR A:0x7715030
y.create.l HWIO_LPASS_LPAIF_WRDMA_PERCLR0_ADDR A:0x7713034
y.create.l HWIO_LPASS_LPAIF_WRDMA_PERCLR1_ADDR A:0x7714034
y.create.l HWIO_LPASS_LPAIF_WRDMA_PERCLR2_ADDR A:0x7715034
y.create.l HWIO_LPASS_LPAIF_WRDMA_BASE_EXT0_ADDR A:0x7713038
y.create.l HWIO_LPASS_LPAIF_WRDMA_BASE_EXT1_ADDR A:0x7714038
y.create.l HWIO_LPASS_LPAIF_WRDMA_BASE_EXT2_ADDR A:0x7715038
y.create.l HWIO_LPASS_LPAIF_WRDMA_CURR_ADDR_EXT0_ADDR A:0x771303c
y.create.l HWIO_LPASS_LPAIF_WRDMA_CURR_ADDR_EXT1_ADDR A:0x771403c
y.create.l HWIO_LPASS_LPAIF_WRDMA_CURR_ADDR_EXT2_ADDR A:0x771503c
y.create.l HWIO_DWC_USB3_REG_BASE_START_ADDR A:0x1a00000
y.create.l HWIO_DWC_USB3_REG_BASE_LAST_ADDR A:0x1a0ca00
y.create.l HWIO_DWC_USB3_REG_BASE_END_ADDR A:0x1a0cd00
y.create.l HWIO_GUSB2PHYCFG_REGS_0_GUSB2PHYCFG_ADDR A:0x1a0c200
y.create.l HWIO_GUSB2PHYACC_REGS_0_GUSB2PHYACC_ULPI_ADDR A:0x1a0c280
y.create.l HWIO_GUSB3PIPECTL_REGS_0_GUSB3PIPECTL_ADDR A:0x1a0c2c0
y.create.l HWIO_GTXFIFOSIZ_REGS_0_GTXFIFOSIZ0_ADDR A:0x1a0c300
y.create.l HWIO_GTXFIFOSIZ_REGS_0_GTXFIFOSIZ1_ADDR A:0x1a0c304
y.create.l HWIO_GTXFIFOSIZ_REGS_0_GTXFIFOSIZ2_ADDR A:0x1a0c308
y.create.l HWIO_GTXFIFOSIZ_REGS_0_GTXFIFOSIZ3_ADDR A:0x1a0c30c
y.create.l HWIO_GTXFIFOSIZ_REGS_0_GTXFIFOSIZ4_ADDR A:0x1a0c310
y.create.l HWIO_GTXFIFOSIZ_REGS_0_GTXFIFOSIZ5_ADDR A:0x1a0c314
y.create.l HWIO_GTXFIFOSIZ_REGS_0_GTXFIFOSIZ6_ADDR A:0x1a0c318
y.create.l HWIO_GTXFIFOSIZ_REGS_0_GTXFIFOSIZ7_ADDR A:0x1a0c31c
y.create.l HWIO_GRXFIFOSIZ_REGS_0_GRXFIFOSIZ0_ADDR A:0x1a0c380
y.create.l HWIO_GEVNTADRLO_REGS_0_GEVNTADRLO_ADDR A:0x1a0c400
y.create.l HWIO_GEVNTADRLO_REGS_0_GEVNTADRHI_ADDR A:0x1a0c404
y.create.l HWIO_GEVNTADRLO_REGS_0_GEVNTSIZ_ADDR A:0x1a0c408
y.create.l HWIO_GEVNTADRLO_REGS_0_GEVNTCOUNT_ADDR A:0x1a0c40c
y.create.l HWIO_GSBUSCFG0_ADDR A:0x1a0c100
y.create.l HWIO_GSBUSCFG1_ADDR A:0x1a0c104
y.create.l HWIO_GTXTHRCFG_ADDR A:0x1a0c108
y.create.l HWIO_GRXTHRCFG_ADDR A:0x1a0c10c
y.create.l HWIO_GCTL_ADDR A:0x1a0c110
y.create.l HWIO_GPMSTS_ADDR A:0x1a0c114
y.create.l HWIO_GSTS_ADDR A:0x1a0c118
y.create.l HWIO_GUCTL1_ADDR A:0x1a0c11c
y.create.l HWIO_GSNPSID_ADDR A:0x1a0c120
y.create.l HWIO_GGPIO_ADDR A:0x1a0c124
y.create.l HWIO_GUID_ADDR A:0x1a0c128
y.create.l HWIO_GUCTL_ADDR A:0x1a0c12c
y.create.l HWIO_GBUSERRADDRLO_ADDR A:0x1a0c130
y.create.l HWIO_GBUSERRADDRHI_ADDR A:0x1a0c134
y.create.l HWIO_GPRTBIMAPLO_ADDR A:0x1a0c138
y.create.l HWIO_GPRTBIMAPHI_ADDR A:0x1a0c13c
y.create.l HWIO_GHWPARAMS0_ADDR A:0x1a0c140
y.create.l HWIO_GHWPARAMS1_ADDR A:0x1a0c144
y.create.l HWIO_GHWPARAMS2_ADDR A:0x1a0c148
y.create.l HWIO_GHWPARAMS3_ADDR A:0x1a0c14c
y.create.l HWIO_GHWPARAMS4_ADDR A:0x1a0c150
y.create.l HWIO_GHWPARAMS5_ADDR A:0x1a0c154
y.create.l HWIO_GHWPARAMS6_ADDR A:0x1a0c158
y.create.l HWIO_GHWPARAMS7_ADDR A:0x1a0c15c
y.create.l HWIO_GDBGFIFOSPACE_ADDR A:0x1a0c160
y.create.l HWIO_GDBGLTSSM_ADDR A:0x1a0c164
y.create.l HWIO_GDBGLNMCC_ADDR A:0x1a0c168
y.create.l HWIO_GDBGBMU_ADDR A:0x1a0c16c
y.create.l HWIO_GDBGLSPMUX_HST_ADDR A:0x1a0c170
y.create.l HWIO_GDBGLSP_ADDR A:0x1a0c174
y.create.l HWIO_GDBGEPINFO0_ADDR A:0x1a0c178
y.create.l HWIO_GDBGEPINFO1_ADDR A:0x1a0c17c
y.create.l HWIO_GPRTBIMAP_HSLO_ADDR A:0x1a0c180
y.create.l HWIO_GPRTBIMAP_HSHI_ADDR A:0x1a0c184
y.create.l HWIO_GPRTBIMAP_FSLO_ADDR A:0x1a0c188
y.create.l HWIO_GPRTBIMAP_FSHI_ADDR A:0x1a0c18c
y.create.l HWIO_GUCTL2_ADDR A:0x1a0c19c
y.create.l HWIO_GHWPARAMS8_ADDR A:0x1a0c600
y.create.l HWIO_GTXFIFOPRIDEV_ADDR A:0x1a0c610
y.create.l HWIO_GFLADJ_ADDR A:0x1a0c630
y.create.l HWIO_DEPCMDPAR2_REGS_0_DEPCMDPAR2_ADDR A:0x1a0c800
y.create.l HWIO_DEPCMDPAR2_REGS_1_DEPCMDPAR2_ADDR A:0x1a0c810
y.create.l HWIO_DEPCMDPAR2_REGS_2_DEPCMDPAR2_ADDR A:0x1a0c820
y.create.l HWIO_DEPCMDPAR2_REGS_3_DEPCMDPAR2_ADDR A:0x1a0c830
y.create.l HWIO_DEPCMDPAR2_REGS_4_DEPCMDPAR2_ADDR A:0x1a0c840
y.create.l HWIO_DEPCMDPAR2_REGS_5_DEPCMDPAR2_ADDR A:0x1a0c850
y.create.l HWIO_DEPCMDPAR2_REGS_6_DEPCMDPAR2_ADDR A:0x1a0c860
y.create.l HWIO_DEPCMDPAR2_REGS_7_DEPCMDPAR2_ADDR A:0x1a0c870
y.create.l HWIO_DEPCMDPAR2_REGS_8_DEPCMDPAR2_ADDR A:0x1a0c880
y.create.l HWIO_DEPCMDPAR2_REGS_9_DEPCMDPAR2_ADDR A:0x1a0c890
y.create.l HWIO_DEPCMDPAR2_REGS_0_DEPCMDPAR1_ADDR A:0x1a0c804
y.create.l HWIO_DEPCMDPAR2_REGS_1_DEPCMDPAR1_ADDR A:0x1a0c814
y.create.l HWIO_DEPCMDPAR2_REGS_2_DEPCMDPAR1_ADDR A:0x1a0c824
y.create.l HWIO_DEPCMDPAR2_REGS_3_DEPCMDPAR1_ADDR A:0x1a0c834
y.create.l HWIO_DEPCMDPAR2_REGS_4_DEPCMDPAR1_ADDR A:0x1a0c844
y.create.l HWIO_DEPCMDPAR2_REGS_5_DEPCMDPAR1_ADDR A:0x1a0c854
y.create.l HWIO_DEPCMDPAR2_REGS_6_DEPCMDPAR1_ADDR A:0x1a0c864
y.create.l HWIO_DEPCMDPAR2_REGS_7_DEPCMDPAR1_ADDR A:0x1a0c874
y.create.l HWIO_DEPCMDPAR2_REGS_8_DEPCMDPAR1_ADDR A:0x1a0c884
y.create.l HWIO_DEPCMDPAR2_REGS_9_DEPCMDPAR1_ADDR A:0x1a0c894
y.create.l HWIO_DEPCMDPAR2_REGS_0_DEPCMDPAR0_ADDR A:0x1a0c808
y.create.l HWIO_DEPCMDPAR2_REGS_1_DEPCMDPAR0_ADDR A:0x1a0c818
y.create.l HWIO_DEPCMDPAR2_REGS_2_DEPCMDPAR0_ADDR A:0x1a0c828
y.create.l HWIO_DEPCMDPAR2_REGS_3_DEPCMDPAR0_ADDR A:0x1a0c838
y.create.l HWIO_DEPCMDPAR2_REGS_4_DEPCMDPAR0_ADDR A:0x1a0c848
y.create.l HWIO_DEPCMDPAR2_REGS_5_DEPCMDPAR0_ADDR A:0x1a0c858
y.create.l HWIO_DEPCMDPAR2_REGS_6_DEPCMDPAR0_ADDR A:0x1a0c868
y.create.l HWIO_DEPCMDPAR2_REGS_7_DEPCMDPAR0_ADDR A:0x1a0c878
y.create.l HWIO_DEPCMDPAR2_REGS_8_DEPCMDPAR0_ADDR A:0x1a0c888
y.create.l HWIO_DEPCMDPAR2_REGS_9_DEPCMDPAR0_ADDR A:0x1a0c898
y.create.l HWIO_DEPCMDPAR2_REGS_0_DEPCMD_ADDR A:0x1a0c80c
y.create.l HWIO_DEPCMDPAR2_REGS_1_DEPCMD_ADDR A:0x1a0c81c
y.create.l HWIO_DEPCMDPAR2_REGS_2_DEPCMD_ADDR A:0x1a0c82c
y.create.l HWIO_DEPCMDPAR2_REGS_3_DEPCMD_ADDR A:0x1a0c83c
y.create.l HWIO_DEPCMDPAR2_REGS_4_DEPCMD_ADDR A:0x1a0c84c
y.create.l HWIO_DEPCMDPAR2_REGS_5_DEPCMD_ADDR A:0x1a0c85c
y.create.l HWIO_DEPCMDPAR2_REGS_6_DEPCMD_ADDR A:0x1a0c86c
y.create.l HWIO_DEPCMDPAR2_REGS_7_DEPCMD_ADDR A:0x1a0c87c
y.create.l HWIO_DEPCMDPAR2_REGS_8_DEPCMD_ADDR A:0x1a0c88c
y.create.l HWIO_DEPCMDPAR2_REGS_9_DEPCMD_ADDR A:0x1a0c89c
y.create.l HWIO_DEV_IMOD_REGS_0_DEV_IMOD_ADDR A:0x1a0ca00
y.create.l HWIO_DCFG_ADDR A:0x1a0c700
y.create.l HWIO_DCTL_ADDR A:0x1a0c704
y.create.l HWIO_DEVTEN_ADDR A:0x1a0c708
y.create.l HWIO_DSTS_ADDR A:0x1a0c70c
y.create.l HWIO_DGCMDPAR_ADDR A:0x1a0c710
y.create.l HWIO_DGCMD_ADDR A:0x1a0c714
y.create.l HWIO_DALEPENA_ADDR A:0x1a0c720
y.create.l HWIO_USB30_QSCRATCH_REG_BASE_START_ADDR A:0x1af8800
y.create.l HWIO_USB30_QSCRATCH_REG_BASE_LAST_ADDR A:0x1af89b0
y.create.l HWIO_USB30_QSCRATCH_REG_BASE_END_ADDR A:0x1af8c00
y.create.l HWIO_IPCAT_REG_ADDR A:0x1af8800
y.create.l HWIO_CTRL_REG_ADDR A:0x1af8804
y.create.l HWIO_GENERAL_CFG_ADDR A:0x1af8808
y.create.l HWIO_RAM1_REG_ADDR A:0x1af880c
y.create.l HWIO_HS_PHY_CTRL_ADDR A:0x1af8810
y.create.l HWIO_CHARGING_DET_OUTPUT_ADDR A:0x1af881c
y.create.l HWIO_ALT_INTERRUPT_EN_ADDR A:0x1af8820
y.create.l HWIO_HS_PHY_IRQ_STAT_ADDR A:0x1af8824
y.create.l HWIO_CGCTL_REG_ADDR A:0x1af8828
y.create.l HWIO_DBG_BUS_REG_ADDR A:0x1af882c
y.create.l HWIO_DBG_BUS_DATA_ADDR A:0x1af8834
y.create.l HWIO_SS_PHY_CTRL_ADDR A:0x1af8830
y.create.l HWIO_PWR_EVNT_IRQ_STAT_ADDR A:0x1af8858
y.create.l HWIO_PWR_EVNT_IRQ_MASK_ADDR A:0x1af885c
y.create.l HWIO_HW_SW_EVT_CTRL_REG_ADDR A:0x1af8860
y.create.l HWIO_FLADJ_30MHZ_REG_ADDR A:0x1af8868
y.create.l HWIO_M_AW_USER_REG_ADDR A:0x1af886c
y.create.l HWIO_M_AR_USER_REG_ADDR A:0x1af8870
y.create.l HWIO_QSCRTCH_REG_0_ADDR A:0x1af88b4
y.create.l HWIO_QSCRTCH_REG_1_ADDR A:0x1af88b8
y.create.l HWIO_QSCRTCH_REG_2_ADDR A:0x1af88bc
y.create.l HWIO_QSCRTCH_REG_3_ADDR A:0x1af88c0
y.create.l HWIO_QSCRTCH_REG_4_ADDR A:0x1af88c4
y.create.l HWIO_SS_QMP_PHY_CTRL_ADDR A:0x1af88f0
y.create.l HWIO_SNPS_CORE_CFG_ADDR A:0x1af88f4
y.create.l HWIO_USB30_STS_REG_ADDR A:0x1af88f8
y.create.l HWIO_USB30_GSI_GENERAL_CFG_ADDR A:0x1af88fc
y.create.l HWIO_USB30_GSI_EVT_POINTER_L_ADDR A:0x1af8900
y.create.l HWIO_USB30_GSI_EVT_POINTER_H_ADDR A:0x1af8904
y.create.l HWIO_USB30_GSI_EVT_ON_ERR_L_ADDR A:0x1af8908
y.create.l HWIO_USB30_GSI_EVT_ON_ERR_H_ADDR A:0x1af890c
y.create.l HWIO_USB30_GSI_DBL_ADDR_L0_ADDR A:0x1af8910
y.create.l HWIO_USB30_GSI_DBL_ADDR_L1_ADDR A:0x1af8914
y.create.l HWIO_USB30_GSI_DBL_ADDR_L2_ADDR A:0x1af8918
y.create.l HWIO_USB30_GSI_DBL_ADDR_H0_ADDR A:0x1af8920
y.create.l HWIO_USB30_GSI_DBL_ADDR_H1_ADDR A:0x1af8924
y.create.l HWIO_USB30_GSI_DBL_ADDR_H2_ADDR A:0x1af8928
y.create.l HWIO_USB30_GSI_RING_BASE_ADDR_L0_ADDR A:0x1af8930
y.create.l HWIO_USB30_GSI_RING_BASE_ADDR_L1_ADDR A:0x1af8934
y.create.l HWIO_USB30_GSI_RING_BASE_ADDR_L2_ADDR A:0x1af8938
y.create.l HWIO_USB30_GSI_RING_BASE_ADDR_H0_ADDR A:0x1af8944
y.create.l HWIO_USB30_GSI_RING_BASE_ADDR_H1_ADDR A:0x1af8948
y.create.l HWIO_USB30_GSI_RING_BASE_ADDR_H2_ADDR A:0x1af894c
y.create.l HWIO_USB30_GSI_DEPCMD_ADDR_L_IPA_EP0_ADDR A:0x1af8950
y.create.l HWIO_USB30_GSI_DEPCMD_ADDR_L_IPA_EP1_ADDR A:0x1af8954
y.create.l HWIO_USB30_IMOD0_ADDR A:0x1af8970
y.create.l HWIO_USB30_IMOD1_ADDR A:0x1af8974
y.create.l HWIO_USB30_USEC_CNT_ADDR A:0x1af8980
y.create.l HWIO_USB30_GSI_IF_CAP_WB_ADDR0_ADDR A:0x1af8984
y.create.l HWIO_USB30_GSI_IF_CAP_WB_ADDR1_ADDR A:0x1af8988
y.create.l HWIO_USB30_GSI_IF_CAP_WB_ADDR2_ADDR A:0x1af898c
y.create.l HWIO_USB30_GSI_IF_CAP_WB_ADDR0_H_ADDR A:0x1af8990
y.create.l HWIO_USB30_GSI_IF_CAP_WB_ADDR1_H_ADDR A:0x1af8994
y.create.l HWIO_USB30_GSI_IF_CAP_WB_ADDR2_H_ADDR A:0x1af8998
y.create.l HWIO_USB30_GSI_IF_STS1_ADDR A:0x1af89a4
y.create.l HWIO_USB30_GSI_EVT_ON_ERR2_L_ADDR A:0x1af89a8
y.create.l HWIO_USB30_GSI_EVT_ON_ERR2_H_ADDR A:0x1af89ac
y.create.l HWIO_USB30_CHIKEN_BIT_REG_ADDR A:0x1af89b0
y.create.l HWIO_USB30_QSRAM_REGS_REG_BASE_START_ADDR A:0x1afc000
y.create.l HWIO_USB30_QSRAM_REGS_REG_BASE_LAST_ADDR A:0x1afc0fc
y.create.l HWIO_USB30_QSRAM_REGS_REG_BASE_END_ADDR A:0x1afc100
y.create.l HWIO_QSRAM_REG_0_ADDR A:0x1afc000
y.create.l HWIO_QSRAM_REG_1_ADDR A:0x1afc004
y.create.l HWIO_QSRAM_REG_2_ADDR A:0x1afc008
y.create.l HWIO_QSRAM_REG_3_ADDR A:0x1afc00c
y.create.l HWIO_QSRAM_REG_4_ADDR A:0x1afc010
y.create.l HWIO_QSRAM_REG_5_ADDR A:0x1afc014
y.create.l HWIO_QSRAM_REG_6_ADDR A:0x1afc018
y.create.l HWIO_QSRAM_REG_7_ADDR A:0x1afc01c
y.create.l HWIO_QSRAM_REG_8_ADDR A:0x1afc020
y.create.l HWIO_QSRAM_REG_9_ADDR A:0x1afc024
y.create.l HWIO_USB30_DBM_REGFILE_REG_BASE_START_ADDR A:0x1af8000
y.create.l HWIO_USB30_DBM_REGFILE_REG_BASE_LAST_ADDR A:0x1af8304
y.create.l HWIO_USB30_DBM_REGFILE_REG_BASE_END_ADDR A:0x1af8400
y.create.l HWIO_DBM_EP_CFG_ADDR0_ADDR A:0x1af8000
y.create.l HWIO_DBM_EP_CFG_ADDR1_ADDR A:0x1af8004
y.create.l HWIO_DBM_EP_CFG_ADDR2_ADDR A:0x1af8008
y.create.l HWIO_DBM_EP_CFG_ADDR3_ADDR A:0x1af800c
y.create.l HWIO_DBM_DATA_SIZE_ADDR0_ADDR A:0x1af8080
y.create.l HWIO_DBM_DATA_SIZE_ADDR1_ADDR A:0x1af8084
y.create.l HWIO_DBM_DATA_SIZE_ADDR2_ADDR A:0x1af8088
y.create.l HWIO_DBM_DATA_SIZE_ADDR3_ADDR A:0x1af808c
y.create.l HWIO_DBM_DATA_FIFO_ADDR_LSB0_ADDR A:0x1af8100
y.create.l HWIO_DBM_DATA_FIFO_ADDR_LSB1_ADDR A:0x1af8108
y.create.l HWIO_DBM_DATA_FIFO_ADDR_LSB2_ADDR A:0x1af8110
y.create.l HWIO_DBM_DATA_FIFO_ADDR_LSB3_ADDR A:0x1af8118
y.create.l HWIO_DBM_DATA_FIFO_ADDR_MSB0_ADDR A:0x1af8104
y.create.l HWIO_DBM_DATA_FIFO_ADDR_MSB1_ADDR A:0x1af810c
y.create.l HWIO_DBM_DATA_FIFO_ADDR_MSB2_ADDR A:0x1af8114
y.create.l HWIO_DBM_DATA_FIFO_ADDR_MSB3_ADDR A:0x1af811c
y.create.l HWIO_DBM_DATA_FIFO_ADDR_EN_ADDR A:0x1af8200
y.create.l HWIO_DBM_DATA_FIFO_SIZE_EN_ADDR A:0x1af8204
y.create.l HWIO_DBM_DBG_CNFG_ADDR A:0x1af8208
y.create.l HWIO_DBM_DIS_UPDXFER_ADDR A:0x1af8298
y.create.l HWIO_DBM_DEPCMD_IOC_ADDR A:0x1af829c
y.create.l HWIO_DBM_DEPCMD_CMDACT_ADDR A:0x1af8300
y.create.l HWIO_DBM_DEPCMD_HIPRI_ADDR A:0x1af8304
y.create.l HWIO_DBM_SOFT_RESET_ADDR A:0x1af820c
y.create.l HWIO_DBM_GEN_CFG_ADDR A:0x1af8210
y.create.l HWIO_DBM_STATUS_ADDR A:0x1af8214
y.create.l HWIO_DBM_STATES_ADDR A:0x1af8218
y.create.l HWIO_DBM_HW_TRB0_EP0_ADDR A:0x1af8220
y.create.l HWIO_DBM_HW_TRB0_EP1_ADDR A:0x1af8224
y.create.l HWIO_DBM_HW_TRB0_EP2_ADDR A:0x1af8228
y.create.l HWIO_DBM_HW_TRB0_EP3_ADDR A:0x1af822c
y.create.l HWIO_DBM_HW_TRB1_EP0_ADDR A:0x1af8230
y.create.l HWIO_DBM_HW_TRB1_EP1_ADDR A:0x1af8234
y.create.l HWIO_DBM_HW_TRB1_EP2_ADDR A:0x1af8238
y.create.l HWIO_DBM_HW_TRB1_EP3_ADDR A:0x1af823c
y.create.l HWIO_DBM_HW_TRB2_EP0_ADDR A:0x1af8240
y.create.l HWIO_DBM_HW_TRB2_EP1_ADDR A:0x1af8244
y.create.l HWIO_DBM_HW_TRB2_EP2_ADDR A:0x1af8248
y.create.l HWIO_DBM_HW_TRB2_EP3_ADDR A:0x1af824c
y.create.l HWIO_DBM_HW_TRB3_EP0_ADDR A:0x1af8250
y.create.l HWIO_DBM_HW_TRB3_EP1_ADDR A:0x1af8254
y.create.l HWIO_DBM_HW_TRB3_EP2_ADDR A:0x1af8258
y.create.l HWIO_DBM_HW_TRB3_EP3_ADDR A:0x1af825c
y.create.l HWIO_DBM_GEVNTADR_LSB_ADDR A:0x1af8260
y.create.l HWIO_DBM_GEVNTADR_MSB_ADDR A:0x1af8264
y.create.l HWIO_DBM_GEVNTSIZ_ADDR A:0x1af8268
y.create.l HWIO_DBM_DATA_FIFO_EN_ADDR A:0x1af826c
y.create.l HWIO_DBM_GEVNTADR_ADDR A:0x1af8270
y.create.l HWIO_DBM_PIPE_CFG_ADDR A:0x1af8274
y.create.l HWIO_INACTIVITY_TIMER_ADDR A:0x1af8278
y.create.l HWIO_DBM_DATA_FIFO_ADDR0_ADDR A:0x1af8280
y.create.l HWIO_DBM_DATA_FIFO_ADDR1_ADDR A:0x1af8284
y.create.l HWIO_DBM_DATA_FIFO_ADDR2_ADDR A:0x1af8288
y.create.l HWIO_DBM_DATA_FIFO_ADDR3_ADDR A:0x1af828c
y.create.l HWIO_DBM_TRB_TRACE_CNT_ADDR A:0x1af8290
y.create.l HWIO_EP_FIFO_OVERRUN_ADDR_ADDR A:0x1af8294
y.create.l HWIO_USB30_BAM_REG_BASE_START_ADDR A:0x1b04000
y.create.l HWIO_USB30_BAM_REG_BASE_LAST_ADDR A:0x1b1a934
y.create.l HWIO_USB30_BAM_REG_BASE_END_ADDR A:0x1b1b000
y.create.l HWIO_USB30_BAM_CTRL_ADDR A:0x1b04000
y.create.l HWIO_USB30_BAM_TIMER_ADDR A:0x1b04040
y.create.l HWIO_USB30_BAM_TIMER_CTRL_ADDR A:0x1b04044
y.create.l HWIO_USB30_BAM_DESC_CNT_TRSHLD_ADDR A:0x1b04008
y.create.l HWIO_USB30_BAM_IRQ_STTS_ADDR A:0x1b04014
y.create.l HWIO_USB30_BAM_IRQ_CLR_ADDR A:0x1b04018
y.create.l HWIO_USB30_BAM_IRQ_EN_ADDR A:0x1b0401c
y.create.l HWIO_USB30_BAM_CNFG_BITS_ADDR A:0x1b0407c
y.create.l HWIO_USB30_BAM_CNFG_BITS_2_ADDR A:0x1b04084
y.create.l HWIO_USB30_BAM_REVISION_ADDR A:0x1b05000
y.create.l HWIO_USB30_BAM_SW_VERSION_ADDR A:0x1b05004
y.create.l HWIO_USB30_BAM_NUM_PIPES_ADDR A:0x1b05008
y.create.l HWIO_USB30_BAM_TEST_BUS_SEL_ADDR A:0x1b05010
y.create.l HWIO_USB30_BAM_TEST_BUS_REG_ADDR A:0x1b05014
y.create.l HWIO_USB30_BAM_AHB_MASTER_ERR_CTRLS_ADDR A:0x1b05024
y.create.l HWIO_USB30_BAM_AHB_MASTER_ERR_ADDR_ADDR A:0x1b05028
y.create.l HWIO_USB30_BAM_AHB_MASTER_ERR_DATA_ADDR A:0x1b0502c
y.create.l HWIO_USB30_BAM_AHB_MASTER_ERR_ADDR_LSB_ADDR A:0x1b05100
y.create.l HWIO_USB30_BAM_AHB_MASTER_ERR_ADDR_MSB_ADDR A:0x1b05104
y.create.l HWIO_USB30_BAM_TRUST_REG_ADDR A:0x1b06000
y.create.l HWIO_USB30_BAM_P_TRUST_REG0_ADDR A:0x1b06020
y.create.l HWIO_USB30_BAM_P_TRUST_REG1_ADDR A:0x1b06024
y.create.l HWIO_USB30_BAM_P_TRUST_REG2_ADDR A:0x1b06028
y.create.l HWIO_USB30_BAM_P_TRUST_REG3_ADDR A:0x1b0602c
y.create.l HWIO_USB30_BAM_IRQ_SRCS_EE0_ADDR A:0x1b07000
y.create.l HWIO_USB30_BAM_IRQ_SRCS_EE1_ADDR A:0x1b08000
y.create.l HWIO_USB30_BAM_IRQ_SRCS_EE2_ADDR A:0x1b09000
y.create.l HWIO_USB30_BAM_IRQ_SRCS_EE3_ADDR A:0x1b0a000
y.create.l HWIO_USB30_BAM_IRQ_SRCS_MSK_EE0_ADDR A:0x1b07004
y.create.l HWIO_USB30_BAM_IRQ_SRCS_MSK_EE1_ADDR A:0x1b08004
y.create.l HWIO_USB30_BAM_IRQ_SRCS_MSK_EE2_ADDR A:0x1b09004
y.create.l HWIO_USB30_BAM_IRQ_SRCS_MSK_EE3_ADDR A:0x1b0a004
y.create.l HWIO_USB30_BAM_IRQ_SRCS_UNMASKED_EE0_ADDR A:0x1b07008
y.create.l HWIO_USB30_BAM_IRQ_SRCS_UNMASKED_EE1_ADDR A:0x1b08008
y.create.l HWIO_USB30_BAM_IRQ_SRCS_UNMASKED_EE2_ADDR A:0x1b09008
y.create.l HWIO_USB30_BAM_IRQ_SRCS_UNMASKED_EE3_ADDR A:0x1b0a008
y.create.l HWIO_USB30_BAM_PIPE_ATTR_EE0_ADDR A:0x1b0700c
y.create.l HWIO_USB30_BAM_PIPE_ATTR_EE1_ADDR A:0x1b0800c
y.create.l HWIO_USB30_BAM_PIPE_ATTR_EE2_ADDR A:0x1b0900c
y.create.l HWIO_USB30_BAM_PIPE_ATTR_EE3_ADDR A:0x1b0a00c
y.create.l HWIO_USB30_BAM_IRQ_SRCS_ADDR A:0x1b07010
y.create.l HWIO_USB30_BAM_IRQ_SRCS_MSK_ADDR A:0x1b07014
y.create.l HWIO_USB30_BAM_IRQ_SRCS_UNMASKED_ADDR A:0x1b07018
y.create.l HWIO_USB30_BAM_P_CTRL0_ADDR A:0x1b17000
y.create.l HWIO_USB30_BAM_P_CTRL1_ADDR A:0x1b18000
y.create.l HWIO_USB30_BAM_P_CTRL2_ADDR A:0x1b19000
y.create.l HWIO_USB30_BAM_P_CTRL3_ADDR A:0x1b1a000
y.create.l HWIO_USB30_BAM_P_RST0_ADDR A:0x1b17004
y.create.l HWIO_USB30_BAM_P_RST1_ADDR A:0x1b18004
y.create.l HWIO_USB30_BAM_P_RST2_ADDR A:0x1b19004
y.create.l HWIO_USB30_BAM_P_RST3_ADDR A:0x1b1a004
y.create.l HWIO_USB30_BAM_P_HALT0_ADDR A:0x1b17008
y.create.l HWIO_USB30_BAM_P_HALT1_ADDR A:0x1b18008
y.create.l HWIO_USB30_BAM_P_HALT2_ADDR A:0x1b19008
y.create.l HWIO_USB30_BAM_P_HALT3_ADDR A:0x1b1a008
y.create.l HWIO_USB30_BAM_P_IRQ_STTS0_ADDR A:0x1b17010
y.create.l HWIO_USB30_BAM_P_IRQ_STTS1_ADDR A:0x1b18010
y.create.l HWIO_USB30_BAM_P_IRQ_STTS2_ADDR A:0x1b19010
y.create.l HWIO_USB30_BAM_P_IRQ_STTS3_ADDR A:0x1b1a010
y.create.l HWIO_USB30_BAM_P_IRQ_CLR0_ADDR A:0x1b17014
y.create.l HWIO_USB30_BAM_P_IRQ_CLR1_ADDR A:0x1b18014
y.create.l HWIO_USB30_BAM_P_IRQ_CLR2_ADDR A:0x1b19014
y.create.l HWIO_USB30_BAM_P_IRQ_CLR3_ADDR A:0x1b1a014
y.create.l HWIO_USB30_BAM_P_IRQ_EN0_ADDR A:0x1b17018
y.create.l HWIO_USB30_BAM_P_IRQ_EN1_ADDR A:0x1b18018
y.create.l HWIO_USB30_BAM_P_IRQ_EN2_ADDR A:0x1b19018
y.create.l HWIO_USB30_BAM_P_IRQ_EN3_ADDR A:0x1b1a018
y.create.l HWIO_USB30_BAM_P_TIMER0_ADDR A:0x1b1701c
y.create.l HWIO_USB30_BAM_P_TIMER1_ADDR A:0x1b1801c
y.create.l HWIO_USB30_BAM_P_TIMER2_ADDR A:0x1b1901c
y.create.l HWIO_USB30_BAM_P_TIMER3_ADDR A:0x1b1a01c
y.create.l HWIO_USB30_BAM_P_TIMER_CTRL0_ADDR A:0x1b17020
y.create.l HWIO_USB30_BAM_P_TIMER_CTRL1_ADDR A:0x1b18020
y.create.l HWIO_USB30_BAM_P_TIMER_CTRL2_ADDR A:0x1b19020
y.create.l HWIO_USB30_BAM_P_TIMER_CTRL3_ADDR A:0x1b1a020
y.create.l HWIO_USB30_BAM_P_PRDCR_SDBND0_ADDR A:0x1b17024
y.create.l HWIO_USB30_BAM_P_PRDCR_SDBND1_ADDR A:0x1b18024
y.create.l HWIO_USB30_BAM_P_PRDCR_SDBND2_ADDR A:0x1b19024
y.create.l HWIO_USB30_BAM_P_PRDCR_SDBND3_ADDR A:0x1b1a024
y.create.l HWIO_USB30_BAM_P_CNSMR_SDBND0_ADDR A:0x1b17028
y.create.l HWIO_USB30_BAM_P_CNSMR_SDBND1_ADDR A:0x1b18028
y.create.l HWIO_USB30_BAM_P_CNSMR_SDBND2_ADDR A:0x1b19028
y.create.l HWIO_USB30_BAM_P_CNSMR_SDBND3_ADDR A:0x1b1a028
y.create.l HWIO_USB30_BAM_P_SW_OFSTS0_ADDR A:0x1b17800
y.create.l HWIO_USB30_BAM_P_SW_OFSTS1_ADDR A:0x1b18800
y.create.l HWIO_USB30_BAM_P_SW_OFSTS2_ADDR A:0x1b19800
y.create.l HWIO_USB30_BAM_P_SW_OFSTS3_ADDR A:0x1b1a800
y.create.l HWIO_USB30_BAM_P_AU_PSM_CNTXT_1_0_ADDR A:0x1b17804
y.create.l HWIO_USB30_BAM_P_AU_PSM_CNTXT_1_1_ADDR A:0x1b18804
y.create.l HWIO_USB30_BAM_P_AU_PSM_CNTXT_1_2_ADDR A:0x1b19804
y.create.l HWIO_USB30_BAM_P_AU_PSM_CNTXT_1_3_ADDR A:0x1b1a804
y.create.l HWIO_USB30_BAM_P_PSM_CNTXT_2_0_ADDR A:0x1b17808
y.create.l HWIO_USB30_BAM_P_PSM_CNTXT_2_1_ADDR A:0x1b18808
y.create.l HWIO_USB30_BAM_P_PSM_CNTXT_2_2_ADDR A:0x1b19808
y.create.l HWIO_USB30_BAM_P_PSM_CNTXT_2_3_ADDR A:0x1b1a808
y.create.l HWIO_USB30_BAM_P_PSM_CNTXT_3_0_ADDR A:0x1b1780c
y.create.l HWIO_USB30_BAM_P_PSM_CNTXT_3_1_ADDR A:0x1b1880c
y.create.l HWIO_USB30_BAM_P_PSM_CNTXT_3_2_ADDR A:0x1b1980c
y.create.l HWIO_USB30_BAM_P_PSM_CNTXT_3_3_ADDR A:0x1b1a80c
y.create.l HWIO_USB30_BAM_P_PSM_CNTXT_4_0_ADDR A:0x1b17810
y.create.l HWIO_USB30_BAM_P_PSM_CNTXT_4_1_ADDR A:0x1b18810
y.create.l HWIO_USB30_BAM_P_PSM_CNTXT_4_2_ADDR A:0x1b19810
y.create.l HWIO_USB30_BAM_P_PSM_CNTXT_4_3_ADDR A:0x1b1a810
y.create.l HWIO_USB30_BAM_P_PSM_CNTXT_5_0_ADDR A:0x1b17814
y.create.l HWIO_USB30_BAM_P_PSM_CNTXT_5_1_ADDR A:0x1b18814
y.create.l HWIO_USB30_BAM_P_PSM_CNTXT_5_2_ADDR A:0x1b19814
y.create.l HWIO_USB30_BAM_P_PSM_CNTXT_5_3_ADDR A:0x1b1a814
y.create.l HWIO_USB30_BAM_P_EVNT_REG0_ADDR A:0x1b17818
y.create.l HWIO_USB30_BAM_P_EVNT_REG1_ADDR A:0x1b18818
y.create.l HWIO_USB30_BAM_P_EVNT_REG2_ADDR A:0x1b19818
y.create.l HWIO_USB30_BAM_P_EVNT_REG3_ADDR A:0x1b1a818
y.create.l HWIO_USB30_BAM_P_DESC_FIFO_ADDR0_ADDR A:0x1b1781c
y.create.l HWIO_USB30_BAM_P_DESC_FIFO_ADDR1_ADDR A:0x1b1881c
y.create.l HWIO_USB30_BAM_P_DESC_FIFO_ADDR2_ADDR A:0x1b1981c
y.create.l HWIO_USB30_BAM_P_DESC_FIFO_ADDR3_ADDR A:0x1b1a81c
y.create.l HWIO_USB30_BAM_P_FIFO_SIZES0_ADDR A:0x1b17820
y.create.l HWIO_USB30_BAM_P_FIFO_SIZES1_ADDR A:0x1b18820
y.create.l HWIO_USB30_BAM_P_FIFO_SIZES2_ADDR A:0x1b19820
y.create.l HWIO_USB30_BAM_P_FIFO_SIZES3_ADDR A:0x1b1a820
y.create.l HWIO_USB30_BAM_P_DATA_FIFO_ADDR0_ADDR A:0x1b17824
y.create.l HWIO_USB30_BAM_P_DATA_FIFO_ADDR1_ADDR A:0x1b18824
y.create.l HWIO_USB30_BAM_P_DATA_FIFO_ADDR2_ADDR A:0x1b19824
y.create.l HWIO_USB30_BAM_P_DATA_FIFO_ADDR3_ADDR A:0x1b1a824
y.create.l HWIO_USB30_BAM_P_EVNT_GEN_TRSHLD0_ADDR A:0x1b17828
y.create.l HWIO_USB30_BAM_P_EVNT_GEN_TRSHLD1_ADDR A:0x1b18828
y.create.l HWIO_USB30_BAM_P_EVNT_GEN_TRSHLD2_ADDR A:0x1b19828
y.create.l HWIO_USB30_BAM_P_EVNT_GEN_TRSHLD3_ADDR A:0x1b1a828
y.create.l HWIO_USB30_BAM_P_EVNT_DEST_ADDR0_ADDR A:0x1b1782c
y.create.l HWIO_USB30_BAM_P_EVNT_DEST_ADDR1_ADDR A:0x1b1882c
y.create.l HWIO_USB30_BAM_P_EVNT_DEST_ADDR2_ADDR A:0x1b1982c
y.create.l HWIO_USB30_BAM_P_EVNT_DEST_ADDR3_ADDR A:0x1b1a82c
y.create.l HWIO_USB30_BAM_P_DF_CNTXT_0_ADDR A:0x1b17830
y.create.l HWIO_USB30_BAM_P_DF_CNTXT_1_ADDR A:0x1b18830
y.create.l HWIO_USB30_BAM_P_DF_CNTXT_2_ADDR A:0x1b19830
y.create.l HWIO_USB30_BAM_P_DF_CNTXT_3_ADDR A:0x1b1a830
y.create.l HWIO_USB30_BAM_P_RETR_CNTXT_0_ADDR A:0x1b17834
y.create.l HWIO_USB30_BAM_P_RETR_CNTXT_1_ADDR A:0x1b18834
y.create.l HWIO_USB30_BAM_P_RETR_CNTXT_2_ADDR A:0x1b19834
y.create.l HWIO_USB30_BAM_P_RETR_CNTXT_3_ADDR A:0x1b1a834
y.create.l HWIO_USB30_BAM_P_SI_CNTXT_0_ADDR A:0x1b17838
y.create.l HWIO_USB30_BAM_P_SI_CNTXT_1_ADDR A:0x1b18838
y.create.l HWIO_USB30_BAM_P_SI_CNTXT_2_ADDR A:0x1b19838
y.create.l HWIO_USB30_BAM_P_SI_CNTXT_3_ADDR A:0x1b1a838
y.create.l HWIO_USB30_BAM_P_PSM_CNTXT_3_LSB0_ADDR A:0x1b17900
y.create.l HWIO_USB30_BAM_P_PSM_CNTXT_3_LSB1_ADDR A:0x1b18900
y.create.l HWIO_USB30_BAM_P_PSM_CNTXT_3_LSB2_ADDR A:0x1b19900
y.create.l HWIO_USB30_BAM_P_PSM_CNTXT_3_LSB3_ADDR A:0x1b1a900
y.create.l HWIO_USB30_BAM_P_PSM_CNTXT_3_MSB0_ADDR A:0x1b17904
y.create.l HWIO_USB30_BAM_P_PSM_CNTXT_3_MSB1_ADDR A:0x1b18904
y.create.l HWIO_USB30_BAM_P_PSM_CNTXT_3_MSB2_ADDR A:0x1b19904
y.create.l HWIO_USB30_BAM_P_PSM_CNTXT_3_MSB3_ADDR A:0x1b1a904
y.create.l HWIO_USB30_BAM_P_DESC_FIFO_ADDR_LSB0_ADDR A:0x1b17910
y.create.l HWIO_USB30_BAM_P_DESC_FIFO_ADDR_LSB1_ADDR A:0x1b18910
y.create.l HWIO_USB30_BAM_P_DESC_FIFO_ADDR_LSB2_ADDR A:0x1b19910
y.create.l HWIO_USB30_BAM_P_DESC_FIFO_ADDR_LSB3_ADDR A:0x1b1a910
y.create.l HWIO_USB30_BAM_P_DESC_FIFO_ADDR_MSB0_ADDR A:0x1b17914
y.create.l HWIO_USB30_BAM_P_DESC_FIFO_ADDR_MSB1_ADDR A:0x1b18914
y.create.l HWIO_USB30_BAM_P_DESC_FIFO_ADDR_MSB2_ADDR A:0x1b19914
y.create.l HWIO_USB30_BAM_P_DESC_FIFO_ADDR_MSB3_ADDR A:0x1b1a914
y.create.l HWIO_USB30_BAM_P_DATA_FIFO_ADDR_LSB0_ADDR A:0x1b17920
y.create.l HWIO_USB30_BAM_P_DATA_FIFO_ADDR_LSB1_ADDR A:0x1b18920
y.create.l HWIO_USB30_BAM_P_DATA_FIFO_ADDR_LSB2_ADDR A:0x1b19920
y.create.l HWIO_USB30_BAM_P_DATA_FIFO_ADDR_LSB3_ADDR A:0x1b1a920
y.create.l HWIO_USB30_BAM_P_DATA_FIFO_ADDR_MSB0_ADDR A:0x1b17924
y.create.l HWIO_USB30_BAM_P_DATA_FIFO_ADDR_MSB1_ADDR A:0x1b18924
y.create.l HWIO_USB30_BAM_P_DATA_FIFO_ADDR_MSB2_ADDR A:0x1b19924
y.create.l HWIO_USB30_BAM_P_DATA_FIFO_ADDR_MSB3_ADDR A:0x1b1a924
y.create.l HWIO_USB30_BAM_P_EVNT_DEST_ADDR_LSB0_ADDR A:0x1b17930
y.create.l HWIO_USB30_BAM_P_EVNT_DEST_ADDR_LSB1_ADDR A:0x1b18930
y.create.l HWIO_USB30_BAM_P_EVNT_DEST_ADDR_LSB2_ADDR A:0x1b19930
y.create.l HWIO_USB30_BAM_P_EVNT_DEST_ADDR_LSB3_ADDR A:0x1b1a930
y.create.l HWIO_USB30_BAM_P_EVNT_DEST_ADDR_MSB0_ADDR A:0x1b17934
y.create.l HWIO_USB30_BAM_P_EVNT_DEST_ADDR_MSB1_ADDR A:0x1b18934
y.create.l HWIO_USB30_BAM_P_EVNT_DEST_ADDR_MSB2_ADDR A:0x1b19934
y.create.l HWIO_USB30_BAM_P_EVNT_DEST_ADDR_MSB3_ADDR A:0x1b1a934
y.create.l HWIO_USB2_PHY_CM_DWC_USB2_SW_REG_BASE_START_ADDR A:0x6c000
y.create.l HWIO_USB2_PHY_CM_DWC_USB2_SW_REG_BASE_LAST_ADDR A:0x6c10c
y.create.l HWIO_USB2_PHY_CM_DWC_USB2_SW_REG_BASE_END_ADDR A:0x6c200
y.create.l HWIO_USB2_PHY_USB_PHY_REVISION_ID0_ADDR A:0x6c000
y.create.l HWIO_USB2_PHY_USB_PHY_REVISION_ID1_ADDR A:0x6c004
y.create.l HWIO_USB2_PHY_USB_PHY_REVISION_ID2_ADDR A:0x6c008
y.create.l HWIO_USB2_PHY_USB_PHY_REVISION_ID3_ADDR A:0x6c00c
y.create.l HWIO_USB2_PHY_USB_PHY_DEBUG_BUS_STAT0_ADDR A:0x6c010
y.create.l HWIO_USB2_PHY_USB_PHY_DEBUG_BUS_STAT1_ADDR A:0x6c014
y.create.l HWIO_USB2_PHY_USB_PHY_DEBUG_BUS_STAT2_ADDR A:0x6c018
y.create.l HWIO_USB2_PHY_USB_PHY_DEBUG_BUS_STAT3_ADDR A:0x6c01c
y.create.l HWIO_USB2_PHY_USB_PHY_HS_RX_TESTER_OUT_1_ADDR A:0x6c020
y.create.l HWIO_USB2_PHY_USB_PHY_CHARGING_DET_OUTPUT_ADDR A:0x6c024
y.create.l HWIO_USB2_PHY_USB_PHY_HS_PHY_IRQ_STAT_ADDR A:0x6c028
y.create.l HWIO_USB2_PHY_USB_PHY_HS_PHY_TEST_OUT_1_ADDR A:0x6c02c
y.create.l HWIO_USB2_PHY_USB_PHY_UTMI_VEC4_STATUS_ADDR A:0x6c030
y.create.l HWIO_USB2_PHY_USB_PHY_ULPI_VEC0_STATUS_ADDR A:0x6c034
y.create.l HWIO_USB2_PHY_USB_PHY_ULPI_VEC1_STATUS_ADDR A:0x6c038
y.create.l HWIO_USB2_PHY_USB_PHY_INTERRUPT_STATUS0_ADDR A:0x6c03c
y.create.l HWIO_USB2_PHY_USB_PHY_INTERRUPT_STATUS1_ADDR A:0x6c040
y.create.l HWIO_USB2_PHY_USB_PHY_RX_CHK_ERR_CNT1_STATUS_ADDR A:0x6c044
y.create.l HWIO_USB2_PHY_USB_PHY_RX_CHK_STATUS_ADDR A:0x6c048
y.create.l HWIO_USB2_PHY_USB_PHY_REFCLK_RXTAP_TEST_STATUS_ADDR A:0x6c04c
y.create.l HWIO_USB2_PHY_USB_PHY_UTMI_RX_DATAL_STATUS_ADDR A:0x6c050
y.create.l HWIO_USB2_PHY_USB_PHY_UTMI_RX_DATAH_STATUS_ADDR A:0x6c054
y.create.l HWIO_USB2_PHY_USB_PHY_UTMI_RX_PORT_STATUS_ADDR A:0x6c058
y.create.l HWIO_USB2_PHY_USB_PHY_INTERRUPT_SRC_STATUS_ADDR A:0x6c05c
y.create.l HWIO_USB2_PHY_USB_PHY_UTMI_CTRL0_ADDR A:0x6c060
y.create.l HWIO_USB2_PHY_USB_PHY_UTMI_CTRL1_ADDR A:0x6c064
y.create.l HWIO_USB2_PHY_USB_PHY_UTMI_CTRL2_ADDR A:0x6c068
y.create.l HWIO_USB2_PHY_USB_PHY_UTMI_CTRL3_ADDR A:0x6c06c
y.create.l HWIO_USB2_PHY_USB_PHY_UTMI_CTRL4_ADDR A:0x6c070
y.create.l HWIO_USB2_PHY_USB_PHY_UTMI_CTRL5_ADDR A:0x6c074
y.create.l HWIO_USB2_PHY_USB_PHY_HS_PHY_CTRL_COMMON0_ADDR A:0x6c078
y.create.l HWIO_USB2_PHY_USB_PHY_HS_PHY_CTRL_COMMON1_ADDR A:0x6c07c
y.create.l HWIO_USB2_PHY_USB_PHY_HS_PHY_CTRL_COMMON2_ADDR A:0x6c080
y.create.l HWIO_USB2_PHY_USB_PHY_HS_PHY_CTRL_COMMON3_ADDR A:0x6c084
y.create.l HWIO_USB2_PHY_USB_PHY_HS_PHY_CTRL0_ADDR A:0x6c088
y.create.l HWIO_USB2_PHY_USB_PHY_HS_PHY_CTRL1_ADDR A:0x6c08c
y.create.l HWIO_USB2_PHY_USB_PHY_HS_PHY_CTRL2_ADDR A:0x6c090
y.create.l HWIO_USB2_PHY_USB_PHY_HS_PHY_CTRL3_ADDR A:0x6c094
y.create.l HWIO_USB2_PHY_USB_PHY_PARAMETER_OVERRIDE_X0_ADDR A:0x6c098
y.create.l HWIO_USB2_PHY_USB_PHY_PARAMETER_OVERRIDE_X1_ADDR A:0x6c09c
y.create.l HWIO_USB2_PHY_USB_PHY_PARAMETER_OVERRIDE_X2_ADDR A:0x6c0a0
y.create.l HWIO_USB2_PHY_USB_PHY_PARAMETER_OVERRIDE_X3_ADDR A:0x6c0a4
y.create.l HWIO_USB2_PHY_USB_PHY_CHARGING_DET_CTRL_ADDR A:0x6c0a8
y.create.l HWIO_USB2_PHY_USB_PHY_HS_PHY_TEST0_ADDR A:0x6c0ac
y.create.l HWIO_USB2_PHY_USB_PHY_HS_PHY_TEST1_ADDR A:0x6c0b0
y.create.l HWIO_USB2_PHY_USB_PHY_HS_RX_TESTER_1_REG0_ADDR A:0x6c0b4
y.create.l HWIO_USB2_PHY_USB_PHY_HS_RX_TESTER_1_REG1_ADDR A:0x6c0b8
y.create.l HWIO_USB2_PHY_USB_PHY_HS_RX_TESTER_1_REG3_ADDR A:0x6c0bc
y.create.l HWIO_USB2_PHY_USB_PHY_TCSR_CTRL_ADDR A:0x6c0c0
y.create.l HWIO_USB2_PHY_USB_PHY_CFG0_ADDR A:0x6c0c4
y.create.l HWIO_USB2_PHY_UTMI_PHY_CMN_CTRL0_ADDR A:0x6c0c8
y.create.l HWIO_USB2_PHY_UTMI_PHY_CMN_CTRL1_ADDR A:0x6c0cc
y.create.l HWIO_USB2_PHY_USB_PHY_IRQ_CMD_ADDR A:0x6c0d0
y.create.l HWIO_USB2_PHY_USB_PHY_INTERRUPT_MASK0_ADDR A:0x6c0d4
y.create.l HWIO_USB2_PHY_USB_PHY_INTERRUPT_MASK1_ADDR A:0x6c0d8
y.create.l HWIO_USB2_PHY_USB_PHY_INTERRUPT_CLEAR0_ADDR A:0x6c0dc
y.create.l HWIO_USB2_PHY_USB_PHY_INTERRUPT_CLEAR1_ADDR A:0x6c0e0
y.create.l HWIO_USB2_PHY_USB_PHY_REFCLK_CTRL_ADDR A:0x6c0e8
y.create.l HWIO_USB2_PHY_USB_PHY_PWRDOWN_CTRL_ADDR A:0x6c0ec
y.create.l HWIO_USB2_PHY_USB_PHY_ULPI_OVERRIDE_7_0_ADDR A:0x6c0f0
y.create.l HWIO_USB2_PHY_USB_PHY_ULPI_OVERRIDE_15_8_ADDR A:0x6c0f4
y.create.l HWIO_USB2_PHY_USB_PHY_ULPI_OVERRIDE_23_16_ADDR A:0x6c0f8
y.create.l HWIO_USB2_PHY_USB_PHY_ULPI_OVERRIDE_31_24_ADDR A:0x6c0fc
y.create.l HWIO_USB2_PHY_USB_PHY_TEST_DEBUG_CTRL_ADDR A:0x6c104
y.create.l HWIO_USB2_PHY_USB_PHY_RESET_CTRL_ADDR A:0x6c108
y.create.l HWIO_VMIDMT_MSS_NAV_CE_CFG_VMIDMT_SMR_4_SSD3_SID3_MA8_REG_BASE_START_ADDR A:0x8c000
y.create.l HWIO_VMIDMT_MSS_NAV_CE_CFG_VMIDMT_SMR_4_SSD3_SID3_MA8_REG_BASE_LAST_ADDR A:0x8ce0c
y.create.l HWIO_VMIDMT_MSS_NAV_CE_CFG_VMIDMT_SMR_4_SSD3_SID3_MA8_REG_BASE_END_ADDR A:0x8d000
y.create.l HWIO_VMIDMT_MSS_NAV_CE_CFG_VMIDMT_SCR0_ADDR A:0x8c000
y.create.l HWIO_VMIDMT_MSS_NAV_CE_CFG_VMIDMT_SCR1_ADDR A:0x8c004
y.create.l HWIO_VMIDMT_MSS_NAV_CE_CFG_VMIDMT_SCR2_ADDR A:0x8c008
y.create.l HWIO_VMIDMT_MSS_NAV_CE_CFG_VMIDMT_SACR_ADDR A:0x8c010
y.create.l HWIO_VMIDMT_MSS_NAV_CE_CFG_VMIDMT_SIDR0_ADDR A:0x8c020
y.create.l HWIO_VMIDMT_MSS_NAV_CE_CFG_VMIDMT_SIDR1_ADDR A:0x8c024
y.create.l HWIO_VMIDMT_MSS_NAV_CE_CFG_VMIDMT_SIDR2_ADDR A:0x8c028
y.create.l HWIO_VMIDMT_MSS_NAV_CE_CFG_VMIDMT_SIDR4_ADDR A:0x8c030
y.create.l HWIO_VMIDMT_MSS_NAV_CE_CFG_VMIDMT_SIDR5_ADDR A:0x8c034
y.create.l HWIO_VMIDMT_MSS_NAV_CE_CFG_VMIDMT_SIDR7_ADDR A:0x8c03c
y.create.l HWIO_VMIDMT_MSS_NAV_CE_CFG_VMIDMT_SGFAR0_ADDR A:0x8c040
y.create.l HWIO_VMIDMT_MSS_NAV_CE_CFG_VMIDMT_SGFSR_ADDR A:0x8c048
y.create.l HWIO_VMIDMT_MSS_NAV_CE_CFG_VMIDMT_SGFSRRESTORE_ADDR A:0x8c04c
y.create.l HWIO_VMIDMT_MSS_NAV_CE_CFG_VMIDMT_SGFSYNDR0_ADDR A:0x8c050
y.create.l HWIO_VMIDMT_MSS_NAV_CE_CFG_VMIDMT_SGFSYNDR1_ADDR A:0x8c054
y.create.l HWIO_VMIDMT_MSS_NAV_CE_CFG_VMIDMT_SGFSYNDR2_ADDR A:0x8c058
y.create.l HWIO_VMIDMT_MSS_NAV_CE_CFG_VMIDMT_VMIDMTSCR0_ADDR A:0x8c090
y.create.l HWIO_VMIDMT_MSS_NAV_CE_CFG_VMIDMT_CR0_ADDR A:0x8c000
y.create.l HWIO_VMIDMT_MSS_NAV_CE_CFG_VMIDMT_CR2_ADDR A:0x8c008
y.create.l HWIO_VMIDMT_MSS_NAV_CE_CFG_VMIDMT_ACR_ADDR A:0x8c010
y.create.l HWIO_VMIDMT_MSS_NAV_CE_CFG_VMIDMT_IDR0_ADDR A:0x8c020
y.create.l HWIO_VMIDMT_MSS_NAV_CE_CFG_VMIDMT_IDR1_ADDR A:0x8c024
y.create.l HWIO_VMIDMT_MSS_NAV_CE_CFG_VMIDMT_IDR2_ADDR A:0x8c028
y.create.l HWIO_VMIDMT_MSS_NAV_CE_CFG_VMIDMT_IDR4_ADDR A:0x8c030
y.create.l HWIO_VMIDMT_MSS_NAV_CE_CFG_VMIDMT_IDR5_ADDR A:0x8c034
y.create.l HWIO_VMIDMT_MSS_NAV_CE_CFG_VMIDMT_IDR7_ADDR A:0x8c03c
y.create.l HWIO_VMIDMT_MSS_NAV_CE_CFG_VMIDMT_GFAR0_ADDR A:0x8c040
y.create.l HWIO_VMIDMT_MSS_NAV_CE_CFG_VMIDMT_GFSR_ADDR A:0x8c048
y.create.l HWIO_VMIDMT_MSS_NAV_CE_CFG_VMIDMT_GFSRRESTORE_ADDR A:0x8c04c
y.create.l HWIO_VMIDMT_MSS_NAV_CE_CFG_VMIDMT_GFSYNDR0_ADDR A:0x8c050
y.create.l HWIO_VMIDMT_MSS_NAV_CE_CFG_VMIDMT_GFSYNDR1_ADDR A:0x8c054
y.create.l HWIO_VMIDMT_MSS_NAV_CE_CFG_VMIDMT_GFSYNDR2_ADDR A:0x8c058
y.create.l HWIO_VMIDMT_MSS_NAV_CE_CFG_VMIDMT_VMIDMTCR0_ADDR A:0x8c090
y.create.l HWIO_VMIDMT_MSS_NAV_CE_CFG_VMIDMT_VMIDMTACR_ADDR A:0x8c09c
y.create.l HWIO_VMIDMT_MSS_NAV_CE_CFG_VMIDMT_NSCR0_ADDR A:0x8c400
y.create.l HWIO_VMIDMT_MSS_NAV_CE_CFG_VMIDMT_NSCR2_ADDR A:0x8c408
y.create.l HWIO_VMIDMT_MSS_NAV_CE_CFG_VMIDMT_NSACR_ADDR A:0x8c410
y.create.l HWIO_VMIDMT_MSS_NAV_CE_CFG_VMIDMT_NSGFAR0_ADDR A:0x8c440
y.create.l HWIO_VMIDMT_MSS_NAV_CE_CFG_VMIDMT_NSGFSR_ADDR A:0x8c448
y.create.l HWIO_VMIDMT_MSS_NAV_CE_CFG_VMIDMT_NSGFSRRESTORE_ADDR A:0x8c44c
y.create.l HWIO_VMIDMT_MSS_NAV_CE_CFG_VMIDMT_NSGFSYNDR0_ADDR A:0x8c450
y.create.l HWIO_VMIDMT_MSS_NAV_CE_CFG_VMIDMT_NSGFSYNDR1_ADDR A:0x8c454
y.create.l HWIO_VMIDMT_MSS_NAV_CE_CFG_VMIDMT_NSGFSYNDR2_ADDR A:0x8c458
y.create.l HWIO_VMIDMT_MSS_NAV_CE_CFG_VMIDMT_NSVMIDMTCR0_ADDR A:0x8c490
y.create.l HWIO_VMIDMT_MSS_NAV_CE_CFG_VMIDMT_SSDR0_ADDR A:0x8c080
y.create.l HWIO_VMIDMT_MSS_NAV_CE_CFG_VMIDMT_MSDR0_ADDR A:0x8c480
y.create.l HWIO_VMIDMT_MSS_NAV_CE_CFG_VMIDMT_MCR_ADDR A:0x8c494
y.create.l HWIO_VMIDMT_MSS_NAV_CE_CFG_VMIDMT_S2VR0_ADDR A:0x8cc00
y.create.l HWIO_VMIDMT_MSS_NAV_CE_CFG_VMIDMT_S2VR1_ADDR A:0x8cc04
y.create.l HWIO_VMIDMT_MSS_NAV_CE_CFG_VMIDMT_S2VR2_ADDR A:0x8cc08
y.create.l HWIO_VMIDMT_MSS_NAV_CE_CFG_VMIDMT_S2VR3_ADDR A:0x8cc0c
y.create.l HWIO_VMIDMT_MSS_NAV_CE_CFG_VMIDMT_AS2VR0_ADDR A:0x8ce00
y.create.l HWIO_VMIDMT_MSS_NAV_CE_CFG_VMIDMT_AS2VR1_ADDR A:0x8ce04
y.create.l HWIO_VMIDMT_MSS_NAV_CE_CFG_VMIDMT_AS2VR2_ADDR A:0x8ce08
y.create.l HWIO_VMIDMT_MSS_NAV_CE_CFG_VMIDMT_AS2VR3_ADDR A:0x8ce0c
y.create.l HWIO_VMIDMT_MSS_NAV_CE_CFG_VMIDMT_SMR0_ADDR A:0x8c800
y.create.l HWIO_VMIDMT_MSS_NAV_CE_CFG_VMIDMT_SMR1_ADDR A:0x8c804
y.create.l HWIO_VMIDMT_MSS_NAV_CE_CFG_VMIDMT_SMR2_ADDR A:0x8c808
y.create.l HWIO_VMIDMT_MSS_NAV_CE_CFG_VMIDMT_SMR3_ADDR A:0x8c80c
y.create.l HWIO_VMIDMT_MSS_Q6_CFG_VMIDMT_SMR_4_SSD3_SID3_MA8_REG_BASE_START_ADDR A:0x90000
y.create.l HWIO_VMIDMT_MSS_Q6_CFG_VMIDMT_SMR_4_SSD3_SID3_MA8_REG_BASE_LAST_ADDR A:0x90e0c
y.create.l HWIO_VMIDMT_MSS_Q6_CFG_VMIDMT_SMR_4_SSD3_SID3_MA8_REG_BASE_END_ADDR A:0x91000
y.create.l HWIO_VMIDMT_MSS_Q6_CFG_VMIDMT_SCR0_ADDR A:0x90000
y.create.l HWIO_VMIDMT_MSS_Q6_CFG_VMIDMT_SCR1_ADDR A:0x90004
y.create.l HWIO_VMIDMT_MSS_Q6_CFG_VMIDMT_SCR2_ADDR A:0x90008
y.create.l HWIO_VMIDMT_MSS_Q6_CFG_VMIDMT_SACR_ADDR A:0x90010
y.create.l HWIO_VMIDMT_MSS_Q6_CFG_VMIDMT_SIDR0_ADDR A:0x90020
y.create.l HWIO_VMIDMT_MSS_Q6_CFG_VMIDMT_SIDR1_ADDR A:0x90024
y.create.l HWIO_VMIDMT_MSS_Q6_CFG_VMIDMT_SIDR2_ADDR A:0x90028
y.create.l HWIO_VMIDMT_MSS_Q6_CFG_VMIDMT_SIDR4_ADDR A:0x90030
y.create.l HWIO_VMIDMT_MSS_Q6_CFG_VMIDMT_SIDR5_ADDR A:0x90034
y.create.l HWIO_VMIDMT_MSS_Q6_CFG_VMIDMT_SIDR7_ADDR A:0x9003c
y.create.l HWIO_VMIDMT_MSS_Q6_CFG_VMIDMT_SGFAR0_ADDR A:0x90040
y.create.l HWIO_VMIDMT_MSS_Q6_CFG_VMIDMT_SGFSR_ADDR A:0x90048
y.create.l HWIO_VMIDMT_MSS_Q6_CFG_VMIDMT_SGFSRRESTORE_ADDR A:0x9004c
y.create.l HWIO_VMIDMT_MSS_Q6_CFG_VMIDMT_SGFSYNDR0_ADDR A:0x90050
y.create.l HWIO_VMIDMT_MSS_Q6_CFG_VMIDMT_SGFSYNDR1_ADDR A:0x90054
y.create.l HWIO_VMIDMT_MSS_Q6_CFG_VMIDMT_SGFSYNDR2_ADDR A:0x90058
y.create.l HWIO_VMIDMT_MSS_Q6_CFG_VMIDMT_VMIDMTSCR0_ADDR A:0x90090
y.create.l HWIO_VMIDMT_MSS_Q6_CFG_VMIDMT_CR0_ADDR A:0x90000
y.create.l HWIO_VMIDMT_MSS_Q6_CFG_VMIDMT_CR2_ADDR A:0x90008
y.create.l HWIO_VMIDMT_MSS_Q6_CFG_VMIDMT_ACR_ADDR A:0x90010
y.create.l HWIO_VMIDMT_MSS_Q6_CFG_VMIDMT_IDR0_ADDR A:0x90020
y.create.l HWIO_VMIDMT_MSS_Q6_CFG_VMIDMT_IDR1_ADDR A:0x90024
y.create.l HWIO_VMIDMT_MSS_Q6_CFG_VMIDMT_IDR2_ADDR A:0x90028
y.create.l HWIO_VMIDMT_MSS_Q6_CFG_VMIDMT_IDR4_ADDR A:0x90030
y.create.l HWIO_VMIDMT_MSS_Q6_CFG_VMIDMT_IDR5_ADDR A:0x90034
y.create.l HWIO_VMIDMT_MSS_Q6_CFG_VMIDMT_IDR7_ADDR A:0x9003c
y.create.l HWIO_VMIDMT_MSS_Q6_CFG_VMIDMT_GFAR0_ADDR A:0x90040
y.create.l HWIO_VMIDMT_MSS_Q6_CFG_VMIDMT_GFSR_ADDR A:0x90048
y.create.l HWIO_VMIDMT_MSS_Q6_CFG_VMIDMT_GFSRRESTORE_ADDR A:0x9004c
y.create.l HWIO_VMIDMT_MSS_Q6_CFG_VMIDMT_GFSYNDR0_ADDR A:0x90050
y.create.l HWIO_VMIDMT_MSS_Q6_CFG_VMIDMT_GFSYNDR1_ADDR A:0x90054
y.create.l HWIO_VMIDMT_MSS_Q6_CFG_VMIDMT_GFSYNDR2_ADDR A:0x90058
y.create.l HWIO_VMIDMT_MSS_Q6_CFG_VMIDMT_VMIDMTCR0_ADDR A:0x90090
y.create.l HWIO_VMIDMT_MSS_Q6_CFG_VMIDMT_VMIDMTACR_ADDR A:0x9009c
y.create.l HWIO_VMIDMT_MSS_Q6_CFG_VMIDMT_NSCR0_ADDR A:0x90400
y.create.l HWIO_VMIDMT_MSS_Q6_CFG_VMIDMT_NSCR2_ADDR A:0x90408
y.create.l HWIO_VMIDMT_MSS_Q6_CFG_VMIDMT_NSACR_ADDR A:0x90410
y.create.l HWIO_VMIDMT_MSS_Q6_CFG_VMIDMT_NSGFAR0_ADDR A:0x90440
y.create.l HWIO_VMIDMT_MSS_Q6_CFG_VMIDMT_NSGFSR_ADDR A:0x90448
y.create.l HWIO_VMIDMT_MSS_Q6_CFG_VMIDMT_NSGFSRRESTORE_ADDR A:0x9044c
y.create.l HWIO_VMIDMT_MSS_Q6_CFG_VMIDMT_NSGFSYNDR0_ADDR A:0x90450
y.create.l HWIO_VMIDMT_MSS_Q6_CFG_VMIDMT_NSGFSYNDR1_ADDR A:0x90454
y.create.l HWIO_VMIDMT_MSS_Q6_CFG_VMIDMT_NSGFSYNDR2_ADDR A:0x90458
y.create.l HWIO_VMIDMT_MSS_Q6_CFG_VMIDMT_NSVMIDMTCR0_ADDR A:0x90490
y.create.l HWIO_VMIDMT_MSS_Q6_CFG_VMIDMT_SSDR0_ADDR A:0x90080
y.create.l HWIO_VMIDMT_MSS_Q6_CFG_VMIDMT_MSDR0_ADDR A:0x90480
y.create.l HWIO_VMIDMT_MSS_Q6_CFG_VMIDMT_MCR_ADDR A:0x90494
y.create.l HWIO_VMIDMT_MSS_Q6_CFG_VMIDMT_S2VR0_ADDR A:0x90c00
y.create.l HWIO_VMIDMT_MSS_Q6_CFG_VMIDMT_S2VR1_ADDR A:0x90c04
y.create.l HWIO_VMIDMT_MSS_Q6_CFG_VMIDMT_S2VR2_ADDR A:0x90c08
y.create.l HWIO_VMIDMT_MSS_Q6_CFG_VMIDMT_S2VR3_ADDR A:0x90c0c
y.create.l HWIO_VMIDMT_MSS_Q6_CFG_VMIDMT_AS2VR0_ADDR A:0x90e00
y.create.l HWIO_VMIDMT_MSS_Q6_CFG_VMIDMT_AS2VR1_ADDR A:0x90e04
y.create.l HWIO_VMIDMT_MSS_Q6_CFG_VMIDMT_AS2VR2_ADDR A:0x90e08
y.create.l HWIO_VMIDMT_MSS_Q6_CFG_VMIDMT_AS2VR3_ADDR A:0x90e0c
y.create.l HWIO_VMIDMT_MSS_Q6_CFG_VMIDMT_SMR0_ADDR A:0x90800
y.create.l HWIO_VMIDMT_MSS_Q6_CFG_VMIDMT_SMR1_ADDR A:0x90804
y.create.l HWIO_VMIDMT_MSS_Q6_CFG_VMIDMT_SMR2_ADDR A:0x90808
y.create.l HWIO_VMIDMT_MSS_Q6_CFG_VMIDMT_SMR3_ADDR A:0x9080c
y.create.l HWIO_VMIDMT_PCNOC_SNOC_1_CFG_VMIDMT_SMR_128_SSD7_SID7_MA128_REG_BASE_START_ADDR A:0x94000
y.create.l HWIO_VMIDMT_PCNOC_SNOC_1_CFG_VMIDMT_SMR_128_SSD7_SID7_MA128_REG_BASE_LAST_ADDR A:0x94ffc
y.create.l HWIO_VMIDMT_PCNOC_SNOC_1_CFG_VMIDMT_SMR_128_SSD7_SID7_MA128_REG_BASE_END_ADDR A:0x95000
y.create.l HWIO_VMIDMT_PCNOC_SNOC_1_CFG_VMIDMT_SCR0_ADDR A:0x94000
y.create.l HWIO_VMIDMT_PCNOC_SNOC_1_CFG_VMIDMT_SCR1_ADDR A:0x94004
y.create.l HWIO_VMIDMT_PCNOC_SNOC_1_CFG_VMIDMT_SCR2_ADDR A:0x94008
y.create.l HWIO_VMIDMT_PCNOC_SNOC_1_CFG_VMIDMT_SACR_ADDR A:0x94010
y.create.l HWIO_VMIDMT_PCNOC_SNOC_1_CFG_VMIDMT_SIDR0_ADDR A:0x94020
y.create.l HWIO_VMIDMT_PCNOC_SNOC_1_CFG_VMIDMT_SIDR1_ADDR A:0x94024
y.create.l HWIO_VMIDMT_PCNOC_SNOC_1_CFG_VMIDMT_SIDR2_ADDR A:0x94028
y.create.l HWIO_VMIDMT_PCNOC_SNOC_1_CFG_VMIDMT_SIDR4_ADDR A:0x94030
y.create.l HWIO_VMIDMT_PCNOC_SNOC_1_CFG_VMIDMT_SIDR5_ADDR A:0x94034
y.create.l HWIO_VMIDMT_PCNOC_SNOC_1_CFG_VMIDMT_SIDR7_ADDR A:0x9403c
y.create.l HWIO_VMIDMT_PCNOC_SNOC_1_CFG_VMIDMT_SGFAR0_ADDR A:0x94040
y.create.l HWIO_VMIDMT_PCNOC_SNOC_1_CFG_VMIDMT_SGFSR_ADDR A:0x94048
y.create.l HWIO_VMIDMT_PCNOC_SNOC_1_CFG_VMIDMT_SGFSRRESTORE_ADDR A:0x9404c
y.create.l HWIO_VMIDMT_PCNOC_SNOC_1_CFG_VMIDMT_SGFSYNDR0_ADDR A:0x94050
y.create.l HWIO_VMIDMT_PCNOC_SNOC_1_CFG_VMIDMT_SGFSYNDR1_ADDR A:0x94054
y.create.l HWIO_VMIDMT_PCNOC_SNOC_1_CFG_VMIDMT_SGFSYNDR2_ADDR A:0x94058
y.create.l HWIO_VMIDMT_PCNOC_SNOC_1_CFG_VMIDMT_VMIDMTSCR0_ADDR A:0x94090
y.create.l HWIO_VMIDMT_PCNOC_SNOC_1_CFG_VMIDMT_CR0_ADDR A:0x94000
y.create.l HWIO_VMIDMT_PCNOC_SNOC_1_CFG_VMIDMT_CR2_ADDR A:0x94008
y.create.l HWIO_VMIDMT_PCNOC_SNOC_1_CFG_VMIDMT_ACR_ADDR A:0x94010
y.create.l HWIO_VMIDMT_PCNOC_SNOC_1_CFG_VMIDMT_IDR0_ADDR A:0x94020
y.create.l HWIO_VMIDMT_PCNOC_SNOC_1_CFG_VMIDMT_IDR1_ADDR A:0x94024
y.create.l HWIO_VMIDMT_PCNOC_SNOC_1_CFG_VMIDMT_IDR2_ADDR A:0x94028
y.create.l HWIO_VMIDMT_PCNOC_SNOC_1_CFG_VMIDMT_IDR4_ADDR A:0x94030
y.create.l HWIO_VMIDMT_PCNOC_SNOC_1_CFG_VMIDMT_IDR5_ADDR A:0x94034
y.create.l HWIO_VMIDMT_PCNOC_SNOC_1_CFG_VMIDMT_IDR7_ADDR A:0x9403c
y.create.l HWIO_VMIDMT_PCNOC_SNOC_1_CFG_VMIDMT_GFAR0_ADDR A:0x94040
y.create.l HWIO_VMIDMT_PCNOC_SNOC_1_CFG_VMIDMT_GFSR_ADDR A:0x94048
y.create.l HWIO_VMIDMT_PCNOC_SNOC_1_CFG_VMIDMT_GFSRRESTORE_ADDR A:0x9404c
y.create.l HWIO_VMIDMT_PCNOC_SNOC_1_CFG_VMIDMT_GFSYNDR0_ADDR A:0x94050
y.create.l HWIO_VMIDMT_PCNOC_SNOC_1_CFG_VMIDMT_GFSYNDR1_ADDR A:0x94054
y.create.l HWIO_VMIDMT_PCNOC_SNOC_1_CFG_VMIDMT_GFSYNDR2_ADDR A:0x94058
y.create.l HWIO_VMIDMT_PCNOC_SNOC_1_CFG_VMIDMT_VMIDMTCR0_ADDR A:0x94090
y.create.l HWIO_VMIDMT_PCNOC_SNOC_1_CFG_VMIDMT_VMIDMTACR_ADDR A:0x9409c
y.create.l HWIO_VMIDMT_PCNOC_SNOC_1_CFG_VMIDMT_NSCR0_ADDR A:0x94400
y.create.l HWIO_VMIDMT_PCNOC_SNOC_1_CFG_VMIDMT_NSCR2_ADDR A:0x94408
y.create.l HWIO_VMIDMT_PCNOC_SNOC_1_CFG_VMIDMT_NSACR_ADDR A:0x94410
y.create.l HWIO_VMIDMT_PCNOC_SNOC_1_CFG_VMIDMT_NSGFAR0_ADDR A:0x94440
y.create.l HWIO_VMIDMT_PCNOC_SNOC_1_CFG_VMIDMT_NSGFSR_ADDR A:0x94448
y.create.l HWIO_VMIDMT_PCNOC_SNOC_1_CFG_VMIDMT_NSGFSRRESTORE_ADDR A:0x9444c
y.create.l HWIO_VMIDMT_PCNOC_SNOC_1_CFG_VMIDMT_NSGFSYNDR0_ADDR A:0x94450
y.create.l HWIO_VMIDMT_PCNOC_SNOC_1_CFG_VMIDMT_NSGFSYNDR1_ADDR A:0x94454
y.create.l HWIO_VMIDMT_PCNOC_SNOC_1_CFG_VMIDMT_NSGFSYNDR2_ADDR A:0x94458
y.create.l HWIO_VMIDMT_PCNOC_SNOC_1_CFG_VMIDMT_NSVMIDMTCR0_ADDR A:0x94490
y.create.l HWIO_VMIDMT_PCNOC_SNOC_1_CFG_VMIDMT_SSDR0_ADDR A:0x94080
y.create.l HWIO_VMIDMT_PCNOC_SNOC_1_CFG_VMIDMT_SSDR1_ADDR A:0x94084
y.create.l HWIO_VMIDMT_PCNOC_SNOC_1_CFG_VMIDMT_SSDR2_ADDR A:0x94088
y.create.l HWIO_VMIDMT_PCNOC_SNOC_1_CFG_VMIDMT_SSDR3_ADDR A:0x9408c
y.create.l HWIO_VMIDMT_PCNOC_SNOC_1_CFG_VMIDMT_MSDR0_ADDR A:0x94480
y.create.l HWIO_VMIDMT_PCNOC_SNOC_1_CFG_VMIDMT_MSDR1_ADDR A:0x94484
y.create.l HWIO_VMIDMT_PCNOC_SNOC_1_CFG_VMIDMT_MSDR2_ADDR A:0x94488
y.create.l HWIO_VMIDMT_PCNOC_SNOC_1_CFG_VMIDMT_MSDR3_ADDR A:0x9448c
y.create.l HWIO_VMIDMT_PCNOC_SNOC_1_CFG_VMIDMT_MCR_ADDR A:0x94494
y.create.l HWIO_VMIDMT_PCNOC_SNOC_1_CFG_VMIDMT_S2VR0_ADDR A:0x94c00
y.create.l HWIO_VMIDMT_PCNOC_SNOC_1_CFG_VMIDMT_S2VR1_ADDR A:0x94c04
y.create.l HWIO_VMIDMT_PCNOC_SNOC_1_CFG_VMIDMT_S2VR2_ADDR A:0x94c08
y.create.l HWIO_VMIDMT_PCNOC_SNOC_1_CFG_VMIDMT_S2VR3_ADDR A:0x94c0c
y.create.l HWIO_VMIDMT_PCNOC_SNOC_1_CFG_VMIDMT_S2VR4_ADDR A:0x94c10
y.create.l HWIO_VMIDMT_PCNOC_SNOC_1_CFG_VMIDMT_S2VR5_ADDR A:0x94c14
y.create.l HWIO_VMIDMT_PCNOC_SNOC_1_CFG_VMIDMT_S2VR6_ADDR A:0x94c18
y.create.l HWIO_VMIDMT_PCNOC_SNOC_1_CFG_VMIDMT_S2VR7_ADDR A:0x94c1c
y.create.l HWIO_VMIDMT_PCNOC_SNOC_1_CFG_VMIDMT_S2VR8_ADDR A:0x94c20
y.create.l HWIO_VMIDMT_PCNOC_SNOC_1_CFG_VMIDMT_S2VR9_ADDR A:0x94c24
y.create.l HWIO_VMIDMT_PCNOC_SNOC_1_CFG_VMIDMT_AS2VR0_ADDR A:0x94e00
y.create.l HWIO_VMIDMT_PCNOC_SNOC_1_CFG_VMIDMT_AS2VR1_ADDR A:0x94e04
y.create.l HWIO_VMIDMT_PCNOC_SNOC_1_CFG_VMIDMT_AS2VR2_ADDR A:0x94e08
y.create.l HWIO_VMIDMT_PCNOC_SNOC_1_CFG_VMIDMT_AS2VR3_ADDR A:0x94e0c
y.create.l HWIO_VMIDMT_PCNOC_SNOC_1_CFG_VMIDMT_AS2VR4_ADDR A:0x94e10
y.create.l HWIO_VMIDMT_PCNOC_SNOC_1_CFG_VMIDMT_AS2VR5_ADDR A:0x94e14
y.create.l HWIO_VMIDMT_PCNOC_SNOC_1_CFG_VMIDMT_AS2VR6_ADDR A:0x94e18
y.create.l HWIO_VMIDMT_PCNOC_SNOC_1_CFG_VMIDMT_AS2VR7_ADDR A:0x94e1c
y.create.l HWIO_VMIDMT_PCNOC_SNOC_1_CFG_VMIDMT_AS2VR8_ADDR A:0x94e20
y.create.l HWIO_VMIDMT_PCNOC_SNOC_1_CFG_VMIDMT_AS2VR9_ADDR A:0x94e24
y.create.l HWIO_VMIDMT_PCNOC_SNOC_1_CFG_VMIDMT_SMR0_ADDR A:0x94800
y.create.l HWIO_VMIDMT_PCNOC_SNOC_1_CFG_VMIDMT_SMR1_ADDR A:0x94804
y.create.l HWIO_VMIDMT_PCNOC_SNOC_1_CFG_VMIDMT_SMR2_ADDR A:0x94808
y.create.l HWIO_VMIDMT_PCNOC_SNOC_1_CFG_VMIDMT_SMR3_ADDR A:0x9480c
y.create.l HWIO_VMIDMT_PCNOC_SNOC_1_CFG_VMIDMT_SMR4_ADDR A:0x94810
y.create.l HWIO_VMIDMT_PCNOC_SNOC_1_CFG_VMIDMT_SMR5_ADDR A:0x94814
y.create.l HWIO_VMIDMT_PCNOC_SNOC_1_CFG_VMIDMT_SMR6_ADDR A:0x94818
y.create.l HWIO_VMIDMT_PCNOC_SNOC_1_CFG_VMIDMT_SMR7_ADDR A:0x9481c
y.create.l HWIO_VMIDMT_PCNOC_SNOC_1_CFG_VMIDMT_SMR8_ADDR A:0x94820
y.create.l HWIO_VMIDMT_PCNOC_SNOC_1_CFG_VMIDMT_SMR9_ADDR A:0x94824
y.create.l HWIO_VMIDMT_PCNOC_SNOC_2_CFG_VMIDMT_SMR_128_SSD7_SID7_MA128_REG_BASE_START_ADDR A:0x96000
y.create.l HWIO_VMIDMT_PCNOC_SNOC_2_CFG_VMIDMT_SMR_128_SSD7_SID7_MA128_REG_BASE_LAST_ADDR A:0x96ffc
y.create.l HWIO_VMIDMT_PCNOC_SNOC_2_CFG_VMIDMT_SMR_128_SSD7_SID7_MA128_REG_BASE_END_ADDR A:0x97000
y.create.l HWIO_VMIDMT_PCNOC_SNOC_2_CFG_VMIDMT_SCR0_ADDR A:0x96000
y.create.l HWIO_VMIDMT_PCNOC_SNOC_2_CFG_VMIDMT_SCR1_ADDR A:0x96004
y.create.l HWIO_VMIDMT_PCNOC_SNOC_2_CFG_VMIDMT_SCR2_ADDR A:0x96008
y.create.l HWIO_VMIDMT_PCNOC_SNOC_2_CFG_VMIDMT_SACR_ADDR A:0x96010
y.create.l HWIO_VMIDMT_PCNOC_SNOC_2_CFG_VMIDMT_SIDR0_ADDR A:0x96020
y.create.l HWIO_VMIDMT_PCNOC_SNOC_2_CFG_VMIDMT_SIDR1_ADDR A:0x96024
y.create.l HWIO_VMIDMT_PCNOC_SNOC_2_CFG_VMIDMT_SIDR2_ADDR A:0x96028
y.create.l HWIO_VMIDMT_PCNOC_SNOC_2_CFG_VMIDMT_SIDR4_ADDR A:0x96030
y.create.l HWIO_VMIDMT_PCNOC_SNOC_2_CFG_VMIDMT_SIDR5_ADDR A:0x96034
y.create.l HWIO_VMIDMT_PCNOC_SNOC_2_CFG_VMIDMT_SIDR7_ADDR A:0x9603c
y.create.l HWIO_VMIDMT_PCNOC_SNOC_2_CFG_VMIDMT_SGFAR0_ADDR A:0x96040
y.create.l HWIO_VMIDMT_PCNOC_SNOC_2_CFG_VMIDMT_SGFSR_ADDR A:0x96048
y.create.l HWIO_VMIDMT_PCNOC_SNOC_2_CFG_VMIDMT_SGFSRRESTORE_ADDR A:0x9604c
y.create.l HWIO_VMIDMT_PCNOC_SNOC_2_CFG_VMIDMT_SGFSYNDR0_ADDR A:0x96050
y.create.l HWIO_VMIDMT_PCNOC_SNOC_2_CFG_VMIDMT_SGFSYNDR1_ADDR A:0x96054
y.create.l HWIO_VMIDMT_PCNOC_SNOC_2_CFG_VMIDMT_SGFSYNDR2_ADDR A:0x96058
y.create.l HWIO_VMIDMT_PCNOC_SNOC_2_CFG_VMIDMT_VMIDMTSCR0_ADDR A:0x96090
y.create.l HWIO_VMIDMT_PCNOC_SNOC_2_CFG_VMIDMT_CR0_ADDR A:0x96000
y.create.l HWIO_VMIDMT_PCNOC_SNOC_2_CFG_VMIDMT_CR2_ADDR A:0x96008
y.create.l HWIO_VMIDMT_PCNOC_SNOC_2_CFG_VMIDMT_ACR_ADDR A:0x96010
y.create.l HWIO_VMIDMT_PCNOC_SNOC_2_CFG_VMIDMT_IDR0_ADDR A:0x96020
y.create.l HWIO_VMIDMT_PCNOC_SNOC_2_CFG_VMIDMT_IDR1_ADDR A:0x96024
y.create.l HWIO_VMIDMT_PCNOC_SNOC_2_CFG_VMIDMT_IDR2_ADDR A:0x96028
y.create.l HWIO_VMIDMT_PCNOC_SNOC_2_CFG_VMIDMT_IDR4_ADDR A:0x96030
y.create.l HWIO_VMIDMT_PCNOC_SNOC_2_CFG_VMIDMT_IDR5_ADDR A:0x96034
y.create.l HWIO_VMIDMT_PCNOC_SNOC_2_CFG_VMIDMT_IDR7_ADDR A:0x9603c
y.create.l HWIO_VMIDMT_PCNOC_SNOC_2_CFG_VMIDMT_GFAR0_ADDR A:0x96040
y.create.l HWIO_VMIDMT_PCNOC_SNOC_2_CFG_VMIDMT_GFSR_ADDR A:0x96048
y.create.l HWIO_VMIDMT_PCNOC_SNOC_2_CFG_VMIDMT_GFSRRESTORE_ADDR A:0x9604c
y.create.l HWIO_VMIDMT_PCNOC_SNOC_2_CFG_VMIDMT_GFSYNDR0_ADDR A:0x96050
y.create.l HWIO_VMIDMT_PCNOC_SNOC_2_CFG_VMIDMT_GFSYNDR1_ADDR A:0x96054
y.create.l HWIO_VMIDMT_PCNOC_SNOC_2_CFG_VMIDMT_GFSYNDR2_ADDR A:0x96058
y.create.l HWIO_VMIDMT_PCNOC_SNOC_2_CFG_VMIDMT_VMIDMTCR0_ADDR A:0x96090
y.create.l HWIO_VMIDMT_PCNOC_SNOC_2_CFG_VMIDMT_VMIDMTACR_ADDR A:0x9609c
y.create.l HWIO_VMIDMT_PCNOC_SNOC_2_CFG_VMIDMT_NSCR0_ADDR A:0x96400
y.create.l HWIO_VMIDMT_PCNOC_SNOC_2_CFG_VMIDMT_NSCR2_ADDR A:0x96408
y.create.l HWIO_VMIDMT_PCNOC_SNOC_2_CFG_VMIDMT_NSACR_ADDR A:0x96410
y.create.l HWIO_VMIDMT_PCNOC_SNOC_2_CFG_VMIDMT_NSGFAR0_ADDR A:0x96440
y.create.l HWIO_VMIDMT_PCNOC_SNOC_2_CFG_VMIDMT_NSGFSR_ADDR A:0x96448
y.create.l HWIO_VMIDMT_PCNOC_SNOC_2_CFG_VMIDMT_NSGFSRRESTORE_ADDR A:0x9644c
y.create.l HWIO_VMIDMT_PCNOC_SNOC_2_CFG_VMIDMT_NSGFSYNDR0_ADDR A:0x96450
y.create.l HWIO_VMIDMT_PCNOC_SNOC_2_CFG_VMIDMT_NSGFSYNDR1_ADDR A:0x96454
y.create.l HWIO_VMIDMT_PCNOC_SNOC_2_CFG_VMIDMT_NSGFSYNDR2_ADDR A:0x96458
y.create.l HWIO_VMIDMT_PCNOC_SNOC_2_CFG_VMIDMT_NSVMIDMTCR0_ADDR A:0x96490
y.create.l HWIO_VMIDMT_PCNOC_SNOC_2_CFG_VMIDMT_SSDR0_ADDR A:0x96080
y.create.l HWIO_VMIDMT_PCNOC_SNOC_2_CFG_VMIDMT_SSDR1_ADDR A:0x96084
y.create.l HWIO_VMIDMT_PCNOC_SNOC_2_CFG_VMIDMT_SSDR2_ADDR A:0x96088
y.create.l HWIO_VMIDMT_PCNOC_SNOC_2_CFG_VMIDMT_SSDR3_ADDR A:0x9608c
y.create.l HWIO_VMIDMT_PCNOC_SNOC_2_CFG_VMIDMT_MSDR0_ADDR A:0x96480
y.create.l HWIO_VMIDMT_PCNOC_SNOC_2_CFG_VMIDMT_MSDR1_ADDR A:0x96484
y.create.l HWIO_VMIDMT_PCNOC_SNOC_2_CFG_VMIDMT_MSDR2_ADDR A:0x96488
y.create.l HWIO_VMIDMT_PCNOC_SNOC_2_CFG_VMIDMT_MSDR3_ADDR A:0x9648c
y.create.l HWIO_VMIDMT_PCNOC_SNOC_2_CFG_VMIDMT_MCR_ADDR A:0x96494
y.create.l HWIO_VMIDMT_PCNOC_SNOC_2_CFG_VMIDMT_S2VR0_ADDR A:0x96c00
y.create.l HWIO_VMIDMT_PCNOC_SNOC_2_CFG_VMIDMT_S2VR1_ADDR A:0x96c04
y.create.l HWIO_VMIDMT_PCNOC_SNOC_2_CFG_VMIDMT_S2VR2_ADDR A:0x96c08
y.create.l HWIO_VMIDMT_PCNOC_SNOC_2_CFG_VMIDMT_S2VR3_ADDR A:0x96c0c
y.create.l HWIO_VMIDMT_PCNOC_SNOC_2_CFG_VMIDMT_S2VR4_ADDR A:0x96c10
y.create.l HWIO_VMIDMT_PCNOC_SNOC_2_CFG_VMIDMT_S2VR5_ADDR A:0x96c14
y.create.l HWIO_VMIDMT_PCNOC_SNOC_2_CFG_VMIDMT_S2VR6_ADDR A:0x96c18
y.create.l HWIO_VMIDMT_PCNOC_SNOC_2_CFG_VMIDMT_S2VR7_ADDR A:0x96c1c
y.create.l HWIO_VMIDMT_PCNOC_SNOC_2_CFG_VMIDMT_S2VR8_ADDR A:0x96c20
y.create.l HWIO_VMIDMT_PCNOC_SNOC_2_CFG_VMIDMT_S2VR9_ADDR A:0x96c24
y.create.l HWIO_VMIDMT_PCNOC_SNOC_2_CFG_VMIDMT_AS2VR0_ADDR A:0x96e00
y.create.l HWIO_VMIDMT_PCNOC_SNOC_2_CFG_VMIDMT_AS2VR1_ADDR A:0x96e04
y.create.l HWIO_VMIDMT_PCNOC_SNOC_2_CFG_VMIDMT_AS2VR2_ADDR A:0x96e08
y.create.l HWIO_VMIDMT_PCNOC_SNOC_2_CFG_VMIDMT_AS2VR3_ADDR A:0x96e0c
y.create.l HWIO_VMIDMT_PCNOC_SNOC_2_CFG_VMIDMT_AS2VR4_ADDR A:0x96e10
y.create.l HWIO_VMIDMT_PCNOC_SNOC_2_CFG_VMIDMT_AS2VR5_ADDR A:0x96e14
y.create.l HWIO_VMIDMT_PCNOC_SNOC_2_CFG_VMIDMT_AS2VR6_ADDR A:0x96e18
y.create.l HWIO_VMIDMT_PCNOC_SNOC_2_CFG_VMIDMT_AS2VR7_ADDR A:0x96e1c
y.create.l HWIO_VMIDMT_PCNOC_SNOC_2_CFG_VMIDMT_AS2VR8_ADDR A:0x96e20
y.create.l HWIO_VMIDMT_PCNOC_SNOC_2_CFG_VMIDMT_AS2VR9_ADDR A:0x96e24
y.create.l HWIO_VMIDMT_PCNOC_SNOC_2_CFG_VMIDMT_SMR0_ADDR A:0x96800
y.create.l HWIO_VMIDMT_PCNOC_SNOC_2_CFG_VMIDMT_SMR1_ADDR A:0x96804
y.create.l HWIO_VMIDMT_PCNOC_SNOC_2_CFG_VMIDMT_SMR2_ADDR A:0x96808
y.create.l HWIO_VMIDMT_PCNOC_SNOC_2_CFG_VMIDMT_SMR3_ADDR A:0x9680c
y.create.l HWIO_VMIDMT_PCNOC_SNOC_2_CFG_VMIDMT_SMR4_ADDR A:0x96810
y.create.l HWIO_VMIDMT_PCNOC_SNOC_2_CFG_VMIDMT_SMR5_ADDR A:0x96814
y.create.l HWIO_VMIDMT_PCNOC_SNOC_2_CFG_VMIDMT_SMR6_ADDR A:0x96818
y.create.l HWIO_VMIDMT_PCNOC_SNOC_2_CFG_VMIDMT_SMR7_ADDR A:0x9681c
y.create.l HWIO_VMIDMT_PCNOC_SNOC_2_CFG_VMIDMT_SMR8_ADDR A:0x96820
y.create.l HWIO_VMIDMT_PCNOC_SNOC_2_CFG_VMIDMT_SMR9_ADDR A:0x96824
y.create.l HWIO_VMIDMT_PCNOC_SNOC_3_CFG_VMIDMT_SMR_128_SSD7_SID7_MA128_REG_BASE_START_ADDR A:0x98000
y.create.l HWIO_VMIDMT_PCNOC_SNOC_3_CFG_VMIDMT_SMR_128_SSD7_SID7_MA128_REG_BASE_LAST_ADDR A:0x98ffc
y.create.l HWIO_VMIDMT_PCNOC_SNOC_3_CFG_VMIDMT_SMR_128_SSD7_SID7_MA128_REG_BASE_END_ADDR A:0x99000
y.create.l HWIO_VMIDMT_PCNOC_SNOC_3_CFG_VMIDMT_SCR0_ADDR A:0x98000
y.create.l HWIO_VMIDMT_PCNOC_SNOC_3_CFG_VMIDMT_SCR1_ADDR A:0x98004
y.create.l HWIO_VMIDMT_PCNOC_SNOC_3_CFG_VMIDMT_SCR2_ADDR A:0x98008
y.create.l HWIO_VMIDMT_PCNOC_SNOC_3_CFG_VMIDMT_SACR_ADDR A:0x98010
y.create.l HWIO_VMIDMT_PCNOC_SNOC_3_CFG_VMIDMT_SIDR0_ADDR A:0x98020
y.create.l HWIO_VMIDMT_PCNOC_SNOC_3_CFG_VMIDMT_SIDR1_ADDR A:0x98024
y.create.l HWIO_VMIDMT_PCNOC_SNOC_3_CFG_VMIDMT_SIDR2_ADDR A:0x98028
y.create.l HWIO_VMIDMT_PCNOC_SNOC_3_CFG_VMIDMT_SIDR4_ADDR A:0x98030
y.create.l HWIO_VMIDMT_PCNOC_SNOC_3_CFG_VMIDMT_SIDR5_ADDR A:0x98034
y.create.l HWIO_VMIDMT_PCNOC_SNOC_3_CFG_VMIDMT_SIDR7_ADDR A:0x9803c
y.create.l HWIO_VMIDMT_PCNOC_SNOC_3_CFG_VMIDMT_SGFAR0_ADDR A:0x98040
y.create.l HWIO_VMIDMT_PCNOC_SNOC_3_CFG_VMIDMT_SGFSR_ADDR A:0x98048
y.create.l HWIO_VMIDMT_PCNOC_SNOC_3_CFG_VMIDMT_SGFSRRESTORE_ADDR A:0x9804c
y.create.l HWIO_VMIDMT_PCNOC_SNOC_3_CFG_VMIDMT_SGFSYNDR0_ADDR A:0x98050
y.create.l HWIO_VMIDMT_PCNOC_SNOC_3_CFG_VMIDMT_SGFSYNDR1_ADDR A:0x98054
y.create.l HWIO_VMIDMT_PCNOC_SNOC_3_CFG_VMIDMT_SGFSYNDR2_ADDR A:0x98058
y.create.l HWIO_VMIDMT_PCNOC_SNOC_3_CFG_VMIDMT_VMIDMTSCR0_ADDR A:0x98090
y.create.l HWIO_VMIDMT_PCNOC_SNOC_3_CFG_VMIDMT_CR0_ADDR A:0x98000
y.create.l HWIO_VMIDMT_PCNOC_SNOC_3_CFG_VMIDMT_CR2_ADDR A:0x98008
y.create.l HWIO_VMIDMT_PCNOC_SNOC_3_CFG_VMIDMT_ACR_ADDR A:0x98010
y.create.l HWIO_VMIDMT_PCNOC_SNOC_3_CFG_VMIDMT_IDR0_ADDR A:0x98020
y.create.l HWIO_VMIDMT_PCNOC_SNOC_3_CFG_VMIDMT_IDR1_ADDR A:0x98024
y.create.l HWIO_VMIDMT_PCNOC_SNOC_3_CFG_VMIDMT_IDR2_ADDR A:0x98028
y.create.l HWIO_VMIDMT_PCNOC_SNOC_3_CFG_VMIDMT_IDR4_ADDR A:0x98030
y.create.l HWIO_VMIDMT_PCNOC_SNOC_3_CFG_VMIDMT_IDR5_ADDR A:0x98034
y.create.l HWIO_VMIDMT_PCNOC_SNOC_3_CFG_VMIDMT_IDR7_ADDR A:0x9803c
y.create.l HWIO_VMIDMT_PCNOC_SNOC_3_CFG_VMIDMT_GFAR0_ADDR A:0x98040
y.create.l HWIO_VMIDMT_PCNOC_SNOC_3_CFG_VMIDMT_GFSR_ADDR A:0x98048
y.create.l HWIO_VMIDMT_PCNOC_SNOC_3_CFG_VMIDMT_GFSRRESTORE_ADDR A:0x9804c
y.create.l HWIO_VMIDMT_PCNOC_SNOC_3_CFG_VMIDMT_GFSYNDR0_ADDR A:0x98050
y.create.l HWIO_VMIDMT_PCNOC_SNOC_3_CFG_VMIDMT_GFSYNDR1_ADDR A:0x98054
y.create.l HWIO_VMIDMT_PCNOC_SNOC_3_CFG_VMIDMT_GFSYNDR2_ADDR A:0x98058
y.create.l HWIO_VMIDMT_PCNOC_SNOC_3_CFG_VMIDMT_VMIDMTCR0_ADDR A:0x98090
y.create.l HWIO_VMIDMT_PCNOC_SNOC_3_CFG_VMIDMT_VMIDMTACR_ADDR A:0x9809c
y.create.l HWIO_VMIDMT_PCNOC_SNOC_3_CFG_VMIDMT_NSCR0_ADDR A:0x98400
y.create.l HWIO_VMIDMT_PCNOC_SNOC_3_CFG_VMIDMT_NSCR2_ADDR A:0x98408
y.create.l HWIO_VMIDMT_PCNOC_SNOC_3_CFG_VMIDMT_NSACR_ADDR A:0x98410
y.create.l HWIO_VMIDMT_PCNOC_SNOC_3_CFG_VMIDMT_NSGFAR0_ADDR A:0x98440
y.create.l HWIO_VMIDMT_PCNOC_SNOC_3_CFG_VMIDMT_NSGFSR_ADDR A:0x98448
y.create.l HWIO_VMIDMT_PCNOC_SNOC_3_CFG_VMIDMT_NSGFSRRESTORE_ADDR A:0x9844c
y.create.l HWIO_VMIDMT_PCNOC_SNOC_3_CFG_VMIDMT_NSGFSYNDR0_ADDR A:0x98450
y.create.l HWIO_VMIDMT_PCNOC_SNOC_3_CFG_VMIDMT_NSGFSYNDR1_ADDR A:0x98454
y.create.l HWIO_VMIDMT_PCNOC_SNOC_3_CFG_VMIDMT_NSGFSYNDR2_ADDR A:0x98458
y.create.l HWIO_VMIDMT_PCNOC_SNOC_3_CFG_VMIDMT_NSVMIDMTCR0_ADDR A:0x98490
y.create.l HWIO_VMIDMT_PCNOC_SNOC_3_CFG_VMIDMT_SSDR0_ADDR A:0x98080
y.create.l HWIO_VMIDMT_PCNOC_SNOC_3_CFG_VMIDMT_SSDR1_ADDR A:0x98084
y.create.l HWIO_VMIDMT_PCNOC_SNOC_3_CFG_VMIDMT_SSDR2_ADDR A:0x98088
y.create.l HWIO_VMIDMT_PCNOC_SNOC_3_CFG_VMIDMT_SSDR3_ADDR A:0x9808c
y.create.l HWIO_VMIDMT_PCNOC_SNOC_3_CFG_VMIDMT_MSDR0_ADDR A:0x98480
y.create.l HWIO_VMIDMT_PCNOC_SNOC_3_CFG_VMIDMT_MSDR1_ADDR A:0x98484
y.create.l HWIO_VMIDMT_PCNOC_SNOC_3_CFG_VMIDMT_MSDR2_ADDR A:0x98488
y.create.l HWIO_VMIDMT_PCNOC_SNOC_3_CFG_VMIDMT_MSDR3_ADDR A:0x9848c
y.create.l HWIO_VMIDMT_PCNOC_SNOC_3_CFG_VMIDMT_MCR_ADDR A:0x98494
y.create.l HWIO_VMIDMT_PCNOC_SNOC_3_CFG_VMIDMT_S2VR0_ADDR A:0x98c00
y.create.l HWIO_VMIDMT_PCNOC_SNOC_3_CFG_VMIDMT_S2VR1_ADDR A:0x98c04
y.create.l HWIO_VMIDMT_PCNOC_SNOC_3_CFG_VMIDMT_S2VR2_ADDR A:0x98c08
y.create.l HWIO_VMIDMT_PCNOC_SNOC_3_CFG_VMIDMT_S2VR3_ADDR A:0x98c0c
y.create.l HWIO_VMIDMT_PCNOC_SNOC_3_CFG_VMIDMT_S2VR4_ADDR A:0x98c10
y.create.l HWIO_VMIDMT_PCNOC_SNOC_3_CFG_VMIDMT_S2VR5_ADDR A:0x98c14
y.create.l HWIO_VMIDMT_PCNOC_SNOC_3_CFG_VMIDMT_S2VR6_ADDR A:0x98c18
y.create.l HWIO_VMIDMT_PCNOC_SNOC_3_CFG_VMIDMT_S2VR7_ADDR A:0x98c1c
y.create.l HWIO_VMIDMT_PCNOC_SNOC_3_CFG_VMIDMT_S2VR8_ADDR A:0x98c20
y.create.l HWIO_VMIDMT_PCNOC_SNOC_3_CFG_VMIDMT_S2VR9_ADDR A:0x98c24
y.create.l HWIO_VMIDMT_PCNOC_SNOC_3_CFG_VMIDMT_AS2VR0_ADDR A:0x98e00
y.create.l HWIO_VMIDMT_PCNOC_SNOC_3_CFG_VMIDMT_AS2VR1_ADDR A:0x98e04
y.create.l HWIO_VMIDMT_PCNOC_SNOC_3_CFG_VMIDMT_AS2VR2_ADDR A:0x98e08
y.create.l HWIO_VMIDMT_PCNOC_SNOC_3_CFG_VMIDMT_AS2VR3_ADDR A:0x98e0c
y.create.l HWIO_VMIDMT_PCNOC_SNOC_3_CFG_VMIDMT_AS2VR4_ADDR A:0x98e10
y.create.l HWIO_VMIDMT_PCNOC_SNOC_3_CFG_VMIDMT_AS2VR5_ADDR A:0x98e14
y.create.l HWIO_VMIDMT_PCNOC_SNOC_3_CFG_VMIDMT_AS2VR6_ADDR A:0x98e18
y.create.l HWIO_VMIDMT_PCNOC_SNOC_3_CFG_VMIDMT_AS2VR7_ADDR A:0x98e1c
y.create.l HWIO_VMIDMT_PCNOC_SNOC_3_CFG_VMIDMT_AS2VR8_ADDR A:0x98e20
y.create.l HWIO_VMIDMT_PCNOC_SNOC_3_CFG_VMIDMT_AS2VR9_ADDR A:0x98e24
y.create.l HWIO_VMIDMT_PCNOC_SNOC_3_CFG_VMIDMT_SMR0_ADDR A:0x98800
y.create.l HWIO_VMIDMT_PCNOC_SNOC_3_CFG_VMIDMT_SMR1_ADDR A:0x98804
y.create.l HWIO_VMIDMT_PCNOC_SNOC_3_CFG_VMIDMT_SMR2_ADDR A:0x98808
y.create.l HWIO_VMIDMT_PCNOC_SNOC_3_CFG_VMIDMT_SMR3_ADDR A:0x9880c
y.create.l HWIO_VMIDMT_PCNOC_SNOC_3_CFG_VMIDMT_SMR4_ADDR A:0x98810
y.create.l HWIO_VMIDMT_PCNOC_SNOC_3_CFG_VMIDMT_SMR5_ADDR A:0x98814
y.create.l HWIO_VMIDMT_PCNOC_SNOC_3_CFG_VMIDMT_SMR6_ADDR A:0x98818
y.create.l HWIO_VMIDMT_PCNOC_SNOC_3_CFG_VMIDMT_SMR7_ADDR A:0x9881c
y.create.l HWIO_VMIDMT_PCNOC_SNOC_3_CFG_VMIDMT_SMR8_ADDR A:0x98820
y.create.l HWIO_VMIDMT_PCNOC_SNOC_3_CFG_VMIDMT_SMR9_ADDR A:0x98824
y.create.l HWIO_VMIDMT_PCNOC_SNOC_4_CFG_VMIDMT_SMR_128_SSD7_SID7_MA128_REG_BASE_START_ADDR A:0x9a000
y.create.l HWIO_VMIDMT_PCNOC_SNOC_4_CFG_VMIDMT_SMR_128_SSD7_SID7_MA128_REG_BASE_LAST_ADDR A:0x9affc
y.create.l HWIO_VMIDMT_PCNOC_SNOC_4_CFG_VMIDMT_SMR_128_SSD7_SID7_MA128_REG_BASE_END_ADDR A:0x9b000
y.create.l HWIO_VMIDMT_PCNOC_SNOC_4_CFG_VMIDMT_SCR0_ADDR A:0x9a000
y.create.l HWIO_VMIDMT_PCNOC_SNOC_4_CFG_VMIDMT_SCR1_ADDR A:0x9a004
y.create.l HWIO_VMIDMT_PCNOC_SNOC_4_CFG_VMIDMT_SCR2_ADDR A:0x9a008
y.create.l HWIO_VMIDMT_PCNOC_SNOC_4_CFG_VMIDMT_SACR_ADDR A:0x9a010
y.create.l HWIO_VMIDMT_PCNOC_SNOC_4_CFG_VMIDMT_SIDR0_ADDR A:0x9a020
y.create.l HWIO_VMIDMT_PCNOC_SNOC_4_CFG_VMIDMT_SIDR1_ADDR A:0x9a024
y.create.l HWIO_VMIDMT_PCNOC_SNOC_4_CFG_VMIDMT_SIDR2_ADDR A:0x9a028
y.create.l HWIO_VMIDMT_PCNOC_SNOC_4_CFG_VMIDMT_SIDR4_ADDR A:0x9a030
y.create.l HWIO_VMIDMT_PCNOC_SNOC_4_CFG_VMIDMT_SIDR5_ADDR A:0x9a034
y.create.l HWIO_VMIDMT_PCNOC_SNOC_4_CFG_VMIDMT_SIDR7_ADDR A:0x9a03c
y.create.l HWIO_VMIDMT_PCNOC_SNOC_4_CFG_VMIDMT_SGFAR0_ADDR A:0x9a040
y.create.l HWIO_VMIDMT_PCNOC_SNOC_4_CFG_VMIDMT_SGFSR_ADDR A:0x9a048
y.create.l HWIO_VMIDMT_PCNOC_SNOC_4_CFG_VMIDMT_SGFSRRESTORE_ADDR A:0x9a04c
y.create.l HWIO_VMIDMT_PCNOC_SNOC_4_CFG_VMIDMT_SGFSYNDR0_ADDR A:0x9a050
y.create.l HWIO_VMIDMT_PCNOC_SNOC_4_CFG_VMIDMT_SGFSYNDR1_ADDR A:0x9a054
y.create.l HWIO_VMIDMT_PCNOC_SNOC_4_CFG_VMIDMT_SGFSYNDR2_ADDR A:0x9a058
y.create.l HWIO_VMIDMT_PCNOC_SNOC_4_CFG_VMIDMT_VMIDMTSCR0_ADDR A:0x9a090
y.create.l HWIO_VMIDMT_PCNOC_SNOC_4_CFG_VMIDMT_CR0_ADDR A:0x9a000
y.create.l HWIO_VMIDMT_PCNOC_SNOC_4_CFG_VMIDMT_CR2_ADDR A:0x9a008
y.create.l HWIO_VMIDMT_PCNOC_SNOC_4_CFG_VMIDMT_ACR_ADDR A:0x9a010
y.create.l HWIO_VMIDMT_PCNOC_SNOC_4_CFG_VMIDMT_IDR0_ADDR A:0x9a020
y.create.l HWIO_VMIDMT_PCNOC_SNOC_4_CFG_VMIDMT_IDR1_ADDR A:0x9a024
y.create.l HWIO_VMIDMT_PCNOC_SNOC_4_CFG_VMIDMT_IDR2_ADDR A:0x9a028
y.create.l HWIO_VMIDMT_PCNOC_SNOC_4_CFG_VMIDMT_IDR4_ADDR A:0x9a030
y.create.l HWIO_VMIDMT_PCNOC_SNOC_4_CFG_VMIDMT_IDR5_ADDR A:0x9a034
y.create.l HWIO_VMIDMT_PCNOC_SNOC_4_CFG_VMIDMT_IDR7_ADDR A:0x9a03c
y.create.l HWIO_VMIDMT_PCNOC_SNOC_4_CFG_VMIDMT_GFAR0_ADDR A:0x9a040
y.create.l HWIO_VMIDMT_PCNOC_SNOC_4_CFG_VMIDMT_GFSR_ADDR A:0x9a048
y.create.l HWIO_VMIDMT_PCNOC_SNOC_4_CFG_VMIDMT_GFSRRESTORE_ADDR A:0x9a04c
y.create.l HWIO_VMIDMT_PCNOC_SNOC_4_CFG_VMIDMT_GFSYNDR0_ADDR A:0x9a050
y.create.l HWIO_VMIDMT_PCNOC_SNOC_4_CFG_VMIDMT_GFSYNDR1_ADDR A:0x9a054
y.create.l HWIO_VMIDMT_PCNOC_SNOC_4_CFG_VMIDMT_GFSYNDR2_ADDR A:0x9a058
y.create.l HWIO_VMIDMT_PCNOC_SNOC_4_CFG_VMIDMT_VMIDMTCR0_ADDR A:0x9a090
y.create.l HWIO_VMIDMT_PCNOC_SNOC_4_CFG_VMIDMT_VMIDMTACR_ADDR A:0x9a09c
y.create.l HWIO_VMIDMT_PCNOC_SNOC_4_CFG_VMIDMT_NSCR0_ADDR A:0x9a400
y.create.l HWIO_VMIDMT_PCNOC_SNOC_4_CFG_VMIDMT_NSCR2_ADDR A:0x9a408
y.create.l HWIO_VMIDMT_PCNOC_SNOC_4_CFG_VMIDMT_NSACR_ADDR A:0x9a410
y.create.l HWIO_VMIDMT_PCNOC_SNOC_4_CFG_VMIDMT_NSGFAR0_ADDR A:0x9a440
y.create.l HWIO_VMIDMT_PCNOC_SNOC_4_CFG_VMIDMT_NSGFSR_ADDR A:0x9a448
y.create.l HWIO_VMIDMT_PCNOC_SNOC_4_CFG_VMIDMT_NSGFSRRESTORE_ADDR A:0x9a44c
y.create.l HWIO_VMIDMT_PCNOC_SNOC_4_CFG_VMIDMT_NSGFSYNDR0_ADDR A:0x9a450
y.create.l HWIO_VMIDMT_PCNOC_SNOC_4_CFG_VMIDMT_NSGFSYNDR1_ADDR A:0x9a454
y.create.l HWIO_VMIDMT_PCNOC_SNOC_4_CFG_VMIDMT_NSGFSYNDR2_ADDR A:0x9a458
y.create.l HWIO_VMIDMT_PCNOC_SNOC_4_CFG_VMIDMT_NSVMIDMTCR0_ADDR A:0x9a490
y.create.l HWIO_VMIDMT_PCNOC_SNOC_4_CFG_VMIDMT_SSDR0_ADDR A:0x9a080
y.create.l HWIO_VMIDMT_PCNOC_SNOC_4_CFG_VMIDMT_SSDR1_ADDR A:0x9a084
y.create.l HWIO_VMIDMT_PCNOC_SNOC_4_CFG_VMIDMT_SSDR2_ADDR A:0x9a088
y.create.l HWIO_VMIDMT_PCNOC_SNOC_4_CFG_VMIDMT_SSDR3_ADDR A:0x9a08c
y.create.l HWIO_VMIDMT_PCNOC_SNOC_4_CFG_VMIDMT_MSDR0_ADDR A:0x9a480
y.create.l HWIO_VMIDMT_PCNOC_SNOC_4_CFG_VMIDMT_MSDR1_ADDR A:0x9a484
y.create.l HWIO_VMIDMT_PCNOC_SNOC_4_CFG_VMIDMT_MSDR2_ADDR A:0x9a488
y.create.l HWIO_VMIDMT_PCNOC_SNOC_4_CFG_VMIDMT_MSDR3_ADDR A:0x9a48c
y.create.l HWIO_VMIDMT_PCNOC_SNOC_4_CFG_VMIDMT_MCR_ADDR A:0x9a494
y.create.l HWIO_VMIDMT_PCNOC_SNOC_4_CFG_VMIDMT_S2VR0_ADDR A:0x9ac00
y.create.l HWIO_VMIDMT_PCNOC_SNOC_4_CFG_VMIDMT_S2VR1_ADDR A:0x9ac04
y.create.l HWIO_VMIDMT_PCNOC_SNOC_4_CFG_VMIDMT_S2VR2_ADDR A:0x9ac08
y.create.l HWIO_VMIDMT_PCNOC_SNOC_4_CFG_VMIDMT_S2VR3_ADDR A:0x9ac0c
y.create.l HWIO_VMIDMT_PCNOC_SNOC_4_CFG_VMIDMT_S2VR4_ADDR A:0x9ac10
y.create.l HWIO_VMIDMT_PCNOC_SNOC_4_CFG_VMIDMT_S2VR5_ADDR A:0x9ac14
y.create.l HWIO_VMIDMT_PCNOC_SNOC_4_CFG_VMIDMT_S2VR6_ADDR A:0x9ac18
y.create.l HWIO_VMIDMT_PCNOC_SNOC_4_CFG_VMIDMT_S2VR7_ADDR A:0x9ac1c
y.create.l HWIO_VMIDMT_PCNOC_SNOC_4_CFG_VMIDMT_S2VR8_ADDR A:0x9ac20
y.create.l HWIO_VMIDMT_PCNOC_SNOC_4_CFG_VMIDMT_S2VR9_ADDR A:0x9ac24
y.create.l HWIO_VMIDMT_PCNOC_SNOC_4_CFG_VMIDMT_AS2VR0_ADDR A:0x9ae00
y.create.l HWIO_VMIDMT_PCNOC_SNOC_4_CFG_VMIDMT_AS2VR1_ADDR A:0x9ae04
y.create.l HWIO_VMIDMT_PCNOC_SNOC_4_CFG_VMIDMT_AS2VR2_ADDR A:0x9ae08
y.create.l HWIO_VMIDMT_PCNOC_SNOC_4_CFG_VMIDMT_AS2VR3_ADDR A:0x9ae0c
y.create.l HWIO_VMIDMT_PCNOC_SNOC_4_CFG_VMIDMT_AS2VR4_ADDR A:0x9ae10
y.create.l HWIO_VMIDMT_PCNOC_SNOC_4_CFG_VMIDMT_AS2VR5_ADDR A:0x9ae14
y.create.l HWIO_VMIDMT_PCNOC_SNOC_4_CFG_VMIDMT_AS2VR6_ADDR A:0x9ae18
y.create.l HWIO_VMIDMT_PCNOC_SNOC_4_CFG_VMIDMT_AS2VR7_ADDR A:0x9ae1c
y.create.l HWIO_VMIDMT_PCNOC_SNOC_4_CFG_VMIDMT_AS2VR8_ADDR A:0x9ae20
y.create.l HWIO_VMIDMT_PCNOC_SNOC_4_CFG_VMIDMT_AS2VR9_ADDR A:0x9ae24
y.create.l HWIO_VMIDMT_PCNOC_SNOC_4_CFG_VMIDMT_SMR0_ADDR A:0x9a800
y.create.l HWIO_VMIDMT_PCNOC_SNOC_4_CFG_VMIDMT_SMR1_ADDR A:0x9a804
y.create.l HWIO_VMIDMT_PCNOC_SNOC_4_CFG_VMIDMT_SMR2_ADDR A:0x9a808
y.create.l HWIO_VMIDMT_PCNOC_SNOC_4_CFG_VMIDMT_SMR3_ADDR A:0x9a80c
y.create.l HWIO_VMIDMT_PCNOC_SNOC_4_CFG_VMIDMT_SMR4_ADDR A:0x9a810
y.create.l HWIO_VMIDMT_PCNOC_SNOC_4_CFG_VMIDMT_SMR5_ADDR A:0x9a814
y.create.l HWIO_VMIDMT_PCNOC_SNOC_4_CFG_VMIDMT_SMR6_ADDR A:0x9a818
y.create.l HWIO_VMIDMT_PCNOC_SNOC_4_CFG_VMIDMT_SMR7_ADDR A:0x9a81c
y.create.l HWIO_VMIDMT_PCNOC_SNOC_4_CFG_VMIDMT_SMR8_ADDR A:0x9a820
y.create.l HWIO_VMIDMT_PCNOC_SNOC_4_CFG_VMIDMT_SMR9_ADDR A:0x9a824
y.create.l HWIO_XPU_CFG_PCNOC_CFG_MPU1132_4_M19L12_AHB_REG_BASE_START_ADDR A:0x2e000
y.create.l HWIO_XPU_CFG_PCNOC_CFG_MPU1132_4_M19L12_AHB_REG_BASE_LAST_ADDR A:0x2e3dc
y.create.l HWIO_XPU_CFG_PCNOC_CFG_MPU1132_4_M19L12_AHB_REG_BASE_END_ADDR A:0x2e400
y.create.l HWIO_XPU_CFG_PCNOC_CFG_XPU_SCR_ADDR A:0x2e000
y.create.l HWIO_XPU_CFG_PCNOC_CFG_XPU_SWDR_ADDR A:0x2e004
y.create.l HWIO_XPU_CFG_PCNOC_CFG_XPU_PRTN_RACR_SSHADOW_ADDR A:0x2e008
y.create.l HWIO_XPU_CFG_PCNOC_CFG_XPU_PRTN_WACR_SSHADOW_ADDR A:0x2e00c
y.create.l HWIO_XPU_CFG_PCNOC_CFG_XPU_PRTN_START_SSHADOW0_ADDR A:0x2e010
y.create.l HWIO_XPU_CFG_PCNOC_CFG_XPU_PRTN_END_SSHADOW0_ADDR A:0x2e018
y.create.l HWIO_XPU_CFG_PCNOC_CFG_XPU_SEAR0_ADDR A:0x2e040
y.create.l HWIO_XPU_CFG_PCNOC_CFG_XPU_SESR_ADDR A:0x2e048
y.create.l HWIO_XPU_CFG_PCNOC_CFG_XPU_SESRRESTORE_ADDR A:0x2e04c
y.create.l HWIO_XPU_CFG_PCNOC_CFG_XPU_SESYNR0_ADDR A:0x2e050
y.create.l HWIO_XPU_CFG_PCNOC_CFG_XPU_SESYNR1_ADDR A:0x2e054
y.create.l HWIO_XPU_CFG_PCNOC_CFG_XPU_SESYNR2_ADDR A:0x2e058
y.create.l HWIO_XPU_CFG_PCNOC_CFG_XPU_MCR_ADDR A:0x2e100
y.create.l HWIO_XPU_CFG_PCNOC_CFG_XPU_MEAR0_ADDR A:0x2e140
y.create.l HWIO_XPU_CFG_PCNOC_CFG_XPU_MESR_ADDR A:0x2e148
y.create.l HWIO_XPU_CFG_PCNOC_CFG_XPU_MESRRESTORE_ADDR A:0x2e14c
y.create.l HWIO_XPU_CFG_PCNOC_CFG_XPU_MESYNR0_ADDR A:0x2e150
y.create.l HWIO_XPU_CFG_PCNOC_CFG_XPU_MESYNR1_ADDR A:0x2e154
y.create.l HWIO_XPU_CFG_PCNOC_CFG_XPU_MESYNR2_ADDR A:0x2e158
y.create.l HWIO_XPU_CFG_PCNOC_CFG_XPU_CR_ADDR A:0x2e080
y.create.l HWIO_XPU_CFG_PCNOC_CFG_XPU_PRTN_RACR_SHADOW_ADDR A:0x2e088
y.create.l HWIO_XPU_CFG_PCNOC_CFG_XPU_PRTN_WACR_SHADOW_ADDR A:0x2e08c
y.create.l HWIO_XPU_CFG_PCNOC_CFG_XPU_PRTN_START_SHADOW0_ADDR A:0x2e090
y.create.l HWIO_XPU_CFG_PCNOC_CFG_XPU_PRTN_END_SHADOW0_ADDR A:0x2e098
y.create.l HWIO_XPU_CFG_PCNOC_CFG_XPU_RPU_ACR0_ADDR A:0x2e0a0
y.create.l HWIO_XPU_CFG_PCNOC_CFG_XPU_EAR0_ADDR A:0x2e0c0
y.create.l HWIO_XPU_CFG_PCNOC_CFG_XPU_ESR_ADDR A:0x2e0c8
y.create.l HWIO_XPU_CFG_PCNOC_CFG_XPU_ESRRESTORE_ADDR A:0x2e0cc
y.create.l HWIO_XPU_CFG_PCNOC_CFG_XPU_ESYNR0_ADDR A:0x2e0d0
y.create.l HWIO_XPU_CFG_PCNOC_CFG_XPU_ESYNR1_ADDR A:0x2e0d4
y.create.l HWIO_XPU_CFG_PCNOC_CFG_XPU_ESYNR2_ADDR A:0x2e0d8
y.create.l HWIO_XPU_CFG_PCNOC_CFG_XPU_UMR_RACR_ADDR A:0x2e0e0
y.create.l HWIO_XPU_CFG_PCNOC_CFG_XPU_UMR_WACR_ADDR A:0x2e0e4
y.create.l HWIO_XPU_CFG_PCNOC_CFG_XPU_UMR_CNTL_ADDR A:0x2e0f0
y.create.l HWIO_XPU_CFG_PCNOC_CFG_XPU_IDR0_ADDR A:0x2e074
y.create.l HWIO_XPU_CFG_PCNOC_CFG_XPU_IDR1_ADDR A:0x2e078
y.create.l HWIO_XPU_CFG_PCNOC_CFG_XPU_REV_ADDR A:0x2e07c
y.create.l HWIO_XPU_CFG_PCNOC_CFG_XPU_PRT0_RACR0_ADDR A:0x2e200
y.create.l HWIO_XPU_CFG_PCNOC_CFG_XPU_PRT1_RACR0_ADDR A:0x2e280
y.create.l HWIO_XPU_CFG_PCNOC_CFG_XPU_PRT2_RACR0_ADDR A:0x2e300
y.create.l HWIO_XPU_CFG_PCNOC_CFG_XPU_PRT3_RACR0_ADDR A:0x2e380
y.create.l HWIO_XPU_CFG_PCNOC_CFG_XPU_PRT0_WACR0_ADDR A:0x2e220
y.create.l HWIO_XPU_CFG_PCNOC_CFG_XPU_PRT1_WACR0_ADDR A:0x2e2a0
y.create.l HWIO_XPU_CFG_PCNOC_CFG_XPU_PRT2_WACR0_ADDR A:0x2e320
y.create.l HWIO_XPU_CFG_PCNOC_CFG_XPU_PRT3_WACR0_ADDR A:0x2e3a0
y.create.l HWIO_XPU_CFG_PCNOC_CFG_XPU_PRT0_START0_ADDR A:0x2e240
y.create.l HWIO_XPU_CFG_PCNOC_CFG_XPU_PRT1_START0_ADDR A:0x2e2c0
y.create.l HWIO_XPU_CFG_PCNOC_CFG_XPU_PRT2_START0_ADDR A:0x2e340
y.create.l HWIO_XPU_CFG_PCNOC_CFG_XPU_PRT3_START0_ADDR A:0x2e3c0
y.create.l HWIO_XPU_CFG_PCNOC_CFG_XPU_PRT0_END0_ADDR A:0x2e248
y.create.l HWIO_XPU_CFG_PCNOC_CFG_XPU_PRT1_END0_ADDR A:0x2e2c8
y.create.l HWIO_XPU_CFG_PCNOC_CFG_XPU_PRT2_END0_ADDR A:0x2e348
y.create.l HWIO_XPU_CFG_PCNOC_CFG_XPU_PRT3_END0_ADDR A:0x2e3c8
y.create.l HWIO_XPU_CFG_PCNOC_CFG_XPU_PRT0_SCR_ADDR A:0x2e250
y.create.l HWIO_XPU_CFG_PCNOC_CFG_XPU_PRT1_SCR_ADDR A:0x2e2d0
y.create.l HWIO_XPU_CFG_PCNOC_CFG_XPU_PRT2_SCR_ADDR A:0x2e350
y.create.l HWIO_XPU_CFG_PCNOC_CFG_XPU_PRT3_SCR_ADDR A:0x2e3d0
y.create.l HWIO_XPU_CFG_PCNOC_CFG_XPU_PRT0_MCR_ADDR A:0x2e254
y.create.l HWIO_XPU_CFG_PCNOC_CFG_XPU_PRT1_MCR_ADDR A:0x2e2d4
y.create.l HWIO_XPU_CFG_PCNOC_CFG_XPU_PRT2_MCR_ADDR A:0x2e354
y.create.l HWIO_XPU_CFG_PCNOC_CFG_XPU_PRT3_MCR_ADDR A:0x2e3d4
y.create.l HWIO_XPU_CFG_PCNOC_CFG_XPU_PRT0_CNTL0_ADDR A:0x2e258
y.create.l HWIO_XPU_CFG_PCNOC_CFG_XPU_PRT1_CNTL0_ADDR A:0x2e2d8
y.create.l HWIO_XPU_CFG_PCNOC_CFG_XPU_PRT2_CNTL0_ADDR A:0x2e358
y.create.l HWIO_XPU_CFG_PCNOC_CFG_XPU_PRT3_CNTL0_ADDR A:0x2e3d8
y.create.l HWIO_XPU_CFG_PCNOC_CFG_XPU_PRT0_CNTL1_ADDR A:0x2e25c
y.create.l HWIO_XPU_CFG_PCNOC_CFG_XPU_PRT1_CNTL1_ADDR A:0x2e2dc
y.create.l HWIO_XPU_CFG_PCNOC_CFG_XPU_PRT2_CNTL1_ADDR A:0x2e35c
y.create.l HWIO_XPU_CFG_PCNOC_CFG_XPU_PRT3_CNTL1_ADDR A:0x2e3dc
y.create.l HWIO_XPU_CFG_RPM_CFG_MPU1132_2_M21L12_AHB_REG_BASE_START_ADDR A:0x33000
y.create.l HWIO_XPU_CFG_RPM_CFG_MPU1132_2_M21L12_AHB_REG_BASE_LAST_ADDR A:0x332dc
y.create.l HWIO_XPU_CFG_RPM_CFG_MPU1132_2_M21L12_AHB_REG_BASE_END_ADDR A:0x33300
y.create.l HWIO_XPU_CFG_RPM_CFG_XPU_SCR_ADDR A:0x33000
y.create.l HWIO_XPU_CFG_RPM_CFG_XPU_SWDR_ADDR A:0x33004
y.create.l HWIO_XPU_CFG_RPM_CFG_XPU_PRTN_RACR_SSHADOW_ADDR A:0x33008
y.create.l HWIO_XPU_CFG_RPM_CFG_XPU_PRTN_WACR_SSHADOW_ADDR A:0x3300c
y.create.l HWIO_XPU_CFG_RPM_CFG_XPU_PRTN_START_SSHADOW0_ADDR A:0x33010
y.create.l HWIO_XPU_CFG_RPM_CFG_XPU_PRTN_END_SSHADOW0_ADDR A:0x33018
y.create.l HWIO_XPU_CFG_RPM_CFG_XPU_SEAR0_ADDR A:0x33040
y.create.l HWIO_XPU_CFG_RPM_CFG_XPU_SESR_ADDR A:0x33048
y.create.l HWIO_XPU_CFG_RPM_CFG_XPU_SESRRESTORE_ADDR A:0x3304c
y.create.l HWIO_XPU_CFG_RPM_CFG_XPU_SESYNR0_ADDR A:0x33050
y.create.l HWIO_XPU_CFG_RPM_CFG_XPU_SESYNR1_ADDR A:0x33054
y.create.l HWIO_XPU_CFG_RPM_CFG_XPU_SESYNR2_ADDR A:0x33058
y.create.l HWIO_XPU_CFG_RPM_CFG_XPU_MCR_ADDR A:0x33100
y.create.l HWIO_XPU_CFG_RPM_CFG_XPU_MEAR0_ADDR A:0x33140
y.create.l HWIO_XPU_CFG_RPM_CFG_XPU_MESR_ADDR A:0x33148
y.create.l HWIO_XPU_CFG_RPM_CFG_XPU_MESRRESTORE_ADDR A:0x3314c
y.create.l HWIO_XPU_CFG_RPM_CFG_XPU_MESYNR0_ADDR A:0x33150
y.create.l HWIO_XPU_CFG_RPM_CFG_XPU_MESYNR1_ADDR A:0x33154
y.create.l HWIO_XPU_CFG_RPM_CFG_XPU_MESYNR2_ADDR A:0x33158
y.create.l HWIO_XPU_CFG_RPM_CFG_XPU_CR_ADDR A:0x33080
y.create.l HWIO_XPU_CFG_RPM_CFG_XPU_PRTN_RACR_SHADOW_ADDR A:0x33088
y.create.l HWIO_XPU_CFG_RPM_CFG_XPU_PRTN_WACR_SHADOW_ADDR A:0x3308c
y.create.l HWIO_XPU_CFG_RPM_CFG_XPU_PRTN_START_SHADOW0_ADDR A:0x33090
y.create.l HWIO_XPU_CFG_RPM_CFG_XPU_PRTN_END_SHADOW0_ADDR A:0x33098
y.create.l HWIO_XPU_CFG_RPM_CFG_XPU_RPU_ACR0_ADDR A:0x330a0
y.create.l HWIO_XPU_CFG_RPM_CFG_XPU_EAR0_ADDR A:0x330c0
y.create.l HWIO_XPU_CFG_RPM_CFG_XPU_ESR_ADDR A:0x330c8
y.create.l HWIO_XPU_CFG_RPM_CFG_XPU_ESRRESTORE_ADDR A:0x330cc
y.create.l HWIO_XPU_CFG_RPM_CFG_XPU_ESYNR0_ADDR A:0x330d0
y.create.l HWIO_XPU_CFG_RPM_CFG_XPU_ESYNR1_ADDR A:0x330d4
y.create.l HWIO_XPU_CFG_RPM_CFG_XPU_ESYNR2_ADDR A:0x330d8
y.create.l HWIO_XPU_CFG_RPM_CFG_XPU_UMR_RACR_ADDR A:0x330e0
y.create.l HWIO_XPU_CFG_RPM_CFG_XPU_UMR_WACR_ADDR A:0x330e4
y.create.l HWIO_XPU_CFG_RPM_CFG_XPU_UMR_CNTL_ADDR A:0x330f0
y.create.l HWIO_XPU_CFG_RPM_CFG_XPU_IDR0_ADDR A:0x33074
y.create.l HWIO_XPU_CFG_RPM_CFG_XPU_IDR1_ADDR A:0x33078
y.create.l HWIO_XPU_CFG_RPM_CFG_XPU_REV_ADDR A:0x3307c
y.create.l HWIO_XPU_CFG_RPM_CFG_XPU_PRT0_RACR0_ADDR A:0x33200
y.create.l HWIO_XPU_CFG_RPM_CFG_XPU_PRT1_RACR0_ADDR A:0x33280
y.create.l HWIO_XPU_CFG_RPM_CFG_XPU_PRT0_WACR0_ADDR A:0x33220
y.create.l HWIO_XPU_CFG_RPM_CFG_XPU_PRT1_WACR0_ADDR A:0x332a0
y.create.l HWIO_XPU_CFG_RPM_CFG_XPU_PRT0_START0_ADDR A:0x33240
y.create.l HWIO_XPU_CFG_RPM_CFG_XPU_PRT1_START0_ADDR A:0x332c0
y.create.l HWIO_XPU_CFG_RPM_CFG_XPU_PRT0_END0_ADDR A:0x33248
y.create.l HWIO_XPU_CFG_RPM_CFG_XPU_PRT1_END0_ADDR A:0x332c8
y.create.l HWIO_XPU_CFG_RPM_CFG_XPU_PRT0_SCR_ADDR A:0x33250
y.create.l HWIO_XPU_CFG_RPM_CFG_XPU_PRT1_SCR_ADDR A:0x332d0
y.create.l HWIO_XPU_CFG_RPM_CFG_XPU_PRT0_MCR_ADDR A:0x33254
y.create.l HWIO_XPU_CFG_RPM_CFG_XPU_PRT1_MCR_ADDR A:0x332d4
y.create.l HWIO_XPU_CFG_RPM_CFG_XPU_PRT0_CNTL0_ADDR A:0x33258
y.create.l HWIO_XPU_CFG_RPM_CFG_XPU_PRT1_CNTL0_ADDR A:0x332d8
y.create.l HWIO_XPU_CFG_RPM_CFG_XPU_PRT0_CNTL1_ADDR A:0x3325c
y.create.l HWIO_XPU_CFG_RPM_CFG_XPU_PRT1_CNTL1_ADDR A:0x332dc
y.create.done
