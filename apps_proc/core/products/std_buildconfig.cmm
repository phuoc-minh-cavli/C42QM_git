//	 Title: std_buildconfig

//	 License: License
//	 Copyright 2010 Qualcomm Inc 

//	 Description: General Description
//	 This script contains build information.

//	 Input: Inputs
//	 None

//	 Output: Outputs
//	 None

//	 Usage: Usage
//	 do std_buildconfig

//	 Team: Functional Area
//	 CoreBSP Products 8960

//	 Target: Target
//	 MSM8960

//	 Author: Author
//	 $Author: rvennam $

//	 Location: Perforce Revision
//	 $Header: //depot/asic/msm8960/temp_dev/AMSS/products/8660/build/ms/std_buildconfig $

//	 Edits: Edits
//	 Autogenerated on Monday 06/11/2023 04:00:23
// ---------------------------------------------------------------------------------
 
 
 

 GLOBAL &APPS_BUILDID
 GLOBAL &APPS_BUILDIDA
 GLOBAL &CHIPSET
 GLOBAL &APPS_BUILDMSDIR
 GLOBAL &APPS_MBNDIR
 GLOBAL &APPS_ELFFILE
 GLOBAL &APPS_TIMESTAMP
 GLOBAL &BUILDID
 GLOBAL &BUILDIDA
 GLOBAL &CHIPSET
 GLOBAL &BUILDROOT
 GLOBAL &COREDIR
 GLOBAL &PRODUCTSDIR
 GLOBAL &BUILDMSDIR
 GLOBAL &MBNDIR
 GLOBAL &ELFFILE
 GLOBAL &TIMESTAMP
 // GLOBAL &BOOTLOADERFLAVOR
 

 &APPS_BUILDID="ACFNAANZ"
 &APPS_BUILDIDA="ACFNAANZA"
 &CHIPSET="MDM9205"
 &APPS_BUILDMSDIR=os.ppd()+"/../../build/ms"
 &APPS_MBNDIR="&BUILDMSDIR"+"/bin/&BUILDID"
 &APPS_ELFFILE="M9205ACFNAANZA1234"
 &APPS_TIMESTAMP="1699272024"
 &BUILDID="ACFNAANZ"
 &BUILDIDM="ACFNAANZA"
 &CHIPSET="MDM9205"
 &PRODUCTSDIR=os.ppd()
 &BUILDROOT=os.ppd()+"/../.."
 &COREDIR=os.ppd()+"/.."
 &BUILDMSDIR=os.ppd()+"/../../build/ms"
 &MBNDIR="&BUILDMSDIR"+"/bin/&BUILDID"
 &ELFFILE="M9205ACFNAANZA1234"
 &TIMESTAMP="1699272024"
 // &BOOTLOADERFLAVOR="AAABQNBG"
 
ENDDO