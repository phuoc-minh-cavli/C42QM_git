;---------------------------------------------------------------------------
;  File: SleepDump.cmm
;  
;  Description: Dumps Sleep related data structures, optionally dumps sleep 
;               ulogs and merge them
;  
;               Copyright (c) 2011-2012 Qualcomm Technologies Incorporated.
;               All Rights Reserved.
;               Qualcomm Confidential and Proprietary
;---------------------------------------------------------------------------


;Path to the output file.
;The three options are for nolog, nodump, and/or nomerge. any ordering is fine
ENTRY &op_path &opt1 &opt2 &opt3 &opt4

;ULog time stamp
GLOBAL &ULogTimestamp &output &curr_dir &resourceStr 

;Local variables
LOCAL &sleepRegistry &temp &lprmName &ulogcall &clprListPtr
LOCAL &numOfCores &coreCounter &scriptDir

&curr_dir=os.pwd()

if "&op_path"==""
(
  ;Print a help message for srcipt
  AREA.Create SleepDumpHelp
  AREA.Select SleepDumpHelp
  AREA SleepDumpHelp

  ; no path to output provided.
  PRINT "Use: SleepDump.cmm <output_path> [config] [nologs] [nodump] [nomerge]"
  PRINT "  Optional arguments, 
  PRINT "  config - default (for default directory structure)"
  PRINT "         - qnx (QNX directory structure for multicore environment)"
  PRINT "  nolog  - Sleep Ulogs will not be dumped"
  PRINT "           (Will set nomerge implicitly)"
  PRINT "  nodump - Sleep Data structures will not be dumped"
  PRINT "  nomerge - Sleep logs will not be merged"

  ENDDO
)

;---------------------------------------------------------------------------
; op_path is the path to output the file, 
; We will see if that directory already exist if not we try to create
; If it fails, we abort the script
;---------------------------------------------------------------------------
if !OS.DIR(&op_path)
(
  PRINT "Output path does not exist. Trying to create..."
  mkdir &op_path

  ; Error while creating output path
  if !OS.DIR(&op_path)
  (
    PRINT "Error: Failed to locate/create &(op_path). Exiting..."
    ENDDO
  )
)

; Opening a file for sleep dump at given output path
cd &op_path
&op_path=os.pwd()
cd &curr_dir

;-------------------------------------------------------------------------
; Processing the optional arguments
;
; Currently we are comparing all combination of last 4 arguments in order 
; to provide flexibility to specify option in any order. But try to find
; out if there is a way for command line arguments with varying numbers.
;-------------------------------------------------------------------------
&buildConfig="default"
&merge="true"
&log="true"
&dump="true"

;if nomerge is passed as either option param
if "&opt1"=="nomerge"||"&opt2"=="nomerge"||"&opt3"=="nomerge"||"&opt4"=="nomerge"
(
  &merge="false"
)

;if nolog is passed as either option param
;merge is implicitly declared as false when log is false, 
;because then theres only 1 or 0 logs, and there's nothing to merge
if "&opt1"=="nolog"||"&opt2"=="nolog"||"&opt3"=="nolog"||"&opt4"=="nolog"
(
  &log="false"
  &merge="false"
)

;if nodump is passed as one of optional param
if "&opt1"=="nodump"||"&opt2"=="nodump"||"&opt3"=="nodump"||"&opt4"=="nodump" 
(
  &dump="false"
)

; finding out the correct build configuration. For each os we might need
; a comparison. Find out the better way if exists
if "&opt1"=="qnx"||"&opt2"=="qnx"||"&opt3"=="qnx"||"&opt4"=="qnx"
(
  &buildConfig="qnx"
)

;-----------------------------------------------------------------------
; Constructing log call string and calling ulog dump on it based on
; build configuration
;-----------------------------------------------------------------------
&resourceStr=""
;switching to appropriate directory to get sleep logs

&numOfCores=FORMAT.DECIMAL(0, V.VALUE(gSleepNumOfCore))

;Don't run if we passed the nolog param
if "&log"=="true"
(
  ; We may need a function that takes argument as build configuration
  ; (modem, apps) and number of cores sleep is running. Based on those
  ; two args, it calls ulog script for all sleep logs before actual 
  ; dumping starts
  if "&numOfCores"=="1"
  (
    if "&buildConfig"=="default"
    (
      ; String to call ulog dump     
      &ulogcall="&(curr_dir)\..\..\..\services\diag\diagbuffer\scripts\ULogDump.cmm"
      &scriptDir="&(curr_dir)"
      
      ; calling ulog script to dump all sleep logs
      DO &ulogcall &op_path "Sleep Debug"
      DO &ulogcall &op_path "Sleep Info"
      DO &ulogcall &op_path "Sleep Profiling"
      DO &ulogcall &op_path "Sleep Statistics"
      DO &ulogcall &op_path "Sleep WarningError"
      DO &ulogcall &op_path "Sleep Requests"
    )  

    ; different configuration can go here like LPASS, sensors if they
    ; have different ulog call or logs than what we have for default
    ; This is for single core environment only. For multicore 
    ; environment, add at the end of else part
  )
  else
  (
    ; Check the OS/build for multicore target
    if "&buildConfig"=="qnx"
    (
;     tested on 8660.
      &ulogcall="&(curr_dir)\..\..\..\common\ulog\scripts\ULogDump_qnx"
      &scriptDir="&(curr_dir)"

      DO &ulogcall &op_path "powerman_g_Sleep Statistics"
      DO &ulogcall &op_path "powerman_g_Sleep Requests"

      &coreCounter=FORMAT.DECIMAL(0,0)
      while &coreCounter<&numOfCores
      (
        DO &ulogcall &op_path "powerman_g_Sleep Debug_c&(coreCounter)"
        DO &ulogcall &op_path "powerman_g_Sleep Info_c&(coreCounter)"
        DO &ulogcall &op_path "powerman_g_Sleep Profiling_c&(coreCounter)"
        Do &ulogcall &op_path "powerman_g_Sleep WarningError_c&(coreCounter)"

        &coreCounter=FORMAT.DECIMAL(0, &coreCounter+1)
      )
    )
  )
)

;----------------------------------------------------------------------------
; Running the actual dump for sleep data structures. If we don't have correct
; time stamp (due to nolog option as input or ulog failed for some reason)
; we simply set it to all Fs so that during merging, dump will be at the end.
;----------------------------------------------------------------------------
if "&ULogTimestamp"==""
(
  &ULogTimestamp=0xFFFFFFFF
)

;Don't run dump if we passed nodump
if "&dump"=="true"
(
  cd &op_path
  OPEN #1 "SleepDump.ulog" /Create
  &output="WRITE #1"

  ; Obtaining sleep registry - the central sleep data structure
  &sleepRegistry=V.VALUE(gLprRegistry)

  &coreCounter=FORMAT.DECIMAL(0,0)
  while &coreCounter<&numOfCores
  (
    ; Getting List pointer for core 'coreCounter'
    &output "&(ULogTimestamp): Core &(coreCounter)" 
    &clprListPtr=V.VALUE((*(gLprRegistry)).m_lprs + &coreCounter)
    PRINT &clprListPtr
    ;&temp=V.VALUE(((CoreListType *)&clprListPtr).front_ptr.single_ele)

    &temp=V.VALUE((CLpr *)(*((CLpr **)&clprListPtr)))
    GOSUB DumpCLpr &temp
    &coreCounter=FORMAT.DECIMAL(0, &coreCounter+1)
    &resourceStr=""
  )
  CLOSE #1
)

;End Dump
PRINT "Completed..."

if "&merge"=="true"
(
  do &(scriptDir)\mergeLogs.cmm &(scriptDir) &op_path mergedOutput.ulog
)

cd &(curr_dir)

ENDDO



;=================================================================
;                          Functions
;=================================================================

;-----------------------------------------------------------------
; Dumping a synthesized LPR. This function will gets called
; while dumping list of Syn LPRs.
;-----------------------------------------------------------------

DumpCLpr:
  ENTRY &clpr
  LOCAL &ptrClprm &ptrLpr &lprName &temp
  LOCAL &numCLprms &numComp 
  LOCAL &it &jt

  &numCLprms=V.VALUE(((CLpr *)&clpr).synth_lpr.mode_count)
  &output "&(ULogTimestamp):  Registered LPRs"

  ; This is somewhat long procedure. We don't store directly registered
  ; sleep_lpr. We can query the look up table but for that we will have 
  ; to introduce new variable for its size as cmm script does not know 
  ; its size at run time. Things may get tricky if binary compatibilty
  ; is to be introduced.

  &it=FORMAT.DECIMAL(0,0)
  while &it<&numCLprms
  (
    &ptrClprm=V.VALUE(((CLpr *)&clpr).m_modes+&it)
    &ptrClprm=V.VALUE((CLprm *)(*((CLprm **)&ptrClprm)))   ;ptrClprm is a CLprm

    ; Num of expected modes of ptrClprm CLprm
    &numComp=V.VALUE(((CLprm *)&ptrClprm).num_expected_component_modes)
    
    &jt=FORMAT.DECIMAL(0,0)
    while &jt<&numComp
    (
      &temp=V.VALUE(((CLprm *)&ptrClprm).m_componentModes + &jt)
      &temp=V.VALUE((sleep_lprm *)(*(sleep_lprm **)&temp))
      &ptrLpr=V.VALUE(((sleep_lprm *)&temp).lpr)
      IF &ptrLpr!=0 
      (
        &lprName=DATA.STRING(D:V.VALUE(((sleep_lpr *)&ptrLpr).resource_name))
  
        if STRING.SCAN("&(resourceStr)", "$&(lprName)$", 0)==-1
        (
          GOSUB DumpSleepLpr &ptrLpr
          &resourceStr="&(resourceStr) $&(lprName)$"
        )
      )

      &jt=FORMAT.DECIMAL(0, &jt+1)
    )

    &it=FORMAT.DECIMAL(0, &it+1)
  )

  &output "&(ULogTimestamp):  Component pre-synthesized modes:"

  &it=FORMAT.DECIMAL(0,0)
  while &it<&numCLprms
  (
    &ptrClprm=V.VALUE(((CLpr *)&clpr).m_modes+&it)
    &ptrClprm=V.VALUE((CLprm *)(*((CLprm **)&ptrClprm)))
    GOSUB DumpCLprm &ptrClprm
    &it=FORMAT.DECIMAL(0, &it+1)
  )

  RETURN

;-----------------------------------------------------------------
; Dumping individual CLprm
;-----------------------------------------------------------------
DumpCLprm:
  ENTRY &clprm
  LOCAL &lprmName &componentLprms &status_val &status_string

  &lprmName=DATA.STRING(D:V.VALUE(((CLprm *)&clprm).lprmName))
  &status_val=FORMAT.DECIMAL(0, V.VALUE(((CLprm *)&clprm).m_status))

  IF &status_val==0
    &status_string="Enabled"
  ELSE
    &status_string="Disabled"

  &output "&(ULogTimestamp):    (Mode: &(lprmName))"
  &output "&(ULogTimestamp):       (Status: &(status_string))"

  RETURN


;---------------------------------------------------------------------------
; Dumps the sleep_lpr structure
;---------------------------------------------------------------------------
DumpSleepLpr:
  ENTRY &lprPtr
  LOCAL &aMode &modeAddress &index

  &index=FORMAT.DECIMAL(0, 0)
 
  &aMode=V.VALUE(((sleep_lpr *)&lprPtr).modes + 1 )
  &lprName=DATA.STRING(D:V.VALUE(((sleep_lpr *)&lprPtr).resource_name))
  &modeCount=FORMAT.DECIMAL(0, V.VALUE(((sleep_lpr *)&lprPtr).mode_count))
  &output "&(ULogTimestamp):    (Resource Name: &(lprName)) (Mode Count: &(modeCount))"

  while &index<&modeCount
  (
    &aMode=V.VALUE(((sleep_lpr *)&lprPtr).modes + &index )
    PRINT &(aMode)
    GOSUB DumpSleepLprm &aMode
    &index=FORMAT.DECIMAL(0, &index+1)
  )

  RETURN


;---------------------------------------------------------------------------
; Dumps sleep_lprm structure
;---------------------------------------------------------------------------
DumpSleepLprm:
  ENTRY &lprm
  LOCAL &modeName &resourceName &opstr
  LOCAL &modeStatus &enter_lat &exit_lat &back_off &intime &attrs &statusStr

  &modeName=DATA.STRING(D:V.VALUE(((sleep_lprm *)&lprm).mode_name))
  &resourceName=DATA.STRING(D:V.VALUE(((sleep_lprm *)&lprm).lpr.resource_name))

  &modeStatus=FORMAT.DECIMAL(0, V.VALUE(((sleep_lprm *)&lprm).mode_enabled))
  IF &modeStatus==0
    &statusStr="Disabled"
  ELSE
    &statusStr="Enabled"

  &enter_lat=FORMAT.DECIMAL(0, V.VALUE(((sleep_lprm *)&lprm).latency_enter_func))
  &exit_lat=FORMAT.DECIMAL(0, V.VALUE(((sleep_lprm *)&lprm).latency_exit_func))
  &back_off=FORMAT.DECIMAL(0, V.VALUE(((sleep_lprm *)&lprm).backoff_func))
  &attrs=FORMAT.HEX(0, V.VALUE(((sleep_lprm *)&lprm).attributes))

  &opstr="&(ULogTimestamp):       (Mode: &(resourceName).&(modeName))"
  &opstr="&(opstr) (status: &(statusStr))"
  &opstr="&(opstr) (enter latency: &(enter_lat))"
  &opstr="&(opstr) (exit latency: &(exit_lat))"
  &opstr="&(opstr) (backoff: &(back_off))"
  &opstr="&(opstr) (Attribute: 0x&(attrs))"

  &output "&(opstr)"

  RETURN


