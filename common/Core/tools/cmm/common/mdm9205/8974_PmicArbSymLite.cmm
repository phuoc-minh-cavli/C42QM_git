

if (Y.EXIST(PMIC_ARB_CHNLn_SYMFLAG))
(
    ;print "Register symbols existed !!!"
)
else
(
    y.create.l PMIC_ARB_CHNL0_CMD 0xFC4CF800 
    y.create.l PMIC_ARB_CHNL0_RDATA0 0xFC4CF818 
    y.create.l PMIC_ARB_CHNL0_RDATA1 0xFC4CF81C 
    y.create.l PMIC_ARB_CHNL0_RDATA2 0xFC4CF820 
    y.create.l PMIC_ARB_CHNL0_WDATA0 0xFC4CF810 
    y.create.l PMIC_ARB_CHNL0_WDATA1 0xFC4CF814 
    y.create.l PMIC_ARB_CHNL0_STATUS 0xFC4CF808 

    y.create.l PMIC_ARB_CHNL1_CMD 0xFC4CF880 
    y.create.l PMIC_ARB_CHNL1_RDATA0 0xFC4CF898 
    y.create.l PMIC_ARB_CHNL1_RDATA1 0xFC4CF89C 
    y.create.l PMIC_ARB_CHNL1_RDATA2 0xFC4CF8A0 
    y.create.l PMIC_ARB_CHNL1_WDATA0 0xFC4CF890 
    y.create.l PMIC_ARB_CHNL1_WDATA1 0xFC4CF894 
    y.create.l PMIC_ARB_CHNL1_STATUS 0xFC4CF888 

    y.create.l PMIC_ARB_CHNL2_CMD 0xFC4CF900 
    y.create.l PMIC_ARB_CHNL2_RDATA0 0xFC4CF918 
    y.create.l PMIC_ARB_CHNL2_RDATA1 0xFC4CF91C 
    y.create.l PMIC_ARB_CHNL2_RDATA2 0xFC4CF920 
    y.create.l PMIC_ARB_CHNL2_WDATA0 0xFC4CF910 
    y.create.l PMIC_ARB_CHNL2_WDATA1 0xFC4CF914 
    y.create.l PMIC_ARB_CHNL2_STATUS 0xFC4CF908 

    y.create.l PMIC_ARB_CHNL3_CMD 0xFC4CF980 
    y.create.l PMIC_ARB_CHNL3_RDATA0 0xFC4CF998 
    y.create.l PMIC_ARB_CHNL3_RDATA1 0xFC4CF99C 
    y.create.l PMIC_ARB_CHNL3_RDATA2 0xFC4CF9A0 
    y.create.l PMIC_ARB_CHNL3_WDATA0 0xFC4CF990 
    y.create.l PMIC_ARB_CHNL3_WDATA1 0xFC4CF994 
    y.create.l PMIC_ARB_CHNL3_STATUS 0xFC4CF988 

    y.create.l PMIC_ARB_CHNL4_CMD 0xFC4CFA00 
    y.create.l PMIC_ARB_CHNL4_RDATA0 0xFC4CFA18 
    y.create.l PMIC_ARB_CHNL4_RDATA1 0xFC4CFA1C 
    y.create.l PMIC_ARB_CHNL4_RDATA2 0xFC4CFA20 
    y.create.l PMIC_ARB_CHNL4_WDATA0 0xFC4CFA10 
    y.create.l PMIC_ARB_CHNL4_WDATA1 0xFC4CFA14 
    y.create.l PMIC_ARB_CHNL4_STATUS 0xFC4CFA08 

    y.create.l PMIC_ARB_CHNL5_CMD 0xFC4CFA80 
    y.create.l PMIC_ARB_CHNL5_RDATA0 0xFC4CFA98 
    y.create.l PMIC_ARB_CHNL5_RDATA1 0xFC4CFA9C 
    y.create.l PMIC_ARB_CHNL5_RDATA2 0xFC4CFAA0 
    y.create.l PMIC_ARB_CHNL5_WDATA0 0xFC4CFA90 
    y.create.l PMIC_ARB_CHNL5_WDATA1 0xFC4CFA94 
    y.create.l PMIC_ARB_CHNL5_STATUS 0xFC4CFA88 
    
    y.create.l PMIC_ARB_CHNLn_SYMFLAG 0xF8200004   ; use unused address as the dummy value
    
    y.create.done
)

if (Y.EXIST(PMIC_ARB_SPMI_GENI_CFG_SYMFLAG))
(
    ;print "Register symbols existed !!!"
)
else
(
    y.create.l PMIC_ARB_HW_VERSION 0xFC4CF000

	y.create.l PMIC_ARB_SPMI_GENI_CLK_CTRL			0xFC4CA000
    y.create.l PMIC_ARB_SPMI_GENI_HW_VERSION		0xFC4CA004
    y.create.l PMIC_ARB_SPMI_GENI_FW_REVISION		0xFC4CA008
    y.create.l PMIC_ARB_SPMI_GENI_S_FW_REVISION		0xFC4CA00C
    y.create.l PMIC_ARB_SPMI_GENI_FORCE_DEFAULT_REG	0xFC4CA010
    y.create.l PMIC_ARB_SPMI_GENI_OUTPUT_CTRL		0xFC4CA014
    y.create.l PMIC_ARB_SPMI_GENI_CGC_CTRL			0xFC4CA018
    y.create.l PMIC_ARB_SPMI_GENI_CHAR_CFG			0xFC4CA01C

;PMIC_ARB_SPMI_GENI_CHAR_DATA_n, n=[0..1]	0xFC4CA020+0X4*n

    y.create.l PMIC_ARB_SPMI_GENI_CTRL				0xFC4CA028
    y.create.l PMIC_ARB_SPMI_GENI_STATUS			0xFC4CA02C
    y.create.l PMIC_ARB_SPMI_GENI_TEST_BUS_CTRL		0xFC4CA030
    y.create.l PMIC_ARB_SPMI_GENI_SER_CLK_CFG		0xFC4CA034
    y.create.l PMIC_ARB_SPMI_GENI_TX_WATERMARK_REG	0xFC4CA038
    y.create.l PMIC_ARB_SPMI_GENI_RX_WATERMARK_REG	0xFC4CA03C
    y.create.l PMIC_ARB_SPMI_GENI_STOP_REG			0xFC4CA040
    y.create.l PMIC_ARB_SPMI_GENI_SW_COMP_REG		0xFC4CA044
    y.create.l PMIC_ARB_SPMI_GENI_PROG_ROM_CTRL_REG	0xFC4CA048

    y.create.l PMIC_ARB_SPMI_GENI_CFG_REG0			0xFC4CA100
    y.create.l PMIC_ARB_SPMI_GENI_CFG_REG1			0xFC4CA104
    y.create.l PMIC_ARB_SPMI_GENI_CFG_REG2			0xFC4CA108
    y.create.l PMIC_ARB_SPMI_GENI_CFG_REG3			0xFC4CA10C
    y.create.l PMIC_ARB_SPMI_GENI_CFG_REG4			0xFC4CA110
    y.create.l PMIC_ARB_SPMI_GENI_CFG_REG5			0xFC4CA114
    y.create.l PMIC_ARB_SPMI_GENI_CFG_REG6			0xFC4CA118
    y.create.l PMIC_ARB_SPMI_GENI_CFG_REG7			0xFC4CA11C
    y.create.l PMIC_ARB_SPMI_GENI_CFG_REG8			0xFC4CA120
    y.create.l PMIC_ARB_SPMI_GENI_CFG_REG9			0xFC4CA124
    y.create.l PMIC_ARB_SPMI_GENI_CFG_REG10			0xFC4CA128
    y.create.l PMIC_ARB_SPMI_GENI_CFG_REG11			0xFC4CA12C
    y.create.l PMIC_ARB_SPMI_GENI_CFG_REG12			0xFC4CA130
    y.create.l PMIC_ARB_SPMI_GENI_CFG_REG13			0xFC4CA134
    y.create.l PMIC_ARB_SPMI_GENI_CFG_REG14			0xFC4CA138
    y.create.l PMIC_ARB_SPMI_GENI_CFG_REG15			0xFC4CA13C
    y.create.l PMIC_ARB_SPMI_GENI_CFG_REG16			0xFC4CA140
    y.create.l PMIC_ARB_SPMI_GENI_CFG_REG17			0xFC4CA144
    y.create.l PMIC_ARB_SPMI_GENI_CFG_REG18			0xFC4CA148
    y.create.l PMIC_ARB_SPMI_GENI_CFG_REG19			0xFC4CA14C
    y.create.l PMIC_ARB_SPMI_GENI_CFG_REG20			0xFC4CA150
    y.create.l PMIC_ARB_SPMI_GENI_CFG_REG21			0xFC4CA154
    y.create.l PMIC_ARB_SPMI_GENI_CFG_REG22			0xFC4CA158
    y.create.l PMIC_ARB_SPMI_GENI_CFG_REG23			0xFC4CA15C
    y.create.l PMIC_ARB_SPMI_GENI_CFG_REG24			0xFC4CA160
    y.create.l PMIC_ARB_SPMI_GENI_CFG_REG25			0xFC4CA164
    y.create.l PMIC_ARB_SPMI_GENI_CFG_REG26			0xFC4CA168
    y.create.l PMIC_ARB_SPMI_GENI_CFG_REG27			0xFC4CA16C
    y.create.l PMIC_ARB_SPMI_GENI_CFG_REG28			0xFC4CA170
    y.create.l PMIC_ARB_SPMI_GENI_CFG_REG29			0xFC4CA174
    y.create.l PMIC_ARB_SPMI_GENI_CFG_REG30			0xFC4CA178

;PMIC_ARB_SPMI_GENI_CFG_RAM_n, n=[0..255]	0xFC4CA200+0X4*n
    y.create.l PMIC_ARB_SPMI_GENI_CFG_RAM0		0xFC4CA200
    y.create.l PMIC_ARB_SPMI_GENI_CFG_RAM1		0xFC4CA204
    y.create.l PMIC_ARB_SPMI_GENI_CFG_RAM2		0xFC4CA208
    y.create.l PMIC_ARB_SPMI_GENI_CFG_RAM3		0xFC4CA20C
    y.create.l PMIC_ARB_SPMI_GENI_CFG_RAM4		0xFC4CA210
    y.create.l PMIC_ARB_SPMI_GENI_CFG_RAM5		0xFC4CA214
    y.create.l PMIC_ARB_SPMI_GENI_CFG_RAM6		0xFC4CA218
    y.create.l PMIC_ARB_SPMI_GENI_CFG_RAM7		0xFC4CA21C
    y.create.l PMIC_ARB_SPMI_GENI_CFG_RAM8		0xFC4CA220
    y.create.l PMIC_ARB_SPMI_GENI_CFG_RAM9		0xFC4CA224
    y.create.l PMIC_ARB_SPMI_GENI_CFG_RAM10		0xFC4CA228
    y.create.l PMIC_ARB_SPMI_GENI_CFG_RAM11		0xFC4CA22C
    y.create.l PMIC_ARB_SPMI_GENI_CFG_RAM12		0xFC4CA230
    y.create.l PMIC_ARB_SPMI_GENI_CFG_RAM13		0xFC4CA234
    y.create.l PMIC_ARB_SPMI_GENI_CFG_RAM14		0xFC4CA238
    y.create.l PMIC_ARB_SPMI_GENI_CFG_RAM15		0xFC4CA23C
    y.create.l PMIC_ARB_SPMI_GENI_CFG_RAM16		0xFC4CA240
    y.create.l PMIC_ARB_SPMI_GENI_CFG_RAM17		0xFC4CA244
    y.create.l PMIC_ARB_SPMI_GENI_CFG_RAM18		0xFC4CA248
    y.create.l PMIC_ARB_SPMI_GENI_CFG_RAM19		0xFC4CA24C
    y.create.l PMIC_ARB_SPMI_GENI_CFG_RAM20		0xFC4CA250
    y.create.l PMIC_ARB_SPMI_GENI_CFG_RAM21		0xFC4CA254
    y.create.l PMIC_ARB_SPMI_GENI_CFG_RAM22		0xFC4CA258
    y.create.l PMIC_ARB_SPMI_GENI_CFG_RAM23		0xFC4CA25C
    y.create.l PMIC_ARB_SPMI_GENI_CFG_RAM24		0xFC4CA260
    y.create.l PMIC_ARB_SPMI_GENI_CFG_RAM25		0xFC4CA264
    y.create.l PMIC_ARB_SPMI_GENI_CFG_RAM26		0xFC4CA268
    y.create.l PMIC_ARB_SPMI_GENI_CFG_RAM27		0xFC4CA26C
    y.create.l PMIC_ARB_SPMI_GENI_CFG_RAM28		0xFC4CA270
    y.create.l PMIC_ARB_SPMI_GENI_CFG_RAM29		0xFC4CA274
    y.create.l PMIC_ARB_SPMI_GENI_CFG_RAM30		0xFC4CA278
    y.create.l PMIC_ARB_SPMI_GENI_CFG_RAM31		0xFC4CA27C
    y.create.l PMIC_ARB_SPMI_GENI_CFG_RAM32		0xFC4CA280
    y.create.l PMIC_ARB_SPMI_GENI_CFG_RAM33		0xFC4CA284
    y.create.l PMIC_ARB_SPMI_GENI_CFG_RAM34		0xFC4CA288
    y.create.l PMIC_ARB_SPMI_GENI_CFG_RAM35		0xFC4CA28C
    y.create.l PMIC_ARB_SPMI_GENI_CFG_RAM36		0xFC4CA290
    y.create.l PMIC_ARB_SPMI_GENI_CFG_RAM37		0xFC4CA294
    y.create.l PMIC_ARB_SPMI_GENI_CFG_RAM38		0xFC4CA298
    y.create.l PMIC_ARB_SPMI_GENI_CFG_RAM39		0xFC4CA29C
    y.create.l PMIC_ARB_SPMI_GENI_CFG_RAM40		0xFC4CA2A0
    y.create.l PMIC_ARB_SPMI_GENI_CFG_RAM41		0xFC4CA2A4
    y.create.l PMIC_ARB_SPMI_GENI_CFG_RAM42		0xFC4CA2A8
    y.create.l PMIC_ARB_SPMI_GENI_CFG_RAM43		0xFC4CA2AC
    y.create.l PMIC_ARB_SPMI_GENI_CFG_RAM44		0xFC4CA2B0
    y.create.l PMIC_ARB_SPMI_GENI_CFG_RAM45		0xFC4CA2B4
    y.create.l PMIC_ARB_SPMI_GENI_CFG_RAM46		0xFC4CA2B8
    y.create.l PMIC_ARB_SPMI_GENI_CFG_RAM47		0xFC4CA2BC
    y.create.l PMIC_ARB_SPMI_GENI_CFG_RAM48		0xFC4CA2C0
    y.create.l PMIC_ARB_SPMI_GENI_CFG_RAM49		0xFC4CA2C4
    y.create.l PMIC_ARB_SPMI_GENI_CFG_RAM50		0xFC4CA2C8
    y.create.l PMIC_ARB_SPMI_GENI_CFG_RAM51		0xFC4CA2CC
    y.create.l PMIC_ARB_SPMI_GENI_CFG_RAM52		0xFC4CA2D0
    y.create.l PMIC_ARB_SPMI_GENI_CFG_RAM53		0xFC4CA2D4
    y.create.l PMIC_ARB_SPMI_GENI_CFG_RAM54		0xFC4CA2D8
    y.create.l PMIC_ARB_SPMI_GENI_CFG_RAM55		0xFC4CA2DC
    y.create.l PMIC_ARB_SPMI_GENI_CFG_RAM56		0xFC4CA2E0
    y.create.l PMIC_ARB_SPMI_GENI_CFG_RAM57		0xFC4CA2E4
    y.create.l PMIC_ARB_SPMI_GENI_CFG_RAM58		0xFC4CA2E8
    y.create.l PMIC_ARB_SPMI_GENI_CFG_RAM59		0xFC4CA2EC
    y.create.l PMIC_ARB_SPMI_GENI_CFG_RAM60		0xFC4CA2F0
    y.create.l PMIC_ARB_SPMI_GENI_CFG_RAM61		0xFC4CA2F4
    y.create.l PMIC_ARB_SPMI_GENI_CFG_RAM62		0xFC4CA2F8
    y.create.l PMIC_ARB_SPMI_GENI_CFG_RAM63		0xFC4CA2FC
    y.create.l PMIC_ARB_SPMI_GENI_CFG_RAM64		0xFC4CA300
    y.create.l PMIC_ARB_SPMI_GENI_CFG_RAM65		0xFC4CA304
    y.create.l PMIC_ARB_SPMI_GENI_CFG_RAM66		0xFC4CA308
    y.create.l PMIC_ARB_SPMI_GENI_CFG_RAM67		0xFC4CA30C
    y.create.l PMIC_ARB_SPMI_GENI_CFG_RAM68		0xFC4CA310
    y.create.l PMIC_ARB_SPMI_GENI_CFG_RAM69		0xFC4CA314
    y.create.l PMIC_ARB_SPMI_GENI_CFG_RAM70		0xFC4CA318
    y.create.l PMIC_ARB_SPMI_GENI_CFG_RAM71		0xFC4CA31C
    y.create.l PMIC_ARB_SPMI_GENI_CFG_RAM72		0xFC4CA320
    y.create.l PMIC_ARB_SPMI_GENI_CFG_RAM73		0xFC4CA324
    y.create.l PMIC_ARB_SPMI_GENI_CFG_RAM74		0xFC4CA328
    y.create.l PMIC_ARB_SPMI_GENI_CFG_RAM75		0xFC4CA32C
    y.create.l PMIC_ARB_SPMI_GENI_CFG_RAM76		0xFC4CA330
    y.create.l PMIC_ARB_SPMI_GENI_CFG_RAM77		0xFC4CA334
    y.create.l PMIC_ARB_SPMI_GENI_CFG_RAM78		0xFC4CA338
    y.create.l PMIC_ARB_SPMI_GENI_CFG_RAM79		0xFC4CA33C
    y.create.l PMIC_ARB_SPMI_GENI_CFG_RAM80		0xFC4CA340
    y.create.l PMIC_ARB_SPMI_GENI_CFG_RAM81		0xFC4CA344
    y.create.l PMIC_ARB_SPMI_GENI_CFG_RAM82		0xFC4CA348
    y.create.l PMIC_ARB_SPMI_GENI_CFG_RAM83		0xFC4CA34C
    y.create.l PMIC_ARB_SPMI_GENI_CFG_RAM84		0xFC4CA350
    y.create.l PMIC_ARB_SPMI_GENI_CFG_RAM85		0xFC4CA354
    y.create.l PMIC_ARB_SPMI_GENI_CFG_RAM86		0xFC4CA358
    y.create.l PMIC_ARB_SPMI_GENI_CFG_RAM87		0xFC4CA35C
    y.create.l PMIC_ARB_SPMI_GENI_CFG_RAM88		0xFC4CA360
    y.create.l PMIC_ARB_SPMI_GENI_CFG_RAM89		0xFC4CA364
    y.create.l PMIC_ARB_SPMI_GENI_CFG_RAM90		0xFC4CA368
    y.create.l PMIC_ARB_SPMI_GENI_CFG_RAM91		0xFC4CA36C
    y.create.l PMIC_ARB_SPMI_GENI_CFG_RAM92		0xFC4CA370
    y.create.l PMIC_ARB_SPMI_GENI_CFG_RAM93		0xFC4CA374
    y.create.l PMIC_ARB_SPMI_GENI_CFG_RAM94		0xFC4CA378
    y.create.l PMIC_ARB_SPMI_GENI_CFG_RAM95		0xFC4CA37C
    y.create.l PMIC_ARB_SPMI_GENI_CFG_RAM96		0xFC4CA380
    y.create.l PMIC_ARB_SPMI_GENI_CFG_RAM97		0xFC4CA384
    y.create.l PMIC_ARB_SPMI_GENI_CFG_RAM98		0xFC4CA388
    y.create.l PMIC_ARB_SPMI_GENI_CFG_RAM99		0xFC4CA38C
    y.create.l PMIC_ARB_SPMI_GENI_CFG_RAM100	0xFC4CA390
    y.create.l PMIC_ARB_SPMI_GENI_CFG_RAM101	0xFC4CA394
    y.create.l PMIC_ARB_SPMI_GENI_CFG_RAM102	0xFC4CA398
    y.create.l PMIC_ARB_SPMI_GENI_CFG_RAM103	0xFC4CA39C
    y.create.l PMIC_ARB_SPMI_GENI_CFG_RAM104	0xFC4CA3A0
    y.create.l PMIC_ARB_SPMI_GENI_CFG_RAM105	0xFC4CA3A4
    y.create.l PMIC_ARB_SPMI_GENI_CFG_RAM106	0xFC4CA3A8
    y.create.l PMIC_ARB_SPMI_GENI_CFG_RAM107	0xFC4CA3AC
    y.create.l PMIC_ARB_SPMI_GENI_CFG_RAM108	0xFC4CA3B0
    y.create.l PMIC_ARB_SPMI_GENI_CFG_RAM109	0xFC4CA3B4
    y.create.l PMIC_ARB_SPMI_GENI_CFG_RAM110	0xFC4CA3B8
    y.create.l PMIC_ARB_SPMI_GENI_CFG_RAM111	0xFC4CA3BC
    y.create.l PMIC_ARB_SPMI_GENI_CFG_RAM112	0xFC4CA3C0
    y.create.l PMIC_ARB_SPMI_GENI_CFG_RAM113	0xFC4CA3C4
    y.create.l PMIC_ARB_SPMI_GENI_CFG_RAM114	0xFC4CA3C8
    y.create.l PMIC_ARB_SPMI_GENI_CFG_RAM115	0xFC4CA3CC
    y.create.l PMIC_ARB_SPMI_GENI_CFG_RAM116	0xFC4CA3D0
    y.create.l PMIC_ARB_SPMI_GENI_CFG_RAM117	0xFC4CA3D4
    y.create.l PMIC_ARB_SPMI_GENI_CFG_RAM118	0xFC4CA3D8
    y.create.l PMIC_ARB_SPMI_GENI_CFG_RAM119	0xFC4CA3DC
    y.create.l PMIC_ARB_SPMI_GENI_CFG_RAM120	0xFC4CA3E0
    y.create.l PMIC_ARB_SPMI_GENI_CFG_RAM121	0xFC4CA3E4
    y.create.l PMIC_ARB_SPMI_GENI_CFG_RAM122	0xFC4CA3E8
    y.create.l PMIC_ARB_SPMI_GENI_CFG_RAM123	0xFC4CA3EC
    y.create.l PMIC_ARB_SPMI_GENI_CFG_RAM124	0xFC4CA3F0
    y.create.l PMIC_ARB_SPMI_GENI_CFG_RAM125	0xFC4CA3F4
    y.create.l PMIC_ARB_SPMI_GENI_CFG_RAM126	0xFC4CA3F8
    y.create.l PMIC_ARB_SPMI_GENI_CFG_RAM127	0xFC4CA3FC
    y.create.l PMIC_ARB_SPMI_GENI_CFG_RAM128	0xFC4CA400
    y.create.l PMIC_ARB_SPMI_GENI_CFG_RAM129	0xFC4CA404
    y.create.l PMIC_ARB_SPMI_GENI_CFG_RAM130	0xFC4CA408
    y.create.l PMIC_ARB_SPMI_GENI_CFG_RAM131	0xFC4CA40C
    y.create.l PMIC_ARB_SPMI_GENI_CFG_RAM132	0xFC4CA410
    y.create.l PMIC_ARB_SPMI_GENI_CFG_RAM133	0xFC4CA414
    y.create.l PMIC_ARB_SPMI_GENI_CFG_RAM134	0xFC4CA418
    y.create.l PMIC_ARB_SPMI_GENI_CFG_RAM135	0xFC4CA41C
    y.create.l PMIC_ARB_SPMI_GENI_CFG_RAM136	0xFC4CA420
    y.create.l PMIC_ARB_SPMI_GENI_CFG_RAM137	0xFC4CA424
    y.create.l PMIC_ARB_SPMI_GENI_CFG_RAM138	0xFC4CA428
    y.create.l PMIC_ARB_SPMI_GENI_CFG_RAM139	0xFC4CA42C
    y.create.l PMIC_ARB_SPMI_GENI_CFG_RAM140	0xFC4CA430
    y.create.l PMIC_ARB_SPMI_GENI_CFG_RAM141	0xFC4CA434
    y.create.l PMIC_ARB_SPMI_GENI_CFG_RAM142	0xFC4CA438
    y.create.l PMIC_ARB_SPMI_GENI_CFG_RAM143	0xFC4CA43C
    y.create.l PMIC_ARB_SPMI_GENI_CFG_RAM144	0xFC4CA440
    y.create.l PMIC_ARB_SPMI_GENI_CFG_RAM145	0xFC4CA444
    y.create.l PMIC_ARB_SPMI_GENI_CFG_RAM146	0xFC4CA448
    y.create.l PMIC_ARB_SPMI_GENI_CFG_RAM147	0xFC4CA44C
    y.create.l PMIC_ARB_SPMI_GENI_CFG_RAM148	0xFC4CA450
    y.create.l PMIC_ARB_SPMI_GENI_CFG_RAM149	0xFC4CA454
    y.create.l PMIC_ARB_SPMI_GENI_CFG_RAM150	0xFC4CA458
    y.create.l PMIC_ARB_SPMI_GENI_CFG_RAM151	0xFC4CA45C
    y.create.l PMIC_ARB_SPMI_GENI_CFG_RAM152	0xFC4CA460
    y.create.l PMIC_ARB_SPMI_GENI_CFG_RAM153	0xFC4CA464
    y.create.l PMIC_ARB_SPMI_GENI_CFG_RAM154	0xFC4CA468
    y.create.l PMIC_ARB_SPMI_GENI_CFG_RAM155	0xFC4CA46C
    y.create.l PMIC_ARB_SPMI_GENI_CFG_RAM156	0xFC4CA470
    y.create.l PMIC_ARB_SPMI_GENI_CFG_RAM157	0xFC4CA474
    y.create.l PMIC_ARB_SPMI_GENI_CFG_RAM158	0xFC4CA478
    y.create.l PMIC_ARB_SPMI_GENI_CFG_RAM159	0xFC4CA47C
    y.create.l PMIC_ARB_SPMI_GENI_CFG_RAM160	0xFC4CA480
    y.create.l PMIC_ARB_SPMI_GENI_CFG_RAM161	0xFC4CA484
    y.create.l PMIC_ARB_SPMI_GENI_CFG_RAM162	0xFC4CA488
    y.create.l PMIC_ARB_SPMI_GENI_CFG_RAM163	0xFC4CA48C
    y.create.l PMIC_ARB_SPMI_GENI_CFG_RAM164	0xFC4CA490
    y.create.l PMIC_ARB_SPMI_GENI_CFG_RAM165	0xFC4CA494
    y.create.l PMIC_ARB_SPMI_GENI_CFG_RAM166	0xFC4CA498
    y.create.l PMIC_ARB_SPMI_GENI_CFG_RAM167	0xFC4CA49C
    y.create.l PMIC_ARB_SPMI_GENI_CFG_RAM168	0xFC4CA4A0
    y.create.l PMIC_ARB_SPMI_GENI_CFG_RAM169	0xFC4CA4A4
    y.create.l PMIC_ARB_SPMI_GENI_CFG_RAM170	0xFC4CA4A8
    y.create.l PMIC_ARB_SPMI_GENI_CFG_RAM171	0xFC4CA4AC
    y.create.l PMIC_ARB_SPMI_GENI_CFG_RAM172	0xFC4CA4B0
    y.create.l PMIC_ARB_SPMI_GENI_CFG_RAM173	0xFC4CA4B4
    y.create.l PMIC_ARB_SPMI_GENI_CFG_RAM174	0xFC4CA4B8
    y.create.l PMIC_ARB_SPMI_GENI_CFG_RAM175	0xFC4CA4BC
    y.create.l PMIC_ARB_SPMI_GENI_CFG_RAM176	0xFC4CA4C0
    y.create.l PMIC_ARB_SPMI_GENI_CFG_RAM177	0xFC4CA4C4
    y.create.l PMIC_ARB_SPMI_GENI_CFG_RAM178	0xFC4CA4C8
    y.create.l PMIC_ARB_SPMI_GENI_CFG_RAM179	0xFC4CA4CC
    y.create.l PMIC_ARB_SPMI_GENI_CFG_RAM180	0xFC4CA4D0
    y.create.l PMIC_ARB_SPMI_GENI_CFG_RAM181	0xFC4CA4D4
    y.create.l PMIC_ARB_SPMI_GENI_CFG_RAM182	0xFC4CA4D8
    y.create.l PMIC_ARB_SPMI_GENI_CFG_RAM183	0xFC4CA4DC
    y.create.l PMIC_ARB_SPMI_GENI_CFG_RAM184	0xFC4CA4E0
    y.create.l PMIC_ARB_SPMI_GENI_CFG_RAM185	0xFC4CA4E4
    y.create.l PMIC_ARB_SPMI_GENI_CFG_RAM186	0xFC4CA4E8
    y.create.l PMIC_ARB_SPMI_GENI_CFG_RAM187	0xFC4CA4EC
    y.create.l PMIC_ARB_SPMI_GENI_CFG_RAM188	0xFC4CA4F0
    y.create.l PMIC_ARB_SPMI_GENI_CFG_RAM189	0xFC4CA4F4
    y.create.l PMIC_ARB_SPMI_GENI_CFG_RAM190	0xFC4CA4F8
    y.create.l PMIC_ARB_SPMI_GENI_CFG_RAM191	0xFC4CA4FC
    y.create.l PMIC_ARB_SPMI_GENI_CFG_RAM192	0xFC4CA500
    y.create.l PMIC_ARB_SPMI_GENI_CFG_RAM193	0xFC4CA504
    y.create.l PMIC_ARB_SPMI_GENI_CFG_RAM194	0xFC4CA508
    y.create.l PMIC_ARB_SPMI_GENI_CFG_RAM195	0xFC4CA50C
    y.create.l PMIC_ARB_SPMI_GENI_CFG_RAM196	0xFC4CA510
    y.create.l PMIC_ARB_SPMI_GENI_CFG_RAM197	0xFC4CA514
    y.create.l PMIC_ARB_SPMI_GENI_CFG_RAM198	0xFC4CA518
    y.create.l PMIC_ARB_SPMI_GENI_CFG_RAM199	0xFC4CA51C
    y.create.l PMIC_ARB_SPMI_GENI_CFG_RAM200	0xFC4CA520
    y.create.l PMIC_ARB_SPMI_GENI_CFG_RAM201	0xFC4CA524
    y.create.l PMIC_ARB_SPMI_GENI_CFG_RAM202	0xFC4CA528
    y.create.l PMIC_ARB_SPMI_GENI_CFG_RAM203	0xFC4CA52C
    y.create.l PMIC_ARB_SPMI_GENI_CFG_RAM204	0xFC4CA530
    y.create.l PMIC_ARB_SPMI_GENI_CFG_RAM205	0xFC4CA534
    y.create.l PMIC_ARB_SPMI_GENI_CFG_RAM206	0xFC4CA538
    y.create.l PMIC_ARB_SPMI_GENI_CFG_RAM207	0xFC4CA53C
    y.create.l PMIC_ARB_SPMI_GENI_CFG_RAM208	0xFC4CA540
    y.create.l PMIC_ARB_SPMI_GENI_CFG_RAM209	0xFC4CA544
    y.create.l PMIC_ARB_SPMI_GENI_CFG_RAM210	0xFC4CA548
    y.create.l PMIC_ARB_SPMI_GENI_CFG_RAM211	0xFC4CA54C
    y.create.l PMIC_ARB_SPMI_GENI_CFG_RAM212	0xFC4CA550
    y.create.l PMIC_ARB_SPMI_GENI_CFG_RAM213	0xFC4CA554
    y.create.l PMIC_ARB_SPMI_GENI_CFG_RAM214	0xFC4CA558
    y.create.l PMIC_ARB_SPMI_GENI_CFG_RAM215	0xFC4CA55C
    y.create.l PMIC_ARB_SPMI_GENI_CFG_RAM216	0xFC4CA560
    y.create.l PMIC_ARB_SPMI_GENI_CFG_RAM217	0xFC4CA564
    y.create.l PMIC_ARB_SPMI_GENI_CFG_RAM218	0xFC4CA568
    y.create.l PMIC_ARB_SPMI_GENI_CFG_RAM219	0xFC4CA56C
    y.create.l PMIC_ARB_SPMI_GENI_CFG_RAM220	0xFC4CA570
    y.create.l PMIC_ARB_SPMI_GENI_CFG_RAM221	0xFC4CA574
    y.create.l PMIC_ARB_SPMI_GENI_CFG_RAM222	0xFC4CA578
    y.create.l PMIC_ARB_SPMI_GENI_CFG_RAM223	0xFC4CA57C
    y.create.l PMIC_ARB_SPMI_GENI_CFG_RAM224	0xFC4CA580
    y.create.l PMIC_ARB_SPMI_GENI_CFG_RAM225	0xFC4CA584
    y.create.l PMIC_ARB_SPMI_GENI_CFG_RAM226	0xFC4CA588
    y.create.l PMIC_ARB_SPMI_GENI_CFG_RAM227	0xFC4CA58C
    y.create.l PMIC_ARB_SPMI_GENI_CFG_RAM228	0xFC4CA590
    y.create.l PMIC_ARB_SPMI_GENI_CFG_RAM229	0xFC4CA594
    y.create.l PMIC_ARB_SPMI_GENI_CFG_RAM230	0xFC4CA598
    y.create.l PMIC_ARB_SPMI_GENI_CFG_RAM231	0xFC4CA59C
    y.create.l PMIC_ARB_SPMI_GENI_CFG_RAM232	0xFC4CA5A0
    y.create.l PMIC_ARB_SPMI_GENI_CFG_RAM233	0xFC4CA5A4
    y.create.l PMIC_ARB_SPMI_GENI_CFG_RAM234	0xFC4CA5A8
    y.create.l PMIC_ARB_SPMI_GENI_CFG_RAM235	0xFC4CA5AC
    y.create.l PMIC_ARB_SPMI_GENI_CFG_RAM236	0xFC4CA5B0
    y.create.l PMIC_ARB_SPMI_GENI_CFG_RAM237	0xFC4CA5B4
    y.create.l PMIC_ARB_SPMI_GENI_CFG_RAM238	0xFC4CA5B8
    y.create.l PMIC_ARB_SPMI_GENI_CFG_RAM239	0xFC4CA5BC
    y.create.l PMIC_ARB_SPMI_GENI_CFG_RAM240	0xFC4CA5C0
    y.create.l PMIC_ARB_SPMI_GENI_CFG_RAM241	0xFC4CA5C4
    y.create.l PMIC_ARB_SPMI_GENI_CFG_RAM242	0xFC4CA5C8
    y.create.l PMIC_ARB_SPMI_GENI_CFG_RAM243	0xFC4CA5CC
    y.create.l PMIC_ARB_SPMI_GENI_CFG_RAM244	0xFC4CA5D0
    y.create.l PMIC_ARB_SPMI_GENI_CFG_RAM245	0xFC4CA5D4
    y.create.l PMIC_ARB_SPMI_GENI_CFG_RAM246	0xFC4CA5D8
    y.create.l PMIC_ARB_SPMI_GENI_CFG_RAM247	0xFC4CA5DC
    y.create.l PMIC_ARB_SPMI_GENI_CFG_RAM248	0xFC4CA5E0
    y.create.l PMIC_ARB_SPMI_GENI_CFG_RAM249	0xFC4CA5E4
    y.create.l PMIC_ARB_SPMI_GENI_CFG_RAM250	0xFC4CA5E8
    y.create.l PMIC_ARB_SPMI_GENI_CFG_RAM251	0xFC4CA5EC
    y.create.l PMIC_ARB_SPMI_GENI_CFG_RAM252	0xFC4CA5F0
    y.create.l PMIC_ARB_SPMI_GENI_CFG_RAM253	0xFC4CA5F4
    y.create.l PMIC_ARB_SPMI_GENI_CFG_RAM254	0xFC4CA5F8
    y.create.l PMIC_ARB_SPMI_GENI_CFG_RAM255	0xFC4CA5FC

    y.create.l PMIC_ARB_SPMI_MID_REG 0xFC4CAF00 
    y.create.l PMIC_ARB_SPMI_CFG_REG 0xFC4CAF04     
		
;PMIC_ARB_SPMI_MAPPING_TABLE_REG_k, k=[0..254] 0xFC4CAB00+0X4*k
    y.create.l PMIC_ARB_SPMI_MAPPING_TABLE_REG0		0xFC4CAB00
    y.create.l PMIC_ARB_SPMI_MAPPING_TABLE_REG1		0xFC4CAB04
    y.create.l PMIC_ARB_SPMI_MAPPING_TABLE_REG2		0xFC4CAB08
    y.create.l PMIC_ARB_SPMI_MAPPING_TABLE_REG3		0xFC4CAB0C
    y.create.l PMIC_ARB_SPMI_MAPPING_TABLE_REG4		0xFC4CAB10
    y.create.l PMIC_ARB_SPMI_MAPPING_TABLE_REG5		0xFC4CAB14
    y.create.l PMIC_ARB_SPMI_MAPPING_TABLE_REG6		0xFC4CAB18
    y.create.l PMIC_ARB_SPMI_MAPPING_TABLE_REG7		0xFC4CAB1C
    y.create.l PMIC_ARB_SPMI_MAPPING_TABLE_REG8		0xFC4CAB20
    y.create.l PMIC_ARB_SPMI_MAPPING_TABLE_REG9		0xFC4CAB24
    y.create.l PMIC_ARB_SPMI_MAPPING_TABLE_REG10		0xFC4CAB28
    y.create.l PMIC_ARB_SPMI_MAPPING_TABLE_REG11		0xFC4CAB2C
    y.create.l PMIC_ARB_SPMI_MAPPING_TABLE_REG12		0xFC4CAB30
    y.create.l PMIC_ARB_SPMI_MAPPING_TABLE_REG13		0xFC4CAB34
    y.create.l PMIC_ARB_SPMI_MAPPING_TABLE_REG14		0xFC4CAB38
    y.create.l PMIC_ARB_SPMI_MAPPING_TABLE_REG15		0xFC4CAB3C
    y.create.l PMIC_ARB_SPMI_MAPPING_TABLE_REG16		0xFC4CAB40
    y.create.l PMIC_ARB_SPMI_MAPPING_TABLE_REG17		0xFC4CAB44
    y.create.l PMIC_ARB_SPMI_MAPPING_TABLE_REG18		0xFC4CAB48
    y.create.l PMIC_ARB_SPMI_MAPPING_TABLE_REG19		0xFC4CAB4C
    y.create.l PMIC_ARB_SPMI_MAPPING_TABLE_REG20		0xFC4CAB50
    y.create.l PMIC_ARB_SPMI_MAPPING_TABLE_REG21		0xFC4CAB54
    y.create.l PMIC_ARB_SPMI_MAPPING_TABLE_REG22		0xFC4CAB58
    y.create.l PMIC_ARB_SPMI_MAPPING_TABLE_REG23		0xFC4CAB5C
    y.create.l PMIC_ARB_SPMI_MAPPING_TABLE_REG24		0xFC4CAB60
    y.create.l PMIC_ARB_SPMI_MAPPING_TABLE_REG25		0xFC4CAB64
    y.create.l PMIC_ARB_SPMI_MAPPING_TABLE_REG26		0xFC4CAB68
    y.create.l PMIC_ARB_SPMI_MAPPING_TABLE_REG27		0xFC4CAB6C
    y.create.l PMIC_ARB_SPMI_MAPPING_TABLE_REG28		0xFC4CAB70
    y.create.l PMIC_ARB_SPMI_MAPPING_TABLE_REG29		0xFC4CAB74
    y.create.l PMIC_ARB_SPMI_MAPPING_TABLE_REG30		0xFC4CAB78
    y.create.l PMIC_ARB_SPMI_MAPPING_TABLE_REG31		0xFC4CAB7C
    y.create.l PMIC_ARB_SPMI_MAPPING_TABLE_REG32		0xFC4CAB80
    y.create.l PMIC_ARB_SPMI_MAPPING_TABLE_REG33		0xFC4CAB84
    y.create.l PMIC_ARB_SPMI_MAPPING_TABLE_REG34		0xFC4CAB88
    y.create.l PMIC_ARB_SPMI_MAPPING_TABLE_REG35		0xFC4CAB8C
    y.create.l PMIC_ARB_SPMI_MAPPING_TABLE_REG36		0xFC4CAB90
    y.create.l PMIC_ARB_SPMI_MAPPING_TABLE_REG37		0xFC4CAB94
    y.create.l PMIC_ARB_SPMI_MAPPING_TABLE_REG38		0xFC4CAB98
    y.create.l PMIC_ARB_SPMI_MAPPING_TABLE_REG39		0xFC4CAB9C
    y.create.l PMIC_ARB_SPMI_MAPPING_TABLE_REG40		0xFC4CABA0
    y.create.l PMIC_ARB_SPMI_MAPPING_TABLE_REG41		0xFC4CABA4
    y.create.l PMIC_ARB_SPMI_MAPPING_TABLE_REG42		0xFC4CABA8
    y.create.l PMIC_ARB_SPMI_MAPPING_TABLE_REG43		0xFC4CABAC
    y.create.l PMIC_ARB_SPMI_MAPPING_TABLE_REG44		0xFC4CABB0
    y.create.l PMIC_ARB_SPMI_MAPPING_TABLE_REG45		0xFC4CABB4
    y.create.l PMIC_ARB_SPMI_MAPPING_TABLE_REG46		0xFC4CABB8
    y.create.l PMIC_ARB_SPMI_MAPPING_TABLE_REG47		0xFC4CABBC
    y.create.l PMIC_ARB_SPMI_MAPPING_TABLE_REG48		0xFC4CABC0
    y.create.l PMIC_ARB_SPMI_MAPPING_TABLE_REG49		0xFC4CABC4
    y.create.l PMIC_ARB_SPMI_MAPPING_TABLE_REG50		0xFC4CABC8
    y.create.l PMIC_ARB_SPMI_MAPPING_TABLE_REG51		0xFC4CABCC
    y.create.l PMIC_ARB_SPMI_MAPPING_TABLE_REG52		0xFC4CABD0
    y.create.l PMIC_ARB_SPMI_MAPPING_TABLE_REG53		0xFC4CABD4
    y.create.l PMIC_ARB_SPMI_MAPPING_TABLE_REG54		0xFC4CABD8
    y.create.l PMIC_ARB_SPMI_MAPPING_TABLE_REG55		0xFC4CABDC
    y.create.l PMIC_ARB_SPMI_MAPPING_TABLE_REG56		0xFC4CABE0
    y.create.l PMIC_ARB_SPMI_MAPPING_TABLE_REG57		0xFC4CABE4
    y.create.l PMIC_ARB_SPMI_MAPPING_TABLE_REG58		0xFC4CABE8
    y.create.l PMIC_ARB_SPMI_MAPPING_TABLE_REG59		0xFC4CABEC
    y.create.l PMIC_ARB_SPMI_MAPPING_TABLE_REG60		0xFC4CABF0
    y.create.l PMIC_ARB_SPMI_MAPPING_TABLE_REG61		0xFC4CABF4
    y.create.l PMIC_ARB_SPMI_MAPPING_TABLE_REG62		0xFC4CABF8
    y.create.l PMIC_ARB_SPMI_MAPPING_TABLE_REG63		0xFC4CABFC
    y.create.l PMIC_ARB_SPMI_MAPPING_TABLE_REG64		0xFC4CAC00
    y.create.l PMIC_ARB_SPMI_MAPPING_TABLE_REG65		0xFC4CAC04
    y.create.l PMIC_ARB_SPMI_MAPPING_TABLE_REG66		0xFC4CAC08
    y.create.l PMIC_ARB_SPMI_MAPPING_TABLE_REG67		0xFC4CAC0C
    y.create.l PMIC_ARB_SPMI_MAPPING_TABLE_REG68		0xFC4CAC10
    y.create.l PMIC_ARB_SPMI_MAPPING_TABLE_REG69		0xFC4CAC14
    y.create.l PMIC_ARB_SPMI_MAPPING_TABLE_REG70		0xFC4CAC18
    y.create.l PMIC_ARB_SPMI_MAPPING_TABLE_REG71		0xFC4CAC1C
    y.create.l PMIC_ARB_SPMI_MAPPING_TABLE_REG72		0xFC4CAC20
    y.create.l PMIC_ARB_SPMI_MAPPING_TABLE_REG73		0xFC4CAC24
    y.create.l PMIC_ARB_SPMI_MAPPING_TABLE_REG74		0xFC4CAC28
    y.create.l PMIC_ARB_SPMI_MAPPING_TABLE_REG75		0xFC4CAC2C
    y.create.l PMIC_ARB_SPMI_MAPPING_TABLE_REG76		0xFC4CAC30
    y.create.l PMIC_ARB_SPMI_MAPPING_TABLE_REG77		0xFC4CAC34
    y.create.l PMIC_ARB_SPMI_MAPPING_TABLE_REG78		0xFC4CAC38
    y.create.l PMIC_ARB_SPMI_MAPPING_TABLE_REG79		0xFC4CAC3C
    y.create.l PMIC_ARB_SPMI_MAPPING_TABLE_REG80		0xFC4CAC40
    y.create.l PMIC_ARB_SPMI_MAPPING_TABLE_REG81		0xFC4CAC44
    y.create.l PMIC_ARB_SPMI_MAPPING_TABLE_REG82		0xFC4CAC48
    y.create.l PMIC_ARB_SPMI_MAPPING_TABLE_REG83		0xFC4CAC4C
    y.create.l PMIC_ARB_SPMI_MAPPING_TABLE_REG84		0xFC4CAC50
    y.create.l PMIC_ARB_SPMI_MAPPING_TABLE_REG85		0xFC4CAC54
    y.create.l PMIC_ARB_SPMI_MAPPING_TABLE_REG86		0xFC4CAC58
    y.create.l PMIC_ARB_SPMI_MAPPING_TABLE_REG87		0xFC4CAC5C
    y.create.l PMIC_ARB_SPMI_MAPPING_TABLE_REG88		0xFC4CAC60
    y.create.l PMIC_ARB_SPMI_MAPPING_TABLE_REG89		0xFC4CAC64
    y.create.l PMIC_ARB_SPMI_MAPPING_TABLE_REG90		0xFC4CAC68
    y.create.l PMIC_ARB_SPMI_MAPPING_TABLE_REG91		0xFC4CAC6C
    y.create.l PMIC_ARB_SPMI_MAPPING_TABLE_REG92		0xFC4CAC70
    y.create.l PMIC_ARB_SPMI_MAPPING_TABLE_REG93		0xFC4CAC74
    y.create.l PMIC_ARB_SPMI_MAPPING_TABLE_REG94		0xFC4CAC78
    y.create.l PMIC_ARB_SPMI_MAPPING_TABLE_REG95		0xFC4CAC7C
    y.create.l PMIC_ARB_SPMI_MAPPING_TABLE_REG96		0xFC4CAC80
    y.create.l PMIC_ARB_SPMI_MAPPING_TABLE_REG97		0xFC4CAC84
    y.create.l PMIC_ARB_SPMI_MAPPING_TABLE_REG98		0xFC4CAC88
    y.create.l PMIC_ARB_SPMI_MAPPING_TABLE_REG99		0xFC4CAC8C
    y.create.l PMIC_ARB_SPMI_MAPPING_TABLE_REG100		0xFC4CAC90
    y.create.l PMIC_ARB_SPMI_MAPPING_TABLE_REG101		0xFC4CAC94
    y.create.l PMIC_ARB_SPMI_MAPPING_TABLE_REG102		0xFC4CAC98
    y.create.l PMIC_ARB_SPMI_MAPPING_TABLE_REG103		0xFC4CAC9C
    y.create.l PMIC_ARB_SPMI_MAPPING_TABLE_REG104		0xFC4CACA0
    y.create.l PMIC_ARB_SPMI_MAPPING_TABLE_REG105		0xFC4CACA4
    y.create.l PMIC_ARB_SPMI_MAPPING_TABLE_REG106		0xFC4CACA8
    y.create.l PMIC_ARB_SPMI_MAPPING_TABLE_REG107		0xFC4CACAC
    y.create.l PMIC_ARB_SPMI_MAPPING_TABLE_REG108		0xFC4CACB0
    y.create.l PMIC_ARB_SPMI_MAPPING_TABLE_REG109		0xFC4CACB4
    y.create.l PMIC_ARB_SPMI_MAPPING_TABLE_REG110		0xFC4CACB8
    y.create.l PMIC_ARB_SPMI_MAPPING_TABLE_REG111		0xFC4CACBC
    y.create.l PMIC_ARB_SPMI_MAPPING_TABLE_REG112		0xFC4CACC0
    y.create.l PMIC_ARB_SPMI_MAPPING_TABLE_REG113		0xFC4CACC4
    y.create.l PMIC_ARB_SPMI_MAPPING_TABLE_REG114		0xFC4CACC8
    y.create.l PMIC_ARB_SPMI_MAPPING_TABLE_REG115		0xFC4CACCC
    y.create.l PMIC_ARB_SPMI_MAPPING_TABLE_REG116		0xFC4CACD0
    y.create.l PMIC_ARB_SPMI_MAPPING_TABLE_REG117		0xFC4CACD4
    y.create.l PMIC_ARB_SPMI_MAPPING_TABLE_REG118		0xFC4CACD8
    y.create.l PMIC_ARB_SPMI_MAPPING_TABLE_REG119		0xFC4CACDC
    y.create.l PMIC_ARB_SPMI_MAPPING_TABLE_REG120		0xFC4CACE0
    y.create.l PMIC_ARB_SPMI_MAPPING_TABLE_REG121		0xFC4CACE4
    y.create.l PMIC_ARB_SPMI_MAPPING_TABLE_REG122		0xFC4CACE8
    y.create.l PMIC_ARB_SPMI_MAPPING_TABLE_REG123		0xFC4CACEC
    y.create.l PMIC_ARB_SPMI_MAPPING_TABLE_REG124		0xFC4CACF0
    y.create.l PMIC_ARB_SPMI_MAPPING_TABLE_REG125		0xFC4CACF4
    y.create.l PMIC_ARB_SPMI_MAPPING_TABLE_REG126		0xFC4CACF8
    y.create.l PMIC_ARB_SPMI_MAPPING_TABLE_REG127		0xFC4CACFC
    y.create.l PMIC_ARB_SPMI_MAPPING_TABLE_REG128		0xFC4CAD00
    y.create.l PMIC_ARB_SPMI_MAPPING_TABLE_REG129		0xFC4CAD04
    y.create.l PMIC_ARB_SPMI_MAPPING_TABLE_REG130		0xFC4CAD08
    y.create.l PMIC_ARB_SPMI_MAPPING_TABLE_REG131		0xFC4CAD0C
    y.create.l PMIC_ARB_SPMI_MAPPING_TABLE_REG132		0xFC4CAD10
    y.create.l PMIC_ARB_SPMI_MAPPING_TABLE_REG133		0xFC4CAD14
    y.create.l PMIC_ARB_SPMI_MAPPING_TABLE_REG134		0xFC4CAD18
    y.create.l PMIC_ARB_SPMI_MAPPING_TABLE_REG135		0xFC4CAD1C
    y.create.l PMIC_ARB_SPMI_MAPPING_TABLE_REG136		0xFC4CAD20
    y.create.l PMIC_ARB_SPMI_MAPPING_TABLE_REG137		0xFC4CAD24
    y.create.l PMIC_ARB_SPMI_MAPPING_TABLE_REG138		0xFC4CAD28
    y.create.l PMIC_ARB_SPMI_MAPPING_TABLE_REG139		0xFC4CAD2C
    y.create.l PMIC_ARB_SPMI_MAPPING_TABLE_REG140		0xFC4CAD30
    y.create.l PMIC_ARB_SPMI_MAPPING_TABLE_REG141		0xFC4CAD34
    y.create.l PMIC_ARB_SPMI_MAPPING_TABLE_REG142		0xFC4CAD38
    y.create.l PMIC_ARB_SPMI_MAPPING_TABLE_REG143		0xFC4CAD3C
    y.create.l PMIC_ARB_SPMI_MAPPING_TABLE_REG144		0xFC4CAD40
    y.create.l PMIC_ARB_SPMI_MAPPING_TABLE_REG145		0xFC4CAD44
    y.create.l PMIC_ARB_SPMI_MAPPING_TABLE_REG146		0xFC4CAD48
    y.create.l PMIC_ARB_SPMI_MAPPING_TABLE_REG147		0xFC4CAD4C
    y.create.l PMIC_ARB_SPMI_MAPPING_TABLE_REG148		0xFC4CAD50
    y.create.l PMIC_ARB_SPMI_MAPPING_TABLE_REG149		0xFC4CAD54
    y.create.l PMIC_ARB_SPMI_MAPPING_TABLE_REG150		0xFC4CAD58
    y.create.l PMIC_ARB_SPMI_MAPPING_TABLE_REG151		0xFC4CAD5C
    y.create.l PMIC_ARB_SPMI_MAPPING_TABLE_REG152		0xFC4CAD60
    y.create.l PMIC_ARB_SPMI_MAPPING_TABLE_REG153		0xFC4CAD64
    y.create.l PMIC_ARB_SPMI_MAPPING_TABLE_REG154		0xFC4CAD68
    y.create.l PMIC_ARB_SPMI_MAPPING_TABLE_REG155		0xFC4CAD6C
    y.create.l PMIC_ARB_SPMI_MAPPING_TABLE_REG156		0xFC4CAD70
    y.create.l PMIC_ARB_SPMI_MAPPING_TABLE_REG157		0xFC4CAD74
    y.create.l PMIC_ARB_SPMI_MAPPING_TABLE_REG158		0xFC4CAD78
    y.create.l PMIC_ARB_SPMI_MAPPING_TABLE_REG159		0xFC4CAD7C
    y.create.l PMIC_ARB_SPMI_MAPPING_TABLE_REG160		0xFC4CAD80
    y.create.l PMIC_ARB_SPMI_MAPPING_TABLE_REG161		0xFC4CAD84
    y.create.l PMIC_ARB_SPMI_MAPPING_TABLE_REG162		0xFC4CAD88
    y.create.l PMIC_ARB_SPMI_MAPPING_TABLE_REG163		0xFC4CAD8C
    y.create.l PMIC_ARB_SPMI_MAPPING_TABLE_REG164		0xFC4CAD90
    y.create.l PMIC_ARB_SPMI_MAPPING_TABLE_REG165		0xFC4CAD94
    y.create.l PMIC_ARB_SPMI_MAPPING_TABLE_REG166		0xFC4CAD98
    y.create.l PMIC_ARB_SPMI_MAPPING_TABLE_REG167		0xFC4CAD9C
    y.create.l PMIC_ARB_SPMI_MAPPING_TABLE_REG168		0xFC4CADA0
    y.create.l PMIC_ARB_SPMI_MAPPING_TABLE_REG169		0xFC4CADA4
    y.create.l PMIC_ARB_SPMI_MAPPING_TABLE_REG170		0xFC4CADA8
    y.create.l PMIC_ARB_SPMI_MAPPING_TABLE_REG171		0xFC4CADAC
    y.create.l PMIC_ARB_SPMI_MAPPING_TABLE_REG172		0xFC4CADB0
    y.create.l PMIC_ARB_SPMI_MAPPING_TABLE_REG173		0xFC4CADB4
    y.create.l PMIC_ARB_SPMI_MAPPING_TABLE_REG174		0xFC4CADB8
    y.create.l PMIC_ARB_SPMI_MAPPING_TABLE_REG175		0xFC4CADBC
    y.create.l PMIC_ARB_SPMI_MAPPING_TABLE_REG176		0xFC4CADC0
    y.create.l PMIC_ARB_SPMI_MAPPING_TABLE_REG177		0xFC4CADC4
    y.create.l PMIC_ARB_SPMI_MAPPING_TABLE_REG178		0xFC4CADC8
    y.create.l PMIC_ARB_SPMI_MAPPING_TABLE_REG179		0xFC4CADCC
    y.create.l PMIC_ARB_SPMI_MAPPING_TABLE_REG180		0xFC4CADD0
    y.create.l PMIC_ARB_SPMI_MAPPING_TABLE_REG181		0xFC4CADD4
    y.create.l PMIC_ARB_SPMI_MAPPING_TABLE_REG182		0xFC4CADD8
    y.create.l PMIC_ARB_SPMI_MAPPING_TABLE_REG183		0xFC4CADDC
    y.create.l PMIC_ARB_SPMI_MAPPING_TABLE_REG184		0xFC4CADE0
    y.create.l PMIC_ARB_SPMI_MAPPING_TABLE_REG185		0xFC4CADE4
    y.create.l PMIC_ARB_SPMI_MAPPING_TABLE_REG186		0xFC4CADE8
    y.create.l PMIC_ARB_SPMI_MAPPING_TABLE_REG187		0xFC4CADEC
    y.create.l PMIC_ARB_SPMI_MAPPING_TABLE_REG188		0xFC4CADF0
    y.create.l PMIC_ARB_SPMI_MAPPING_TABLE_REG189		0xFC4CADF4
    y.create.l PMIC_ARB_SPMI_MAPPING_TABLE_REG190		0xFC4CADF8
    y.create.l PMIC_ARB_SPMI_MAPPING_TABLE_REG191		0xFC4CADFC
    y.create.l PMIC_ARB_SPMI_MAPPING_TABLE_REG192		0xFC4CAE00
    y.create.l PMIC_ARB_SPMI_MAPPING_TABLE_REG193		0xFC4CAE04
    y.create.l PMIC_ARB_SPMI_MAPPING_TABLE_REG194		0xFC4CAE08
    y.create.l PMIC_ARB_SPMI_MAPPING_TABLE_REG195		0xFC4CAE0C
    y.create.l PMIC_ARB_SPMI_MAPPING_TABLE_REG196		0xFC4CAE10
    y.create.l PMIC_ARB_SPMI_MAPPING_TABLE_REG197		0xFC4CAE14
    y.create.l PMIC_ARB_SPMI_MAPPING_TABLE_REG198		0xFC4CAE18
    y.create.l PMIC_ARB_SPMI_MAPPING_TABLE_REG199		0xFC4CAE1C
    y.create.l PMIC_ARB_SPMI_MAPPING_TABLE_REG200		0xFC4CAE20
    y.create.l PMIC_ARB_SPMI_MAPPING_TABLE_REG201		0xFC4CAE24
    y.create.l PMIC_ARB_SPMI_MAPPING_TABLE_REG202		0xFC4CAE28
    y.create.l PMIC_ARB_SPMI_MAPPING_TABLE_REG203		0xFC4CAE2C
    y.create.l PMIC_ARB_SPMI_MAPPING_TABLE_REG204		0xFC4CAE30
    y.create.l PMIC_ARB_SPMI_MAPPING_TABLE_REG205		0xFC4CAE34
    y.create.l PMIC_ARB_SPMI_MAPPING_TABLE_REG206		0xFC4CAE38
    y.create.l PMIC_ARB_SPMI_MAPPING_TABLE_REG207		0xFC4CAE3C
    y.create.l PMIC_ARB_SPMI_MAPPING_TABLE_REG208		0xFC4CAE40
    y.create.l PMIC_ARB_SPMI_MAPPING_TABLE_REG209		0xFC4CAE44
    y.create.l PMIC_ARB_SPMI_MAPPING_TABLE_REG210		0xFC4CAE48
    y.create.l PMIC_ARB_SPMI_MAPPING_TABLE_REG211		0xFC4CAE4C
    y.create.l PMIC_ARB_SPMI_MAPPING_TABLE_REG212		0xFC4CAE50
    y.create.l PMIC_ARB_SPMI_MAPPING_TABLE_REG213		0xFC4CAE54
    y.create.l PMIC_ARB_SPMI_MAPPING_TABLE_REG214		0xFC4CAE58
    y.create.l PMIC_ARB_SPMI_MAPPING_TABLE_REG215		0xFC4CAE5C
    y.create.l PMIC_ARB_SPMI_MAPPING_TABLE_REG216		0xFC4CAE60
    y.create.l PMIC_ARB_SPMI_MAPPING_TABLE_REG217		0xFC4CAE64
    y.create.l PMIC_ARB_SPMI_MAPPING_TABLE_REG218		0xFC4CAE68
    y.create.l PMIC_ARB_SPMI_MAPPING_TABLE_REG219		0xFC4CAE6C
    y.create.l PMIC_ARB_SPMI_MAPPING_TABLE_REG220		0xFC4CAE70
    y.create.l PMIC_ARB_SPMI_MAPPING_TABLE_REG221		0xFC4CAE74
    y.create.l PMIC_ARB_SPMI_MAPPING_TABLE_REG222		0xFC4CAE78
    y.create.l PMIC_ARB_SPMI_MAPPING_TABLE_REG223		0xFC4CAE7C
    y.create.l PMIC_ARB_SPMI_MAPPING_TABLE_REG224		0xFC4CAE80
    y.create.l PMIC_ARB_SPMI_MAPPING_TABLE_REG225		0xFC4CAE84
    y.create.l PMIC_ARB_SPMI_MAPPING_TABLE_REG226		0xFC4CAE88
    y.create.l PMIC_ARB_SPMI_MAPPING_TABLE_REG227		0xFC4CAE8C
    y.create.l PMIC_ARB_SPMI_MAPPING_TABLE_REG228		0xFC4CAE90
    y.create.l PMIC_ARB_SPMI_MAPPING_TABLE_REG229		0xFC4CAE94
    y.create.l PMIC_ARB_SPMI_MAPPING_TABLE_REG230		0xFC4CAE98
    y.create.l PMIC_ARB_SPMI_MAPPING_TABLE_REG231		0xFC4CAE9C
    y.create.l PMIC_ARB_SPMI_MAPPING_TABLE_REG232		0xFC4CAEA0
    y.create.l PMIC_ARB_SPMI_MAPPING_TABLE_REG233		0xFC4CAEA4
    y.create.l PMIC_ARB_SPMI_MAPPING_TABLE_REG234		0xFC4CAEA8
    y.create.l PMIC_ARB_SPMI_MAPPING_TABLE_REG235		0xFC4CAEAC
    y.create.l PMIC_ARB_SPMI_MAPPING_TABLE_REG236		0xFC4CAEB0
    y.create.l PMIC_ARB_SPMI_MAPPING_TABLE_REG237		0xFC4CAEB4
    y.create.l PMIC_ARB_SPMI_MAPPING_TABLE_REG238		0xFC4CAEB8
    y.create.l PMIC_ARB_SPMI_MAPPING_TABLE_REG239		0xFC4CAEBC
    y.create.l PMIC_ARB_SPMI_MAPPING_TABLE_REG240		0xFC4CAEC0
    y.create.l PMIC_ARB_SPMI_MAPPING_TABLE_REG241		0xFC4CAEC4
    y.create.l PMIC_ARB_SPMI_MAPPING_TABLE_REG242		0xFC4CAEC8
    y.create.l PMIC_ARB_SPMI_MAPPING_TABLE_REG243		0xFC4CAECC
    y.create.l PMIC_ARB_SPMI_MAPPING_TABLE_REG244		0xFC4CAED0
    y.create.l PMIC_ARB_SPMI_MAPPING_TABLE_REG245		0xFC4CAED4
    y.create.l PMIC_ARB_SPMI_MAPPING_TABLE_REG246		0xFC4CAED8
    y.create.l PMIC_ARB_SPMI_MAPPING_TABLE_REG247		0xFC4CAEDC
    y.create.l PMIC_ARB_SPMI_MAPPING_TABLE_REG248		0xFC4CAEE0
    y.create.l PMIC_ARB_SPMI_MAPPING_TABLE_REG249		0xFC4CAEE4
    y.create.l PMIC_ARB_SPMI_MAPPING_TABLE_REG250		0xFC4CAEE8
    y.create.l PMIC_ARB_SPMI_MAPPING_TABLE_REG251		0xFC4CAEEC
    y.create.l PMIC_ARB_SPMI_MAPPING_TABLE_REG252		0xFC4CAEF0
    y.create.l PMIC_ARB_SPMI_MAPPING_TABLE_REG253		0xFC4CAEF4
    y.create.l PMIC_ARB_SPMI_MAPPING_TABLE_REG254		0xFC4CAEF8

    y.create.l PMIC_ARB_SPMI_PERIPH0_2OWNER_TABLE_REG 	0xFC4CA700
    y.create.l PMIC_ARB_SPMI_PERIPH1_2OWNER_TABLE_REG 	0xFC4CA704
    y.create.l PMIC_ARB_SPMI_PERIPH2_2OWNER_TABLE_REG 	0xFC4CA708
    y.create.l PMIC_ARB_SPMI_PERIPH3_2OWNER_TABLE_REG 	0xFC4CA70C
    y.create.l PMIC_ARB_SPMI_PERIPH4_2OWNER_TABLE_REG 	0xFC4CA710
    y.create.l PMIC_ARB_SPMI_PERIPH5_2OWNER_TABLE_REG 	0xFC4CA714
    y.create.l PMIC_ARB_SPMI_PERIPH6_2OWNER_TABLE_REG 	0xFC4CA718
    y.create.l PMIC_ARB_SPMI_PERIPH7_2OWNER_TABLE_REG 	0xFC4CA71C
    y.create.l PMIC_ARB_SPMI_PERIPH8_2OWNER_TABLE_REG 	0xFC4CA720
    y.create.l PMIC_ARB_SPMI_PERIPH9_2OWNER_TABLE_REG 	0xFC4CA724
    y.create.l PMIC_ARB_SPMI_PERIPH10_2OWNER_TABLE_REG  0xFC4CA728
    y.create.l PMIC_ARB_SPMI_PERIPH11_2OWNER_TABLE_REG  0xFC4CA72C
    y.create.l PMIC_ARB_SPMI_PERIPH12_2OWNER_TABLE_REG  0xFC4CA730
    y.create.l PMIC_ARB_SPMI_PERIPH13_2OWNER_TABLE_REG  0xFC4CA734
    y.create.l PMIC_ARB_SPMI_PERIPH14_2OWNER_TABLE_REG  0xFC4CA738
    y.create.l PMIC_ARB_SPMI_PERIPH15_2OWNER_TABLE_REG  0xFC4CA73C
    y.create.l PMIC_ARB_SPMI_PERIPH16_2OWNER_TABLE_REG  0xFC4CA740
    y.create.l PMIC_ARB_SPMI_PERIPH17_2OWNER_TABLE_REG  0xFC4CA744
    y.create.l PMIC_ARB_SPMI_PERIPH18_2OWNER_TABLE_REG  0xFC4CA748
    y.create.l PMIC_ARB_SPMI_PERIPH19_2OWNER_TABLE_REG  0xFC4CA74C
    y.create.l PMIC_ARB_SPMI_PERIPH20_2OWNER_TABLE_REG  0xFC4CA750
    y.create.l PMIC_ARB_SPMI_PERIPH21_2OWNER_TABLE_REG  0xFC4CA754
    y.create.l PMIC_ARB_SPMI_PERIPH22_2OWNER_TABLE_REG  0xFC4CA758
    y.create.l PMIC_ARB_SPMI_PERIPH23_2OWNER_TABLE_REG  0xFC4CA75C
    y.create.l PMIC_ARB_SPMI_PERIPH24_2OWNER_TABLE_REG  0xFC4CA760
    y.create.l PMIC_ARB_SPMI_PERIPH25_2OWNER_TABLE_REG  0xFC4CA764
    y.create.l PMIC_ARB_SPMI_PERIPH26_2OWNER_TABLE_REG  0xFC4CA768
    y.create.l PMIC_ARB_SPMI_PERIPH27_2OWNER_TABLE_REG  0xFC4CA76C
    y.create.l PMIC_ARB_SPMI_PERIPH28_2OWNER_TABLE_REG  0xFC4CA770
    y.create.l PMIC_ARB_SPMI_PERIPH29_2OWNER_TABLE_REG  0xFC4CA774
    y.create.l PMIC_ARB_SPMI_PERIPH30_2OWNER_TABLE_REG  0xFC4CA778
    y.create.l PMIC_ARB_SPMI_PERIPH31_2OWNER_TABLE_REG  0xFC4CA77C
    y.create.l PMIC_ARB_SPMI_PERIPH32_2OWNER_TABLE_REG  0xFC4CA780
    y.create.l PMIC_ARB_SPMI_PERIPH33_2OWNER_TABLE_REG  0xFC4CA784
    y.create.l PMIC_ARB_SPMI_PERIPH34_2OWNER_TABLE_REG  0xFC4CA788
    y.create.l PMIC_ARB_SPMI_PERIPH35_2OWNER_TABLE_REG  0xFC4CA78C
    y.create.l PMIC_ARB_SPMI_PERIPH36_2OWNER_TABLE_REG  0xFC4CA790
    y.create.l PMIC_ARB_SPMI_PERIPH37_2OWNER_TABLE_REG  0xFC4CA794
    y.create.l PMIC_ARB_SPMI_PERIPH38_2OWNER_TABLE_REG  0xFC4CA798
    y.create.l PMIC_ARB_SPMI_PERIPH39_2OWNER_TABLE_REG  0xFC4CA79C
    y.create.l PMIC_ARB_SPMI_PERIPH40_2OWNER_TABLE_REG  0xFC4CA7A0
    y.create.l PMIC_ARB_SPMI_PERIPH41_2OWNER_TABLE_REG  0xFC4CA7A4
    y.create.l PMIC_ARB_SPMI_PERIPH42_2OWNER_TABLE_REG  0xFC4CA7A8
    y.create.l PMIC_ARB_SPMI_PERIPH43_2OWNER_TABLE_REG  0xFC4CA7AC
    y.create.l PMIC_ARB_SPMI_PERIPH44_2OWNER_TABLE_REG  0xFC4CA7B0
    y.create.l PMIC_ARB_SPMI_PERIPH45_2OWNER_TABLE_REG  0xFC4CA7B4
    y.create.l PMIC_ARB_SPMI_PERIPH46_2OWNER_TABLE_REG  0xFC4CA7B8
    y.create.l PMIC_ARB_SPMI_PERIPH47_2OWNER_TABLE_REG  0xFC4CA7BC
    y.create.l PMIC_ARB_SPMI_PERIPH48_2OWNER_TABLE_REG  0xFC4CA7C0
    y.create.l PMIC_ARB_SPMI_PERIPH49_2OWNER_TABLE_REG  0xFC4CA7C4
    y.create.l PMIC_ARB_SPMI_PERIPH50_2OWNER_TABLE_REG  0xFC4CA7C8
    y.create.l PMIC_ARB_SPMI_PERIPH51_2OWNER_TABLE_REG  0xFC4CA7CC
    y.create.l PMIC_ARB_SPMI_PERIPH52_2OWNER_TABLE_REG  0xFC4CA7D0
    y.create.l PMIC_ARB_SPMI_PERIPH53_2OWNER_TABLE_REG  0xFC4CA7D4
    y.create.l PMIC_ARB_SPMI_PERIPH54_2OWNER_TABLE_REG  0xFC4CA7D8
    y.create.l PMIC_ARB_SPMI_PERIPH55_2OWNER_TABLE_REG  0xFC4CA7DC
    y.create.l PMIC_ARB_SPMI_PERIPH56_2OWNER_TABLE_REG  0xFC4CA7E0
    y.create.l PMIC_ARB_SPMI_PERIPH57_2OWNER_TABLE_REG  0xFC4CA7E4
    y.create.l PMIC_ARB_SPMI_PERIPH58_2OWNER_TABLE_REG  0xFC4CA7E8
    y.create.l PMIC_ARB_SPMI_PERIPH59_2OWNER_TABLE_REG  0xFC4CA7EC
    y.create.l PMIC_ARB_SPMI_PERIPH60_2OWNER_TABLE_REG  0xFC4CA7F0
    y.create.l PMIC_ARB_SPMI_PERIPH61_2OWNER_TABLE_REG  0xFC4CA7F4
    y.create.l PMIC_ARB_SPMI_PERIPH62_2OWNER_TABLE_REG  0xFC4CA7F8
    y.create.l PMIC_ARB_SPMI_PERIPH63_2OWNER_TABLE_REG  0xFC4CA7FC
    y.create.l PMIC_ARB_SPMI_PERIPH64_2OWNER_TABLE_REG  0xFC4CA800
    y.create.l PMIC_ARB_SPMI_PERIPH65_2OWNER_TABLE_REG  0xFC4CA804
    y.create.l PMIC_ARB_SPMI_PERIPH66_2OWNER_TABLE_REG  0xFC4CA808
    y.create.l PMIC_ARB_SPMI_PERIPH67_2OWNER_TABLE_REG  0xFC4CA80C
    y.create.l PMIC_ARB_SPMI_PERIPH68_2OWNER_TABLE_REG  0xFC4CA810
    y.create.l PMIC_ARB_SPMI_PERIPH69_2OWNER_TABLE_REG  0xFC4CA814
    y.create.l PMIC_ARB_SPMI_PERIPH70_2OWNER_TABLE_REG  0xFC4CA818
    y.create.l PMIC_ARB_SPMI_PERIPH71_2OWNER_TABLE_REG  0xFC4CA81C
    y.create.l PMIC_ARB_SPMI_PERIPH72_2OWNER_TABLE_REG  0xFC4CA820
    y.create.l PMIC_ARB_SPMI_PERIPH73_2OWNER_TABLE_REG  0xFC4CA824
    y.create.l PMIC_ARB_SPMI_PERIPH74_2OWNER_TABLE_REG  0xFC4CA828
    y.create.l PMIC_ARB_SPMI_PERIPH75_2OWNER_TABLE_REG  0xFC4CA82C
    y.create.l PMIC_ARB_SPMI_PERIPH76_2OWNER_TABLE_REG  0xFC4CA830
    y.create.l PMIC_ARB_SPMI_PERIPH77_2OWNER_TABLE_REG  0xFC4CA834
    y.create.l PMIC_ARB_SPMI_PERIPH78_2OWNER_TABLE_REG  0xFC4CA838
    y.create.l PMIC_ARB_SPMI_PERIPH79_2OWNER_TABLE_REG  0xFC4CA83C
    y.create.l PMIC_ARB_SPMI_PERIPH80_2OWNER_TABLE_REG  0xFC4CA840
    y.create.l PMIC_ARB_SPMI_PERIPH81_2OWNER_TABLE_REG  0xFC4CA844
    y.create.l PMIC_ARB_SPMI_PERIPH82_2OWNER_TABLE_REG  0xFC4CA848
    y.create.l PMIC_ARB_SPMI_PERIPH83_2OWNER_TABLE_REG  0xFC4CA84C
    y.create.l PMIC_ARB_SPMI_PERIPH84_2OWNER_TABLE_REG  0xFC4CA850
    y.create.l PMIC_ARB_SPMI_PERIPH85_2OWNER_TABLE_REG  0xFC4CA854
    y.create.l PMIC_ARB_SPMI_PERIPH86_2OWNER_TABLE_REG  0xFC4CA858
    y.create.l PMIC_ARB_SPMI_PERIPH87_2OWNER_TABLE_REG  0xFC4CA85C
    y.create.l PMIC_ARB_SPMI_PERIPH88_2OWNER_TABLE_REG  0xFC4CA860
    y.create.l PMIC_ARB_SPMI_PERIPH89_2OWNER_TABLE_REG  0xFC4CA864
    y.create.l PMIC_ARB_SPMI_PERIPH90_2OWNER_TABLE_REG  0xFC4CA868
    y.create.l PMIC_ARB_SPMI_PERIPH91_2OWNER_TABLE_REG  0xFC4CA86C
    y.create.l PMIC_ARB_SPMI_PERIPH92_2OWNER_TABLE_REG  0xFC4CA870
    y.create.l PMIC_ARB_SPMI_PERIPH93_2OWNER_TABLE_REG  0xFC4CA874
    y.create.l PMIC_ARB_SPMI_PERIPH94_2OWNER_TABLE_REG  0xFC4CA878
    y.create.l PMIC_ARB_SPMI_PERIPH95_2OWNER_TABLE_REG  0xFC4CA87C
    y.create.l PMIC_ARB_SPMI_PERIPH96_2OWNER_TABLE_REG  0xFC4CA880
    y.create.l PMIC_ARB_SPMI_PERIPH97_2OWNER_TABLE_REG  0xFC4CA884
    y.create.l PMIC_ARB_SPMI_PERIPH98_2OWNER_TABLE_REG  0xFC4CA888
    y.create.l PMIC_ARB_SPMI_PERIPH99_2OWNER_TABLE_REG  0xFC4CA88C
    y.create.l PMIC_ARB_SPMI_PERIPH100_2OWNER_TABLE_REG  0xFC4CA890
    y.create.l PMIC_ARB_SPMI_PERIPH101_2OWNER_TABLE_REG  0xFC4CA894
    y.create.l PMIC_ARB_SPMI_PERIPH102_2OWNER_TABLE_REG  0xFC4CA898
    y.create.l PMIC_ARB_SPMI_PERIPH103_2OWNER_TABLE_REG  0xFC4CA89C
    y.create.l PMIC_ARB_SPMI_PERIPH104_2OWNER_TABLE_REG  0xFC4CA8A0
    y.create.l PMIC_ARB_SPMI_PERIPH105_2OWNER_TABLE_REG  0xFC4CA8A4
    y.create.l PMIC_ARB_SPMI_PERIPH106_2OWNER_TABLE_REG  0xFC4CA8A8
    y.create.l PMIC_ARB_SPMI_PERIPH107_2OWNER_TABLE_REG  0xFC4CA8AC
    y.create.l PMIC_ARB_SPMI_PERIPH108_2OWNER_TABLE_REG  0xFC4CA8B0
    y.create.l PMIC_ARB_SPMI_PERIPH109_2OWNER_TABLE_REG  0xFC4CA8B4
    y.create.l PMIC_ARB_SPMI_PERIPH110_2OWNER_TABLE_REG  0xFC4CA8B8
    y.create.l PMIC_ARB_SPMI_PERIPH111_2OWNER_TABLE_REG  0xFC4CA8BC
    y.create.l PMIC_ARB_SPMI_PERIPH112_2OWNER_TABLE_REG  0xFC4CA8C0
    y.create.l PMIC_ARB_SPMI_PERIPH113_2OWNER_TABLE_REG  0xFC4CA8C4
    y.create.l PMIC_ARB_SPMI_PERIPH114_2OWNER_TABLE_REG  0xFC4CA8C8
    y.create.l PMIC_ARB_SPMI_PERIPH115_2OWNER_TABLE_REG  0xFC4CA8CC
    y.create.l PMIC_ARB_SPMI_PERIPH116_2OWNER_TABLE_REG  0xFC4CA8D0
    y.create.l PMIC_ARB_SPMI_PERIPH117_2OWNER_TABLE_REG  0xFC4CA8D4
    y.create.l PMIC_ARB_SPMI_PERIPH118_2OWNER_TABLE_REG  0xFC4CA8D8
    y.create.l PMIC_ARB_SPMI_PERIPH119_2OWNER_TABLE_REG  0xFC4CA8DC
    y.create.l PMIC_ARB_SPMI_PERIPH120_2OWNER_TABLE_REG  0xFC4CA8E0
    y.create.l PMIC_ARB_SPMI_PERIPH121_2OWNER_TABLE_REG  0xFC4CA8E4
    y.create.l PMIC_ARB_SPMI_PERIPH122_2OWNER_TABLE_REG  0xFC4CA8E8
    y.create.l PMIC_ARB_SPMI_PERIPH123_2OWNER_TABLE_REG  0xFC4CA8EC
    y.create.l PMIC_ARB_SPMI_PERIPH124_2OWNER_TABLE_REG  0xFC4CA8F0
    y.create.l PMIC_ARB_SPMI_PERIPH125_2OWNER_TABLE_REG  0xFC4CA8F4
    y.create.l PMIC_ARB_SPMI_PERIPH126_2OWNER_TABLE_REG  0xFC4CA8F8
    y.create.l PMIC_ARB_SPMI_PERIPH127_2OWNER_TABLE_REG  0xFC4CA8FC
    y.create.l PMIC_ARB_SPMI_PERIPH128_2OWNER_TABLE_REG  0xFC4CA900
    y.create.l PMIC_ARB_SPMI_PERIPH129_2OWNER_TABLE_REG  0xFC4CA904
    y.create.l PMIC_ARB_SPMI_PERIPH130_2OWNER_TABLE_REG  0xFC4CA908
    y.create.l PMIC_ARB_SPMI_PERIPH131_2OWNER_TABLE_REG  0xFC4CA90C
    y.create.l PMIC_ARB_SPMI_PERIPH132_2OWNER_TABLE_REG  0xFC4CA910
    y.create.l PMIC_ARB_SPMI_PERIPH133_2OWNER_TABLE_REG  0xFC4CA914
    y.create.l PMIC_ARB_SPMI_PERIPH134_2OWNER_TABLE_REG  0xFC4CA918
    y.create.l PMIC_ARB_SPMI_PERIPH135_2OWNER_TABLE_REG  0xFC4CA91C
    y.create.l PMIC_ARB_SPMI_PERIPH136_2OWNER_TABLE_REG  0xFC4CA920
    y.create.l PMIC_ARB_SPMI_PERIPH137_2OWNER_TABLE_REG  0xFC4CA924
    y.create.l PMIC_ARB_SPMI_PERIPH138_2OWNER_TABLE_REG  0xFC4CA928
    y.create.l PMIC_ARB_SPMI_PERIPH139_2OWNER_TABLE_REG  0xFC4CA92C
    y.create.l PMIC_ARB_SPMI_PERIPH140_2OWNER_TABLE_REG  0xFC4CA930
    y.create.l PMIC_ARB_SPMI_PERIPH141_2OWNER_TABLE_REG  0xFC4CA934
    y.create.l PMIC_ARB_SPMI_PERIPH142_2OWNER_TABLE_REG  0xFC4CA938
    y.create.l PMIC_ARB_SPMI_PERIPH143_2OWNER_TABLE_REG  0xFC4CA93C
    y.create.l PMIC_ARB_SPMI_PERIPH144_2OWNER_TABLE_REG  0xFC4CA940
    y.create.l PMIC_ARB_SPMI_PERIPH145_2OWNER_TABLE_REG  0xFC4CA944
    y.create.l PMIC_ARB_SPMI_PERIPH146_2OWNER_TABLE_REG  0xFC4CA948
    y.create.l PMIC_ARB_SPMI_PERIPH147_2OWNER_TABLE_REG  0xFC4CA94C
    y.create.l PMIC_ARB_SPMI_PERIPH148_2OWNER_TABLE_REG  0xFC4CA950
    y.create.l PMIC_ARB_SPMI_PERIPH149_2OWNER_TABLE_REG  0xFC4CA954
    y.create.l PMIC_ARB_SPMI_PERIPH150_2OWNER_TABLE_REG  0xFC4CA958
    y.create.l PMIC_ARB_SPMI_PERIPH151_2OWNER_TABLE_REG  0xFC4CA95C
    y.create.l PMIC_ARB_SPMI_PERIPH152_2OWNER_TABLE_REG  0xFC4CA960
    y.create.l PMIC_ARB_SPMI_PERIPH153_2OWNER_TABLE_REG  0xFC4CA964
    y.create.l PMIC_ARB_SPMI_PERIPH154_2OWNER_TABLE_REG  0xFC4CA968
    y.create.l PMIC_ARB_SPMI_PERIPH155_2OWNER_TABLE_REG  0xFC4CA96C
    y.create.l PMIC_ARB_SPMI_PERIPH156_2OWNER_TABLE_REG  0xFC4CA970
    y.create.l PMIC_ARB_SPMI_PERIPH157_2OWNER_TABLE_REG  0xFC4CA974
    y.create.l PMIC_ARB_SPMI_PERIPH158_2OWNER_TABLE_REG  0xFC4CA978
    y.create.l PMIC_ARB_SPMI_PERIPH159_2OWNER_TABLE_REG  0xFC4CA97C
    y.create.l PMIC_ARB_SPMI_PERIPH160_2OWNER_TABLE_REG  0xFC4CA980
    y.create.l PMIC_ARB_SPMI_PERIPH161_2OWNER_TABLE_REG  0xFC4CA984
    y.create.l PMIC_ARB_SPMI_PERIPH162_2OWNER_TABLE_REG  0xFC4CA988
    y.create.l PMIC_ARB_SPMI_PERIPH163_2OWNER_TABLE_REG  0xFC4CA98C
    y.create.l PMIC_ARB_SPMI_PERIPH164_2OWNER_TABLE_REG  0xFC4CA990
    y.create.l PMIC_ARB_SPMI_PERIPH165_2OWNER_TABLE_REG  0xFC4CA994
    y.create.l PMIC_ARB_SPMI_PERIPH166_2OWNER_TABLE_REG  0xFC4CA998
    y.create.l PMIC_ARB_SPMI_PERIPH167_2OWNER_TABLE_REG  0xFC4CA99C
    y.create.l PMIC_ARB_SPMI_PERIPH168_2OWNER_TABLE_REG  0xFC4CA9A0
    y.create.l PMIC_ARB_SPMI_PERIPH169_2OWNER_TABLE_REG  0xFC4CA9A4
    y.create.l PMIC_ARB_SPMI_PERIPH170_2OWNER_TABLE_REG  0xFC4CA9A8
    y.create.l PMIC_ARB_SPMI_PERIPH171_2OWNER_TABLE_REG  0xFC4CA9AC
    y.create.l PMIC_ARB_SPMI_PERIPH172_2OWNER_TABLE_REG  0xFC4CA9B0
    y.create.l PMIC_ARB_SPMI_PERIPH173_2OWNER_TABLE_REG  0xFC4CA9B4
    y.create.l PMIC_ARB_SPMI_PERIPH174_2OWNER_TABLE_REG  0xFC4CA9B8
    y.create.l PMIC_ARB_SPMI_PERIPH175_2OWNER_TABLE_REG  0xFC4CA9BC
    y.create.l PMIC_ARB_SPMI_PERIPH176_2OWNER_TABLE_REG  0xFC4CA9C0
    y.create.l PMIC_ARB_SPMI_PERIPH177_2OWNER_TABLE_REG  0xFC4CA9C4
    y.create.l PMIC_ARB_SPMI_PERIPH178_2OWNER_TABLE_REG  0xFC4CA9C8
    y.create.l PMIC_ARB_SPMI_PERIPH179_2OWNER_TABLE_REG  0xFC4CA9CC
    y.create.l PMIC_ARB_SPMI_PERIPH180_2OWNER_TABLE_REG  0xFC4CA9D0
    y.create.l PMIC_ARB_SPMI_PERIPH181_2OWNER_TABLE_REG  0xFC4CA9D4
    y.create.l PMIC_ARB_SPMI_PERIPH182_2OWNER_TABLE_REG  0xFC4CA9D8
    y.create.l PMIC_ARB_SPMI_PERIPH183_2OWNER_TABLE_REG  0xFC4CA9DC
    y.create.l PMIC_ARB_SPMI_PERIPH184_2OWNER_TABLE_REG  0xFC4CA9E0
    y.create.l PMIC_ARB_SPMI_PERIPH185_2OWNER_TABLE_REG  0xFC4CA9E4
    y.create.l PMIC_ARB_SPMI_PERIPH186_2OWNER_TABLE_REG  0xFC4CA9E8
    y.create.l PMIC_ARB_SPMI_PERIPH187_2OWNER_TABLE_REG  0xFC4CA9EC
    y.create.l PMIC_ARB_SPMI_PERIPH188_2OWNER_TABLE_REG  0xFC4CA9F0
    y.create.l PMIC_ARB_SPMI_PERIPH189_2OWNER_TABLE_REG  0xFC4CA9F4
    y.create.l PMIC_ARB_SPMI_PERIPH190_2OWNER_TABLE_REG  0xFC4CA9F8
    y.create.l PMIC_ARB_SPMI_PERIPH191_2OWNER_TABLE_REG  0xFC4CA9FC
    y.create.l PMIC_ARB_SPMI_PERIPH192_2OWNER_TABLE_REG  0xFC4CAA00
    y.create.l PMIC_ARB_SPMI_PERIPH193_2OWNER_TABLE_REG  0xFC4CAA04
    y.create.l PMIC_ARB_SPMI_PERIPH194_2OWNER_TABLE_REG  0xFC4CAA08
    y.create.l PMIC_ARB_SPMI_PERIPH195_2OWNER_TABLE_REG  0xFC4CAA0C
    y.create.l PMIC_ARB_SPMI_PERIPH196_2OWNER_TABLE_REG  0xFC4CAA10
    y.create.l PMIC_ARB_SPMI_PERIPH197_2OWNER_TABLE_REG  0xFC4CAA14
    y.create.l PMIC_ARB_SPMI_PERIPH198_2OWNER_TABLE_REG  0xFC4CAA18
    y.create.l PMIC_ARB_SPMI_PERIPH199_2OWNER_TABLE_REG  0xFC4CAA1C
    y.create.l PMIC_ARB_SPMI_PERIPH200_2OWNER_TABLE_REG  0xFC4CAA20
    y.create.l PMIC_ARB_SPMI_PERIPH201_2OWNER_TABLE_REG  0xFC4CAA24
    y.create.l PMIC_ARB_SPMI_PERIPH202_2OWNER_TABLE_REG  0xFC4CAA28
    y.create.l PMIC_ARB_SPMI_PERIPH203_2OWNER_TABLE_REG  0xFC4CAA2C
    y.create.l PMIC_ARB_SPMI_PERIPH204_2OWNER_TABLE_REG  0xFC4CAA30
    y.create.l PMIC_ARB_SPMI_PERIPH205_2OWNER_TABLE_REG  0xFC4CAA34
    y.create.l PMIC_ARB_SPMI_PERIPH206_2OWNER_TABLE_REG  0xFC4CAA38
    y.create.l PMIC_ARB_SPMI_PERIPH207_2OWNER_TABLE_REG  0xFC4CAA3C
    y.create.l PMIC_ARB_SPMI_PERIPH208_2OWNER_TABLE_REG  0xFC4CAA40
    y.create.l PMIC_ARB_SPMI_PERIPH209_2OWNER_TABLE_REG  0xFC4CAA44
    y.create.l PMIC_ARB_SPMI_PERIPH210_2OWNER_TABLE_REG  0xFC4CAA48
    y.create.l PMIC_ARB_SPMI_PERIPH211_2OWNER_TABLE_REG  0xFC4CAA4C
    y.create.l PMIC_ARB_SPMI_PERIPH212_2OWNER_TABLE_REG  0xFC4CAA50
    y.create.l PMIC_ARB_SPMI_PERIPH213_2OWNER_TABLE_REG  0xFC4CAA54
    y.create.l PMIC_ARB_SPMI_PERIPH214_2OWNER_TABLE_REG  0xFC4CAA58
    y.create.l PMIC_ARB_SPMI_PERIPH215_2OWNER_TABLE_REG  0xFC4CAA5C
    y.create.l PMIC_ARB_SPMI_PERIPH216_2OWNER_TABLE_REG  0xFC4CAA60
    y.create.l PMIC_ARB_SPMI_PERIPH217_2OWNER_TABLE_REG  0xFC4CAA64
    y.create.l PMIC_ARB_SPMI_PERIPH218_2OWNER_TABLE_REG  0xFC4CAA68
    y.create.l PMIC_ARB_SPMI_PERIPH219_2OWNER_TABLE_REG  0xFC4CAA6C
    y.create.l PMIC_ARB_SPMI_PERIPH220_2OWNER_TABLE_REG  0xFC4CAA70
    y.create.l PMIC_ARB_SPMI_PERIPH221_2OWNER_TABLE_REG  0xFC4CAA74
    y.create.l PMIC_ARB_SPMI_PERIPH222_2OWNER_TABLE_REG  0xFC4CAA78
    y.create.l PMIC_ARB_SPMI_PERIPH223_2OWNER_TABLE_REG  0xFC4CAA7C
    y.create.l PMIC_ARB_SPMI_PERIPH224_2OWNER_TABLE_REG  0xFC4CAA80
    y.create.l PMIC_ARB_SPMI_PERIPH225_2OWNER_TABLE_REG  0xFC4CAA84
    y.create.l PMIC_ARB_SPMI_PERIPH226_2OWNER_TABLE_REG  0xFC4CAA88
    y.create.l PMIC_ARB_SPMI_PERIPH227_2OWNER_TABLE_REG  0xFC4CAA8C
    y.create.l PMIC_ARB_SPMI_PERIPH228_2OWNER_TABLE_REG  0xFC4CAA90
    y.create.l PMIC_ARB_SPMI_PERIPH229_2OWNER_TABLE_REG  0xFC4CAA94
    y.create.l PMIC_ARB_SPMI_PERIPH230_2OWNER_TABLE_REG  0xFC4CAA98
    y.create.l PMIC_ARB_SPMI_PERIPH231_2OWNER_TABLE_REG  0xFC4CAA9C
    y.create.l PMIC_ARB_SPMI_PERIPH232_2OWNER_TABLE_REG  0xFC4CAAA0
    y.create.l PMIC_ARB_SPMI_PERIPH233_2OWNER_TABLE_REG  0xFC4CAAA4
    y.create.l PMIC_ARB_SPMI_PERIPH234_2OWNER_TABLE_REG  0xFC4CAAA8
    y.create.l PMIC_ARB_SPMI_PERIPH235_2OWNER_TABLE_REG  0xFC4CAAAC
    y.create.l PMIC_ARB_SPMI_PERIPH236_2OWNER_TABLE_REG  0xFC4CAAB0
    y.create.l PMIC_ARB_SPMI_PERIPH237_2OWNER_TABLE_REG  0xFC4CAAB4
    y.create.l PMIC_ARB_SPMI_PERIPH238_2OWNER_TABLE_REG  0xFC4CAAB8
    y.create.l PMIC_ARB_SPMI_PERIPH239_2OWNER_TABLE_REG  0xFC4CAABC
    y.create.l PMIC_ARB_SPMI_PERIPH240_2OWNER_TABLE_REG  0xFC4CAAC0
    y.create.l PMIC_ARB_SPMI_PERIPH241_2OWNER_TABLE_REG  0xFC4CAAC4
    y.create.l PMIC_ARB_SPMI_PERIPH242_2OWNER_TABLE_REG  0xFC4CAAC8
    y.create.l PMIC_ARB_SPMI_PERIPH243_2OWNER_TABLE_REG  0xFC4CAACC
    y.create.l PMIC_ARB_SPMI_PERIPH244_2OWNER_TABLE_REG  0xFC4CAAD0
    y.create.l PMIC_ARB_SPMI_PERIPH245_2OWNER_TABLE_REG  0xFC4CAAD4
    y.create.l PMIC_ARB_SPMI_PERIPH246_2OWNER_TABLE_REG  0xFC4CAAD8
    y.create.l PMIC_ARB_SPMI_PERIPH247_2OWNER_TABLE_REG  0xFC4CAADC
    y.create.l PMIC_ARB_SPMI_PERIPH248_2OWNER_TABLE_REG  0xFC4CAAE0
    y.create.l PMIC_ARB_SPMI_PERIPH249_2OWNER_TABLE_REG  0xFC4CAAE4
    y.create.l PMIC_ARB_SPMI_PERIPH250_2OWNER_TABLE_REG  0xFC4CAAE8
    y.create.l PMIC_ARB_SPMI_PERIPH251_2OWNER_TABLE_REG  0xFC4CAAEC
    y.create.l PMIC_ARB_SPMI_PERIPH252_2OWNER_TABLE_REG  0xFC4CAAF0
    y.create.l PMIC_ARB_SPMI_PERIPH253_2OWNER_TABLE_REG  0xFC4CAAF4
    y.create.l PMIC_ARB_SPMI_PERIPH254_2OWNER_TABLE_REG  0xFC4CAAF8
    y.create.l PMIC_ARB_SPMI_PERIPH255_2OWNER_TABLE_REG  0xFC4CAAFC

    y.create.l PMIC_ARB_SPMI_GENI_FORCE_DEFAULT_REG		0xFC4CA010 ; 0xFC4CA00C 
    y.create.l PMIC_ARB_SPMI_GENI_CLK_CTRL				0xFC4CA000 
    y.create.l PMIC_ARB_SPMI_SEC_DISABLE_REG			0xFC4CAF08 
    y.create.l PMIC_ARB_SPMI_GENI_OUTPUT_CTRL			0xFC4CA014 ; 0xFC4CA010 

    y.create.l GCC_GCC_IM_SLEEP_CBCR					0xFC4010CC
    y.create.l GCC_SPMI_BCR								0xFC400FC0
    
    y.create.l PMIC_ARB_SPMI_GENI_CFG_SYMFLAG 0xF8200008   ; use unused address as the dummy value
    
    y.create.done    
)

ENDDO