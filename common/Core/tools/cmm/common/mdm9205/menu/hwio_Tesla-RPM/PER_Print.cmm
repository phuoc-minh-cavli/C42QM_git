;//////////////////////////////////////////////////////////////////////////////
; 2014_109_011855
; PER_Print.cmm                                 Generated by VI__HWIO_SUITE.exe
;
; TESLA9X45 PER_Print.cmm
;//////////////////////////////////////////////////////////////////////////////

 local &per_reg &reg &per_file &my_per_path &prev_path &val &append &file &vio &reg_symbol
 local &tmp_path &batch_vio &batch_dump

 &tmp_path=OS.PTD()
 &my_per_path=OS.PPD()
 &prev_path=OS.PWD()

 &batch_vio="C:\dropbox\batch_VIO.txt"
 &batch_dump="C:\dropbox\batch_reg_dump.txt"

 entry &per_reg &per_file &append &vio &reg_symbol

 if "&append"=="-history"
 (
    area.open A000 C:\dropbox\PER_Find_history.cmm /Append
    area.select A000
    print "per &my_per_path/&per_file ""&per_reg"" /sl"
    area.close A000
    enddo
 )

 if "&per_reg"=="VIO_batch"
 (
    if OS.FILE("&batch_vio")
       DEL "&batch_vio"

    if OS.FILE(C:\dropbox\VIO_Code.c)
       DEL C:\dropbox\VIO_Code.c

    enddo
 )
 if "&per_reg"=="Dump_batch"
 (
    if OS.FILE("&batch_dump")
       DEL "&batch_dump"

    if OS.FILE("C:\dropbox\PER_REG_DUMP.txt")
       DEL "C:\dropbox\PER_REG_DUMP.txt"

    enddo
 )

 if "&per_reg"=="-batch_Dump"||"&per_reg"=="-batch_VIO"
 (
    local &read_line &reg_dump_list &batch_file_type &read_file

	if "&per_reg"=="-batch_VIO"
	(
		&reg_dump_list="&tmp_path\batch_VIO_with_val.txt"
		&batch_file_type="&tmp_path\batch_VIO.bat"
		&read_file="&batch_vio"
	)
	if "&per_reg"=="-batch_Dump"
	(
		&reg_dump_list="&tmp_path\batch_reg_dump_with_val.txt"
		&batch_file_type="&tmp_path\batch_reg_dump.bat"
		&read_file="&batch_dump"
	)
	area.create A001
    area.open A001 &reg_dump_list
    area.select A001

	OPEN #1 &read_file /Read
Read_File:
	READ #1 %line &read_line

	IF EOF()
		GOTO Close_File

	&reg=STRing.SCANAndExtract("&read_line","$","")
    &val=data.long(A:&reg)
	print "&read_line -val &val"
	GOTO Read_File

Close_File:
	CLOSE #1
	area.close A001

	area.create A002
    area.open A002 &batch_file_type
    area.select A002
    print
    print "pushd &my_per_path"
	print "per_utils.exe -batch &reg_dump_list"
	print "popd"
    area.close A002
    OS.Screen &batch_file_type
    enddo
 )

 &reg=string.cut("&per_reg",1);
 &reg=string.cut("&reg",-1);

 if "&append"=="-queue"
 (
    local &batch_file

    if "&vio"=="-m"
    (
        &batch_file="&batch_vio"
        &append="-a -all"
    )
    else
    (
        &batch_file="&batch_dump"
        &append="-a"
        &reg_symbol="&vio"
        &vio="-nt"
    )

    area.open A000 "&batch_file" /Append
    area.select A000
    print "$&reg -d -f &per_file &append &vio &reg_symbol"
    area.close A000
    enddo
 )

 if OS.FILE(C:\dropbox\&(reg).txt)
 (
   rm C:\dropbox\&(reg).txt
 )

 if OS.FILE(C:\dropbox\PER_Dump_Success.txt)
 (
   rm C:\dropbox\PER_Dump_Success.txt
 )

 &val=data.long(A:&reg)

 cd &my_per_path
 &per_file=string.UPR("&per_file")
 &file=string.scan("&per_file", ".PER",-1)

 if (&file>0)
 (
  print "per_utils.exe &per_reg -d -f &per_file -val &val &append &vio &reg_symbol"
  OS.screen per_utils.exe &per_reg -d -f &per_file -val &val &append &vio &reg_symbol
 )
 else
 (
  print "per_utils.exe &per_reg -d -val &val &per_file &append &vio &reg_symbol"
  OS.screen per_utils.exe &per_reg -d -val &val &per_file &append &vio &reg_symbol
 )
 OS.screen exit
 cd &prev_path

 if ("&append"=="-a")||("&per_file"=="-a")
 (
   print "appending &reg"
   wait OS.FILE(C:\dropbox\PER_Dump_Success.txt)
 )

enddo
