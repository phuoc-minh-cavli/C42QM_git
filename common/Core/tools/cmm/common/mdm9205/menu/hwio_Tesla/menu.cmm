;//////////////////////////////////////////////////////////////////////////////
; 2014_0911_122259
; menu.cmm                                      Generated by VI__HWIO_SUITE.exe
;
; Tesla9X45 Trace32 Pulldown menu
;//////////////////////////////////////////////////////////////////////////////

global &dp_cmm_path
&dp_cmm_path=OS.PPD()

local &skip
entry &skip

; if "&skip"==""
 (
   ;menu.reset
   //do &dp_cmm_path\symbols
 )

 path + &dp_cmm_path

;menu.reprogram &dp_cmm_path\menu_Tesla9X45.men

 MENU.AddMenu "Clear prev. searched Regs,ALT+F11" "DEL C:\dropbox\PER_Find_history.cmm"
 MENU.AddMenu "Load prev. searched Regs,F10"   "do C:\dropbox\PER_Find_history.cmm"
 MENU.AddMenu "Show prev. searched Regs,F11"   "OS notepad.exe C:\dropbox\PER_Find_history.cmm"
 MENU.AddMenu "Search PER files,F12"           "do &dp_cmm_path\PER_Find"


 if "&skip"!=""
 (
   do &dp_cmm_path\PER_Find &skip PER_TESLA9X45.per
 )

 enddo