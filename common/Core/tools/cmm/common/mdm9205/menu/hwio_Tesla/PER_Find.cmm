;//////////////////////////////////////////////////////////////////////////////
; 2014_109_011855
; PER_Find.cmm                                  Generated by VI__HWIO_SUITE.exe
;
; TESLA9X45 PER_Find.cmm
;//////////////////////////////////////////////////////////////////////////////

 &local &per_reg &per_file &my_per_path &prev_path
 &my_per_path=OS.PPD()
 &prev_path=OS.PWD()

 if OS.FILE(C:\dropbox\PER_View.cmm)
 (
   rm C:\dropbox\PER_View.cmm
 )

 entry &per_reg &per_file

 if ("&per_reg"!="")&&("&per_file"!="")
   goto NO_PROMPT

 if STRING.FIND("&per_reg","--")
  &per_file=STRING.CUT("&per_reg",2)

 area.create Screen
 area.select Screen
 area.view Screen
 area.clear Screen

 print " Register name: "
 enter &per_reg

 winclear TOP

NO_PROMPT:

 area.select A000

 cd &my_per_path

 if !OS.FILE(per_utils.exe)
 (
   print "&my_per_path\per_utils.exe is missing"
   enddo
 )

 OS.screen per_utils.exe &per_reg -f &per_file -path &my_per_path
 wait OS.FILE(C:\dropbox\PER_View.cmm)
 OS.screen exit

 do C:\dropbox\per_view &my_per_path
 cd &prev_path
 enddo

