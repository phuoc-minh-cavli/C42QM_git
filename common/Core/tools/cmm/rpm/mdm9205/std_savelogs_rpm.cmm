//============================================================================
//  Name:                                                                     
//    std_savelogs_rpm.cmm 
//
//  Description:                                                              
//    Script to save RPM memory locations
//                                                                            
// Copyright (c) 2012 - 2014 by Qualcomm Technologies, Incorporated.  All Rights Reserved.        
//
//
//
//
//                      EDIT HISTORY FOR FILE
//  This section contains comments describing changes made to the module.
//  Notice that changes are listed in reverse chronological order.
//
// when       who     		what, where, why
// --------   ---     		---------------------------------------------------------
// 11/26/2015 c_akaki	    Saving DATARAM Correctly
// 07/02/2014 AJCheriyan    Added MSGRAM back in
// 07/10/2012 AJCheriyan    Created for B-family 
//

// We support one argument for this script
// &ARG0 - Output location for the logs
ENTRY &ARG0

LOCAL &LOGLOCATION &filename

&LOGLOCATION="&ARG0"

MAIN:
	&LOGLOCATION="&ARG0"

	// Load the memory map
	do std_constants

	// Save the memories first
	GOSUB SAVEBIN

	// Save registers and anything else
	GOSUB SAVESTATE

	// Done
	GOTO EXIT

// Function that actually saves the binaries
SAVEBIN:
    do std_utils SAVEBIN &LOGLOCATION &CODERAM_log &CODERAM_START &CODERAM_SIZE+1
    do std_utils SAVEBIN &LOGLOCATION &DATARAM_log &DATARAM_START &DATARAM_SIZE
    do std_utils SAVEBIN &LOGLOCATION &MSGRAM_log  &MSGRAM_START  &MSGRAM_SIZE+1

	RETURN

// Function that actually saves the state
SAVESTATE:

	&filename="&RPM_root"+"&regs_log"
	do std_utils SAVEREGS &LOGLOCATION &filename

	&filename="&LOGLOCATION"+"\"+"&RPM_root"+"&bp_log"
	store &filename hex break tronchip 
	print "ARM7 breakpoint state saved to file &filename.cmm"

	RETURN	

FATALEXIT:
	END

EXIT:
	ENDDO


		


