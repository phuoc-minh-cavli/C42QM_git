entry &file

on error gosub
(
	return
)

do &file