//   Title: std_memorymap

//   License: License
//   Copyright 2012 Qualcomm Technologies Inc

//   Description: This script setup the memory map for the target

//   Input: None

//   Output: None

//   Usage: do std_memorymap

//   Team: CoreBSP Products 8994

//   Target: MSM8974

//   Author: Author
//   $Author: pwbldsvc $

//   Location: Perforce Revision
//   $Header: 
//
//   Edits : 		Edits
//   AJC   :    Updated for memorymap changes   : 07/02/2014
//   AJC   :    Updated for Elessar             : 05/04/2014
//   AJC   :	Relocatable image support		: 02/20/2013
//   AJC   : 	Updated DDR addresses			: 04/02/2013
//   AJC   : 	Correct RPM addresses			: 01/10/2013
//   AJC   : 	Added more debug cookies		: 10/19/2012
//   AJC   :	Added debug cookies to map		: 10/10/2012
//   AJC   :	Corrected addresses				: 08/03/2012
//   AJC   : 	First version for MSM8974		: 05/03/2012
//	 AJC   :	Re-written for B-family			: 05/03/2012




// RPM Code RAM - 160 KB
GLOBAL &CODERAM_start
GLOBAL &CODERAM_RPM_start
GLOBAL &CODERAM_end
GLOBAL &CODERAM_size
GLOBAL &CODERAM_log
GLOBAL &CODERAM_USB_log
&CODERAM_start=0xFC100000
&CODERAM_RPM_start=0x200000
&CODERAM_end=0XFC127FFF
&CODERAM_size=0X24000
&CODERAM_log="CODERAM_log.bin"
&CODERAM_USB_log="CODERAM.bin"

// RPM Data RAM - 80 kB 
GLOBAL &DATARAM_start
GLOBAL &DATARAM_RPM_start
GLOBAL &DATARAM_end
GLOBAL &DATARAM_size
GLOBAL &DATARAM_log
GLOBAL &DATARAM_USB_log
&DATARAM_start=0xFC190000
&DATARAM_RPM_start=0x290000
&DATARAM_end=0xFC1A3FFF
&DATARAM_size=0X10000
&DATARAM_log="DATARAM_log.bin"
&DATARAM_USB_log="DATARAM.bin"

// RPM Message RAM - 16KB
GLOBAL &MSGRAM_start
GLOBAL &MSGRAM_end
GLOBAL &MSGRAM_size
GLOBAL &MSGRAM_log
GLOBAL &MSGRAM_USB_log
&MSGRAM_start=0xFC60000
&MSGRAM_end=0xFC42FFFF
&MSGRAM_size=0x3000
&MSGRAM_log="MSGRAM_log.bin"
&MSGRAM_USB_log="MSGRAM.bin"


// Debug Image - 24 kB
//GLOBAL &SDI_start
//GLOBAL &SDI_end
//GLOBAL &SDI_size
//GLOBAL &SDI_log
//&SDI_start=0XFE800000
//&SDI_end=0XFE805FFF
//&SDI_size=0X6000
//&SDII_log="SDI_log.bin"


GLOBAL &HLOS_1_start
GLOBAL &HLOS_1_end
GLOBAL &HLOS_1_size
GLOBAL &HLOS_1_log
&HLOS_1_start=0x81500000
&HLOS_1_end=0x81E22000
&HLOS_1_size=0X922000
&HLOS_1_log="HLOS_1_log.bin"


//GLOBAL &HLOS_2_start
//GLOBAL &HLOS_2_end
//GLOBAL &HLOS_2_size
//GLOBAL &HLOS_2_log
//&HLOS_2_start=0XFF00000
//&HLOS_2_end=0XFFFFFFF
//&HLOS_2_size=0X100000
//&HLOS_2_log="HLOS_2_log.bin"


//GLOBAL &HLOS_3_start
//GLOBAL &HLOS_3_end
//GLOBAL &HLOS_3_size
//GLOBAL &HLOS_3_log
//&HLOS_3_start=0X11000000
//&HLOS_3_end=0X1FFFFFFF
//&HLOS_3_size=0XEFFFFFF
//&HLOS_3_log="HLOS_3_log.bin"


//GLOBAL &HLOS_4_start
//GLOBAL &HLOS_4_end
//GLOBAL &HLOS_4_size
//GLOBAL &HLOS_4_log
//&HLOS_4_start=0X20000000
//&HLOS_4_end=0X7FFFFFFF
//&HLOS_4_size=0X5FFFFFFF
//&HLOS_4_log="HLOS_4_log.bin"

//GLOBAL &MBA_SW_start
//GLOBAL &MBA_SW_end
//GLOBAL &MBA_SW_size
//GLOBAL &MBA_SW_log
//&MBA_SW_start=0XD100000
//&MBA_SW_end=0XD1FBFFF
//&MBA_SW_size=0XFC000
//&MBA_SW_log="MBA_SW_log.bin"


//GLOBAL &MPSS_EFS_start
//GLOBAL &MPSS_EFS_end
//GLOBAL &MPSS_EFS_size
//GLOBAL &MPSS_EFS_log
//&MPSS_EFS_start=0XD900000
//&MPSS_EFS_end=0XDBFFFFF
//&MPSS_EFS_size=0X300000
//&MPSS_EFS_log="MPSS_EFS_log.bin"


// MPSS Image - 77 MB
GLOBAL &MPSS_SW_start
GLOBAL &MPSS_SW_end
GLOBAL &MPSS_SW_size
GLOBAL &MPSS_SW_log
&MPSS_SW_start=0x80000000
&MPSS_SW_end=0x81500000
&MPSS_SW_size=0x1500000
&MPSS_SW_log="MPSS_SW_log.bin"

GLOBAL &MPSS_TCM_start
&MPSS_TCM_start=0xFCC00000

// QDSS Image - 16 MB
//GLOBAL &QDSS_SW_start
//GLOBAL &QDSS_SW_end
//GLOBAL &QDSS_SW_size
//GLOBAL &QDSS_SW_log
//&QDSS_SW_start=0X10000000
//&QDSS_SW_end=0X10FFFFFF
//&QDSS_SW_size=0x1000000
//&QDSS_SW_log="QDSS_SW_log.bin"


GLOBAL &SMEM_start
GLOBAL &SMEM_end
GLOBAL &SMEM_size
GLOBAL &SMEM_log
&SMEM_start=0x08628000
&SMEM_end=0x08629000
&SMEM_size=0X10000
&SMEM_log="SMEM_log.bin"


GLOBAL &TZ_SW_start
GLOBAL &TZ_SW_end
GLOBAL &TZ_SW_size
GLOBAL &TZ_SW_log
&TZ_SW_start=0x81EC0000
&TZ_SW_end=0x82000000
&TZ_SW_size=0X140000
&TZ_SW_log="TZ_SW_log.bin"


// IPA memories and register spaces
//GLOBAL &IPA_IRAM_log
//GLOBAL &IPA_IRAM_IPA_start
//GLOBAL &IPA_IRAM_start
//GLOBAL &IPA_IRAM_end
//GLOBAL &IPA_IRAM_size
//&IPA_IRAM_log="IPA_IRAM.bin"
//&IPA_IRAM_IPA_start=0x0
//&IPA_IRAM_start=0xFD4F0000
//&IPA_IRAM_end=0xFD4F1FFF
//&IPA_IRAM_size=0x2000

//GLOBAL &IPA_DRAM_log
//GLOBAL &IPA_DRAM_IPA_start
//GLOBAL &IPA_DRAM_start
//GLOBAL &IPA_DRAM_end
//GLOBAL &IPA_DRAM_size
//&IPA_DRAM_log="IPA_DRAM.bin"
//&IPA_DRAM_IPA_start=0x4000
//&IPA_DRAM_start=0xFD4F4000
//&IPA_DRAM_end=0xFD4F7EFF
//&IPA_DRAM_size=0x3F00
//
//GLOBAL &IPA_SRAM_log 
//GLOBAL &IPA_SRAM_start
//GLOBAL &IPA_SRAM_end
//GLOBAL &IPA_SRAM_size
//&IPA_SRAM_log="IPA_SRAM.bin" 
//&IPA_SRAM_start=0xFD4E5100
//&IPA_SRAM_end=0xFD4E8FFF
//&IPA_SRAM_size=0x3F00
//
//GLOBAL &IPA_MBOX_log
//GLOBAL &IPA_MBOX_start
//GLOBAL &IPA_MBOX_end
//GLOBAL &IPA_MBOX_size
//&IPA_MBOX_log="IPA_MBOX.bin"
//&IPA_MBOX_start=0xFD4FA000
//&IPA_MBOX_end=0xFD4FA0FF
//&IPA_MBOX_size=0x100
//
//GLOBAL &IPA_REG1_log
//GLOBAL &IPA_REG1_start
//GLOBAL &IPA_REG1_end
//GLOBAL &IPA_REG1_size
//&IPA_REG1_log="IPA_REG1.bin"
//&IPA_REG1_start=0xFD4C4000
//&IPA_REG1_end=0xFD4D8FFF
//&IPA_REG1_size=0x15000
//
//GLOBAL &IPA_REG2_log
//GLOBAL &IPA_REG2_start
//GLOBAL &IPA_REG2_end
//GLOBAL &IPA_REG2_size
//&IPA_REG2_log="IPA_REG2.bin"
//&IPA_REG2_start=0xFD4E0000
//&IPA_REG2_end=0xFD4E4FFF
//&IPA_REG2_size=0x5000
//
//GLOBAL &IPA_REG3_log
//GLOBAL &IPA_REG3_start
//GLOBAL &IPA_REG3_end
//GLOBAL &IPA_REG3_size
//&IPA_REG3_log="IPA_REG3.bin"
//&IPA_REG3_start=0xFD4F8000
//&IPA_REG3_end=0xFD4F81FFF
//&IPA_REG3_size=0x2000


// DDR memory - combined space used by all images
GLOBAL &DDR_1_start
GLOBAL &DDR_1_end
GLOBAL &DDR_1_size
GLOBAL &DDR_1_log
GLOBAL &DDR_1_USB_log
&DDR_1_start=0x80000000
&DDR_1_end=0x82000000
&DDR_1_size=0x2000000
&DDR_1_log="DDR0CS0.BIN"
&DDR_1_USB_log="DDRCS0_0.BIN"

// This region is in the Shared IMEM block
// These are the cookies used to debug any image
// Allocation varies from target to target
GLOBAL &DEBUG_REGION_START
GLOBAL &DEBUG_REGION_END
GLOBAL &DEBUG_REGION_SIZE
GLOBAL &DEBUG_COOKIE_VALUE
GLOBAL &RPM_DEBUG_COOKIE
GLOBAL &SBL1_DEBUG_COOKIE
GLOBAL &MBA_DEBUG_COOKIE
GLOBAL &MPSS_DEBUG_COOKIE
GLOBAL &APPSBOOT_DEBUG_COOKIE
GLOBAL &MDM_DEBUG_COOKIE
&DEBUG_COOKIE_VALUE=0x53444247
&DEBUG_REGION_START=0xFE87F934
&DEBUG_REGION_END=0xFE87F94C
&DEBUG_REGION_SIZE=0x18
&SBL1_DEBUG_COOKIE=0x0
&RPM_DEBUG_COOKIE=0x8628B18
&MBA_DEBUG_COOKIE=0x08628938
&MPSS_DEBUG_COOKIE=0x08628934
&APPSBOOT_DEBUG_COOKIE=0xFE87F948
&MDM_DEBUG_COOKIE="&MPSS_DEBUG_COOKIE"

// OCIMEM section
GLOBAL &OCIMEM_start
GLOBAL &OCIMEM_end
GLOBAL &OCIMEM_size
GLOBAL &OCIMEM_log
GLOBAL &OCIMEM_USB_log
&OCIMEM_start=0x8600000
&OCIMEM_end=0x08629000
&OCIMEM_size=0x29000
&OCIMEM_log="OCIMEM.bin"
&OCIMEM_USB_log="OCIMEM.bin"

// Shared IMEM section
GLOBAL &SHARED_IMEM_start
GLOBAL &SHARED_IMEM_end
GLOBAL &SHARED_IMEM_size
GLOBAL &SHARED_IMEM_log
GLOBAL &SHARED_IMEM_USB_log
&SHARED_IMEM_start=0x08628000
&SHARED_IMEM_end=0x08629000
&SHARED_IMEM_size=0x1000
&SHARED_IMEM_log="SHARED_IMEM.bin"



// Relocatable Image support
GLOBAL &RELOCATION_DATA_start
GLOBAL &RELOCATION_DATA_end
GLOBAL &RELOCATION_DATA_size
&RELOCATION_DATA_start=&SHARED_IMEM_start+0x94C
&RELOCATION_DATA_end=&RELOCATION_DATA_start+0xC7
&RELOCATION_DATA_size=0xC8
// Each entry in the table is in the following format
// 8 bytes - image name
// 8 bytes - image start address
// 4 bytes - image size



GLOBAL &RPM_regs
GLOBAL &RPM_mmu
&RPM_regs="RPM_regs.cmm"
&RPM_mmu="RPM_regs.cmm"

GLOBAL &MPSS_Thread0_regs
&MPSS_Thread0_regs="MPSS_Thread0_regs.cmm"
GLOBAL &MPSS_Thread1_regs
&MPSS_Thread1_regs="MPSS_Thread1_regs.cmm"
GLOBAL &MPSS_Thread2_regs
&MPSS_Thread2_regs="MPSS_Thread2_regs.cmm"
GLOBAL &MPSS_Thread3_regs
&MPSS_Thread3_regs="MPSS_Thread3_regs.cmm"


GLOBAL &KPSS_Core3_regs
GLOBAL &KPSS_Core3_mmu
&KPSS_Core3_regs="KPSS_Core3_regs.cmm"
&KPSS_Core3_mmu="KPSS_Core3_mmu.cmm"





MAIN:
    ENTRY &LoadOption
   
    // Check if any attributes obtained at run time are needed
    If ("&LoadOption"=="DYNAMIC")
    (
            // Change any defaults
            IF (!SIMULATOR())
            (
                // Get relocated image info again
                GOSUB PARSE_IMAGE_RELOCATION
            )
            ELSE
            (
                // Do both together on simulator
                GOSUB RELOC_SIMEM_N_PARSE_IMAGE_RELOC
            )
    )

	GOTO EXIT

EXIT:
	ENDDO



// Function to parse relocated image data that is 
// saved in internal memory
// This function will be run once only unless a new 
// session has started
PARSE_IMAGE_RELOCATION:
	LOCAL &HEAD &TAIL &IMG_NAME &IMG_START &IMG_SIZE

	&HEAD=&RELOCATION_DATA_start
	&TAIL=&RELOCATION_DATA_end

	WHILE (&HEAD<=&TAIL)
	(
		// Null terminate the string
		DATA.SET EA:&HEAD+0x4 %LONG DATA.LONG(EA:&HEAD+0x4)&0xFFFFFF
	 	&IMG_NAME=DATA.STRING(EA:&HEAD)
		&IMG_START=DATA.LONG(EA:&HEAD+0xC)<<32.|DATA.LONG(EA:&HEAD+0x8)
		&IMG_SIZE=DATA.LONG(EA:&HEAD+0x10)

		// We have 5 images supported. No error if an image is not present
		IF ("&IMG_NAME"=="adsp")
		(
			&ADSP_SW_start=&IMG_START
			&ADSP_SW_size=&IMG_SIZE
			&ADSP_SW_end=&IMG_START+&IMG_SIZE-1
		)

		IF ("&IMG_NAME"=="modem")
		(
			&MPSS_SW_start=&IMG_START
			&MPSS_SW_size=&IMG_SIZE
			&MPSS_SW_end=&IMG_START+&IMG_SIZE-1
		)

		IF ("&IMG_NAME"=="wcnss")
		(
			&WCNSS_SW_start=&IMG_START
			&WCNSS_SW_size=&IMG_SIZE
			&WCNSS_SW_end=&IMG_START+&IMG_SIZE-1
		)

		// Move to the next entry
		&HEAD=&HEAD+0x14
	)

	RETURN


// Function to parse relocated image data that is 
// saved in internal memory and identify shared IMEM location
// This function will be run once only unless a new debug
// session has started	
RELOC_SIMEM_N_PARSE_IMAGE_RELOC:
	LOCAL &HEAD &TAIL &IMG_NAME &IMG_START &IMG_SIZE 
	LOCAL &RELOCATED &COUNT

	// Init locals
	&RELOCATED=0
	&COUNT=0

	// Start with default location for shared IMEM
	WHILE ((&RELOCATED==0)&&(&COUNT<1))
	(
		&HEAD=&RELOCATION_DATA_start
		&TAIL=&RELOCATION_DATA_end
		WHILE (&HEAD<=&TAIL)
		(
			// Null terminate the string
			DATA.SET EA:&HEAD+0x4 %LONG DATA.LONG(EA:&HEAD+0x4)&0xFFFFFF
		 	&IMG_NAME=DATA.STRING(EA:&HEAD)
			&IMG_START=DATA.LONG(EA:&HEAD+0xC)<<32.|DATA.LONG(EA:&HEAD+0x8)
			&IMG_SIZE=DATA.LONG(EA:&HEAD+0x10)

			// We have 5 images supported. No error if an image is not present
			IF ("&IMG_NAME"=="adsp")
			(
				&ADSP_SW_start=&IMG_START
				&ADSP_SW_size=&IMG_SIZE
				&ADSP_SW_end=&IMG_START+&IMG_SIZE-1
				&RELOCATED=1
			)

			IF ("&IMG_NAME"=="modem")
			(
				&MPSS_SW_start=&IMG_START
				&MPSS_SW_size=&IMG_SIZE
				&MPSS_SW_end=&IMG_START+&IMG_SIZE-1
				&RELOCATED=1
			)

			IF ("&IMG_NAME"=="wcnss")
			(
				&WCNSS_SW_start=&IMG_START
				&WCNSS_SW_size=&IMG_SIZE
				&WCNSS_SW_end=&IMG_START+&IMG_SIZE-1
				&RELOCATED=1
			)

			// Move to the next entry
			&HEAD=&HEAD+0x14
		)

		// Increment count
		&COUNT=&COUNT+1

	)

	// If we reach this point without finding relocated data, it means 911 time !
	IF (&RELOCATED==0)
	(
		PRINT "Relocated data not found at : &RELOCATION_DATA_start"
	)
	ELSE
	(
		PRINT "Relocated data found at : &RELOCATION_DATA_start"
	)

	RETURN


	

