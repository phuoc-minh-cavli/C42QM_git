GLOBAL &HLOS
&HLOS="MN"

; APSS Addresses
global &MN_HLOS1_DUMP_START_ADDR
&MN_HLOS1_DUMP_START_ADDR=0x80000000

global &MN_HLOS1_DUMP_SIZE
&MN_HLOS1_DUMP_SIZE=0x9FFFFF

global &MODEM_DDR_Q6SW_DUMP_START_ADDR
&MODEM_DDR_Q6SW_DUMP_START_ADDR=0x81000000

global &MODEM_DDR_Q6SW_DUMP_SIZE
&MODEM_DDR_Q6SW_DUMP_SIZE=0x677FFFF

global &Q6SW_START_ADDRESS
&Q6SW_START_ADDRESS=&MODEM_DDR_Q6SW_DUMP_START_ADDR

;ACDB address
global &ACDB_DUMP_START_ADDR
&ACDB_DUMP_START_ADDR=0x80CE0000

global &ACDB_DUMP_SIZE
&ACDB_DUMP_SIZE=0x1FFFF
