//============================================================================
//  Name:                                                                     
//    std_apps_msm8996.cmm
//
//  Description:                                                              
//    Script for CTI configurations specific to target
//
//  Usage
//  do std_cti_msm8992 <Subroutine>
//
//  where <Subroutine> is one of the following:
//      GETAPPSCORELIST - returns a string of all apps cores to be used in std_cti
//      SETCTIGPIOS - Configures TLMM to map GPIO's to CTI's for this target
//      HELP/help - prints help window
//     
//
// Copyright (c) 2012 - 2014 by Qualcomm Technologies, Incorporated.  All Rights Reserved.        
//
//
//
//                      EDIT HISTORY FOR FILE
//  This section contains comments describing changes made to the module.
//  Notice that changes are listed in reverse chronological order.
//
// when         who         what, where, why
// --------     ---        --------------------------------------------------------
// 08/11/2014   JBILLING    Added TESTCLOCK API, commented for FC
// 05/21/2014   JBilling    Added subroutines appropriately
// 10/29/2013   JBILLING    Created

//###################Arguments passed #####################

LOCAL &UTILITY &OPTION &IARG0 &IARG1 &IARG2 &IARG3 &IARG4 &IARG5 &IARG6 &IARG7 &IARG8 &IARG9 &IARG10 &IARG11
LOCAL &ArgumentLine
LOCAL &SUBROUTINE

ENTRY %LINE &ArgumentLine
ENTRY &UTILITY &OPTION &IARG0 &IARG1 &IARG2 &IARG3 &IARG4 &IARG5 &IARG6 &IARG7 &IARG8 &IARG9 &IARG10 &IARG11

//#####################Select Subroutine###################


// Input Argument 0 is the name of the utility
&SUBROUTINE="&UTILITY"
IF !(("&SUBROUTINE"=="APPSLIST")||("&SUBROUTINE"=="GETCORETYPE")||("&SUBROUTINE"=="SETCTIGPIOS")||("&SUBROUTINE"=="GETALLCORELIST")||("&SUBROUTINE"=="HELP")||("&SUBROUTINE"=="help"))
(
    &SUBROUTINE="HELP"
    PRINT %ERROR "std_cti_msm8992: Subroutine not found! Printing Help Window"
)

    // This should be created by some top level script. The setupenv for each proc would
    // set this up
    AREA.SELECT
    // Call the required utility
    GOSUB &SUBROUTINE &OPTION &IARG0 &IARG1 &IARG2 &IARG3 &IARG4 &IARG5 &IARG6 &IARG7 &IARG8 &IARG9 &IARG10 &IARG11
    ENTRY &PASS &RVAL0 &RVAL1 &RVAL2

    GOTO EXIT
    
APPSLIST:

    ENDDO "APPS0"

        
        
GETALLCORELIST:

        ENDDO "APPS0"

RETURN

GETCORETYPE:
   
         ENDDO A7
    
RETURN


 
    
help:
HELP:
    AREA.RESET
    AREA.CREATE std_cti_target_help 125. 23.
    AREA.SELECT std_cti_target_help
    WINPOS 5. 39. 125. 23.
    AREA.VIEW std_cti_target_help

    PRINT " Description:                                       "                       
    PRINT "   Script for CTI configurations specific to target"
    PRINT " "
    PRINT " Usage"
    PRINT " do std_cti_msm8992 <Subroutine>"
    PRINT " "
    PRINT " where <Subroutine> is one of the following:"
    PRINT "     GETAPPSCORELIST - returns a string of all apps cores to be used in std_cti"
    PRINT "     SETCTIGPIOS - Configures TLMM to map GPIO's to CTI's for this target"
    PRINT "     HELP/help - prints help window"

enddo

    
