//============================================================================
//  Name:                                                                     
//    std_extensions.cmm 
//
//  Description:                                                              
//    None 
//                                                                            
// Copyright (c) 2019 by QUALCOMM, Incorporated.  All Rights Reserved.        
//============================================================================
//                                                                            
// *** AUTO GENERATED FILE - DO NOT EDIT                                      
//                                                                            
// GENERATED: Mon Dec 23 01:59:50 2019 
//============================================================================

ENDDO