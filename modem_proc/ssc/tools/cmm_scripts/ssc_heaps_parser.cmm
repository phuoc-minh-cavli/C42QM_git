;============================================================================
;
; Sensors heaps parser
;
;   To be called by ssc_parser.cmm to walk the Sensor heaps
;
; Version: 2.0
;
; Copyright (c) 2017-2019 Qualcomm Technologies, Inc.
; All Rights Reserved.
; Qualcomm Technologies, Inc. Confidential and Proprietary.
;============================================================================

ENTRY

print "##### Heaps #####"

if &heap_info_avail==0
(
  print
  print "Heap info not available.  Heap analysis not performed."
  print
)
else
(
  gosub parse_heap_head &sns_island_heap_head
  gosub parse_heap_head &sns_batch_heap_head
  gosub parse_heap_head &sns_main_heap_head
  if Y.exist(sns_event_heap_head)
  (
    gosub parse_heap_head &sns_event_heap_head
  )
  gosub parse_heap_head &sns_pram_heap_head
)
print "==================================================================================="
print

enddo

; **********************************parse_heap_head***************************************
parse_heap_head:
  entry &heap_head
  &heap=V.VALUE(&heap_head)
  &mem_block_list_out="&parser_ouput_dir\&heap_head.csv"
  &heap_start=V.VALUE(((sns_mem_heap_type*)&heap)->first_block)
  &heap_name=Y.NAME(D:&heap_start)
  &total_blocks=V.VALUE(((sns_mem_heap_type*)&heap)->total_blocks)
  &used_blocks=0
  &total_bytes=V.VALUE(((sns_mem_heap_type*)&heap)->total_bytes)
  &used_bytes=V.VALUE(((sns_mem_heap_type*)&heap)->used_bytes)
  &heap_end=&heap_start+&total_bytes
  &max_free_block_size=0

  if &used_bytes!=0
  (
    OPEN  #1 &mem_block_list_out /Create
    WRITE #1 ""
    WRITE #1 "&heap_name"
    WRITE #1 "======================================================================================"
    WRITE #1 "  #Blocks,"+format.decimal(1.,&total_blocks)
    WRITE #1 "  #Bytes,"+format.decimal(1.,&total_bytes)
    WRITE #1 "  Used,""=sumif(f:f,""""0"""",d:d)"""
    WRITE #1 "  Used %,""=B6*100/B5"""
    WRITE #1 "======================================================================================"
    if !Y.exist(sns_event_heap_head)
    (
      ; for SLPI 2.2 and later
      ;        "A,     B,   C,       D,   E,    F,   G,           "
      WRITE #1 "Block#,Addr,HdrGuard,Size,Extra,Free,Caller Symbol"
    )
    else
    (
      ; for SLPI 2.1
      if V.VALUE(&heap_head)!=V.VALUE(&sns_event_heap_head)
      (
        ;        "A,     B,   C,       D,   E,    F,   G,           "
        WRITE #1 "Block#,Addr,HdrGuard,Size,Extra,Free,Caller Symbol"
      )
      else 
      (
        ;        "A,     B,   C,       D,   E,    F,   G,      H,    I,        J"
        WRITE #1 "Block#,Addr,HdrGuard,Size,Extra,Free,Clients,MsgID,Timestamp,Caller Symbol"
      )
    )

    &lastflag=0;
    &header_guard=1
    &block_count=1
    &used_bytes=0
    &curr_heap_mem=&heap_start
    while (&lastflag!=0x01)&&(&header_guard!=0)&&(&curr_heap_mem<&heap_end)
    (
      &header_guard=V.VALUE(((sns_mem_block_header_type*)&curr_heap_mem)->header_guard)
      &lastflag=V.VALUE(((sns_mem_block_header_type*)&curr_heap_mem)->last_flag)
      &freeflag=V.VALUE(((sns_mem_block_header_type*)&curr_heap_mem)->free_flag)
      &size=V.VALUE(((sns_mem_block_header_type*)&curr_heap_mem)->forw_offset)
      &extrabytes=V.VALUE(((sns_mem_block_header_type*)&curr_heap_mem)->extra)

      &writestring=format.DECIMAL(1, &block_count)
      &writestring="&writestring"+","+format.HEX(8, &curr_heap_mem)
      &writestring="&writestring"+","+format.HEX(1, &header_guard)
      &writestring="&writestring"+","+format.DECIMAL(1, &size)
      &writestring="&writestring"+","+format.DECIMAL(1, &extrabytes)
      &writestring="&writestring"+","+format.HEX(1, &freeflag)

      if !Y.exist(sns_event_heap_head)
      (
        &debug_info=V.VALUE(((sns_mem_block_header_type*)&curr_heap_mem)->caller_ptr)
        &debug_info_symbol=Y.NAME(D:&debug_info)
        if "&debug_info_symbol"!=""
        (
          &debug_info_symbol= "'"+string.split("&debug_info_symbol","\",-1)+"'"
        )
        &writestring="&writestring"+", "+"&debug_info_symbol"
      )
      else
      (
        if V.VALUE(&heap_head)!=V.VALUE(&sns_event_heap_head)
        (
          &debug_info=V.VALUE(((sns_mem_block_header_type*)&curr_heap_mem)->caller_ptr)
          &debug_info_symbol=Y.NAME(D:&debug_info)
          if "&debug_info_symbol"!=""
          (
            &debug_info_symbol= "'"+string.split("&debug_info_symbol","\",-1)+"'"
          )
          &writestring="&writestring"+", "+"&debug_info_symbol"
        )
        else
        (
          &event=&curr_heap_mem+&mem_block_header_size
          &num_clients=V.VALUE(((sns_fw_sensor_event*)&event)->header.client_cnt)
          &msg_id=V.VALUE(((sns_fw_sensor_event*)&event)->event.message_id)
          &timestamp=V.VALUE(((sns_fw_sensor_event*)&event)->event.timestamp)
          &writestring="&writestring"+","+format.DECIMAL(1, &num_clients)
          &writestring="&writestring"+","+format.DECIMAL(1, &msg_id)
          &writestring="&writestring"+","+format.DECIMAL(1, &timestamp)

          if &fw_event_header_size!=0x20
          (
            &debug_info=V.VALUE(((sns_fw_sensor_event*)&event)->header.caller)
            &debug_info_symbol=Y.FUNCTION(D:&debug_info)
            if "&debug_info_symbol"!=""
            (
              &debug_info_symbol= "'"+string.split("&debug_info_symbol","\",-1)+"'"
            )
            &writestring="&writestring"+", "+"&debug_info_symbol"
          )
        )
      )

      WRITE #1 "&writestring"

      if &freeflag==0
      (
        &used_blocks=&used_blocks+1
        &used_bytes=&used_bytes+&size
      )
      else if &size>&max_free_block_size
      (
        &max_free_block_size=&size
      )

      &curr_heap_mem=&curr_heap_mem+&size
      &block_count=&block_count+1
    )
    if &header_guard==0
    (
      &writestring=format.HEX(8.,&curr_heap_mem)
      &writestring="&writestring"+","+format.HEX(1, &header_guard)
      WRITE #1 "&writestring"
    )
    CLOSE #1
  )

  &used_pct=(&used_bytes*100.)/&total_bytes

  print
  print "&heap_head"
  if &used_bytes!=0
  (
    print "  List = &mem_block_list_out"
  )
  print "  Address            = &heap_start" " - " "&heap_end"
  print "  #Blocks            = "+format.decimal(8.,&total_blocks)
  print "  #Used Blocks       = "+format.decimal(8.,&used_blocks)
  print "  Size               = "+format.decimal(8.,&total_bytes)
  print "  Used               = "+format.decimal(8.,&used_bytes)+" ("+format.decimal(2.,&used_pct)+"%)"
  if &used_bytes!=0
  (
    print "  Largest free block = "+format.decimal(8.,&max_free_block_size)
  )

  return
; ************************************************************************************

