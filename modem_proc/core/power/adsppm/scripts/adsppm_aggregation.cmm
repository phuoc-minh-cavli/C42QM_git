;====================================================================
; Copyright (c) 2015 Qualcomm Technologies, Inc.
; All Rights Reserved.
; Qualcomm Technologies, Inc. Confidential and Proprietary.
;====================================================================

;===================================================================
; Name:  adsppm_aggregation.cmm
;
; Description:
;   Print out all the aggregated values and the contributions from 
;	client requests
;
;====================================================================

LOCAL &AggrOutput
&AggrOutput="adsppm_aggregated_outputs"

AREA.RESet

WINPOS 0. 0. 50% 100% , , AggrOutput
AREA.CREATE &AggrOutput 256. 1024.
AREA.CLEAR &AggrOutput
AREA.VIEW &AggrOutput
AREA.SELECT &AggrOutput

LOCAL &clientNode &clientName &clientId &client &clientNodeBckup
LOCAL &index &numClients &numClientsPrint
LOCAL &reqArray &reqNode &resIdToDump
LOCAL &rscIdx &counter &nRscClients

LOCAL &typeList
LOCAL &nTypes   ; of AdsppmRscIds

&output="PRINT"
&typeList=":power:core_clk:sleep_latency:mips:bw::mempower"

&nTypes=0
WHILE (VAR.STRING((AdsppmRscIdType)&nTypes)!="Adsppm_Rsc_Id_Max")
(
    &nTypes=&nTypes+1
)

PRINT ""
PRINT "--------------------------------------------------------------------------------"
PRINT %COLOR.PURPLE "ADSPPM client list"
PRINT "--------------------------------------------------------------------------------"
PRINT ""

&clientNode=V.VALUE(gAdsppmClientManager.clients.link.pNext)
&clientNodeBckup=&clientNode
&numClients=V.VALUE(gAdsppmClientManager.clients.nCnt)
&numClientsPrint=FORMAT.DECIMAL(0,&numClients)

PRINT %COLOR.GREEN "Total No. of clients  = &numClientsPrint"
PRINT ""
PRINT "--------------------------------------------------------------------------------"
;&resIdToDump=3	;Adsppm_Rsc_Id_Sleep_Latency
;GOSUB printReq &resIdToDump &clientNodeBckup
;PRINT "--------------------------------------------------------------------------------"
GOSUB printMIPSMgr
PRINT "--------------------------------------------------------------------------------"
&resIdToDump=4	;Adsppm_Rsc_Id_Mips
GOSUB printReq &resIdToDump &clientNodeBckup
PRINT "--------------------------------------------------------------------------------"
GOSUB printBusMgr
PRINT "--------------------------------------------------------------------------------"
&resIdToDump=5	;Adsppm_Rsc_Id_BW
GOSUB printReq &resIdToDump &clientNodeBckup
PRINT "--------------------------------------------------------------------------------"
GOSUB printSleep
PRINT "--------------------------------------------------------------------------------"
PRINT ""
PRINT %COLOR.PURPLE "Dump Completed"

GOSUB cleanup_exit

; This is the generic code to print the respect data for mips/bus/sleep etc.
printReq:
	ENTRY &resIdToDump &clientNodeBckup

	&index=0

	&clientNode=&clientNodeBckup

	WHILE &index<&numClients
	(
		&client=&clientNode+8
		PRIVATE &shortTypeName

		&reqArray=VAR.VALUE(gAdsppmCoreCtx.rscReqQ)
		&rscIdx=&resIdToDump

		IF (&rscIdx<&nTypes)
		(
			; Parse for a specific resource type
			&shortTypeName=STRING.LoWeR(STRING.MID(VAR.STRING((AdsppmRscIdType)&rscIdx),14.,100.))  ; e.g. power, mips, bw

			IF (STRing.SCAN("&typeList",":&shortTypeName",0.)>=0)
			(
				&reqNode=VAR.VALUE(gAdsppmCoreCtx.rscReqQ[&rscIdx-1].link.pNext)        ; Head of the list of clients for the current resource type
				&nRscClients=VAR.VALUE(((coreUtils_Q_Type *)&reqArray)[&rscIdx-1].nCnt) ; number of clients for the current resource type
				&counter=0

				WHILE (&counter<&nRscClients)
				(
					IF (&counter==&index)
					(
						IF ("&shortTypeName"=="sleep_latency")
                        (
                            GOSUB printLatency &client &reqNode
                        )
						ELSE IF ("&shortTypeName"=="mips")
						(
							GOSUB printMIPS &client &reqNode
						)
						ELSE IF ("&shortTypeName"=="bw")
						(
							GOSUB printBW &client &reqNode
						)
					)    ; if counter == index
				
					&reqNode=VAR.VALUE((*((coreUtils_Q_LinkType *)&reqNode)).pNext)
					&counter=&counter+1
				)   ; counter < nRscClients loop
			)
		) ; rscIdx loop

		&clientNode=V.VALUE((*((coreUtils_Q_LinkType *)&clientNode)).pNext)
		&index=&index+1	
	) ; index loop
RETURN

;
;   ADSPPM Sleep Latency requests
;
printLatency:
    ENTRY   &client &reqNode
    LOCAL   &validFlag &validFlagExt &reqData &latencyVote
	
	&clientId=FORMAT.DECIMAL(3.,V.VALUE((*((AdsppmClientType *)&client)).clientId))
	&clientName=DATA.STRING(D:V.VALUE((*((AdsppmClientType *)&client)).clientName))

    &validFlag=VAR.VALUE((*((RMHandleType *)&reqNode)).validFlag)
    &validFlagExt=VAR.VALUE((*((RMHandleType *)&reqNode)).validFlag_Ext)
    &reqData=VAR.VALUE((*((RMHandleType *)&reqNode)).pRequestData)
    &latencyVote=FORMAT.DECIMAL(0,VAR.VALUE(*((uint32 *)(&reqData))))

    IF &validFlag==1
    (
		&output  FORMAT.STRing("&clientName",15.,' ') "CID: &clientId   latencyVote       : &latencyVote" 
    )

RETURN

;
;   ADSPPM Bandwidth requests
;
printBW:
    ENTRY   &client &reqNode
    LOCAL   &validFlag &validFlagExt &reqData &reqDataExt &numBwReq &bwReq
    LOCAL   &bwIndex &bwIndexPrint &reqArray
    LOCAL   &bytesPerSec &usagePercentage

    &validFlag=VAR.VALUE((*((RMHandleType *)&reqNode)).validFlag)
    &validFlagExt=VAR.VALUE((*((RMHandleType *)&reqNode)).validFlag_Ext)
    &reqData=VAR.VALUE((*((RMHandleType *)&reqNode)).pRequestData)
    &reqDataExt=VAR.VALUE((*((RMHandleType *)&reqNode)).pRequestData_Ext)
    &numBwReq=VAR.VALUE((*((AdsppmBwReqType *)&reqData)).numOfBw)

    &bwReq=FORMAT.DECIMAL(0,VAR.VALUE((*((AdsppmBwReqType *)&reqData)).pBwArray))

    IF &validFlag==1||&validFlagExt==1
    (
		&clientId=FORMAT.DECIMAL(3.,V.VALUE((*((AdsppmClientType *)&client)).clientId))
		&clientName=DATA.STRING(D:V.VALUE((*((AdsppmClientType *)&client)).clientName))
	)
	
    IF &validFlag==1
    (
        &bwIndex=0
        &bwIndexPrint=FORMAT.DECIMAL(1.,&bwIndex)
        &reqArray=VAR.VALUE((*((AdsppmBwReqType *)&reqData)).pBwArray)

        WHILE (&bwIndex<&numBwReq)
        (
            &bwReq=VAR.VALUE((AdsppmBusBWRequestValueType *)&reqArray)+Var.SIZEOF(((AdsppmBusBWRequestValueType *)&reqArray)[0])*&bwIndex

            &bytesPerSec=FORMAT.UDECIMAL(10.,VAR.VALUE((*((AdsppmBusBWRequestValueType *)&bwReq)).bwValue.busBwValue.bwBytePerSec))
            &usagePercentage=FORMAT.DECIMAL(5.,VAR.VALUE((*((AdsppmBusBWRequestValueType *)&bwReq)).bwValue.busBwValue.usagePercentage))
            &output  FORMAT.STRing("&clientName",15.,' ') "CID: &clientId" FORMAT.STRing("BW-> ",-10.,' ') "&bwIndexPrint    BytesPerSec &bytesPerSec" " : Usage% &usagePercentage"

            &bwIndex=&bwIndex+1
            &bwIndexPrint=FORMAT.DECIMAL(0,&bwIndex)
        )
    )

    IF &validFlagExt==1
    (
		&bwIndex=0
		&bwIndexPrint=FORMAT.DECIMAL(1.,&bwIndex)
        &bytesPerSec=FORMAT.UDECIMAL(10.,VAR.VALUE((*((AdsppmBusBWRequestValueType *)&reqDataExt)).bwValue.busBwValue.bwBytePerSec))
        &usagePercentage=FORMAT.DECIMAL(5.,VAR.VALUE((*((AdsppmBusBWRequestValueType *)&reqDataExt)).bwValue.busBwValue.usagePercentage))
        &output  FORMAT.STRing("&clientName",15.,' ') "CID: &clientId" FORMAT.STRing("Reg->",-10.,' ') "&bwIndexPrint    BytesPerSec &bytesPerSec" " : Usage% &usagePercentage"
    )
	RETURN

printBusMgr:
    PRIVATE &preCurrentIndex &indexToDump
    PRIVATE &masterPort &slavePort
    PRIVATE &abVal &ibVal &latVal

    IF (sYmbol.EXIST("gBusMgrCtx"))
    (
        ; General Info
        &preCurrentIndex=VAR.VALUE(gBusMgrCtx.preCurrentIndex)
        &indexToDump=&preCurrentIndex^1

        &masterPort=VAR.STRING((*(gBusMgrCtx.pExtBwAggregateData[&indexToDump])).busRoute.masterPort)
        &slavePort=VAR.STRING((*(gBusMgrCtx.pExtBwAggregateData[&indexToDump])).busRoute.slavePort)
        &abVal=FORMAT.DECIMAL(0.,VAR.VALUE((*(gBusMgrCtx.pExtBwAggregateData[&indexToDump])).bwValue.busBwAbIb.Ab))
        &ibVal=FORMAT.DECIMAL(0.,VAR.VALUE((*(gBusMgrCtx.pExtBwAggregateData[&indexToDump])).bwValue.busBwAbIb.Ib))
		&latVal=FORMAT.DECIMAL(0.,VAR.VALUE((*(gBusMgrCtx.pExtBwAggregateData[&indexToDump])).bwValue.busBwAbIb.latencyNs))
		PRINT ""
		&output  %COLOR.BLUE "Total DDR BW Aggr    AB : &abVal    IB : &ibVal    lat : &latVal"
    )
    ELSE
    (
        &err "Ignoring BusMgr dump: No such symbol"
    )
RETURN

;
;   ADSPPM MIPS requests
;
printMIPS:
    ENTRY   &client &reqNode
    LOCAL   &validFlag &validFlagExt &reqData
    PRIVATE &mppsTotal &adspFloorClock

    &validFlag=VAR.VALUE((*((RMHandleType *)&reqNode)).validFlag)
    &validFlagExt=VAR.VALUE((*((RMHandleType *)&reqNode)).validFlag_Ext)
    &reqData=VAR.VALUE((*((RMHandleType *)&reqNode)).pRequestData)

    IF &validFlag==1||&validFlagExt==1
    (
	&clientId=FORMAT.DECIMAL(3.,V.VALUE((*((AdsppmClientType *)&client)).clientId))
    &clientName=DATA.STRING(D:V.VALUE((*((AdsppmClientType *)&client)).clientName))
	)

    IF &validFlag==1
    (
		&mppsTotal=FORMAT.DECIMAL(5.,VAR.VALUE((*((AdsppmQ6ClockRequestInfoType *)&reqData)).AdsppmQ6ClockRequestType.mppsRequestData.mppsTotal))
		&adspFloorClock=FORMAT.DECIMAL(5.,VAR.VALUE((*((AdsppmQ6ClockRequestInfoType *)&reqData)).AdsppmQ6ClockRequestType.mppsRequestData.adspFloorClock))
		&output  FORMAT.STRing("&clientName",15.,' ') "CID: &clientId    MPPS total &mppsTotal    ADSP floor clock &adspFloorClock"
    )
RETURN

printMIPSMgr:
    PRIVATE &qdsp6Clk
    IF (sYmbol.EXIST("mipsMgrCtx"))
    (
        ; MPPS Aggregate Data
        PRIVATE &totalMPPS &nDominantThreads

        &totalMPPS=FORMAT.Decimal(0.,VAR.VALUE(mipsMgrCtx.mppsAggregateData.mppsTotal))
        &nDominantThreads=FORMAT.Decimal(0.,VAR.VALUE(mipsMgrCtx.mppsAggregateData.numDominantThreads))
        &qdsp6Clk=FORMAT.DECIMAL(0.,VAR.VALUE(mipsMgrCtx.currentAggregateData.mipsToClockData.qDSP6Clock))
		PRINT ""
		&output  %COLOR.BLUE "Total MPPS Aggr    MPPS : &totalMPPS    Dominant Threads: &nDominantThreads    QDSP6_Clk : &qdsp6Clk"
    )
    ELSE
    (
        &err "Ignoring mipsMgr dump: no such symbol"
    )
RETURN

printSleep:
    IF (sYmbol.EXIST("gUSleepMgrCtx"))
    (
		PRIVATE &activeStateIndex &currActiveStateIndex
		PRIVATE &currentSleepVote &maxVoterId &currVoterIndex
		PRIVATE	&currVote

		&maxVoterId=0
		WHILE (VAR.STRING((USleepMgr_VoterIdType)&maxVoterId)!="USleepMgr_VoterId_Max")
		(
			&maxVoterId=&maxVoterId+1		;this includes USleepMgr_VoterId_None
		)
        &activeStateIndex=VAR.VALUE(gUSleepMgrCtx.activeStateIndex)
        &currActiveStateIndex=&activeStateIndex^1
		
		&currentSleepVote=VAR.VALUE((gUSleepMgrCtx.currentAggrVote[&currActiveStateIndex]))
		PRINT ""
		&output  %COLOR.BLUE "Final Sleep Vote &currentSleepVote ("+VAR.STRING((USleepMgr_VoteType)&currentSleepVote)+")"
		PRINT "--------------------------------------------------------------------------------"

		&currVoterIndex=0
		WHILE (&currVoterIndex<(&maxVoterId-1))
        (
			&currVote=VAR.VALUE((gUSleepMgrCtx.votes[&currVoterIndex]))
			&currVoterIndex=&currVoterIndex+1
			&output FORMAT.STRing(VAR.STRING((USleepMgr_VoterIdType)&currVoterIndex),30.,' ') ": "+VAR.STRING((USleepMgr_VoteType)&currVote)
		)
	)
	ELSE
    (
        &err "Ignoring uSleep dump: no such symbol"
    )
RETURN

cleanup_exit:
    AREA.CLOSE  ; close everything since we're exiting

    IF ("&output"!="PRINT")
    (
        CLOSE #1
    )

    PRINT %COLOR.PURPLE "Exiting..."
    ENDDO