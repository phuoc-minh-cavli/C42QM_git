;============================================================================
;  Name:
;    NAND_PAGE_UTIL.CMM
;
;  Description:
;    NAND block utility for Lauterbach JTAG/ICD TRACE32.
;
;  Execution:
;    Inside the debugger, type at the command line: "do pageutil".  Make
;    menu choices as directed.
;
;  Copyright (c) 2008-2011,2014-2016, 2019 Qualcomm Technologies, Incorporated.
;  All Rights Reserved.
;  Qualcomm Confidential and Proprietary
;----------------------------------------------------------------------------
;============================================================================
;
;                        EDIT HISTORY FOR MODULE
;
;
; when       who     what, where, why
; -------    ---     --------------------------------------------------------
; 06/11/19   sl     Added support for multipage read.
; 04/16/19   sl     Remove any reference to "0:"
; 08/17/16   eo     Fix WinPOS compatibility issue with latest t32 builds 
; 05/07/15   sb     Update settings for 9x55 Virtio
; 06/04/14   sb     Update to support 9x45
; 03/21/11   jz     Updated to support new T32 versions
; 04/15/10   jz     Added 2X support
; 03/31/10   sb     Fix for "emulation debug port time-out at C:0x0" in 0:Exit
; 07/08/09   mm     Added new mode to disable ECC for OneNAND
; 05/20/09   jz     Added checking of flash_tools_disable_ecc existance
; 02/25/09   eo     Disable HW ECC in Onenand for RAW mode page access.
; 11/16/04   mm     Created
;============================================================================;

;============================================================================
; Declare variables used
;============================================================================
local &DoDebug
local &Verbose
local &ClearWin
local &Choice
local &Assertion
local &PauseTime
local &BlockToMark
local &CurrentCmd
local &Page
local &PageCount
local &EccDefaultState
local &MainSpareState
local &FillValue
local &ResetPartitionConfig
local &DefaultMode
local &Addr

;============================================================================
; Set up some defaults for some variables
;============================================================================
&DoDebug="no"          ; Do not do debugging
&Verbose="yes"         ; Do not present status messages as we process
&ClearWin="yes"         ; Remove all windows before starting
&PauseTime="10.ms"     ; Time to pause without action
&ResetPartitionConfig=0

;============================================================================
; For normal use set up the screen with only area window for reports
; For debug purposes, don't clear
; In both cases, make sure we have an area window
;============================================================================
if "&ClearWin"=="yes"
(
  WinCLEAR
  WinPage.Reset
)

;============================================================================
; Set some MSM specific variables used later in flash.target command
;    &nandCodeAddr=
;    &nandParamAddr=
;    &nandCpuType=
;============================================================================
do nand_param
winclear
area.reset
area.create NAND_OUT 200. 1000.
winpos 0% 0% 49% 49% , , , NAND_OUT
area.view NAND_OUT
area.clear NAND_OUT
winpos 0% 49% 49% 49% , , , NAND
area.create NAND 200. 1000.
area.view NAND
area.clear NAND

area.select NAND
wintop NAND
screen.display


;============================================================================
; 1) Set variables used to set up the JTAG debugger for this MSM
; 2) Init important MSM/ASB registers
;    use existing external script that is MSM specific
;============================================================================
do &NandConfigDir/nand_msm_init

;-------------------------------------------------------------------------------
; Set some variables used later on to peek and poke parameter block
;   This script file is sourced by both nand.cmm and nandtest.cmm
;-------------------------------------------------------------------------------
do nand_init.cmm

;-------------------------------------------------------------------------------
; Initialize ECC state to Enabled
;-------------------------------------------------------------------------------
&EccDefaultState=&EccEnabledMainSpare

;-------------------------------------------------------------------------------
; Initialize Main and/or Spare state
;-------------------------------------------------------------------------------
local &MainOnly &SpareUdataOnly &MainSpareUdata &Raw
&MainOnly=0.
&SpareUdataOnly=1.
&MainSpareUdata=2.
&Raw=3.
&MainSpareState=&MainSpareUdata

;-------------------------------------------------------------------------------
; Initialize 2X mode to Disabled
;-------------------------------------------------------------------------------
&DefaultMode=&Mode2XDisabled

;======================================================
; Load our flash programming routine and prepare flash
;======================================================
d.load.elf &NandJtagToolsDir/NandJtagTools.elf /VERIFY

; need this breakpoint as per Lauterbach Spec so that we
; can hand back control to the Debugger
break.delete /ALL
break.set hanghere /onchip /program

;============================================================================
; Present user with normal main menu for NAND.  Manual selection is done.
;============================================================================
area.clear NAND

MainMenu:
  print
  print "------------------------------------------------"
  print "|       _   _    _    _   _ ____               |"
  print "|      | \ | |  / \  | \ | |  _ \              |"
  print "|      |  \| | / _ \ |  \| | | | |             |"
  print "|      | |\  |/ ___ \| |\  | |_| |             |"
  print "|      |_| \_/_/   \_\_| \_|____/              |"
  print "|                                              |"
  print "|                Page  Utility                 |"
  print "|                                              |"
  print "|     Copyright (c) 2009 by QUALCOMM, Inc.     |"
  print "|                                              |"
  print "------------------------------------------------"
  print
  print " 0: Exit"
  print " Configure ECC state:"
  print "     2. Enable ECC on Main and Spare (default)"
  print "     3. Disable ECC"
  print " Configure Read/Write Data state:"

  if &EccDefaultState!=&EccDisabled
  (
    print "     4. Main Only"
    print "     6. Main and Spare Udata"
  )
  else
  (
    print "     7. Raw (Main + Spare Udata + ECC)"
  )
  print " Operation:"
  print " 8. Read Page"
  print " 9. Write Page"

  print "-----------------------------------"
  if &EccDefaultState==&EccEnabledMain
  (
    print " ECC state : Enabled on Main only"
  )
  if &EccDefaultState==&EccEnabledMainSpare
  (
    print " ECC state : Enabled on Main and Spare"
  )
  if &EccDefaultState==&EccDisabled
  (
    print " ECC state : Disabled"
  )

  if &MainSpareState==&MainOnly
  (
    print " Data state : Main only"
  )
  if &MainSpareState==&SpareUdataOnly
  (
    print " Data state : Spare Udata only"
  )
  if &MainSpareState==&MainSpareUdata
  (
    print " Data state : Main and Spare Udata"
  )
  if &MainSpareState==&Raw
  (
    print " Data state : Raw (Main + Spare Udata + ECC)"
  )
  print "-----------------------------------"
  print " Please make a choice: "

  &t32_cmm_stopped=1
  enter &Choice
  &t32_cmm_stopped=0
  print "-----------------------------------"

  print
  print

  if "&Choice"=="" 
  (
    goto MainMenu
  )

  if &Choice==0
  (
    print "...exiting NAND Page Utility"
    gosub CleanUpExit
    enddo
  )

  if &Choice==2
  (
    print "Setting ECC state to enabled on Main and Spare"
    &EccDefaultState=&EccEnabledMainSpare
    &MainSpareState=&MainSpareUdata
    ;======================================================
    ; Load our flash programming routine and prepare flash
    ;======================================================
    d.load.elf "&NandJtagToolsDir/NandJtagTools.elf" /VERIFY
    break.set tools_can_update_config /WRITE
    &ResetPartitionConfig=1
  )

  if &Choice==3
  (
    print "Setting ECC state to disabled on Main and Spare"
    &EccDefaultState=&EccDisabled
    &MainSpareState=&Raw
    
  )

  if &Choice==4
  (
    print "Setting Data state to Main Only"
    &MainSpareState=&MainOnly
  )

  if &Choice==6
  (
    print "Setting Data state to Main and Spare Udata"
    &MainSpareState=&MainSpareUdata
  )

  if &Choice==7
  (
    print "Setting Data state to Raw (Main+SpareUdata+ECC) Only"
    &MainSpareState=&Raw
  )

  if &Choice==8
  (
    print
    print
    print "Enter page to retrieve (do not forget 0x or . to define radix)::  "
    &t32_cmm_stopped=1
    enter &Page
    &t32_cmm_stopped=0
    print "Enter number of pages to read (Max Allowed is 10(0xA) pages)::  "
    &t32_cmm_stopped=1
    enter &PageCount
    &t32_cmm_stopped=0
    print

    gosub ReadPage
  )

  if &Choice==9
  (
    gosub FillPage
  )

  if &Choice>9
  (
    print "Invalid option: " &Choice " Please see below available options"
    print "Press any key to return to main menu   "
    &t32_cmm_stopped=1
    enter &Continue
    &t32_cmm_stopped=0
  )

  goto MainMenu

enddo

;=====================================================
; --- Function to clean up just before exit
;=====================================================
CleanUpExit:
  ;--------------------------------------------------------
  ; ok we're finished completely, clean up for exit
  ;--------------------------------------------------------
  winclear
  ;sys.d
  b.delete /all
  ;sys.u
return


;=====================================================
; --- Function to check command status return
;       and exit if 0x100
;=====================================================
check_status:
  wait !run()
  do print_output_buffer
  &Result=data.long(A:&ParmStatus)
  if &Result==0x100
  (
    print " "
    print "---- &Command failed"
    &Result=data.long(A:&ParmReserved)
    do flash_prog_error &Result
    print " "

    print "Press any key to return to main menu   "
    &t32_cmm_stopped=1
    enter &Continue
    &t32_cmm_stopped=0
  )
  else
  (
    if (&Result==&CurrentCmd)
    (
      print " "
      print "----  DID NOT COMPLETE &Command"
      print &Result
      print " "
    )
    else
    (
      if "&Verbose"=="yes"
      (
        print "+++++ &Command Succeeded"
      )
    )
  )
return



;=====================================================
; --- Function to read a page and display it
;=====================================================
ReadPage:
  &Command="Read Page"

  data.set &ParmSize %LONG &MainSpareState
  data.set &ParmWidth %LONG &PageCount
  data.set &ParmCmd %LONG &ReadPageCmd
  &CurrentCmd=&ReadPageCmd
  data.set &ParmReserved %LONG &Page
  r.s pc &StartAddr
  go
  if &ResetPartitionConfig==1
  (
    gosub reconfigure_partition
    go
  )
  gosub check_status  ;; returns even if error found

  if &MainSpareState!=&Raw
  (
    winclear MAINAREA
    WinPOS 50% 0% 50% 70% 0. 0. MAINAREA NORMAL "Main Data"
    data.dump d.l(v.address("page_buff_desc.BufInfo[0].PhysicalAddr"))

    winclear SPAREAREA
    WinPOS 50% 70% 50% 30% 0. 0. SPAREAREA NORMAL "Spare Data"
    data.dump d.l(v.address("page_buff_desc.BufInfo[1].PhysicalAddr"))
  )
  else
  (
    winclear MAINAREA
    WinPOS 50% 0% 50% 70% 0. 0. MAINAREA NORMAL "Main+Spare Data"
    data.dump d.l(v.address("page_buff_desc.BufInfo[0].PhysicalAddr"))
    winclear SPAREAREA
  )
return

;=====================================================
; --- Function to fill a page with a 32-bit value
;=====================================================
FillPage:
  &Command="fill Page"

  print "Do not forget 0x or . to define radix for data entry!  "

  print
  print
  print "Enter page to fill ::  "
  &t32_cmm_stopped=1
  enter &Page
  &t32_cmm_stopped=0
  print

  print
  print
  print "Enter 32-bit value to use for filling page ::  "
  &t32_cmm_stopped=1
  enter &FillValue
  &t32_cmm_stopped=0
  print


  data.set &ParmSize %LONG &FillValue
  data.set &ParmWidth %LONG &MainSpareState
  data.set &ParmCmd %LONG &FillPageCmd
  &CurrentCmd=&FillPageCmd
  data.set &ParmReserved %LONG &Page
  r.s pc &StartAddr

  go
  if &ResetPartitionConfig==1
  (
    gosub reconfigure_partition
    go
  )
  gosub check_status  ;; returns even if error found

return

;=====================================================
; --- Function to fill a page with 16-bit ordinals
;=====================================================
FillPageWithOrdinals:
  &Command="fill Page with ordinals"


  print "Do not forget 0x or . to define radix for data entry!  "

  print
  print
  print "Enter page to fill ::  "
  &t32_cmm_stopped=1
  enter &Page
  &t32_cmm_stopped=0
  print
  print
  print
  print

  data.set &ParmSize %LONG &EccDefaultState
  data.set &ParmCmd %LONG &FillPageOrdCmd
  &CurrentCmd=&FillPageOrdCmd
  data.set &ParmReserved %LONG &Page
  r.s pc &StartAddr

  go
  gosub check_status  ;; returns even if error found

return


;=====================================================
; --- Function to reset ECC state of all partition
;=====================================================
reconfigure_partition:
  wait !run()
  V client_ctxt->client_data.ecc_state = &EccDefaultState
  b.d
  break.set hanghere /onchip /program
  &ResetPartitionConfig=0

return

END
