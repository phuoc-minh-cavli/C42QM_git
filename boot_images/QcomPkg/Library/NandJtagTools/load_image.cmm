;============================================================================
;  Name:
;    LOAD_IMAGE.CMM
;
;  Description:
;    Setup image's location for downloading from different builds.
; 
;    This script should be invoked from another .cmm script before mjnand.cmm is called.
;
;  Usage: do load_image.cmm <IMAGE_TYPE> <IMAGE_FULL_PATH>
;    e.g.,
;      do load_image partition \\boot_image_build\build\ms\bin\AAABQNBG\partition.mbn
;      do load_image sbl \\boot_image_build\build\ms\bin\AAABQNBG\sbl1.mbn
;      do load_image sbl2 \\boot_image_build\build\ms\bin\AAABQNBG\sbl2.mbn
;      do load_image dspsw \\boot_image_build\build\ms\bin\AAABQNBG\dsp2.mbn
;      do load_image dspfw \\boot_image_build\build\ms\bin\AAABQNBG\dsp1.mbn
;
;  Copyright (c) 2011-2012,2015,2018-2019,2022 by Qualcomm Technologies, Inc.
;  All Rights Reserved.
;  Qualcomm Confidential and Proprietary
;----------------------------------------------------------------------------
;============================================================================
;
;                        EDIT HISTORY FOR MODULE
;
;
; when       who     what, where, why
; -------    ---     --------------------------------------------------------
; 11/08/22   sk      Add DevcfgFota partition image support for 9205.TX.2.1
; 02/19/19   sl      Add QdspTiny partition image support for 9205
; 12/04/18   sl      Add QdspPaging partition image support for 9205
; 08/24/18   sl      Add Pmic partition image support for VT
; 10/13/17   eo      Add Qhee partition image support for sdx24
; 07/31/15   sb      Add AVS image programming support for 9x55
; 03/05/12   eo      Replace WDT name reference with SDI 
; 11/07/12   eo      Add ACDB image programming support for 9x25
; 09/10/12   eo      Update image ids for 9x25
; 08/23/11   eo      Add Appsbl image support
; 07/22/11   sv      Update DSP3 variable image name
; 07/15/11   jz      Initial version
;============================================================================;

entry &ImageType &Image &PartitionName
global &Parti &Sbl1
global &Apps &AppsBoot &Tz &Sdi &Rpm &Avs &Mba &QDsp &ADsp &Acdb
global &TzDevcfg &Apdp &XblConfig &MultiImageQti &MultiImage &Aop &Uefi &Abl &Toolsfv &Qhee
global &Pmic &QdspPaging &QdspTiny &DevcfgFota


if "&ImageType"=="partition"
(
  &Parti="&Image"
)
else if "&ImageType"=="sbl"
(
  &Sbl1="&Image"
)
else if "&ImageType"=="tz"
(
  &Tz="&Image"
)
else if "&ImageType"=="sdi"
(
  &Sdi="&Image"
)
else if "&ImageType"=="mba"
(
  &Mba="&Image"
)
else if "&ImageType"=="apps"
(
  &Apps="&Image"
)
else if "&ImageType"=="appsboot"
(
  &AppsBoot="&Image"
)
else if "&ImageType"=="rpm"
(
  &Rpm="&Image"
)
else if "&ImageType"=="avs.mdsp"
(
  &Avs="&Image"
)
else if "&ImageType"=="qdsp"
(
  &QDsp="&Image"
)
else if "&ImageType"=="adsp"
(
  &ADsp="&Image"
)
else if "&ImageType"=="acdb"
(
  &Acdb="&Image"
)
else if "&ImageType"=="tz_devcfg"
(
  &TzDevcfg="&Image"
)
else if "&ImageType"=="apdp"
(
  &Apdp="&Image"
)
else if "&ImageType"=="xbl_config"
(
  &XblConfig="&Image"
)
else if "&ImageType"=="multi_image_qti"
(
  &MultiImageQti="&Image"
)
else if "&ImageType"=="multi_image"
(
  &MultiImage="&Image"
)
else if "&ImageType"=="aop"
(
  &Aop="&Image"
)
else if "&ImageType"=="uefi"
(
  &Uefi="&Image"
)
else if "&ImageType"=="abl"
(
  &Abl="&Image"
)
else if "&ImageType"=="toolsfv"
(
  &Toolsfv="&Image"
)
else if "&ImageType"=="qhee"
(
  &Qhee="&Image"
)
else if "&ImageType"=="pmic"
(
  &Pmic="&Image"
)
else if "&ImageType"=="qdsp_paging"
(
  &QdspPaging="&Image"
)
else if "&ImageType"=="qdsp_tiny"
(
  &QdspTiny="&Image"
)
else if "&ImageType"=="devcfg_fota"
(
  &DevcfgFota="&Image"
)