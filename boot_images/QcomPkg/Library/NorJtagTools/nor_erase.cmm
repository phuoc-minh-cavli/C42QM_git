;============================================================================
;  Name:
;    NOR_ERASE.CMM
;
;  Description:
;    Lauterbach JTAG/ICD TRACE32 script to erase entire NOR flash.
;
;  Execution:
;    Inside the debugger, type at the command line: "do nor_erase".  Make
;    menu choices as directed.
;
;       OR
;
;   If you absolutely know what you are doing and want to bypass menu,
;      type:
;
;            "do nor_erase NOMENU"
;
;      and the script will not prompt you at all
;
;  Copyright (c) 2010-2011, 2014, 2016 Qualcomm Technologies, Incorporated.  
;  All Rights Reserved.
;  Qualcomm Confidential and Proprietary
;----------------------------------------------------------------------------
;============================================================================
;
;                        EDIT HISTORY FOR MODULE
;
;
; when       who     what, where, why
; -------    ---     --------------------------------------------------------
; 08/17/16   eo     Fix WinPOS compatibility issue with latest t32 builds 
; 06/21/16   eo     Add spi-nor tools support
; 03/31/14   whc     Updated to load correct param and elf
; 03/21/11   jz      Updated to support new T32 versions
; 09/02/10   sv      Created
;============================================================================;



;============================================================================
; Declare variables used
;============================================================================
local &MenuMode
local &DoDebug 
local &Verbose
local &ClearWin
local &Choice
local &CurrentCmd
local &CheckStatusExit
local &GoForIt
; this variable is used in setuphwio.cmm for Determine the MSM id
global &jload_build_msm

;============================================================================
; Set up some defaults for some variables
;============================================================================
&DoDebug="no"           ; Do not do debugging      
&ClearWin="yes"         ; Remove all windows before starting
&Verbose="yes"          ; Tell the user what is happening
&CheckStatusExit="yes"  ; Exit on failure

;============================================================================
; Get the arguments passed in.
;============================================================================
ENTRY &GoForIt


;============================================================================
; For normal use set up the screen with only area window for reports 
; For debug purposes, don't clear
; In both cases, make sure we have an area window
;============================================================================

if "&ClearWin"=="yes"  
(  
  WinCLEAR
  WinPage.Reset
)

 
;============================================================================
; Initialze PATH with Current directory only. Other directory paths will be 
; appended later in respective modules
;============================================================================
PATH .
 
;============================================================================
; Set some MSM specific variables used later in flash.target command
;    &NorCodeAddr=
;    &NorParamAddr=
;    &NorCpuType=
;============================================================================
do nor_param

;============================================================================
; 1) Set variables used to set up the JTAG debugger for this MSM
; 2) Init important MSM/ASB registers
;    use existing external script that is MSM specific
;============================================================================
&jload_build_msm="&NorMsmId"
do &NorConfigDir/nor_msm_init

;-------------------------------------------------------------------------------
; Set some variables used later on to peek and poke parameter block
;-------------------------------------------------------------------------------
do nor_init.cmm

;============================================================================
; If user passed "YES" on command line, just go
;============================================================================
if "&GoForIt"=="NOMENU"  
(  
  gosub EraseChip
  enddo
)


;============================================================================
; don't proceed without user confirmation
;============================================================================
      
print "      "
print "      __        __               _             "
print "      \ \      / /_ _ _ __ _ __ (_)_ __   __ _ "
print "       \ \ /\ / / _` | '__| '_ \| | '_ \ / _` |"
print "        \ V  V / (_| | |  | | | | | | | | (_| |"
print "         \_/\_/ \__,_|_|  |_| |_|_|_| |_|\__, |"
print "                                         |___/ "
print " "
print
print
print
print " You are about to erase the entire NOR flash"
print " "
print " "
print
print " Please enter YES to continue, any other value will abort::     "
  
&t32_cmm_stopped=1
enter &Choice
&t32_cmm_stopped=0
print
print
	 
if "&Choice"=="YES" 
(  
  print "Erasing entire flash....."
  gosub EraseChip
)
else
(
  print "Bailing out, correct answer not given" 
)
  

enddo
 
 
;=====================================================
; --- Function to Erase entire chip
;=====================================================
EraseChip: 

  ; set up addresses used with FLASH.* commands
  &RomBegin=&NorCodeRomBegin
  &RomEnd=&NorCodeRomEnd
  gosub CreateRom
	 
  ;--------------------------------------------------------
  ; We have to set this command up by hand as it is one
  ;  that we added to the flash.* protocol and JTAG does
  ;  not know about it.
  ;--------------------------------------------------------
  if "&Verbose"=="yes"
  (
    print "Erasing entire chip"
  )
  &Command="Erase Chip"
  data.set &ParmCmd %LONG &EraseChipCmd
  &CurrentCmd=&EraseChipCmd
   
  ; set flash base address
  data.set &ParmFlashaddr %LONG &NorCodeRomBegin

  r.s pc &StartAddr
  go

  gosub check_status  ;; will not return if error 
	 
  if "&Verbose"=="yes"
  (
    print "Entire Chip is Erased"                                             
    beep 5
  )
  return


;=====================================================
; --- Function to check command status return
;       and exit if 0x100
;=====================================================
check_status:
  wait !run()
  do print_output_buffer
  &Result=data.long(A:&ParmStatus)
  if &Result==0x100
  (
    print " " 
    print "---- &Command failed"
    &Result=data.long(A:&ParmReserved)
    do flash_prog_error &Result
    print " "
     
    if "&CheckStatusExit"=="yes"
    (
      print "EXITING due to failed command:: &Command"
  
      print "Closing teminal window on error"
       
  	  enddo
    )
    else
    (
      &CheckStatusFailed="yes"
    )
  )
  else
  (
    if (&Result==&CurrentCmd)
    (
  	  print " " 
  	  print "----  DID NOT COMPLETE &Command"
  	  print " "
  	  print "EXITING due to failed command:: &Command"
       
      end
    )
    else
    (
      if "&Verbose"=="yes"
      (
        print "+++++ &Command Succeeded"  
      )
    )
  )
  return


;=====================================================
; --- Function to create the FLASH map
;=====================================================
CreateRom:
  ;======================================================
  ; Map flash readonly - must encompass the addresse
  ;     of the image being loaded
  ;======================================================
  map.readonly &RomBegin--&RomEnd

  ;======================================================
  ; Load our flash programming routine and prepare flash
  ;======================================================
  d.load.elf "spi_nor_tools.elf"
  d.load.elf "spi_nor_tools.elf" /VERIFY
	 
  ; need this breakpoint as per Lauterbach Spec so that we
  ; can hand back control to the Debugger
  break.delete /ALL
  break.set hanghere /onchip /program

  ;--------------------------------------------------------
  ; reset our flash command
  ;--------------------------------------------------------
  flash.res
	 
  ;--------------------------------------------------------
  ; Let flash command know where our routine and buffer is located
  ; code at &NorCodeAddr, data at &NorParamAddr, buffer size = 16K
  ; Earlier versions of JTAG s/w would allow larger buffer of 64k
  ; but now we seem to be limited to 16k
  ;--------------------------------------------------------
  flash.target &NorCodeAddr &NorParamAddr 4000 
	 
  ;--------------------------------------------------------
  ; Define our flash range and tell flash command we're using
  ; our own flash programming routine via keyword "target"
  ; right now, we are defining 3 MBytes for code which in
  ; the NOR environment is meaningless, as this has to do
  ; with memory mapping in the flash, but we have to use it
  ; to use the other FLASH.* functions
  ;--------------------------------------------------------
  flash.create &RomBegin--&RomEnd target word

  return

END
