;============================================================================
;  Name:
;    NOR_BLOCK_UTIL.CMM
;
;  Description:
;    NOR block utility for Lauterbach JTAG/ICD TRACE32.
;
;  Execution:
;    Inside the debugger, type at the command line: "do blockutil".  Make
;    menu choices as directed.
;
;  Copyright (c) 2010-2011, 2014, 2016 Qualcomm Technologies Incorporated.
;  All Rights Reserved.
;  Qualcomm Confidential and Proprietary
;----------------------------------------------------------------------------
;============================================================================
;
;                        EDIT HISTORY FOR MODULE
;
;
; when       who     what, where, why
; -------    ---     --------------------------------------------------------
; 08/17/16   eo     Fix WinPOS compatibility issue with latest t32 builds 
; 06/21/16   eo     Add spi-nor tools support
; 03/31/14   whc     Updated to load correct param and elf
; 03/21/11   jz      Updated to support new T32 versions
; 09/03/10   sv      Created
;============================================================================;


;============================================================================
; Declare variables used
;============================================================================
local &DoDebug
local &Verbose
local &ClearWin
local &Choice
local &HideWarning
local &PauseTime
local &BlockToMark
local &BlockToErase
local &CurrentCmd

;============================================================================
; Set up some defaults for some variables
;============================================================================
&DoDebug="no"         ; Do not do debugging
&Verbose="yes"        ; Do not present status messages as we process
&ClearWin="yes"       ; Remove all windows before starting
&PauseTime="10.ms"    ; Time to pause without action
&HideWarning="no"     ; Set to "no" to show warning message at least once
&NorSrcRoot="../../../../.." ; setup the source root for scripts
;============================================================================
; For normal use set up the screen with only area window for reports
; For debug purposes, don't clear
; In both cases, make sure we have an area window
;============================================================================
if "&ClearWin"=="yes"
(
  WinCLEAR
  WinPage.Reset
)

;============================================================================
; Initialze PATH with Current directory only. Other directory paths will be 
; appended later in respective modules
;============================================================================
PATH .

;============================================================================
; Set some MSM specific variables used later in flash.target command
;    &NorCodeAddr=
;    &NorParamAddr=
;    &NorCpuType=
;============================================================================
do nor_param

;============================================================================
; 1) Set variables used to set up the JTAG debugger for this MSM
; 2) Init important MSM/ASB registers
;    use existing external script that is MSM specific
;============================================================================
do &NorConfigDir/nor_msm_init

;-------------------------------------------------------------------------------
; Set some variables used later on to peek and poke parameter block
;-------------------------------------------------------------------------------
do nor_init.cmm

;======================================================
; Load our flash programming routine and prepare flash
;======================================================
d.load.elf "spi_nor_tools.elf"
data.load.elf "spi_nor_tools.elf" /VERIFY

; need this breakpoint as per Lauterbach Spec so that we
; can hand back control to the Debugger
break.delete /ALL
break.set hanghere /onchip /program

;============================================================================
; Present user with normal main menu for NOR.  Manual selection is done.
;============================================================================
area.clear NOR

MainMenu:
  print
  print
  print "/---------------------------------------------\"
  print "|               _   _  ___  ____              |"
  print "|              | \ | |/ _ \|  _ \             |"
  print "|              |  \| | | | | |_) |            |"
  print "|              | |\  | |_| |  _ <             |"
  print "|              |_| \_|\___/|_| \_\            |"
  print "|                                             |"
  print "|                                             |"
  print "|                                             |"
  print "|                Block Utility                |"
  print "|                                             |"
  print "|                                             |"
  print "|     Copyright (c) 2010 by QUALCOMM, Inc     |"
  print "|                                             |"
  print "-----------------------------------------------"
  print
  print
  print " 0: Exit"
  print " 1: Erase block"
  print
  print " Please make a choice: "

  &t32_cmm_stopped=1
  enter &Choice
  &t32_cmm_stopped=0
  print
  print

  if &Choice==0
  (
    print "...exiting NOR Flash Programmer"
    gosub CleanUpExit
    enddo
  )

  if &Choice==1
  (
    print
    print
    gosub EraseBlock
  )

  goto MainMenu

  enddo

;%%%%%%%%%%%%%%%%%%%%%%%%%%%%%%%%%%%%%%%%%%%%%%%%%%%%%%%%%%%%
;
;  SUBROUTINES
;
;%%%%%%%%%%%%%%%%%%%%%%%%%%%%%%%%%%%%%%%%%%%%%%%%%%%%%%%%%%%%

;=====================================================
; --- Function to clean up just before exit
;=====================================================
CleanUpExit:
  ;--------------------------------------------------------
  ; ok we're finished completely, clean up for exit
  ;--------------------------------------------------------
  sys.d
  b.delete /all
  sys.u
  return

;=====================================================
; --- Function to check command status return
;       and exit if 0x100
;=====================================================
check_status:
  wait !run()
  do print_output_buffer
  &Result=data.long(A:&ParmStatus)
  if &Result==0x100
  (
    print " "
    print "---- &Command failed"
    &Result=data.long(A:&ParmReserved)
    do flash_prog_error &Result
    print " "
    print "EXITING due to failed command:: &Command"
    end
  )
  else
  (
    if (&Result==&CurrentCmd)
    (
      print " "
      print "----  DID NOT COMPLETE &Command"
      print " "
      print "EXITING due to failed command:: &Command"
      end
    )
    else
    (
      if "&Verbose"=="yes"
      (
        print "+++++ &Command Succeeded"
      )
    )
  )
  return

;=====================================================
; --- Function to erase a block
;=====================================================
EraseBlock:
  &Command="Erase Block"
  print
  print " Please Enter block number to be erased:   "

  &t32_cmm_stopped=1
  enter &BlockToErase
  &t32_cmm_stopped=0
  print
  print "Block &BlockToErase will be erased"

  data.set &ParmAddr %LONG &BlockToErase
  data.set &ParmCmd %LONG &EraseBlockCmd
  &CurrentCmd=&EraseBlockCmd
  r.s pc &StartAddr
  go
  gosub check_status  ;; will not return if error

  return

END
